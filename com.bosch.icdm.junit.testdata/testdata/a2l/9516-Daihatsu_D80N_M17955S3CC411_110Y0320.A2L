ASAP2_VERSION 1 4
/begin PROJECT M17955S3CC411_110Y0320 "M17955S3CC411_110Y0320"
/begin HEADER "" VERSION "M17955S3CC411_110Y0320" PROJECT_NO M17955S3CC411_110Y0320 /end HEADER
/begin MODULE DIM ""
/begin MOD_COMMON "" BYTE_ORDER MSB_LAST ALIGNMENT_BYTE 1 ALIGNMENT_WORD 2 ALIGNMENT_LONG 4 ALIGNMENT_FLOAT32_IEEE 4 /end MOD_COMMON
/begin CHARACTERISTIC ABKKATTAB "" CURVE 0x800425E0 KlAxU8SstxU16WU8 0.9961 fak_ub_b1 0.00 0.9961
 /begin AXIS_DESCR STD_AXIS tabst_w t1sxs_uw_q1 6 0.00 65535.00 FORMAT "%8.2" DEPOSIT ABSOLUTE /end AXIS_DESCR
/end CHARACTERISTIC
/begin CHARACTERISTIC AHENSADMX "" VALUE 0x80042A46 KwWU16 65535.00 dez 0.00 65535.00 FORMAT "%8.2" /end CHARACTERISTIC
/begin CHARACTERISTIC AirCCmpr_ATS.LimitTypeMsk_C "" VALUE 0x8004B590 Val_Wu8 255.0 OneToOne 0.00 255.0 FORMAT "%5.1" /end CHARACTERISTIC
/begin CHARACTERISTIC AirCCmpr_ATS.CnvNorm_C "" VALUE 0x8004B591 Val_Wu8 255.0 OneToOne 0.00 255.0 FORMAT "%5.1" /end CHARACTERISTIC
/begin CHARACTERISTIC AirCCmpr_ATS.LowLim_C "" VALUE 0x8004B592 Val_Ws16 65535.00 OneToOne -32768.00 32767.00 FORMAT "%8.2" /end CHARACTERISTIC
/begin CHARACTERISTIC AirCCmpr_ATS.UpLim_C "" VALUE 0x8004B594 Val_Ws16 65535.00 OneToOne -32768.00 32767.00 FORMAT "%8.2" /end CHARACTERISTIC
/begin CHARACTERISTIC AirCCmpr_ATS.CnvFac_C "" VALUE 0x8004B598 Val_Ws32 4294967295.00 OneToOne -2147483648.00 2147483647.00 FORMAT "%13.2" /end CHARACTERISTIC
/begin CHARACTERISTIC AirCCmpr_ATS.CnvOfs_C "" VALUE 0x8004B59C Val_Ws16 65535.00 OneToOne -32768.00 32767.00 FORMAT "%8.2" /end CHARACTERISTIC
/begin CHARACTERISTIC AirCCmpr_ATS.DfltVal_C "" VALUE 0x8004B59E Val_Ws16 65535.00 OneToOne -32768.00 32767.00 FORMAT "%8.2" /end CHARACTERISTIC
/begin CHARACTERISTIC AltIO_ATS.LimitTypeMsk_C "" VALUE 0x8004B5A0 Val_Wu8 255.0 OneToOne 0.00 255.0 FORMAT "%5.1" /end CHARACTERISTIC
/begin CHARACTERISTIC AltIO_ATS.CnvNorm_C "" VALUE 0x8004B5A1 Val_Wu8 255.0 OneToOne 0.00 255.0 FORMAT "%5.1" /end CHARACTERISTIC
/begin CHARACTERISTIC AltIO_ATS.LowLim_C "" VALUE 0x8004B5A2 Val_Ws16 65535.00 OneToOne -32768.00 32767.00 FORMAT "%8.2" /end CHARACTERISTIC
/begin CHARACTERISTIC AltIO_ATS.UpLim_C "" VALUE 0x8004B5A4 Val_Ws16 65535.00 OneToOne -32768.00 32767.00 FORMAT "%8.2" /end CHARACTERISTIC
/begin CHARACTERISTIC AltIO_ATS.CnvFac_C "" VALUE 0x8004B5A8 Val_Ws32 4294967295.00 OneToOne -2147483648.00 2147483647.00 FORMAT "%13.2" /end CHARACTERISTIC
/begin CHARACTERISTIC AltIO_ATS.CnvOfs_C "" VALUE 0x8004B5AC Val_Ws16 65535.00 OneToOne -32768.00 32767.00 FORMAT "%8.2" /end CHARACTERISTIC
/begin CHARACTERISTIC AltIO_ATS.DfltVal_C "" VALUE 0x8004B5AE Val_Ws16 65535.00 OneToOne -32768.00 32767.00 FORMAT "%8.2" /end CHARACTERISTIC
/begin CHARACTERISTIC Alt_facAdjValMax_C "" VALUE 0x8004B8A0 Val_Ws16 6.553500 FactHigh1 -3.276800 3.276700 FORMAT "%8.6" /end CHARACTERISTIC
/begin CHARACTERISTIC Alt_facAdjValMin_C "" VALUE 0x8004B8A2 Val_Ws16 6.553500 FactHigh1 -3.276800 3.276700 FORMAT "%8.6" /end CHARACTERISTIC
/begin CHARACTERISTIC Alt_facCorTemp_CUR "" CURVE 0x8004B8A4 Cur_Xs16Ws16 511.9922 Fact1 -256.0000 255.9922 FORMAT "%8.4"
 /begin AXIS_DESCR STD_AXIS EngDa_tEng Temp_Cels 4 -3549.940 3003.560 FORMAT "%8.3" DEPOSIT ABSOLUTE /end AXIS_DESCR
/end CHARACTERISTIC
/begin CHARACTERISTIC Alt_facCorT_CUR "" CURVE 0x8004B8B6 Cur_Xs16Ws16 511.9922 Fact1 -256.0000 255.9922 FORMAT "%8.4"
 /begin AXIS_DESCR STD_AXIS CoEng_tiNormalRed TimeRed 4 -5242.880 5242.720 FORMAT "%8.3" DEPOSIT ABSOLUTE /end AXIS_DESCR
/end CHARACTERISTIC
/begin CHARACTERISTIC Alt_pwrCanMax_C "" VALUE 0x8004B8C8 Val_Ws16 300000.1 Pwr 0.00 300000.1 FORMAT "%8.1" /end CHARACTERISTIC
/begin CHARACTERISTIC Alt_pwrCanMin_C "" VALUE 0x8004B8CA Val_Ws16 300000.1 Pwr 0.00 300000.1 FORMAT "%8.1" /end CHARACTERISTIC
/begin CHARACTERISTIC Alt_stTrqMode_CW "" VALUE 0x8004B8CC Val_Wu8 255.0 OneToOne 0.00 255.0 FORMAT "%5.1" /end CHARACTERISTIC
/begin CHARACTERISTIC Alt_tiCldStrtDel_MAP "" MAP 0x8004B8CE Map_Xs16Ys16Ws16 327460.0 Time_ms 0.00 327460.0 FORMAT "%8.1"
 /begin AXIS_DESCR STD_AXIS EnvT_t Temp_Cels 5 -3549.940 3003.560 FORMAT "%8.3" DEPOSIT ABSOLUTE /end AXIS_DESCR
 /begin AXIS_DESCR STD_AXIS EnvP_p Pres_hPa 5 -32768.00 32767.00 FORMAT "%8.2" DEPOSIT ABSOLUTE /end AXIS_DESCR
/end CHARACTERISTIC
/begin CHARACTERISTIC Alt_tiLRAlt_CUR "" CURVE 0x8004B918 Cur_Xs16Ws16 100.0000 Time_s 0.00 100.0000 FORMAT "%8.4"
 /begin AXIS_DESCR STD_AXIS EngDa_tEng Temp_Cels 4 -50.04000 149.9600 FORMAT "%8.4" DEPOSIT ABSOLUTE /end AXIS_DESCR
/end CHARACTERISTIC
/begin CHARACTERISTIC Alt_tiPT1Del_C "" VALUE 0x8004B92C Val_Ws32 4294.9672940 TimeDelay_s 0.000002000000001 4294.9672960 FORMAT "%12.7" /end CHARACTERISTIC
/begin CHARACTERISTIC Alt_trqCalcVar2_MAP "" MAP 0x8004B930 Map_Xs16Ys16Ws16 6553.500 Trq -3276.800 3276.700 FORMAT "%8.3"
 /begin AXIS_DESCR STD_AXIS Epm_nEng EngN 8 0.00 10000.00 FORMAT "%8.2" DEPOSIT ABSOLUTE /end AXIS_DESCR
 /begin AXIS_DESCR STD_AXIS AltIO_rAltLoad DtyCyc 8 0.00 100.0000 FORMAT "%8.4" DEPOSIT ABSOLUTE /end AXIS_DESCR
/end CHARACTERISTIC
/begin CHARACTERISTIC Alt_trqCalcVar3_MAP "" MAP 0x8004B9D4 Map_Xs16Ys16Ws16 4276.800 Trq -3276.800 1000.000 FORMAT "%8.3"
 /begin AXIS_DESCR STD_AXIS Epm_nEng EngN 8 0.00 10000.00 FORMAT "%8.2" DEPOSIT ABSOLUTE /end AXIS_DESCR
 /begin AXIS_DESCR STD_AXIS AltIO_rAltLoad DtyCyc 8 0.00 100.0000 FORMAT "%8.4" DEPOSIT ABSOLUTE /end AXIS_DESCR
/end CHARACTERISTIC
/begin CHARACTERISTIC Alt_trqCalc_MAP "" MAP 0x8004BA78 Map_Xs16Ys16Ws16 6553.500 Trq -3276.800 3276.700 FORMAT "%8.3"
 /begin AXIS_DESCR STD_AXIS Epm_nEng EngN 8 0.00 10000.00 FORMAT "%8.2" DEPOSIT ABSOLUTE /end AXIS_DESCR
 /begin AXIS_DESCR STD_AXIS AltIO_rAltLoad DtyCyc 8 0.00 100.0000 FORMAT "%8.4" DEPOSIT ABSOLUTE /end AXIS_DESCR
/end CHARACTERISTIC
/begin CHARACTERISTIC Alt_trqCanErr_MAP "" MAP 0x8004BB1C Map_Xs16Ys16Ws16 4276.800 Trq -3276.800 1000.000 FORMAT "%8.3"
 /begin AXIS_DESCR STD_AXIS CEngDsT_t Temp_Cels 4 -50.04000 149.9600 FORMAT "%8.4" DEPOSIT ABSOLUTE /end AXIS_DESCR
 /begin AXIS_DESCR STD_AXIS Epm_nEng EngN 8 0.00 10000.00 FORMAT "%8.2" DEPOSIT ABSOLUTE /end AXIS_DESCR
/end CHARACTERISTIC
/begin CHARACTERISTIC Alt_trqRmpSlpDes.Pos_C "" VALUE 0x8004BB78 Kw_Ws32 3276799.99847 RmpTrq 0.00 3276799.99847 FORMAT "%13.5" /end CHARACTERISTIC
/begin CHARACTERISTIC Alt_trqRmpSlpDes.Neg_C "" VALUE 0x8004BB7C Kw_Ws32 3276799.99847 RmpTrq 0.00 3276799.99847 FORMAT "%13.5" /end CHARACTERISTIC
/begin CHARACTERISTIC ANZTIMNSAD "" VALUE 0x80042A48 KwWU16 65535.00 dez 0.00 65535.00 FORMAT "%8.2" /end CHARACTERISTIC
/begin CHARACTERISTIC APP_AliveDeb.tiHiLo_C "" VALUE 0x8004B500 Kw_Ws16 500.0000 Time_ms 0.00 500.0000 FORMAT "%8.4" /end CHARACTERISTIC
/begin CHARACTERISTIC APP_AliveDeb.tiLoHi_C "" VALUE 0x8004B502 Kw_Ws16 500.0000 Time_ms 0.00 500.0000 FORMAT "%8.4" /end CHARACTERISTIC
/begin CHARACTERISTIC APP_dRawSigFac_C "" VALUE 0x8004B558 Val_Wu16 6.000000 Fact 0.00 6.000000 FORMAT "%8.6" /end CHARACTERISTIC
/begin CHARACTERISTIC APP_drLim.Pos_C "" VALUE 0x8004B504 Kw_Ws32 200.000032783 RmpPrc 0.00 200.000032783 FORMAT "%13.9" /end CHARACTERISTIC
/begin CHARACTERISTIC APP_drLim.Neg_C "" VALUE 0x8004B508 Kw_Ws32 200.000032783 RmpPrc 0.00 200.000032783 FORMAT "%13.9" /end CHARACTERISTIC
/begin CHARACTERISTIC APP_drLimpMax_C "" VALUE 0x8004B50C Val_Ws16 200.1953 PrcPerSec 0.00 200.1953 FORMAT "%8.4" /end CHARACTERISTIC
/begin CHARACTERISTIC APP_drUnFltLim_C "" VALUE 0x8004B534 Val_Ws16 200.1953 PrcPerSec 0.00 200.1953 FORMAT "%8.4" /end CHARACTERISTIC
/begin CHARACTERISTIC APP_duLimErr.Pos_C "" VALUE 0x8004B54C Kw_Ws32 6553599.99695 RmpVolt 0.00 6553599.99695 FORMAT "%13.5" /end CHARACTERISTIC
/begin CHARACTERISTIC APP_duLimErr.Neg_C "" VALUE 0x8004B550 Kw_Ws32 6553599.99695 RmpVolt 0.00 6553599.99695 FORMAT "%13.5" /end CHARACTERISTIC
/begin CHARACTERISTIC APP_GradCondDeb.tiHiLo_C "" VALUE 0x8004B536 Kw_Ws16 1000.000 Time_ms 0.00 1000.000 FORMAT "%8.3" /end CHARACTERISTIC
/begin CHARACTERISTIC APP_GradCondDeb.tiLoHi_C "" VALUE 0x8004B538 Kw_Ws16 1000.000 Time_ms 0.00 1000.000 FORMAT "%8.3" /end CHARACTERISTIC
/begin CHARACTERISTIC APP_nLim_C "" VALUE 0x8004B53A Val_Ws16 6000.000 EngN 0.00 6000.000 FORMAT "%8.3" /end CHARACTERISTIC
/begin CHARACTERISTIC APP_rLimpMax_C "" VALUE 0x8004B50E Val_Ws16 100.0000 Prc 0.00 100.0000 FORMAT "%8.4" /end CHARACTERISTIC
/begin CHARACTERISTIC APP_rLinAPP_CUR "" CURVE 0x8004B55A Cur_Xs16Ws16 100.0000 Prc 0.00 100.0000 FORMAT "%8.4"
 /begin AXIS_DESCR STD_AXIS APP_uUnJit_mp Volt 2 0.00 5200.000 FORMAT "%8.3" DEPOSIT ABSOLUTE /end AXIS_DESCR
/end CHARACTERISTIC
/begin CHARACTERISTIC APP_rPlaMaxVal_C "" VALUE 0x8004B510 Val_Ws16 100.0000 Prc 0.00 100.0000 FORMAT "%8.4" /end CHARACTERISTIC
/begin CHARACTERISTIC APP_rThresAliveDet_C "" VALUE 0x8004B512 Val_Ws16 100.0000 Prc 0.00 100.0000 FORMAT "%8.4" /end CHARACTERISTIC
/begin CHARACTERISTIC APP_rThresFltLowNeg_C "" VALUE 0x8004B564 Val_Ws16 100.0000 Prc 0.00 100.0000 FORMAT "%8.4" /end CHARACTERISTIC
/begin CHARACTERISTIC APP_rThresFltLowPos_C "" VALUE 0x8004B566 Val_Ws16 100.0000 Prc 0.00 100.0000 FORMAT "%8.4" /end CHARACTERISTIC
/begin CHARACTERISTIC APP_rThresFltMidNeg_C "" VALUE 0x8004B568 Val_Ws16 100.0000 Prc 0.00 100.0000 FORMAT "%8.4" /end CHARACTERISTIC
/begin CHARACTERISTIC APP_rThresFltMidPos_C "" VALUE 0x8004B56A Val_Ws16 100.0000 Prc 0.00 100.0000 FORMAT "%8.4" /end CHARACTERISTIC
/begin CHARACTERISTIC APP_swtAliveDetEna_C "" VALUE 0x8004B514 Val_Wu8 1.000 OneToOne 0.00 1.000 FORMAT "%5.3" /end CHARACTERISTIC
/begin CHARACTERISTIC APP_swtAppGradEna_C "" VALUE 0x8004B53C Val_Wu8 1.000 OneToOne 0.00 1.000 FORMAT "%5.3" /end CHARACTERISTIC
/begin CHARACTERISTIC APP_swtBrkDet_C "" VALUE 0x8004B53D Val_Wu8 1.000 OneToOne 0.00 1.000 FORMAT "%5.3" /end CHARACTERISTIC
/begin CHARACTERISTIC APP_swtEnaUnJit_C "" VALUE 0x8004B56C Val_Wu8 1.000 OneToOne 0.00 1.000 FORMAT "%5.3" /end CHARACTERISTIC
/begin CHARACTERISTIC APP_swtNoFlt_C "" VALUE 0x8004B56D Val_Wu8 1.000 OneToOne 0.00 1.000 FORMAT "%5.3" /end CHARACTERISTIC
/begin CHARACTERISTIC APP_swtPlaChkEna_C "" VALUE 0x8004B515 Val_Wu8 1.000 OneToOne 0.00 1.000 FORMAT "%5.3" /end CHARACTERISTIC
/begin CHARACTERISTIC APP_swtRstCon_C "" VALUE 0x8004B53E Val_Wu8 1.000 OneToOne 0.00 1.000 FORMAT "%5.3" /end CHARACTERISTIC
/begin CHARACTERISTIC APP_swtVehDynReqd_C "" VALUE 0x8004B53F Val_Wu8 1.000 OneToOne 0.00 1.000 FORMAT "%5.3" /end CHARACTERISTIC
/begin CHARACTERISTIC APP_tiLowNegPT1_C "" VALUE 0x8004B570 Val_Ws32 4294.9672940 TimeDelay_s 0.000002000000001 4294.9672960 FORMAT "%12.7" /end CHARACTERISTIC
/begin CHARACTERISTIC APP_tiLowPosPT1_C "" VALUE 0x8004B574 Val_Ws32 4294.9672940 TimeDelay_s 0.000002000000001 4294.9672960 FORMAT "%12.7" /end CHARACTERISTIC
/begin CHARACTERISTIC APP_tiMidNegPT1_C "" VALUE 0x8004B578 Val_Ws32 4294.9672940 TimeDelay_s 0.000002000000001 4294.9672960 FORMAT "%12.7" /end CHARACTERISTIC
/begin CHARACTERISTIC APP_tiMidPosPT1_C "" VALUE 0x8004B57C Val_Ws32 4294.9672940 TimeDelay_s 0.000002000000001 4294.9672960 FORMAT "%12.7" /end CHARACTERISTIC
/begin CHARACTERISTIC APP_tiPlaBrkDetDeb_C "" VALUE 0x8004B540 Val_Ws32 4294967295.00 TimeDT -2147483648.00 2147483647.00 FORMAT "%13.2" /end CHARACTERISTIC
/begin CHARACTERISTIC APP_tiPlaBrkRstDeb_C "" VALUE 0x8004B544 Val_Ws32 4294967295.00 TimeDT -2147483648.00 2147483647.00 FORMAT "%13.2" /end CHARACTERISTIC
/begin CHARACTERISTIC APP_tiUppNegPT1_C "" VALUE 0x8004B580 Val_Ws32 4294.9672940 TimeDelay_s 0.000002000000001 4294.9672960 FORMAT "%12.7" /end CHARACTERISTIC
/begin CHARACTERISTIC APP_tiUppPosPT1_C "" VALUE 0x8004B584 Val_Ws32 4294.9672940 TimeDelay_s 0.000002000000001 4294.9672960 FORMAT "%12.7" /end CHARACTERISTIC
/begin CHARACTERISTIC APP_uAPPDef_C "" VALUE 0x8004B554 Val_Ws16 5300.000 Volt 0.00 5300.000 FORMAT "%8.3" /end CHARACTERISTIC
/begin CHARACTERISTIC APP_uJitter_C "" VALUE 0x8004B588 Val_Ws16 0.4000000 Volt 0.00 0.4000000 FORMAT "%9.7" /end CHARACTERISTIC
/begin CHARACTERISTIC APP_uKDHighAPP_C "" VALUE 0x8004B520 Val_Ws16 5200.000 Volt 0.00 5200.000 FORMAT "%8.3" /end CHARACTERISTIC
/begin CHARACTERISTIC APP_uKDLowAPP_C "" VALUE 0x8004B522 Val_Ws16 11753.60 Volt -6553.600 5200.000 FORMAT "%8.3" /end CHARACTERISTIC
/begin CHARACTERISTIC APP_uRaw1Def_C "" VALUE 0x8004B58A Val_Ws16 5000.000 Volt 0.00 5000.000 FORMAT "%8.3" /end CHARACTERISTIC
/begin CHARACTERISTIC APP_uRaw1SRCHigh_C "" VALUE 0x8004B518 Val_Ws16 5200.000 Volt 0.00 5200.000 FORMAT "%8.3" /end CHARACTERISTIC
/begin CHARACTERISTIC APP_uRaw1SRCLow_C "" VALUE 0x8004B51A Val_Ws16 5200.000 Volt 0.00 5200.000 FORMAT "%8.3" /end CHARACTERISTIC
/begin CHARACTERISTIC APP_uRaw2Def_C "" VALUE 0x8004B58C Val_Ws16 5000.000 Volt 0.00 5000.000 FORMAT "%8.3" /end CHARACTERISTIC
/begin CHARACTERISTIC APP_uRaw2Offset_C "" VALUE 0x8004B556 Val_Ws16 5300.000 Volt 0.00 5300.000 FORMAT "%8.3" /end CHARACTERISTIC
/begin CHARACTERISTIC APP_uRaw2SRCHigh_C "" VALUE 0x8004B51C Val_Ws16 5200.000 Volt 0.00 5200.000 FORMAT "%8.3" /end CHARACTERISTIC
/begin CHARACTERISTIC APP_uRaw2SRCLow_C "" VALUE 0x8004B51E Val_Ws16 5200.000 Volt 0.00 5200.000 FORMAT "%8.3" /end CHARACTERISTIC
/begin CHARACTERISTIC APP_uSply_C "" VALUE 0x8004B58E Val_Ws16 4200.000 Volt 1000.000 5200.000 FORMAT "%8.3" /end CHARACTERISTIC
/begin CHARACTERISTIC APP_uSyncMin_C "" VALUE 0x8004B524 Val_Ws16 5200.000 Volt 0.00 5200.000 FORMAT "%8.3" /end CHARACTERISTIC
/begin CHARACTERISTIC APP_uSync_CUR "" CURVE 0x8004B526 Cur_Xs16Ws16 5200.000 Volt 0.00 5200.000 FORMAT "%8.3"
 /begin AXIS_DESCR STD_AXIS APP_uMin12half_mp Volt 3 0.00 5200.000 FORMAT "%8.3" DEPOSIT ABSOLUTE /end AXIS_DESCR
/end CHARACTERISTIC
/begin CHARACTERISTIC APP_vLim_C "" VALUE 0x8004B548 Val_Ws16 250.0000 Vel 0.00 250.0000 FORMAT "%8.4" /end CHARACTERISTIC
/begin CHARACTERISTIC ATMINIAR "" VAL_BLK 0x80041FFE KwbWU8 5.000 dez 1.000 6.000 FORMAT "%5.3" NUMBER 13 /end CHARACTERISTIC
/begin CHARACTERISTIC ATMINISEKA "" VAL_BLK 0x8004200B KwbWU8 255.0 dez 0.00 255.0 FORMAT "%5.1" NUMBER 4 /end CHARACTERISTIC
/begin CHARACTERISTIC ATMKHK "" CURVE 0x80042010 GklWU16 255.9961 fak_ub_b1 0.00 255.9961 FORMAT "%8.4"
 /begin AXIS_DESCR COM_AXIS tabatmlc_w t1sxs_uw_q1 6 0.00 65535.00 FORMAT "%8.2" AXIS_PTS_REF STS06TAMUW /end AXIS_DESCR
/end CHARACTERISTIC
/begin CHARACTERISTIC ATMKVK "" CURVE 0x8004201C GklWU16 255.9961 fak_ub_b1 0.00 255.9961 FORMAT "%8.4"
 /begin AXIS_DESCR COM_AXIS tabatmlc_w t1sxs_uw_q1 6 0.00 65535.00 FORMAT "%8.2" AXIS_PTS_REF STS06TAMUW /end AXIS_DESCR
/end CHARACTERISTIC
/begin CHARACTERISTIC ATMOUTCFG "" VAL_BLK 0x80041FB4 KwbWU8 255.0 dez 0.00 255.0 FORMAT "%5.1" NUMBER 20 /end CHARACTERISTIC
/begin CHARACTERISTIC ATMSTAR "" VAL_BLK 0x80042028 KwbWU8 7.000 dez 0.00 7.000 FORMAT "%5.3" NUMBER 13 /end CHARACTERISTIC
/begin CHARACTERISTIC ATS_Standby_Disabled_C "" VALUE 0x8004B5B0 Val_Wu8 255.0 OneToOne 0.00 255.0 FORMAT "%5.1" /end CHARACTERISTIC
/begin CHARACTERISTIC ATS_tiTstDemHeal_C "" VALUE 0x8004B5B2 Val_Wu16 655.3500 Time_s 0.00 655.3500 FORMAT "%8.4" /end CHARACTERISTIC
/begin CHARACTERISTIC ATS_tiTstDemMax_C "" VALUE 0x8004B5B4 Val_Wu16 655.3500 Time_s 0.00 655.3500 FORMAT "%8.4" /end CHARACTERISTIC
/begin CHARACTERISTIC ATS_TmrBehaviour_C "" VALUE 0x8004B5B6 Val_Wu8 255.0 OneToOne 0.00 255.0 FORMAT "%5.1" /end CHARACTERISTIC
/begin CHARACTERISTIC ATS_TstDemMaxEngN_C "" VALUE 0x8004B5B7 Val_Wu8 10200. EngN_LRes 0.00 10200. FORMAT "%5.0" /end CHARACTERISTIC
/begin CHARACTERISTIC ATS_TstDemMaxVSSCDV_C "" VALUE 0x8004B5B8 Val_Ws16 655.3500 Vel -327.6800 327.6700 FORMAT "%8.4" /end CHARACTERISTIC
/begin CHARACTERISTIC BasSvrAppl_EepAltAdap_C "" VALUE 0x8004B5DC Val_Ws16 65535.00 OneToOne -32768.00 32767.00 FORMAT "%8.2" /end CHARACTERISTIC
/begin CHARACTERISTIC BasSvrAppl_EepHwPartNum_C "" ASCII 0x8004BB80 ValA_Wu8 255.0 OneToOne 0.00 255.0 NUMBER 11 /end CHARACTERISTIC
/begin CHARACTERISTIC BasSvrAppl_EepODXFileID_C "" ASCII 0x8004BB8C ValA_Wu8 255.0 OneToOne 0.00 255.0 NUMBER 26 /end CHARACTERISTIC
/begin CHARACTERISTIC BasSvrAppl_EepODXFileVer_C "" ASCII 0x8004BBA7 ValA_Wu8 255.0 OneToOne 0.00 255.0 NUMBER 6 /end CHARACTERISTIC
/begin CHARACTERISTIC BasSvrAppl_EepPartNr_C "" ASCII 0x8004BBAE ValA_Wu8 255.0 OneToOne 0.00 255.0 NUMBER 12 /end CHARACTERISTIC
/begin CHARACTERISTIC BasSvrAppl_EepPrgVer_C "" ASCII 0x8004BBBB ValA_Wu8 255.0 OneToOne 0.00 255.0 NUMBER 4 /end CHARACTERISTIC
/begin CHARACTERISTIC BasSvrAppl_EepSysName2_C "" ASCII 0x8004BBC0 ValA_Wu8 255.0 OneToOne 0.00 255.0 NUMBER 20 /end CHARACTERISTIC
/begin CHARACTERISTIC BasSvrAppl_EepSysName_C "" ASCII 0x8004BBD5 ValA_Wu8 255.0 OneToOne 0.00 255.0 NUMBER 20 /end CHARACTERISTIC
/begin CHARACTERISTIC BasSvrAppl_EngineCodeL_C "" ASCII 0x8004BBEA ValA_Wu8 255.0 OneToOne 0.00 255.0 NUMBER 4 /end CHARACTERISTIC
/begin CHARACTERISTIC BasSvrAppl_numValofSysName_C "" VALUE 0x8004BBEF Val_Wu8 255.0 OneToOne 0.00 255.0 FORMAT "%5.1" /end CHARACTERISTIC
/begin CHARACTERISTIC BasSvrAppl_VWWorkShopSysN_C "" ASCII 0x8004BBF0 ValA_Wu8 255.0 OneToOne 0.00 255.0 NUMBER 5 /end CHARACTERISTIC
/begin CHARACTERISTIC BFZGLCR "" VALUE 0x80042598 KwWS8 55.34 bfzg_sb_q0p217 -27.78 27.56 FORMAT "%5.2" /end CHARACTERISTIC
/begin CHARACTERISTIC BFZGLNCH "" VALUE 0x8004259A KwWS16 27.7802865 bfzg_sw_q4p239Em4 -13.8903552 13.8899313 /end CHARACTERISTIC
/begin CHARACTERISTIC BTRKHTMS "" CURVE 0x800425F4 KlAxU8SstxU8WU8 0.9961 fak_ub_b1 0.00 0.9961
 /begin AXIS_DESCR STD_AXIS tmst temp_ub_q0p75_o48 8 -48.00 143.3 FORMAT "%5.1" DEPOSIT ABSOLUTE /end AXIS_DESCR
/end CHARACTERISTIC
/begin CHARACTERISTIC CATMBRX "" CURVE 0x80042036 KlAxU8SstxU8WU16 14563.11 fak_q0p2222_JK 0.2222222 14563.33 FORMAT "%8.2"
 /begin AXIS_DESCR STD_AXIS mainloop dez 4 0.00 255.0 FORMAT "%5.1" DEPOSIT ABSOLUTE /end AXIS_DESCR
/end CHARACTERISTIC
/begin CHARACTERISTIC CATMPIX "" CURVE 0x80042044 KlAxU8SstxU8WU16 14563.11 fak_q0p2222_JK 0.2222222 14563.33 FORMAT "%8.2"
 /begin AXIS_DESCR STD_AXIS mainloop dez 13 0.00 255.0 FORMAT "%5.1" DEPOSIT ABSOLUTE /end AXIS_DESCR
/end CHARACTERISTIC
/begin CHARACTERISTIC CLUTWMENMN "" VALUE 0x80042A4A KwWU16 65535.00 dez 0.00 65535.00 FORMAT "%8.2" /end CHARACTERISTIC
/begin CHARACTERISTIC CWATMEXFB "" VALUE 0x8004206C KwWU8 255.0 dez 0.00 255.0 FORMAT "%5.1" /end CHARACTERISTIC
/begin CHARACTERISTIC CWATMIFAC "" VALUE 0x80041FC8 KwWU8 255.0 dez 0.00 255.0 FORMAT "%5.1" /end CHARACTERISTIC
/begin CHARACTERISTIC CWATMINT "" VALUE 0x8004206D KwWU8 255.0 dez 0.00 255.0 FORMAT "%5.1" /end CHARACTERISTIC
/begin CHARACTERISTIC CWATMINT1 "" VALUE 0x8004206E KwWU8 255.0 dez 0.00 255.0 FORMAT "%5.1" /end CHARACTERISTIC
/begin CHARACTERISTIC CWATMSTAR "" VALUE 0x8004206F KwWU8 255.0 dez 0.00 255.0 FORMAT "%5.1" /end CHARACTERISTIC
/begin CHARACTERISTIC CWATMSTAR2 "" VALUE 0x80042070 KwWU8 255.0 dez 0.00 255.0 FORMAT "%5.1" /end CHARACTERISTIC
/begin CHARACTERISTIC CWATMSTD "" VALUE 0x80042071 KwWU8 255.0 dez 0.00 255.0 FORMAT "%5.1" /end CHARACTERISTIC
/begin CHARACTERISTIC CWATMTABST "" VALUE 0x80042072 KwWU8 255.0 dez 0.00 255.0 FORMAT "%5.1" /end CHARACTERISTIC
/begin CHARACTERISTIC CWBBKHAKT "" VALUE 0x80042606 KwWU16 65535.00 dez 0.00 65535.00 FORMAT "%8.2" /end CHARACTERISTIC
/begin CHARACTERISTIC CWBBKHAKW "" VALUE 0x8004267A KwWU8 255.0 dez 0.00 255.0 FORMAT "%5.1" /end CHARACTERISTIC
/begin CHARACTERISTIC CWBBSTNSAD "" VALUE 0x80042A4C KwWU8 255.0 dez 0.00 255.0 FORMAT "%5.1" /end CHARACTERISTIC
/begin CHARACTERISTIC CWBBSTT "" VALUE 0x80042A74 KwWU8 255.0 dez 0.00 255.0 FORMAT "%5.1" /end CHARACTERISTIC
/begin CHARACTERISTIC CWBGFKMS "" VALUE 0x80042C9C KwWU16 65535.00 dez 0.00 65535.00 FORMAT "%8.2" /end CHARACTERISTIC
/begin CHARACTERISTIC CWBGKSE "" VALUE 0x80042D02 KwWU8 255.0 dez 0.00 255.0 FORMAT "%5.1" /end CHARACTERISTIC
/begin CHARACTERISTIC CWBH "" VALUE 0x80042A9A KwWU8 255.0 dez 0.00 255.0 FORMAT "%5.1" /end CHARACTERISTIC
/begin CHARACTERISTIC CWDNMNSIL "" VALUE 0x8004259C KwWU8 255.0 dez 0.00 255.0 FORMAT "%5.1" /end CHARACTERISTIC
/begin CHARACTERISTIC CWKSEAG "" VALUE 0x80042D04 KwWU16 65535.00 dez 0.00 65535.00 FORMAT "%8.2" /end CHARACTERISTIC
/begin CHARACTERISTIC CWLAMABM "" VALUE 0x80042D0A KwUb 255.0 dez 0.00 255.0 FORMAT "%5.1" /end CHARACTERISTIC
/begin CHARACTERISTIC CWLAMFAW "" VALUE 0x80042C4C KwUb 255.0 dez 0.00 255.0 FORMAT "%5.1" /end CHARACTERISTIC
/begin CHARACTERISTIC CWSAFG "" VALUE 0x80042882 KwWU8 255.0 dez 0.00 255.0 FORMAT "%5.1" /end CHARACTERISTIC
/begin CHARACTERISTIC CWSAWE "" VALUE 0x80042883 KwWU8 255.0 dez 0.00 255.0 FORMAT "%5.1" /end CHARACTERISTIC
/begin CHARACTERISTIC DBFZGLNCH "" VALUE 0x8004259E KwWS16 27.7802865 bfzg_sw_q4p239Em4 -13.8903552 13.8899313 /end CHARACTERISTIC
/begin CHARACTERISTIC DFAOMSNDE "" VALUE 0x80042C9E KwWU16 1.999969 fak_uw_b2 0.00 1.999969 FORMAT "%8.6" /end CHARACTERISTIC
/begin CHARACTERISTIC DFEADKE "" VALUE 0x80042CA0 KwWU16 1.999969 fak_uw_b2 0.00 1.999969 FORMAT "%8.6" /end CHARACTERISTIC
/begin CHARACTERISTIC DFKMSDELSR "" VALUE 0x80042A90 KwWU16 0.2000122 fak_q6p1035Em5 0.00 0.2000122 FORMAT "%9.7" /end CHARACTERISTIC
/begin CHARACTERISTIC DFKMSDSTZ "" VALUE 0x80042CA2 KwWS16 0.9999695 fak_sw_b1 0.00 0.9999695 FORMAT "%9.7" /end CHARACTERISTIC
/begin CHARACTERISTIC DLAMFAW "" VALUE 0x80042C4E KwUw 15.99976 fak_uw_b16 0.00 15.99976 FORMAT "%8.5" /end CHARACTERISTIC
/begin CHARACTERISTIC DNMNSIL "" VALUE 0x800425A0 KwWU16 16383.75 nmot_uw_q0p25 0.00 16383.75 FORMAT "%8.2" /end CHARACTERISTIC
/begin CHARACTERISTIC DNSAH "" VALUE 0x80042884 KwWU8 5080. nmot_ub_q40 0.00 5080. FORMAT "%5.0" /end CHARACTERISTIC
/begin CHARACTERISTIC DNSAL "" VALUE 0x80042885 KwWU8 5080. nmot_ub_q40 0.00 5080. FORMAT "%5.0" /end CHARACTERISTIC
/begin CHARACTERISTIC DNSALH "" VALUE 0x80042886 KwWU8 5080. nmot_ub_q40 0.00 5080. FORMAT "%5.0" /end CHARACTERISTIC
/begin CHARACTERISTIC DNSLL "" VALUE 0x80042887 KwWU8 5080. nmot_ub_q40 0.00 5080. FORMAT "%5.0" /end CHARACTERISTIC
/begin CHARACTERISTIC DNSLLK "" VALUE 0x80042888 KwWU8 10200. nmot_ub_q40 0.00 10200. FORMAT "%5.0" /end CHARACTERISTIC
/begin CHARACTERISTIC DNWEK "" VALUE 0x80042889 KwWU8 10200. nmot_ub_q40 0.00 10200. FORMAT "%5.0" /end CHARACTERISTIC
/begin CHARACTERISTIC DNWEKFS "" VALUE 0x8004288A KwWU8 10200. nmot_ub_q40 0.00 10200. FORMAT "%5.0" /end CHARACTERISTIC
/begin CHARACTERISTIC DNWEOFF "" VALUE 0x8004288B KwWU8 10200. nmot_ub_q40 0.00 10200. FORMAT "%5.0" /end CHARACTERISTIC
/begin CHARACTERISTIC DOXSG "" VALUE 0x80042D0C KwUw 6553.500 m_q0p1_mg 0.00 6553.500 FORMAT "%8.3" /end CHARACTERISTIC
/begin CHARACTERISTIC DSDLUTSR "" VALUE 0x80042A4D KwWU8 255.0 dez 0.00 255.0 FORMAT "%5.1" /end CHARACTERISTIC
/begin CHARACTERISTIC DTAOMSNDKE "" VALUE 0x80042CA4 KwWU8 10.00 t_q0p1 0.00 10.00 FORMAT "%5.2" /end CHARACTERISTIC
/begin CHARACTERISTIC DTMABKH "" VALUE 0x80042608 KwWU8 191.3 temp_ub_b191p25 0.00 191.3 FORMAT "%5.1" /end CHARACTERISTIC
/begin CHARACTERISTIC DTMSRT "" VALUE 0x80042A9B KwWU8 191.3 temp_ub_q0p75_o48 -48.00 143.3 FORMAT "%5.1" /end CHARACTERISTIC
/begin CHARACTERISTIC DTMTNSEZMK "" VALUE 0x80042A75 KwWU8 191.3 temp_q0p75 0.00 191.3 FORMAT "%5.1" /end CHARACTERISTIC
/begin CHARACTERISTIC DYESPFFKT "" CURVE 0x800427D8 GklWU8 2.984 fak_ub_b4 1.000 3.984 FORMAT "%5.3"
 /begin AXIS_DESCR COM_AXIS rl rel_ub_q0p75 4 0.00 191.3 FORMAT "%5.1" AXIS_PTS_REF SRL04DYUB /end AXIS_DESCR
/end CHARACTERISTIC
/begin CHARACTERISTIC DZWETA "" CURVE 0x80042AAA FklWS8 95.25 kw_q0p75 0.00 95.25 FORMAT "%5.2"
 /begin AXIS_DESCR FIX_AXIS etazwsol fak_ub_b1 256 0.00 0.9961 FIX_AXIS_PAR 0 0 256 /end AXIS_DESCR
/end CHARACTERISTIC
/begin CHARACTERISTIC ENSAD "" VALUE 0x80042A4E KwWU8 255.0 dez 0.00 255.0 FORMAT "%5.1" /end CHARACTERISTIC
/begin CHARACTERISTIC ENSAKHG "" VALUE 0x8004288C KwWU8 255.0 dez 0.00 255.0 FORMAT "%5.1" /end CHARACTERISTIC
/begin CHARACTERISTIC ESDLUTS "" VALUE 0x80042A4F KwWU8 255.0 dez 0.00 255.0 FORMAT "%5.1" /end CHARACTERISTIC
/begin CHARACTERISTIC ETADZW "" CURVE 0x80042BAA FklWU16 1.000000 fak_uw_b2 0.00 1.000000 FORMAT "%8.6"
 /begin AXIS_DESCR FIX_AXIS dzwi kw_q0p75 81 0.00 60.00 FORMAT "%5.2" FIX_AXIS_PAR 0 0 81 /end AXIS_DESCR
/end CHARACTERISTIC
/begin CHARACTERISTIC FanDig0_ATS.LimitTypeMsk_C "" VALUE 0x8004B5BC Val_Wu8 255.0 OneToOne 0.00 255.0 FORMAT "%5.1" /end CHARACTERISTIC
/begin CHARACTERISTIC FanDig0_ATS.CnvNorm_C "" VALUE 0x8004B5BD Val_Wu8 255.0 OneToOne 0.00 255.0 FORMAT "%5.1" /end CHARACTERISTIC
/begin CHARACTERISTIC FanDig0_ATS.LowLim_C "" VALUE 0x8004B5BE Val_Ws16 65535.00 OneToOne -32768.00 32767.00 FORMAT "%8.2" /end CHARACTERISTIC
/begin CHARACTERISTIC FanDig0_ATS.UpLim_C "" VALUE 0x8004B5C0 Val_Ws16 65535.00 OneToOne -32768.00 32767.00 FORMAT "%8.2" /end CHARACTERISTIC
/begin CHARACTERISTIC FanDig0_ATS.CnvFac_C "" VALUE 0x8004B5C4 Val_Ws32 4294967295.00 OneToOne -2147483648.00 2147483647.00 FORMAT "%13.2" /end CHARACTERISTIC
/begin CHARACTERISTIC FanDig0_ATS.CnvOfs_C "" VALUE 0x8004B5C8 Val_Ws16 65535.00 OneToOne -32768.00 32767.00 FORMAT "%8.2" /end CHARACTERISTIC
/begin CHARACTERISTIC FanDig0_ATS.DfltVal_C "" VALUE 0x8004B5CA Val_Ws16 65535.00 OneToOne -32768.00 32767.00 FORMAT "%8.2" /end CHARACTERISTIC
/begin CHARACTERISTIC FHOKH "" VALUE 0x8004260A KwWU16 3.999939 fak_uw_b4 0.00 3.999939 FORMAT "%8.6" /end CHARACTERISTIC
/begin CHARACTERISTIC FKHABMN "" VALUE 0x8004260C KwWU8 0.9961 fak_ub_b1 0.00 0.9961 /end CHARACTERISTIC
/begin CHARACTERISTIC FKMSDKMN "" VALUE 0x80042CA6 KwWU16 3.999939 fak_q6p1035Em5 0.00 3.999939 FORMAT "%8.6" /end CHARACTERISTIC
/begin CHARACTERISTIC FKMSDKMX "" VALUE 0x80042CA8 KwWU16 3.999939 fak_q6p1035Em5 0.00 3.999939 FORMAT "%8.6" /end CHARACTERISTIC
/begin CHARACTERISTIC FKPVDKMSMN "" VALUE 0x80042CAA KwWU16 6553.500 m_q0p1 0.00 6553.500 FORMAT "%8.3" /end CHARACTERISTIC
/begin CHARACTERISTIC FKPVDKPMN "" VALUE 0x80042CAC KwWU16 1.999969 fak_uw_b2 0.00 1.999969 FORMAT "%8.6" /end CHARACTERISTIC
/begin CHARACTERISTIC FKPVDKPUGD "" VALUE 0x80042CAE KwWU16 1.999969 fak_uw_b2 0.00 1.999969 FORMAT "%8.6" /end CHARACTERISTIC
/begin CHARACTERISTIC FSDLUSOL "" VALUE 0x80042A50 KwWU8 1.992188 fak_ub_b2 0.00 1.992188 FORMAT "%8.6" /end CHARACTERISTIC
/begin CHARACTERISTIC FUGKUE "" CURVE 0x800425A2 KlAxU8SstxU8WU8 255.0 dez 0.00 255.0 FORMAT "%5.1"
 /begin AXIS_DESCR STD_AXIS uebver fak_b0p051 7 0.00 0.05100 FORMAT "%7.5" DEPOSIT ABSOLUTE /end AXIS_DESCR
/end CHARACTERISTIC
/begin CHARACTERISTIC IdleChrgActr_ATS.LimitTypeMsk_C "" VALUE 0x8004B5CC Val_Wu8 255.0 OneToOne 0.00 255.0 FORMAT "%5.1" /end CHARACTERISTIC
/begin CHARACTERISTIC IdleChrgActr_ATS.CnvNorm_C "" VALUE 0x8004B5CD Val_Wu8 255.0 OneToOne 0.00 255.0 FORMAT "%5.1" /end CHARACTERISTIC
/begin CHARACTERISTIC IdleChrgActr_ATS.LowLim_C "" VALUE 0x8004B5CE Val_Ws16 799.9878 Prc -400.0000 399.9878 FORMAT "%8.4" /end CHARACTERISTIC
/begin CHARACTERISTIC IdleChrgActr_ATS.UpLim_C "" VALUE 0x8004B5D0 Val_Ws16 799.9878 Prc -400.0000 399.9878 FORMAT "%8.4" /end CHARACTERISTIC
/begin CHARACTERISTIC IdleChrgActr_ATS.CnvFac_C "" VALUE 0x8004B5D4 Val_Ws32 4294967295.00 OneToOne -2147483648.00 2147483647.00 FORMAT "%13.2" /end CHARACTERISTIC
/begin CHARACTERISTIC IdleChrgActr_ATS.CnvOfs_C "" VALUE 0x8004B5D8 Val_Ws16 65535.00 OneToOne -32768.00 32767.00 FORMAT "%8.2" /end CHARACTERISTIC
/begin CHARACTERISTIC IdleChrgActr_ATS.DfltVal_C "" VALUE 0x8004B5DA Val_Ws16 65535.00 OneToOne -32768.00 32767.00 FORMAT "%8.2" /end CHARACTERISTIC
/begin CHARACTERISTIC IMLATMMX "" VALUE 0x8004260E KwWU16 23.30133 m_uw_b23p3 0.00 23.30133 FORMAT "%8.5" /end CHARACTERISTIC
/begin CHARACTERISTIC IMLATWS "" VALUE 0x80042610 KwWU16 23.30133 m_uw_b23p3 0.00 23.30133 FORMAT "%8.5" /end CHARACTERISTIC
/begin CHARACTERISTIC IMLPRMX "" VALUE 0x80042612 KwWU16 0.9999847 fak_uw_b1 0.00 0.9999847 FORMAT "%9.7" /end CHARACTERISTIC
/begin CHARACTERISTIC KATMCPAV "" VALUE 0x80042074 KwWU16 3881.069 q5p922Em2_JK 0.05922222 3881.128 FORMAT "%8.3" /end CHARACTERISTIC
/begin CHARACTERISTIC KFATAPIX "" MAP 0x80042076 KfAxU8AyU8SstxU16SstyU16WU16 0.9999847 fak_uw_b1 0.00 0.9999847 FORMAT "%9.7"
 /begin AXIS_DESCR STD_AXIS msabein_w m_uw_b6553p5 12 0.00 6553.500 FORMAT "%8.3" DEPOSIT ABSOLUTE /end AXIS_DESCR
 /begin AXIS_DESCR STD_AXIS mainloop dez 7 0.00 255.0000 FORMAT "%8.4" DEPOSIT ABSOLUTE /end AXIS_DESCR
/end CHARACTERISTIC
/begin CHARACTERISTIC KFATLAMS "" MAP 0x80042148 KfAxU8AyU8SstxU16SstyU16WU16 1.999969 fak_uw_b2 0.00 1.999969 FORMAT "%8.6"
 /begin AXIS_DESCR STD_AXIS laatmlc_w fak_uw_b16 12 0.00 15.99976 FORMAT "%8.5" DEPOSIT ABSOLUTE /end AXIS_DESCR
 /begin AXIS_DESCR STD_AXIS msabnav_w m_uw_b6553p5 6 0.00 6553.500 FORMAT "%8.3" DEPOSIT ABSOLUTE /end AXIS_DESCR
/end CHARACTERISTIC
/begin CHARACTERISTIC KFATMKRH "" MAP 0x80042200 KfAxU8AyU8SstxU16SstyU16WU16 1262.836 temp_q0p0234_o273 -0.009375000 1262.827 FORMAT "%8.3"
 /begin AXIS_DESCR STD_AXIS nmot_w nmot_uw_q0p25 11 0.00 16383.75 FORMAT "%8.2" DEPOSIT ABSOLUTE /end AXIS_DESCR
 /begin AXIS_DESCR STD_AXIS rlkatm_w rel_uw_b3072 11 0.00 3071.953 FORMAT "%8.3" DEPOSIT ABSOLUTE /end AXIS_DESCR
/end CHARACTERISTIC
/begin CHARACTERISTIC KFATVBRX "" MAP 0x80042322 KfAxU8AyU8SstxU16SstyU16WU16 113.7760 fak_q0p00174_JsK 0.00 113.7760 FORMAT "%8.4"
 /begin AXIS_DESCR STD_AXIS vfzg_w vfzg_uw_b512 7 0.00 511.9922 FORMAT "%8.4" DEPOSIT ABSOLUTE /end AXIS_DESCR
 /begin AXIS_DESCR STD_AXIS mainloop dez 4 0.00 255.0000 FORMAT "%8.4" DEPOSIT ABSOLUTE /end AXIS_DESCR
/end CHARACTERISTIC
/begin CHARACTERISTIC KFATVPIX "" MAP 0x80042374 KfAxU8AyU8SstxU16SstyU16WU16 113.7760 fak_q0p00174_JsK 0.00 113.7760 FORMAT "%8.4"
 /begin AXIS_DESCR STD_AXIS vfzg_w vfzg_uw_b512 7 0.00 511.9922 FORMAT "%8.4" DEPOSIT ABSOLUTE /end AXIS_DESCR
 /begin AXIS_DESCR STD_AXIS mainloop dez 7 0.00 255.0000 FORMAT "%8.4" DEPOSIT ABSOLUTE /end AXIS_DESCR
/end CHARACTERISTIC
/begin CHARACTERISTIC KFATZWMS "" MAP 0x800423F6 KfAxU8AyU8SstxU8SstyU16WU16 1.999969 fak_uw_b2 0.00 1.999969 FORMAT "%8.6"
 /begin AXIS_DESCR STD_AXIS etazwimt rel_ub_b127p5 6 0.00 127.5 FORMAT "%5.1" DEPOSIT ABSOLUTE /end AXIS_DESCR
 /begin AXIS_DESCR STD_AXIS msabnav_w m_uw_b6553p5 6 0.00 6553.500 FORMAT "%8.3" DEPOSIT ABSOLUTE /end AXIS_DESCR
/end CHARACTERISTIC
/begin CHARACTERISTIC KFDYESPF "" MAP 0x800427DC GkfWS8 1270. p_q10 0.00 1270. FORMAT "%5.0"
 /begin AXIS_DESCR COM_AXIS nmot nmot_ub_q40 13 0.00 10200. FORMAT "%5.0" AXIS_PTS_REF SNMKRA /end AXIS_DESCR
 /begin AXIS_DESCR COM_AXIS rl rel_ub_q0p75 4 0.00 191.3 FORMAT "%5.1" AXIS_PTS_REF SRL04DYUB /end AXIS_DESCR
/end CHARACTERISTIC
/begin CHARACTERISTIC KFEHBRX "" MAP 0x80042452 KfAxU8AyU8SstxU16SstyU16WS16 1535.977 temp_q0p0234 -768.0000 767.9766 FORMAT "%8.4"
 /begin AXIS_DESCR STD_AXIS msabein_w m_uw_b6553p5 11 0.00 6553.500 FORMAT "%8.3" DEPOSIT ABSOLUTE /end AXIS_DESCR
 /begin AXIS_DESCR STD_AXIS mainloop dez 4 0.00 255.0000 FORMAT "%8.4" DEPOSIT ABSOLUTE /end AXIS_DESCR
/end CHARACTERISTIC
/begin CHARACTERISTIC KFEXLACTX "" MAP 0x800424CC KfAxU8AyU8SstxU16SstyU8WU8 1.992188 fak_ub_b2 0.00 1.992188 FORMAT "%8.6"
 /begin AXIS_DESCR STD_AXIS lamein_w fak_uw_b16 7 0.00 15.99976 FORMAT "%8.5" DEPOSIT ABSOLUTE /end AXIS_DESCR
 /begin AXIS_DESCR STD_AXIS mainloop dez 2 0.00 255.0 FORMAT "%5.1" DEPOSIT ABSOLUTE /end AXIS_DESCR
/end CHARACTERISTIC
/begin CHARACTERISTIC KFFNWEKHAS "" MAP 0x800426E6 KfAxU8AyU8SstxU8SstyU16WU8 1.992188 fak_ub_b2 0.00 1.992188 FORMAT "%8.6"
 /begin AXIS_DESCR STD_AXIS tmst temp_ub_q0p75_o48 8 -48.00 143.3 FORMAT "%5.1" DEPOSIT ABSOLUTE /end AXIS_DESCR
 /begin AXIS_DESCR STD_AXIS tnse_w t100msxs_uw_b6553p5 8 0.00 6553.500 FORMAT "%8.3" DEPOSIT ABSOLUTE /end AXIS_DESCR
/end CHARACTERISTIC
/begin CHARACTERISTIC KFFNWEKHHS "" MAP 0x80042740 KfAxU8AyU8SstxU8SstyU16WU8 1.992188 fak_ub_b2 0.00 1.992188 FORMAT "%8.6"
 /begin AXIS_DESCR STD_AXIS tmst temp_ub_q0p75_o48 8 -48.00 143.3 FORMAT "%5.1" DEPOSIT ABSOLUTE /end AXIS_DESCR
 /begin AXIS_DESCR STD_AXIS tnse_w t100msxs_uw_b6553p5 8 0.00 6553.500 FORMAT "%8.3" DEPOSIT ABSOLUTE /end AXIS_DESCR
/end CHARACTERISTIC
/begin CHARACTERISTIC KFNWEGM "" MAP 0x8004288D GkfWU8 10200. nmot_ub_q40 0.00 10200. FORMAT "%5.0"
 /begin AXIS_DESCR COM_AXIS tmot temp_ub_q0p75_o48 5 -48.00 143.3 FORMAT "%5.1" AXIS_PTS_REF STM05SAUB /end AXIS_DESCR
 /begin AXIS_DESCR COM_AXIS gangsist dez 8 -128.0 127.0 FORMAT "%5.1" AXIS_PTS_REF SGZ08MDUB /end AXIS_DESCR
/end CHARACTERISTIC
/begin CHARACTERISTIC KFTATMSA "" MAP 0x800424EC KfAxU8AyU8SstxU16SstyU16WU16 1535.977 temp_q0p0234_o273 -273.1500 1262.827 FORMAT "%8.3"
 /begin AXIS_DESCR STD_AXIS nmot_w nmot_uw_q0p25 5 0.00 16383.75 FORMAT "%8.2" DEPOSIT ABSOLUTE /end AXIS_DESCR
 /begin AXIS_DESCR STD_AXIS tmotk_w temp_q0p0234_o273 5 -273.1500 1262.827 FORMAT "%8.3" DEPOSIT ABSOLUTE /end AXIS_DESCR
/end CHARACTERISTIC
/begin CHARACTERISTIC KFTNSEADMX "" MAP 0x80042A51 KfAxU8AyU8SstxU8SstyU8WU8 1020. t_q4_s 0.00 1020. FORMAT "%5.0"
 /begin AXIS_DESCR STD_AXIS tmstbstnsd temp_ub_q0p75_o48 4 -48.00 143.3 FORMAT "%5.1" DEPOSIT ABSOLUTE /end AXIS_DESCR
 /begin AXIS_DESCR STD_AXIS fvapskstaa fak_ub_b2 2 0.00 1.992188 FORMAT "%8.6" DEPOSIT ABSOLUTE /end AXIS_DESCR
/end CHARACTERISTIC
/begin CHARACTERISTIC KFTSAVGRL "" MAP 0x800428B6 KfAxU8AyU8SstxU8SstyU16WU8 10.20 t_q0p04 0.00 10.20 FORMAT "%5.2"
 /begin AXIS_DESCR STD_AXIS nmot nmot_ub_q40 8 0.00 10200. FORMAT "%5.0" DEPOSIT ABSOLUTE /end AXIS_DESCR
 /begin AXIS_DESCR STD_AXIS rl_w rel_uw_q0p0234 8 0.00 1535.977 FORMAT "%8.3" DEPOSIT ABSOLUTE /end AXIS_DESCR
/end CHARACTERISTIC
/begin CHARACTERISTIC KFTVSA "" MAP 0x80042910 GkfWU8 2.550 t_q0p01 0.00 2.550 FORMAT "%5.3"
 /begin AXIS_DESCR COM_AXIS tmot temp_ub_q0p75_o48 5 -48.00 143.3 FORMAT "%5.1" AXIS_PTS_REF STM05SAUB /end AXIS_DESCR
 /begin AXIS_DESCR COM_AXIS nmot nmot_ub_q40 8 0.00 10200. FORMAT "%5.0" AXIS_PTS_REF SNM08SAUB /end AXIS_DESCR
/end CHARACTERISTIC
/begin CHARACTERISTIC KFTVSAGNG "" MAP 0x80042938 KfAxU8AyU8SstxS16SstyU8WU16 655.3500 t_q0p01 0.00 655.3500 FORMAT "%8.4"
 /begin AXIS_DESCR STD_AXIS gangsist dez 8 -128.0000 127.0000 FORMAT "%8.4" DEPOSIT ABSOLUTE /end AXIS_DESCR
 /begin AXIS_DESCR STD_AXIS nmot nmot_ub_q40 3 0.00 10200. FORMAT "%5.0" DEPOSIT ABSOLUTE /end AXIS_DESCR
/end CHARACTERISTIC
/begin CHARACTERISTIC KFTVSAGNG2 "" MAP 0x8004297E KfAxU8AyU8SstxS16SstyU8WU16 655.3500 t_q0p01 0.00 655.3500 FORMAT "%8.4"
 /begin AXIS_DESCR STD_AXIS gangsist dez 8 -128.0000 127.0000 FORMAT "%8.4" DEPOSIT ABSOLUTE /end AXIS_DESCR
 /begin AXIS_DESCR STD_AXIS nmot nmot_ub_q40 3 0.00 10200. FORMAT "%5.0" DEPOSIT ABSOLUTE /end AXIS_DESCR
/end CHARACTERISTIC
/begin CHARACTERISTIC KFTVSAKAT "" MAP 0x800429C4 GkfWU8 10.20 t_q0p04 0.00 10.20 FORMAT "%5.2"
 /begin AXIS_DESCR COM_AXIS nmot nmot_ub_q40 8 0.00 10200. FORMAT "%5.0" AXIS_PTS_REF SNM08SAUB /end AXIS_DESCR
 /begin AXIS_DESCR COM_AXIS tkattmp temp_ub_q5_o50 4 -50.00 1225. FORMAT "%5.0" AXIS_PTS_REF STK04SAUB /end AXIS_DESCR
/end CHARACTERISTIC
/begin CHARACTERISTIC KIMSALL "" VALUE 0x80042CB0 KwWU16 255.9961 mk100msxs_uw_b256 0.003906310 256.0000 FORMAT "%8.4" /end CHARACTERISTIC
/begin CHARACTERISTIC KIMSALLGA "" VALUE 0x80042CB2 KwWU16 255.9961 mk100msxs_uw_b256 0.003906310 256.0000 FORMAT "%8.4" /end CHARACTERISTIC
/begin CHARACTERISTIC KIMSALLKT "" VALUE 0x80042CB4 KwWU16 255.9961 mk100msxs_uw_b256 0.003906310 256.0000 FORMAT "%8.4" /end CHARACTERISTIC
/begin CHARACTERISTIC KLDNVSA "" CURVE 0x800429E4 KlAxU8SstxU8WU8 10200. nmot_ub_q40 0.00 10200. FORMAT "%5.0"
 /begin AXIS_DESCR STD_AXIS vfzg vfzg_ub_q1p25 4 0.00 318.8 FORMAT "%5.1" DEPOSIT ABSOLUTE /end AXIS_DESCR
/end CHARACTERISTIC
/begin CHARACTERISTIC KLFKWTIHK "" CURVE 0x8004267C KlAxU8SstxU16WU16 1.999969 fak_uw_b2 0.00 1.999969 FORMAT "%8.6"
 /begin AXIS_DESCR STD_AXIS tkihkmmn_w temp_q0p0234_o273 6 -273.1500 1262.827 FORMAT "%8.3" DEPOSIT ABSOLUTE /end AXIS_DESCR
/end CHARACTERISTIC
/begin CHARACTERISTIC KLFLAKH "" CURVE 0x8004279A GklWU8 0.9961 fak_ub_b1 0.00 0.9961
 /begin AXIS_DESCR COM_AXIS tnse_w t100msxs_uw_b6553p5 8 0.00 6553.500 FORMAT "%8.3" AXIS_PTS_REF STN08KHUW /end AXIS_DESCR
/end CHARACTERISTIC
/begin CHARACTERISTIC KLFLBKKH "" CURVE 0x800427A2 KlAxU8SstxU16WU8 0.9961 fak_ub_b1 0.00 0.9961
 /begin AXIS_DESCR STD_AXIS tnse_w t100msxs_uw_b6553p5 8 0.00 6553.500 FORMAT "%8.3" DEPOSIT ABSOLUTE /end AXIS_DESCR
/end CHARACTERISTIC
/begin CHARACTERISTIC KLMLSKHAGE "" CURVE 0x80042614 KlAxU8SstxU16WU16 1.999969 fak_uw_b2 0.00 1.999969 FORMAT "%8.6"
 /begin AXIS_DESCR STD_AXIS fcosawkt_w fak_uw_b2 4 0.00 1.999969 FORMAT "%8.6" DEPOSIT ABSOLUTE /end AXIS_DESCR
/end CHARACTERISTIC
/begin CHARACTERISTIC KLSIMLKHKT "" CURVE 0x80042626 KlAxU8SstxU16WU16 23.30133 m_uw_b23p3 0.00 23.30133 FORMAT "%8.5"
 /begin AXIS_DESCR STD_AXIS tmst temp_ub_q0p75_o48 8 -48.00000 143.2500 FORMAT "%8.4" DEPOSIT ABSOLUTE /end AXIS_DESCR
/end CHARACTERISTIC
/begin CHARACTERISTIC KLTKHMXHAG "" CURVE 0x80042648 KlAxU8SstxU16WU16 1.999969 fak_uw_b2 0.00 1.999969 FORMAT "%8.6"
 /begin AXIS_DESCR STD_AXIS fcosawkt_w fak_uw_b2 4 0.00 1.999969 FORMAT "%8.6" DEPOSIT ABSOLUTE /end AXIS_DESCR
/end CHARACTERISTIC
/begin CHARACTERISTIC KLTWSKWTMS "" CURVE 0x80042696 KlAxU8SstxU8WU16 6553.500 t_q0p1 0.00 6553.500 FORMAT "%8.3"
 /begin AXIS_DESCR STD_AXIS tmst temp_ub_q0p75_o48 6 -48.00 143.3 FORMAT "%5.1" DEPOSIT ABSOLUTE /end AXIS_DESCR
/end CHARACTERISTIC
/begin CHARACTERISTIC KLWSATAVS "" CURVE 0x800426AA KlAxU8SstxU16WU16 1.999969 fak_uw_b2 0.00 1.999969 FORMAT "%8.6"
 /begin AXIS_DESCR STD_AXIS tavsomn_w temp_q0p0234_o273 6 -273.1500 1262.827 FORMAT "%8.3" DEPOSIT ABSOLUTE /end AXIS_DESCR
/end CHARACTERISTIC
/begin CHARACTERISTIC KLWSATWVSO "" CURVE 0x800426C4 KlAxU8SstxU16WU16 1.999969 fak_uw_b2 0.00 1.999969 FORMAT "%8.6"
 /begin AXIS_DESCR STD_AXIS twvsomn_w temp_q0p0234_o273 6 -273.1500 1262.827 FORMAT "%8.3" DEPOSIT ABSOLUTE /end AXIS_DESCR
/end CHARACTERISTIC
/begin CHARACTERISTIC KRAL1N "" CURVE 0x80042810 GklWU8 191.3 rel_q0p75 0.00 191.3 FORMAT "%5.1"
 /begin AXIS_DESCR COM_AXIS nmot nmot_ub_q40 13 0.00 10200. FORMAT "%5.0" AXIS_PTS_REF SNMKRA /end AXIS_DESCR
/end CHARACTERISTIC
/begin CHARACTERISTIC KRAL2N "" CURVE 0x8004281D GklWU8 191.3 rel_q0p75 0.00 191.3 FORMAT "%5.1"
 /begin AXIS_DESCR COM_AXIS nmot nmot_ub_q40 13 0.00 10200. FORMAT "%5.0" AXIS_PTS_REF SNMKRA /end AXIS_DESCR
/end CHARACTERISTIC
/begin CHARACTERISTIC KRAL3N "" CURVE 0x8004282A GklWU8 191.3 rel_q0p75 0.00 191.3 FORMAT "%5.1"
 /begin AXIS_DESCR COM_AXIS nmot nmot_ub_q40 13 0.00 10200. FORMAT "%5.0" AXIS_PTS_REF SNMKRA /end AXIS_DESCR
/end CHARACTERISTIC
/begin CHARACTERISTIC KRALH "" VALUE 0x80042837 KwWU8 10.50 rel_q0p75 0.00 10.50 FORMAT "%5.2" /end CHARACTERISTIC
/begin CHARACTERISTIC KRAN1 "" VALUE 0x80042838 KwWU8 10200. nmot_ub_q40 0.00 10200. FORMAT "%5.0" /end CHARACTERISTIC
/begin CHARACTERISTIC KRAN2 "" VALUE 0x80042839 KwWU8 10200. nmot_ub_q40 0.00 10200. FORMAT "%5.0" /end CHARACTERISTIC
/begin CHARACTERISTIC KRAN3 "" VALUE 0x8004283A KwWU8 10200. nmot_ub_q40 0.00 10200. FORMAT "%5.0" /end CHARACTERISTIC
/begin CHARACTERISTIC KRAN4 "" VALUE 0x8004283B KwWU8 10200. nmot_ub_q40 0.00 10200. FORMAT "%5.0" /end CHARACTERISTIC
/begin CHARACTERISTIC KRANH "" VALUE 0x8004283C KwWU8 10200. nmot_ub_q40 0.00 10200. FORMAT "%5.0" /end CHARACTERISTIC
/begin CHARACTERISTIC KRDYDELAY "" CURVE 0x8004283D GklWU8 32.00 dez 0.00 32.00 FORMAT "%5.2"
 /begin AXIS_DESCR COM_AXIS nmot nmot_ub_q40 8 0.00 10200. FORMAT "%5.0" AXIS_PTS_REF SNMKRB /end AXIS_DESCR
/end CHARACTERISTIC
/begin CHARACTERISTIC KSTANSAD "" VALUE 0x80042A61 KwWU8 1.992188 fak_ub_b2 0.00 1.992188 FORMAT "%8.6" /end CHARACTERISTIC
/begin CHARACTERISTIC KWVFZGRS "" VALUE 0x800426DE KwWU16 511.9922 vfzg_uw_b512 0.00 511.9922 FORMAT "%8.4" /end CHARACTERISTIC
/begin CHARACTERISTIC KWVFZGST "" VALUE 0x800426E0 KwWU16 511.9922 vfzg_uw_b512 0.00 511.9922 FORMAT "%8.4" /end CHARACTERISTIC
/begin CHARACTERISTIC LAMFA "" MAP 0x80042C50 KfAxUbAyUbSstxUbSstyUwWUb 1.000000 fak_ub_b2 0.00 1.000000 FORMAT "%8.6"
 /begin AXIS_DESCR STD_AXIS nmot nmot_ub_q40 12 0.00 10200. FORMAT "%5.0" DEPOSIT ABSOLUTE /end AXIS_DESCR
 /begin AXIS_DESCR STD_AXIS mrfa_w rel_uw_b200 4 0.00 199.9969 FORMAT "%8.4" DEPOSIT ABSOLUTE /end AXIS_DESCR
/end CHARACTERISTIC
/begin CHARACTERISTIC LKRN "" CURVE 0x80042845 GklWU8 191.3 rel_q0p75 0.00 191.3 FORMAT "%5.1"
 /begin AXIS_DESCR COM_AXIS nmot nmot_ub_q40 13 0.00 10200. FORMAT "%5.0" AXIS_PTS_REF SNMKRA /end AXIS_DESCR
/end CHARACTERISTIC
/begin CHARACTERISTIC LZSRPUMN "" VALUE 0x80042A92 KwWU16 2559.961 p_q0p039 0.00 2559.961 FORMAT "%8.3" /end CHARACTERISTIC
/begin CHARACTERISTIC LZSRTMOTMN "" VALUE 0x80042A94 KwWU8 191.3 temp_ub_q0p75_o48 -48.00 143.3 FORMAT "%5.1" /end CHARACTERISTIC
/begin CHARACTERISTIC LZSRTMOTMX "" VALUE 0x80042A95 KwWU8 191.3 temp_ub_q0p75_o48 -48.00 143.3 FORMAT "%5.1" /end CHARACTERISTIC
/begin CHARACTERISTIC MKARO "" VALUE 0x80042D06 KwWS16 199.9969 rel_sw_b100 -100.0000 99.99695 FORMAT "%8.4" /end CHARACTERISTIC
/begin CHARACTERISTIC MKARU "" VALUE 0x80042D08 KwWS16 199.9969 rel_sw_b100 -100.0000 99.99695 FORMAT "%8.4" /end CHARACTERISTIC
/begin CHARACTERISTIC MNCLUTWM "" VALUE 0x80042A62 KwWU16 65535.00 dez 0.00 65535.00 FORMAT "%8.2" /end CHARACTERISTIC
/begin CHARACTERISTIC MXCLUTWM "" VALUE 0x80042A64 KwWU16 65535.00 dez 0.00 65535.00 FORMAT "%8.2" /end CHARACTERISTIC
/begin CHARACTERISTIC NDKADVSLMX "" VALUE 0x80042CB6 KwWU8 10200. nmot_ub_q40 0.00 10200. FORMAT "%5.0" /end CHARACTERISTIC
/begin CHARACTERISTIC NGDNSA "" VALUE 0x800429EE KwWS16 10239.84 nmotg_sw_q0p15625 -5120.000 5119.844 FORMAT "%8.3" /end CHARACTERISTIC
/begin CHARACTERISTIC NGDNSAL "" VALUE 0x800429F0 KwWS16 10239.84 nmotg_sw_q0p15625 -5120.000 5119.844 FORMAT "%8.3" /end CHARACTERISTIC
/begin CHARACTERISTIC NGKRWN "" CURVE 0x80042852 GklWS8 25500. nmotg_sb_q100 -12800. 12700. FORMAT "%5.0"
 /begin AXIS_DESCR COM_AXIS nmot nmot_ub_q40 13 0.00 10200. FORMAT "%5.0" AXIS_PTS_REF SNMKRA /end AXIS_DESCR
/end CHARACTERISTIC
/begin CHARACTERISTIC NLLREIN "" VALUE 0x80042A76 KwWU16 16383.75 nmot_uw_q0p25 0.00 16383.75 FORMAT "%8.2" /end CHARACTERISTIC
/begin CHARACTERISTIC NMAXKW "" VALUE 0x800426E2 KwWU16 16383.75 nmot_uw_q0p25 0.00 16383.75 FORMAT "%8.2" /end CHARACTERISTIC
/begin CHARACTERISTIC NMNDDS2A3 "" VALUE 0x80042A9E KwWU16 16383.75 nmot_uw_q0p25 0.00 16383.75 FORMAT "%8.2" /end CHARACTERISTIC
/begin CHARACTERISTIC NMOTFADKMN "" VALUE 0x80042CB8 KwWU16 16383.75 nmot_uw_q0p25 0.00 16383.75 FORMAT "%8.2" /end CHARACTERISTIC
/begin CHARACTERISTIC NMOTFADKMX "" VALUE 0x80042CBA KwWU16 16383.75 nmot_uw_q0p25 0.00 16383.75 FORMAT "%8.2" /end CHARACTERISTIC
/begin CHARACTERISTIC NMOTNCHMX "" VALUE 0x800425B2 KwWU16 16383.75 nmot_uw_q0p25 0.00 16383.75 FORMAT "%8.2" /end CHARACTERISTIC
/begin CHARACTERISTIC NMOTOFDKMN "" VALUE 0x80042CBC KwWU16 16383.75 nmot_uw_q0p25 0.00 16383.75 FORMAT "%8.2" /end CHARACTERISTIC
/begin CHARACTERISTIC NMOTOFDKMX "" VALUE 0x80042CBE KwWU16 16383.75 nmot_uw_q0p25 0.00 16383.75 FORMAT "%8.2" /end CHARACTERISTIC
/begin CHARACTERISTIC NMXNSAD "" VALUE 0x80042A66 KwWU8 10200. nmot_ub_q40 0.00 10200. FORMAT "%5.0" /end CHARACTERISTIC
/begin CHARACTERISTIC NNSTA "" CURVE 0x80042A78 KlAxU8SstxU8WU8 10200. nmot_ub_q40 0.00 10200. FORMAT "%5.0"
 /begin AXIS_DESCR STD_AXIS tans temp_ub_q0p75_o48 3 -48.00 143.3 FORMAT "%5.1" DEPOSIT ABSOLUTE /end AXIS_DESCR
/end CHARACTERISTIC
/begin CHARACTERISTIC NSTNM "" CURVE 0x80042A7F KlAxU8SstxU8WU8 10200. nmot_ub_q40 0.00 10200. FORMAT "%5.0"
 /begin AXIS_DESCR STD_AXIS tmbbstt Temp_Cels_Short 6 -48.00 143.3 FORMAT "%5.1" DEPOSIT ABSOLUTE /end AXIS_DESCR
/end CHARACTERISTIC
/begin CHARACTERISTIC NWEMIN "" VALUE 0x800429F2 KwWU8 10200. nmot_ub_q40 0.00 10200. FORMAT "%5.0" /end CHARACTERISTIC
/begin CHARACTERISTIC NWENG "" CURVE 0x800429F4 KlAxU8SstxS8WU8 10200. nmot_ub_q40 0.00 10200. FORMAT "%5.0"
 /begin AXIS_DESCR STD_AXIS ngfil nmotg_sb_q100 5 -12800. 12700. FORMAT "%5.0" DEPOSIT ABSOLUTE /end AXIS_DESCR
/end CHARACTERISTIC
/begin CHARACTERISTIC NWENGFS "" CURVE 0x80042A00 KlAxU8SstxS8WU8 10200. nmot_ub_q40 0.00 10200. FORMAT "%5.0"
 /begin AXIS_DESCR STD_AXIS ngfil nmotg_sb_q100 5 -12800. 12700. FORMAT "%5.0" DEPOSIT ABSOLUTE /end AXIS_DESCR
/end CHARACTERISTIC
/begin CHARACTERISTIC OFMSNDKINI "" VALUE 0x80042CC0 KwWS16 6553.500 m_q0p1 -3276.800 3276.700 FORMAT "%8.3" /end CHARACTERISTIC
/begin CHARACTERISTIC OFMSNDKMN "" VALUE 0x80042CC2 KwWS16 6553.500 m_q0p1 -3276.800 3276.700 FORMAT "%8.3" /end CHARACTERISTIC
/begin CHARACTERISTIC OFMSNDKMX "" VALUE 0x80042CC4 KwWS16 6553.500 m_q0p1 -3276.800 3276.700 FORMAT "%8.3" /end CHARACTERISTIC
/begin CHARACTERISTIC OFMSNDMSMN "" VALUE 0x80042CC6 KwWU16 6553.500 m_q0p1 0.00 6553.500 FORMAT "%8.3" /end CHARACTERISTIC
/begin CHARACTERISTIC OFMSNDMSMX "" VALUE 0x80042CC8 KwWU16 6553.500 m_q0p1 0.00 6553.500 FORMAT "%8.3" /end CHARACTERISTIC
/begin CHARACTERISTIC OMSNDKLSMX "" VALUE 0x80042A96 KwWU16 3276.800 m_uw_b6553p5 0.00 3276.800 FORMAT "%8.3" /end CHARACTERISTIC
/begin CHARACTERISTIC PDSUMX "" VALUE 0x80042AA0 KwWU16 5119.922 p_uw_q0p078 0.00 5119.922 FORMAT "%8.3" /end CHARACTERISTIC
/begin CHARACTERISTIC PSPVDKUG "" VALUE 0x80041FB2 KwWU16 1.999969 fak_uw_b2 0.00 1.999969 FORMAT "%8.6" READ_ONLY /end CHARACTERISTIC
/begin CHARACTERISTIC RSOXABST "" VALUE 0x80042D0E KwUb 3.188 m_q0p0125_mg_DIV_s 0.00 3.188 FORMAT "%5.3" /end CHARACTERISTIC
/begin CHARACTERISTIC SAVGANGI "" VALUE 0x80042A0C KwWU8 255.0 dez 0.00 255.0 FORMAT "%5.1" /end CHARACTERISTIC
/begin CHARACTERISTIC SF_DKVS "" VAL_BLK 0x80042AA2 KwbWU16 86. dfp_verbal 0.00 86. FORMAT "%2.0" READ_ONLY NUMBER 4 /end CHARACTERISTIC
/begin AXIS_PTS SGZ08MDUB "" 0x80042A0D gangsist SstAU8SstS8 255.0 dez 8 -128.0 127.0 FORMAT "%5.1" DEPOSIT ABSOLUTE /end AXIS_PTS
/begin AXIS_PTS SNM08SAUB "" 0x80042A16 nmot SstAU8SstU8 10200. nmot_ub_q40 8 0.00 10200. FORMAT "%5.0" DEPOSIT ABSOLUTE /end AXIS_PTS
/begin AXIS_PTS SNMKRA "" 0x80046282 nmot SstAU8SstU8 10200. nmot_ub_q40 13 0.00 10200. FORMAT "%5.0" DEPOSIT ABSOLUTE /end AXIS_PTS
/begin AXIS_PTS SNMKRB "" 0x80046290 nmot SstAU8SstU8 10200. nmot_ub_q40 8 0.00 10200. FORMAT "%5.0" DEPOSIT ABSOLUTE /end AXIS_PTS
/begin AXIS_PTS SRL04DYUB "" 0x80046299 rl SstAU8SstU8 191.3 rel_ub_q0p75 4 0.00 191.3 FORMAT "%5.1" DEPOSIT ABSOLUTE /end AXIS_PTS
/begin AXIS_PTS STK04SAUB "" 0x80042A1F tkattmp SstAU8SstU8 1275. temp_ub_q5_o50 4 -50.00 1225. FORMAT "%5.0" DEPOSIT ABSOLUTE /end AXIS_PTS
/begin AXIS_PTS STM05SAUB "" 0x80042A24 tmot SstAU8SstU8 191.3 temp_ub_q0p75_o48 5 -48.00 143.3 FORMAT "%5.1" DEPOSIT ABSOLUTE /end AXIS_PTS
/begin AXIS_PTS STN08KHUW "" 0x800427BC tnse_w SstAU8SstU16 6553.500 t100msxs_uw_b6553p5 8 0.00 6553.500 FORMAT "%8.3" DEPOSIT ABSOLUTE /end AXIS_PTS
/begin AXIS_PTS STS06TAMUW "" 0x80042536 tabatmlc_w SstAU8SstU16 65535.00 t1sxs_uw_q1 6 0.00 65535.00 FORMAT "%8.2" DEPOSIT ABSOLUTE /end AXIS_PTS
/begin AXIS_PTS STS08KHUB "" 0x800427CE tmst SstAU8SstU8 191.3 temp_ub_q0p75_o48 8 -48.00 143.3 FORMAT "%5.1" DEPOSIT ABSOLUTE /end AXIS_PTS
/begin CHARACTERISTIC TAAMNCTX "" CURVE 0x80042544 KlAxU8SstxU8WU16 1535.977 temp_q0p0234_o273 -273.1500 1262.827 FORMAT "%8.3"
 /begin AXIS_DESCR STD_AXIS mainloop dez 2 0.00 255.0 FORMAT "%5.1" DEPOSIT ABSOLUTE /end AXIS_DESCR
/end CHARACTERISTIC
/begin CHARACTERISTIC TABSTKHMX "" VALUE 0x8004265A KwWU16 65535.00 t1sxs_uw_q1 0.00 65535.00 FORMAT "%8.2" /end CHARACTERISTIC
/begin CHARACTERISTIC TAIKRAP "" VALUE 0x80041FCA KwWU16 1535.977 temp_q0p0234_o273 -273.1500 1262.827 FORMAT "%8.3" /end CHARACTERISTIC
/begin CHARACTERISTIC TANSMNKH "" VALUE 0x8004265C KwWU8 191.3 temp_ub_q0p75_o48 -48.00 143.3 FORMAT "%5.1" /end CHARACTERISTIC
/begin CHARACTERISTIC TAOFMSNDKE "" VALUE 0x80042CCA KwWU8 25.50 t_q0p1 0.00 25.50 FORMAT "%5.2" /end CHARACTERISTIC
/begin CHARACTERISTIC TATMABIPWF "" VALUE 0x8004254C KwWU16 1535.977 temp_q0p0234_o273 -273.1500 1262.827 FORMAT "%8.3" /end CHARACTERISTIC
/begin CHARACTERISTIC TAUTAFSO "" VALUE 0x80041FCC KwWU16 3276.700 t_q0p05 0.05000000 3276.750 FORMAT "%8.3" /end CHARACTERISTIC
/begin CHARACTERISTIC TAUTAHSO "" VALUE 0x80041FCE KwWU16 3276.700 t_q0p05 0.05000000 3276.750 FORMAT "%8.3" /end CHARACTERISTIC
/begin CHARACTERISTIC TAUTAIKR "" VALUE 0x80041FD0 KwWU16 3276.700 t_q0p05 0.05000000 3276.750 FORMAT "%8.3" /end CHARACTERISTIC
/begin CHARACTERISTIC TAUTAIKRM "" VALUE 0x80041FD2 KwWU16 3276.700 t_q0p05 0.05000000 3276.750 FORMAT "%8.3" /end CHARACTERISTIC
/begin CHARACTERISTIC TAUTAVROM "" VALUE 0x80041FD4 KwWU16 3276.700 t_q0p05 0.05000000 3276.750 FORMAT "%8.3" /end CHARACTERISTIC
/begin CHARACTERISTIC TAUTAVSO "" VALUE 0x80041FD6 KwWU16 3276.700 t_q0p05 0.05000000 3276.750 FORMAT "%8.3" /end CHARACTERISTIC
/begin CHARACTERISTIC TAUTAVVK "" VALUE 0x80041FD8 KwWU16 3276.700 t_q0p05 0.05000000 3276.750 FORMAT "%8.3" /end CHARACTERISTIC
/begin CHARACTERISTIC TAUTAVVKM "" VALUE 0x80041FDA KwWU16 3276.700 t_q0p05 0.05000000 3276.750 FORMAT "%8.3" /end CHARACTERISTIC
/begin CHARACTERISTIC TAVHKAP "" VALUE 0x80041FDC KwWU16 1535.977 temp_q0p0234_o273 -273.1500 1262.827 FORMAT "%8.3" /end CHARACTERISTIC
/begin CHARACTERISTIC TAVVKAP "" VALUE 0x80041FDE KwWU16 1535.977 temp_q0p0234_o273 -273.1500 1262.827 FORMAT "%8.3" /end CHARACTERISTIC
/begin CHARACTERISTIC TDABGLST "" VALUE 0x80042CCC KwWU16 655.3500 t_q0p01 0.00 655.3500 FORMAT "%8.4" /end CHARACTERISTIC
/begin CHARACTERISTIC TDCN "" VALUE 0x800425B4 KwWU16 655.3500 t10msxs_uw_b655p35 0.00 655.3500 FORMAT "%8.4" /end CHARACTERISTIC
/begin CHARACTERISTIC TDDTEVFGAB "" VALUE 0x80042CCE KwWU16 655.3500 t_q0p01 0.00 655.3500 FORMAT "%8.4" /end CHARACTERISTIC
/begin CHARACTERISTIC TDGC "" VALUE 0x800425B6 KwWU16 655.3500 t10msxs_uw_b655p35 0.00 655.3500 FORMAT "%8.4" /end CHARACTERISTIC
/begin CHARACTERISTIC TDGC1 "" VALUE 0x800425B8 KwWU16 655.3500 t10msxs_uw_b655p35 0.00 655.3500 FORMAT "%8.4" /end CHARACTERISTIC
/begin CHARACTERISTIC TDIFKH "" VALUE 0x8004265D KwWU8 191.3 temp_ub_b191p25 0.00 191.3 FORMAT "%5.1" /end CHARACTERISTIC
/begin CHARACTERISTIC TDLZSR "" VALUE 0x80042A98 KwWU8 51.00 t_q0p2 0.00 51.00 FORMAT "%5.2" /end CHARACTERISTIC
/begin CHARACTERISTIC TDNCHOFF "" VALUE 0x800425BA KwWU16 655.3500 t10msxs_uw_b655p35 0.00 655.3500 FORMAT "%8.4" /end CHARACTERISTIC
/begin CHARACTERISTIC TDNCHON "" VALUE 0x800425BC KwWU16 655.3500 t10msxs_uw_b655p35 0.00 655.3500 FORMAT "%8.4" /end CHARACTERISTIC
/begin CHARACTERISTIC TDSAFGABGL "" VALUE 0x80042CD0 KwWU16 655.3500 t_q0p01 0.00 655.3500 FORMAT "%8.4" /end CHARACTERISTIC
/begin CHARACTERISTIC TDSAOFMNDP "" VALUE 0x80042CD2 KwWU16 6553.500 t_q0p1 0.00 6553.500 FORMAT "%8.3" /end CHARACTERISTIC
/begin CHARACTERISTIC TDWDKSUGD "" VALUE 0x80042CD4 KwWU8 0.1000 t_q0p01 0.00 0.1000 /end CHARACTERISTIC
/begin CHARACTERISTIC TENGSDECR "" VALUE 0x80042A68 KwWU16 65535.00 t1sxs_uw_q1 0.00 65535.00 FORMAT "%8.2" /end CHARACTERISTIC
/begin CHARACTERISTIC TEXOHALTN "" VALUE 0x8004254E KwWU16 3276.750 t_q0p05 0.00 3276.750 FORMAT "%8.3" /end CHARACTERISTIC
/begin CHARACTERISTIC TIFKATMN "" VALUE 0x8004265E KwWU16 1535.977 temp_q0p0234_o273 -273.1500 1262.827 FORMAT "%8.3" /end CHARACTERISTIC
/begin CHARACTERISTIC TKHMXFHO "" CURVE 0x80042660 KlAxU8SstxU16WU16 6553.500 t100msxs_uw_b6553p5 0.00 6553.500 FORMAT "%8.3"
 /begin AXIS_DESCR STD_AXIS fho_w fak_uw_b4 4 0.00 3.999939 FORMAT "%8.6" DEPOSIT ABSOLUTE /end AXIS_DESCR
/end CHARACTERISTIC
/begin CHARACTERISTIC TKHMXLL "" VALUE 0x80042672 KwWU16 6553.500 t_q0p1 0.00 6553.500 FORMAT "%8.3" /end CHARACTERISTIC
/begin CHARACTERISTIC TKIHKAP "" VALUE 0x80041FE0 KwWU16 1535.977 temp_q0p0234_o273 -273.1500 1262.827 FORMAT "%8.3" /end CHARACTERISTIC
/begin CHARACTERISTIC TKIVKAP "" VALUE 0x80041FE2 KwWU16 1535.977 temp_q0p0234_o273 -273.1500 1262.827 FORMAT "%8.3" /end CHARACTERISTIC
/begin CHARACTERISTIC TLAFA "" VALUE 0x80042C96 KwUb 25.50 t100msxs_ub_b25p5 0.00 25.50 FORMAT "%5.2" /end CHARACTERISTIC
/begin CHARACTERISTIC TMKR "" VALUE 0x8004285F KwWU8 191.3 temp_ub_q0p75_o48 -48.00 143.3 FORMAT "%5.1" /end CHARACTERISTIC
/begin CHARACTERISTIC TMKRA "" VALUE 0x80042860 KwWU8 191.3 temp_ub_q0p75_o48 -48.00 143.3 FORMAT "%5.1" /end CHARACTERISTIC
/begin CHARACTERISTIC TMMXRT "" VALUE 0x80042A9C KwWU8 191.3 temp_ub_q0p75_o48 -48.00 143.3 FORMAT "%5.1" /end CHARACTERISTIC
/begin CHARACTERISTIC TMNSADMN "" VALUE 0x80042A6A KwWU8 191.3 temp_ub_q0p75_o48 -48.00 143.3 FORMAT "%5.1" /end CHARACTERISTIC
/begin CHARACTERISTIC TMNSADMX "" VALUE 0x80042A6B KwWU8 191.3 temp_ub_q0p75_o48 -48.00 143.3 FORMAT "%5.1" /end CHARACTERISTIC
/begin CHARACTERISTIC TMORSTE "" VALUE 0x80042A8C KwWU8 191.3 temp_ub_q0p75_o48 -48.00 143.3 FORMAT "%5.1" /end CHARACTERISTIC
/begin CHARACTERISTIC TMOTMNSAD "" VALUE 0x80042A6C KwWU8 191.3 temp_ub_q0p75_o48 -48.00 143.3 FORMAT "%5.1" /end CHARACTERISTIC
/begin CHARACTERISTIC TMTNSEZMK "" VALUE 0x80042A8D KwWU8 191.3 temp_q0p75_om48 -48.00 143.3 FORMAT "%5.1" /end CHARACTERISTIC
/begin CHARACTERISTIC TMURSTE "" VALUE 0x80042A8E KwWU8 191.3 temp_ub_q0p75_o48 -48.00 143.3 FORMAT "%5.1" /end CHARACTERISTIC
/begin CHARACTERISTIC TNSELDCYMX "" VALUE 0x80042674 KwWU16 6553.500 t_q0p1 0.00 6553.500 FORMAT "%8.3" /end CHARACTERISTIC
/begin CHARACTERISTIC TNSRT "" VALUE 0x80042A9D KwWU8 255.0 t_q1 0.00 255.0 FORMAT "%5.1" /end CHARACTERISTIC
/begin CHARACTERISTIC TOEXCTX "" CURVE 0x80042550 KlAxU8SstxU16WS16 1535.977 temp_q0p0234 -768.0000 767.9766 FORMAT "%8.4"
 /begin AXIS_DESCR STD_AXIS mainloop dez 2 0.00 255.0000 FORMAT "%8.4" DEPOSIT ABSOLUTE /end AXIS_DESCR
/end CHARACTERISTIC
/begin CHARACTERISTIC TSABGE "" VALUE 0x8004255A KwWU16 1535.977 temp_q0p0234_o273 -273.1500 1262.827 FORMAT "%8.3" /end CHARACTERISTIC
/begin CHARACTERISTIC TSABGEAR "" VAL_BLK 0x8004255C KwbWU16 1535.977 temp_q0p0234_o273 -273.1500 1262.827 FORMAT "%8.3" NUMBER 13 /end CHARACTERISTIC
/begin CHARACTERISTIC TUMGMNKH "" VALUE 0x80042676 KwWU8 191.3 temp_ub_q0p75_o48 -48.00 143.3 FORMAT "%5.1" /end CHARACTERISTIC
/begin CHARACTERISTIC TVBGSCH "" VALUE 0x80042A2A KwWU8 2.550 t_q0p01 0.00 2.550 FORMAT "%5.3" /end CHARACTERISTIC
/begin CHARACTERISTIC TVFGKHTUM "" VALUE 0x80042677 KwWU8 25.50 t_q0p1 0.00 25.50 FORMAT "%5.2" /end CHARACTERISTIC
/begin CHARACTERISTIC TVLLRSTE "" VALUE 0x80042A8F KwWU8 5.100 t_q0p02 0.00 5.100 FORMAT "%5.3" /end CHARACTERISTIC
/begin CHARACTERISTIC TVNSADLROF "" VALUE 0x80042A6D KwWU8 25.50 t100msxs_ub_b25p5 0.00 25.50 FORMAT "%5.2" /end CHARACTERISTIC
/begin CHARACTERISTIC TVNSKUPPEF "" VALUE 0x80042A6E KwWU8 25.50 t100msxs_ub_b25p5 0.00 25.50 FORMAT "%5.2" /end CHARACTERISTIC
/begin CHARACTERISTIC TVNSKUPPER "" VALUE 0x80042A6F KwWU8 25.50 t100msxs_ub_b25p5 0.00 25.50 FORMAT "%5.2" /end CHARACTERISTIC
/begin CHARACTERISTIC TVSABFA "" VALUE 0x80042A2C KwWU16 655.3500 t_q0p01 0.00 655.3500 FORMAT "%8.4" /end CHARACTERISTIC
/begin CHARACTERISTIC TVSABTE "" VALUE 0x80042A2E KwWU16 655.3500 t_q0p01 0.00 655.3500 FORMAT "%8.4" /end CHARACTERISTIC
/begin CHARACTERISTIC TVSAGSCH "" VALUE 0x80042A30 KwWU16 655.3500 t_q0p01 0.00 655.3500 FORMAT "%8.4" /end CHARACTERISTIC
/begin CHARACTERISTIC TVSATM "" CURVE 0x80042A32 KlAxU8SstxU8WU16 655.3500 t_q0p01 0.00 655.3500 FORMAT "%8.4"
 /begin AXIS_DESCR STD_AXIS tmst temp_ub_q0p75_o48 6 -48.00 143.3 FORMAT "%5.1" DEPOSIT ABSOLUTE /end AXIS_DESCR
/end CHARACTERISTIC
/begin CHARACTERISTIC TVTOFLUT "" VALUE 0x80042A70 KwWU8 25.50 t100msxs_ub_b25p5 0.00 25.50 FORMAT "%5.2" /end CHARACTERISTIC
/begin CHARACTERISTIC TVVFZGNOI "" VALUE 0x800425BE KwWU8 2.550 t_q0p01 0.00 2.550 FORMAT "%5.3" /end CHARACTERISTIC
/begin CHARACTERISTIC TVVFZGNOST "" VALUE 0x800425C0 KwWU16 655.3500 t10msxs_uw_b655p35 0.00 655.3500 FORMAT "%8.4" /end CHARACTERISTIC
/begin CHARACTERISTIC TWSKWATMMX "" VALUE 0x800426E4 KwWU16 6553.500 t_q0p1 0.00 6553.500 FORMAT "%8.3" /end CHARACTERISTIC
/begin CHARACTERISTIC UBKST "" VALUE 0x80042A71 KwWU8 25.50 spg_q0p1 0.00 25.50 FORMAT "%5.2" /end CHARACTERISTIC
/begin CHARACTERISTIC UBKSTMX "" VALUE 0x80042A72 KwWU8 255.0 dez 0.00 255.0 FORMAT "%5.1" /end CHARACTERISTIC
/begin CHARACTERISTIC UEVGANG "" CURVE 0x800425C2 FklWU16 25.50000 fak_q0p02 0.00 25.50000 FORMAT "%8.5"
 /begin AXIS_DESCR FIX_AXIS gangi dez 10 0.00 9.000 FORMAT "%5.3" FIX_AXIS_PAR 0 0 10 /end AXIS_DESCR
/end CHARACTERISTIC
/begin CHARACTERISTIC VFZGMINNOI "" VALUE 0x800425D6 KwWU16 511.9922 vfzg_uw_b512 0.00 511.9922 FORMAT "%8.4" /end CHARACTERISTIC
/begin CHARACTERISTIC VFZGNCHMX "" VALUE 0x800425D8 KwWU16 511.9922 vfzg_uw_b512 0.00 511.9922 FORMAT "%8.4" /end CHARACTERISTIC
/begin CHARACTERISTIC VNVKVHK "" VALUE 0x80042D10 KwUw 19999.69 vol_q0p306_cme3 0.00 19999.69 FORMAT "%8.2" /end CHARACTERISTIC
/begin CHARACTERISTIC VPSPVDMNFA "" VALUE 0x80042CD6 KwWU16 1.999969 fak_uw_b2 0.00 1.999969 FORMAT "%8.6" /end CHARACTERISTIC
/begin CHARACTERISTIC WDKBALAMFA "" VALUE 0x80042C98 KwSw 1599.976 relDK_q0p02441 -800.0000 799.9756 FORMAT "%8.4" /end CHARACTERISTIC
/begin CHARACTERISTIC ZATMSAMS "" CURVE 0x80042576 KlAxU8SstxU16WU16 3276.7499992 zk50msxs_uw_b3276p8 0.050000762951 3276.8000000 FORMAT "%12.7"
 /begin AXIS_DESCR STD_AXIS msabnav_w m_uw_b6553p5 8 0.00 6553.500 FORMAT "%8.3" DEPOSIT ABSOLUTE /end AXIS_DESCR
/end CHARACTERISTIC
/begin CHARACTERISTIC ZATMTKR "" CURVE 0x80041FE4 KlAxU8SstxU16WU16 1.000000 fak_uw_b2 0.00 1.000000 FORMAT "%8.6"
 /begin AXIS_DESCR STD_AXIS msabikr_w m_uw_b6553p5 6 0.00 6553.500 FORMAT "%8.3" DEPOSIT ABSOLUTE /end AXIS_DESCR
/end CHARACTERISTIC
/begin CHARACTERISTIC ZCRDETEC "" VALUE 0x800425DA KwWU16 655.3500 t10msxs_uw_b655p35 0.00 655.3500 FORMAT "%8.4" /end CHARACTERISTIC
/begin CHARACTERISTIC ZFKMSDKSNW "" VALUE 0x80042CD8 KwWU16 4.9927479390 zk10msxs_uw_b655 0.010000152590 5.0027480916 FORMAT "%12.10" /end CHARACTERISTIC
/begin CHARACTERISTIC ZGKLL "" VALUE 0x800425DC KwWU8 2.550 t10msxs_ub_b2p55 0.00 2.550 FORMAT "%5.3" /end CHARACTERISTIC
/begin CHARACTERISTIC ZGKTL "" VALUE 0x800425DD KwWU8 2.550 t10msxs_ub_b2p55 0.00 2.550 FORMAT "%5.3" /end CHARACTERISTIC
/begin CHARACTERISTIC ZKBFZGLNCH "" VALUE 0x800425DE KwWU8 2.540 t_q0p01 0.01000 2.550 FORMAT "%5.3" /end CHARACTERISTIC
/begin CHARACTERISTIC ZKHABB "" VALUE 0x80042678 KwWU8 25.4996 zk100msxs_ub_b25p5 0.100392 25.6000 FORMAT "%7.4" /end CHARACTERISTIC
/begin CHARACTERISTIC ZKLAMFAW "" VALUE 0x80042C9A KwUw 6553.4999985 zk100msxs_uw_b6553 0.10000152590 6553.6000000 FORMAT "%12.7" /end CHARACTERISTIC
/begin CHARACTERISTIC ZKMSDKDSKT "" VALUE 0x80042CDA KwWU16 1.9880486279 zk10msxs_uw_b655 0.010000152590 1.9980487805 FORMAT "%12.10" /end CHARACTERISTIC
/begin CHARACTERISTIC ZKMSDKT "" CURVE 0x80042CDC KlAxU8SstxU16WU16 1.9880486279 zk10msxs_uw_b655 0.010000152590 1.9980487805 FORMAT "%12.10"
 /begin AXIS_DESCR STD_AXIS vpsrvd_w fak_uw_b2 8 0.00 1.999969 FORMAT "%8.6" DEPOSIT ABSOLUTE /end AXIS_DESCR
/end CHARACTERISTIC
/begin CHARACTERISTIC ZKRDYDELAY "" CURVE 0x80042861 KlAxU8SstxU8WU8 2.550 t_q0p01 0.00 2.550 FORMAT "%5.3"
 /begin AXIS_DESCR STD_AXIS nmot nmot_ub_q40 4 0.00 10200. FORMAT "%5.0" DEPOSIT ABSOLUTE /end AXIS_DESCR
/end CHARACTERISTIC
/begin CHARACTERISTIC ZKREGLDYN "" CURVE 0x8004286A GklWU8 2.540 t_q0p01 0.01000 2.550 FORMAT "%5.3"
 /begin AXIS_DESCR COM_AXIS nmot nmot_ub_q40 8 0.00 10200. FORMAT "%5.0" AXIS_PTS_REF SNMKRB /end AXIS_DESCR
/end CHARACTERISTIC
/begin CHARACTERISTIC ZKRKELDYN "" CURVE 0x80042872 GklWU8 2.540 t_q0p01 0.01000 2.550 FORMAT "%5.3"
 /begin AXIS_DESCR COM_AXIS nmot nmot_ub_q40 8 0.00 10200. FORMAT "%5.0" AXIS_PTS_REF SNMKRB /end AXIS_DESCR
/end CHARACTERISTIC
/begin CHARACTERISTIC ZKRKENDYN "" CURVE 0x8004287A GklWU8 2.540 t_q0p01 0.01000 2.550 FORMAT "%5.3"
 /begin AXIS_DESCR COM_AXIS nmot nmot_ub_q40 8 0.00 10200. FORMAT "%5.0" AXIS_PTS_REF SNMKRB /end AXIS_DESCR
/end CHARACTERISTIC
/begin CHARACTERISTIC ZRFKMSDK "" VALUE 0x80042CFE KwWU16 655.30999924 zk10msxs_uw_b655 0.050000762951 655.36000000 FORMAT "%12.8" /end CHARACTERISTIC
/begin CHARACTERISTIC ZROFMSNDK "" VALUE 0x80042D00 KwWU16 6553.4999985 zk100msxs_uw_b6553 0.10000152590 6553.6000000 FORMAT "%12.7" /end CHARACTERISTIC
/begin MEASUREMENT actkeldyn "" UBYTE t_q0p01 1 100 0.00 2.550 FORMAT "%5.3" ECU_ADDRESS 0xD0000BA4 /end MEASUREMENT
/begin MEASUREMENT actkendyn "" UBYTE t_q0p01 1 100 0.00 2.550 FORMAT "%5.3" ECU_ADDRESS 0xD0000BA5 /end MEASUREMENT
/begin MEASUREMENT actldyn "" UBYTE t_q0p01 1 100 0.00 2.550 FORMAT "%5.3" ECU_ADDRESS 0xD0000BA6 /end MEASUREMENT
/begin MEASUREMENT Alt_facDemandEEP_mp "" SWORD FactHigh1 1 100 -3.276800 3.276700 FORMAT "%8.6" ECU_ADDRESS 0xD00052AE /end MEASUREMENT
/begin MEASUREMENT Alt_stCldStrtRls "" UBYTE OneToOne 1 100 0.00 255.0 FORMAT "%5.1" ECU_ADDRESS 0xD0003C0A /end MEASUREMENT
/begin MEASUREMENT Alt_trqCalc_mp "" SWORD Trq 1 100 -3276.800 3276.700 FORMAT "%8.3" ECU_ADDRESS 0xD00052B0 /end MEASUREMENT
/begin MEASUREMENT Alt_trqCor_mp "" SWORD Trq 1 100 -3276.800 3276.700 FORMAT "%8.3" ECU_ADDRESS 0xD00052B2 /end MEASUREMENT
/begin MEASUREMENT Alt_trqDes "" SWORD Trq 1 100 -3276.800 3276.700 FORMAT "%8.3" ECU_ADDRESS 0xD000346A /end MEASUREMENT
/begin MEASUREMENT Alt_trqFlt_mp "" SWORD Trq 1 100 -3276.800 3276.700 FORMAT "%8.3" ECU_ADDRESS 0xD00052B4 /end MEASUREMENT
/begin MEASUREMENT Alt_trqResv "" SWORD Trq 1 100 -3276.800 3276.700 FORMAT "%8.3" ECU_ADDRESS 0xD000346C /end MEASUREMENT
/begin MEASUREMENT APP_drUnFlt "" SWORD PrcPerSec 1 100 -20000.00 19999.39 FORMAT "%8.2" ECU_ADDRESS 0xD0003436 /end MEASUREMENT
/begin MEASUREMENT APP_r "" SWORD Prc 1 100 -400.0000 399.9878 FORMAT "%8.4" ECU_ADDRESS 0xD0003438 /end MEASUREMENT
/begin MEASUREMENT APP_rFlt_mp "" SWORD Prc 1 100 -400.0000 399.9878 FORMAT "%8.4" ECU_ADDRESS 0xD00052C0 /end MEASUREMENT
/begin MEASUREMENT APP_rOBDPID5A "" SWORD Prc 1 100 -400.0000 399.9878 FORMAT "%8.4" ECU_ADDRESS 0xD000327C /end MEASUREMENT
/begin MEASUREMENT APP_rPla_mp "" SWORD Prc 1 100 -400.0000 399.9878 FORMAT "%8.4" ECU_ADDRESS 0xD00052B6 /end MEASUREMENT
/begin MEASUREMENT APP_rUnFlt "" SWORD Prc 1 100 -400.0000 399.9878 FORMAT "%8.4" ECU_ADDRESS 0xD000343A /end MEASUREMENT
/begin MEASUREMENT APP_rUnLim_mp "" SWORD Prc 1 100 -400.0000 399.9878 FORMAT "%8.4" ECU_ADDRESS 0xD00052B8 /end MEASUREMENT
/begin MEASUREMENT APP_stAlive_mp "" UBYTE OneToOne 1 100 0.00 255.0 FORMAT "%5.1" ECU_ADDRESS 0xD00053B7 /end MEASUREMENT
/begin MEASUREMENT APP_stKD "" UBYTE OneToOne 1 100 0.00 255.0 FORMAT "%5.1" ECU_ADDRESS 0xD0003BF6 /end MEASUREMENT
/begin MEASUREMENT APP_stPlaBrkDet_mp "" UBYTE OneToOne 1 100 0.00 255.0 FORMAT "%5.1" ECU_ADDRESS 0xD00053B8 /end MEASUREMENT
/begin MEASUREMENT APP_stPlaBrkRst_mp "" UBYTE OneToOne 1 100 0.00 255.0 FORMAT "%5.1" ECU_ADDRESS 0xD00053B9 /end MEASUREMENT
/begin MEASUREMENT APP_stPlaBrk_mp "" UBYTE OneToOne 1 100 0.00 255.0 FORMAT "%5.1" ECU_ADDRESS 0xD00053BB /end MEASUREMENT
/begin MEASUREMENT APP_stSigSrc "" UBYTE OneToOne 1 100 0.00 255.0 FORMAT "%5.1" ECU_ADDRESS 0xD0003BF7 /end MEASUREMENT
/begin MEASUREMENT APP_stTempErr_mp "" UBYTE OneToOne 1 100 0.00 255.0 FORMAT "%5.1" ECU_ADDRESS 0xD00053BA /end MEASUREMENT
/begin MEASUREMENT APP_uDiffMax_mp "" SWORD Volt 1 100 -6553.600 6553.400 FORMAT "%8.3" ECU_ADDRESS 0xD00052BA /end MEASUREMENT
/begin MEASUREMENT APP_uDiff_mp "" SWORD Volt 1 100 -6553.600 6553.400 FORMAT "%8.3" ECU_ADDRESS 0xD00052BC /end MEASUREMENT
/begin MEASUREMENT APP_uMin12half_mp "" SWORD Volt 1 100 -6553.600 6553.400 FORMAT "%8.3" ECU_ADDRESS 0xD00052BE /end MEASUREMENT
/begin MEASUREMENT APP_uRaw1 "" SWORD Volt 1 100 -6553.600 6553.400 FORMAT "%8.3" ECU_ADDRESS 0xD000343E /end MEASUREMENT
/begin MEASUREMENT APP_uRaw1unLim "" SWORD Volt 1 100 -6553.600 6553.400 FORMAT "%8.3" ECU_ADDRESS 0xD000327E /end MEASUREMENT
/begin MEASUREMENT APP_uRaw2 "" SWORD Volt 1 100 -6553.600 6553.400 FORMAT "%8.3" ECU_ADDRESS 0xD0003440 /end MEASUREMENT
/begin MEASUREMENT APP_uRaw2unLim "" SWORD Volt 1 100 -6553.600 6553.400 FORMAT "%8.3" ECU_ADDRESS 0xD0003280 /end MEASUREMENT
/begin MEASUREMENT APP_uRaw2unLimWoNTP "" SWORD Volt 1 100 -6553.600 6553.400 FORMAT "%8.3" ECU_ADDRESS 0xD0003282 /end MEASUREMENT
/begin MEASUREMENT APP_uRaw_mp "" SWORD Volt 1 100 -6553.600 6553.400 FORMAT "%8.3" ECU_ADDRESS 0xD00052C2 /end MEASUREMENT
/begin MEASUREMENT APP_uUnJit_mp "" SWORD Volt 1 100 -6553.600 6553.400 FORMAT "%8.3" ECU_ADDRESS 0xD00052C4 /end MEASUREMENT
/begin MEASUREMENT ATS_ctCurRunTst "" UBYTE OneToOne 1 100 0.00 255.0 FORMAT "%5.1" ECU_ADDRESS 0xD0003BF8 /end MEASUREMENT
/begin MEASUREMENT ATS_IntvVal_mp "" SWORD OneToOne 1 100 -32768.00 32767.00 FORMAT "%8.2" ECU_ADDRESS 0xD00052C6 /end MEASUREMENT
/begin MEASUREMENT ATS_stMon "" UBYTE OneToOne 1 100 0.00 255.0 FORMAT "%5.1" ECU_ADDRESS 0xD0003BF9 /end MEASUREMENT
/begin MEASUREMENT ATS_stMonTimeLimit "" UBYTE OneToOne 1 100 0.00 255.0 FORMAT "%5.1" ECU_ADDRESS 0xD0003BFA /end MEASUREMENT
/begin MEASUREMENT ATS_TstStatus_mp "" UBYTE OneToOne 1 100 0.00 255.0 FORMAT "%5.1" ECU_ADDRESS 0xD00053BC /end MEASUREMENT
/begin MEASUREMENT bfzglflt_b "" SWORD bfzg_sw_q4p239Em4 1 100 -13.8903552 13.8899313 ECU_ADDRESS 0xD0000144 /end MEASUREMENT
/begin MEASUREMENT bgevabAusBits10ms "" UBYTE dez 1 100 0.00 255.0 FORMAT "%5.1" ECU_ADDRESS 0xD0000BD9 /end MEASUREMENT
/begin MEASUREMENT bitmuster "" UBYTE dez 1 100 0.00 255.0 FORMAT "%5.1" ECU_ADDRESS 0xD0000BE1 /end MEASUREMENT
/begin MEASUREMENT btrkht "" UBYTE fak_ub_b1 1 100 0.00 0.9961 ECU_ADDRESS 0xD0000B9A /end MEASUREMENT
/begin MEASUREMENT B_adkose "" UBYTE B_TRUE 1 100 0.00 1.00000000000 BIT_MASK 0x80 FORMAT "%13.11" ECU_ADDRESS 0xD000008F /end MEASUREMENT
/begin MEASUREMENT B_adkospe "" UBYTE B_TRUE 1 100 0.00 1.00000000000 BIT_MASK 0x2 FORMAT "%13.11" ECU_ADDRESS 0xD0000BDF /end MEASUREMENT
/begin MEASUREMENT B_adkpe "" UBYTE B_TRUE 1 100 0.00 1.00000000000 BIT_MASK 0x2 FORMAT "%13.11" ECU_ADDRESS 0xAFE80158 /end MEASUREMENT
/begin MEASUREMENT B_adneusyn "" UBYTE B_TRUE 1 100 0.00 1.00000000000 BIT_MASK 0x80 FORMAT "%13.11" ECU_ADDRESS 0xD0000025 /end MEASUREMENT
/begin MEASUREMENT B_adstopnd "" UBYTE B_TRUE 1 100 0.00 1.00000000000 BIT_MASK 0x8 FORMAT "%13.11" ECU_ADDRESS 0xD0000026 /end MEASUREMENT
/begin MEASUREMENT B_afkpvdei "" UBYTE B_TRUE 1 100 0.00 1.00000000000 BIT_MASK 0x1 FORMAT "%13.11" ECU_ADDRESS 0xAFE80157 /end MEASUREMENT
/begin MEASUREMENT B_afkpvdke "" UBYTE B_TRUE 1 100 0.00 1.00000000000 BIT_MASK 0x40 FORMAT "%13.11" ECU_ADDRESS 0xD0000081 /end MEASUREMENT
/begin MEASUREMENT B_afkpvdpe "" UBYTE B_TRUE 1 100 0.00 1.00000000000 BIT_MASK 0x1 FORMAT "%13.11" ECU_ADDRESS 0xD0000BE0 /end MEASUREMENT
/begin MEASUREMENT B_amsndkoe "" UBYTE B_TRUE 1 100 0.00 1.00000000000 BIT_MASK 0x2 FORMAT "%13.11" ECU_ADDRESS 0xD000009A /end MEASUREMENT
/begin MEASUREMENT B_anfkwtp "" UBYTE B_TRUE 1 100 0.00 1.00000000000 BIT_MASK 0x1 FORMAT "%13.11" ECU_ADDRESS 0xD0000B9C /end MEASUREMENT
/begin MEASUREMENT B_aomsndpe "" UBYTE B_TRUE 1 100 0.00 1.00000000000 BIT_MASK 0x8 FORMAT "%13.11" ECU_ADDRESS 0xD0000BDF /end MEASUREMENT
/begin MEASUREMENT B_apslmds "" UBYTE B_TRUE 1 100 0.00 1.00000000000 BIT_MASK 0x20 FORMAT "%13.11" ECU_ADDRESS 0xD000007A /end MEASUREMENT
/begin MEASUREMENT B_apslmdse "" UBYTE B_TRUE 1 100 0.00 1.00000000000 BIT_MASK 0x1 FORMAT "%13.11" ECU_ADDRESS 0xD000005F /end MEASUREMENT
/begin MEASUREMENT B_atikatst "" UBYTE B_TRUE 1 100 0.00 1.00000000000 BIT_MASK 0x10 FORMAT "%13.11" ECU_ADDRESS 0xD0000020 /end MEASUREMENT
/begin MEASUREMENT B_atmng "" UBYTE B_TRUE 1 100 0.00 1.00000000000 BIT_MASK 0x10 FORMAT "%13.11" ECU_ADDRESS 0xD000007D /end MEASUREMENT
/begin MEASUREMENT B_bevab "" UBYTE B_TRUE 1 100 0.00 1.00000000000 BIT_MASK 0x1 FORMAT "%13.11" ECU_ADDRESS 0xD0000BD9 /end MEASUREMENT
/begin MEASUREMENT B_bsconch "" UBYTE B_TRUE 1 100 0.00 1.00000000000 BIT_MASK 0x80 FORMAT "%13.11" ECU_ADDRESS 0xD0000023 /end MEASUREMENT
/begin MEASUREMENT B_clcbh "" UBYTE B_TRUE 1 100 0.00 1.00000000000 BIT_MASK 0x2 FORMAT "%13.11" ECU_ADDRESS 0xD0000BD4 /end MEASUREMENT
/begin MEASUREMENT B_cwkhakt1 "" UBYTE B_TRUE 1 100 0.00 1.00000000000 BIT_MASK 0x40 FORMAT "%13.11" ECU_ADDRESS 0xD0000021 /end MEASUREMENT
/begin MEASUREMENT B_cwkhakt3 "" UBYTE B_TRUE 1 100 0.00 1.00000000000 BIT_MASK 0x4 FORMAT "%13.11" ECU_ADDRESS 0xD0000020 /end MEASUREMENT
/begin MEASUREMENT B_cwkhakt4 "" UBYTE B_TRUE 1 100 0.00 1.00000000000 BIT_MASK 0x80 FORMAT "%13.11" ECU_ADDRESS 0xD0000021 /end MEASUREMENT
/begin MEASUREMENT B_cwkhakt5 "" UBYTE B_TRUE 1 100 0.00 1.00000000000 BIT_MASK 0x1 FORMAT "%13.11" ECU_ADDRESS 0xD0000020 /end MEASUREMENT
/begin MEASUREMENT B_cwkhakt6 "" UBYTE B_TRUE 1 100 0.00 1.00000000000 BIT_MASK 0x8 FORMAT "%13.11" ECU_ADDRESS 0xD0000020 /end MEASUREMENT
/begin MEASUREMENT B_cwkhakw0 "" UBYTE B_TRUE 1 100 0.00 1.00000000000 BIT_MASK 0x8 FORMAT "%13.11" ECU_ADDRESS 0xD0000B9C /end MEASUREMENT
/begin MEASUREMENT B_delayhld "" UBYTE B_TRUE 1 100 0.00 1.00000000000 BIT_MASK 0x1 FORMAT "%13.11" ECU_ADDRESS 0xD0000BA7 /end MEASUREMENT
/begin MEASUREMENT B_dknolu "" UBYTE B_TRUE 1 100 0.00 1.00000000000 BIT_MASK 0x40 FORMAT "%13.11" ECU_ADDRESS 0xD000009A /end MEASUREMENT
/begin MEASUREMENT B_dkpiu "" UBYTE B_TRUE 1 100 0.00 1.00000000000 BIT_MASK 0x2 FORMAT "%13.11" ECU_ADDRESS 0xD0000064 /end MEASUREMENT
/begin MEASUREMENT B_dnsll "" UBYTE B_TRUE 1 100 0.00 1.00000000000 BIT_MASK 0x80 FORMAT "%13.11" ECU_ADDRESS 0xD0000024 /end MEASUREMENT
/begin MEASUREMENT B_dschlldk "" UBYTE B_TRUE 1 100 0.00 1.00000000000 BIT_MASK 0x4 FORMAT "%13.11" ECU_ADDRESS 0xD000007A /end MEASUREMENT
/begin MEASUREMENT B_dtevlb "" UBYTE B_TRUE 1 100 0.00 1.00000000000 BIT_MASK 0x4 FORMAT "%13.11" ECU_ADDRESS 0xD0000024 /end MEASUREMENT
/begin MEASUREMENT B_edpsrmn "" UBYTE B_TRUE 1 100 0.00 1.00000000000 BIT_MASK 0x4 FORMAT "%13.11" ECU_ADDRESS 0xD0000082 /end MEASUREMENT
/begin MEASUREMENT B_edpsrmx "" UBYTE B_TRUE 1 100 0.00 1.00000000000 BIT_MASK 0x20 FORMAT "%13.11" ECU_ADDRESS 0xD0000070 /end MEASUREMENT
/begin MEASUREMENT B_egwhs "" UBYTE B_TRUE 1 100 0.00 1.00000000000 BIT_MASK 0x10 FORMAT "%13.11" ECU_ADDRESS 0xD0000027 /end MEASUREMENT
/begin MEASUREMENT B_eks "" UBYTE B_TRUE 1 100 0.00 1.00000000000 BIT_MASK 0x1 FORMAT "%13.11" ECU_ADDRESS 0xD0000BA9 /end MEASUREMENT
/begin MEASUREMENT B_enbhtr "" UBYTE B_TRUE 1 100 0.00 1.00000000000 BIT_MASK 0x10 FORMAT "%13.11" ECU_ADDRESS 0xD0000BD7 /end MEASUREMENT
/begin MEASUREMENT B_engroads "" UBYTE B_TRUE 1 100 0.00 1.00000000000 BIT_MASK 0x1 FORMAT "%13.11" ECU_ADDRESS 0xAFE80154 /end MEASUREMENT
/begin MEASUREMENT B_engroold "" UBYTE B_TRUE 1 100 0.00 1.00000000000 BIT_MASK 0x40 FORMAT "%13.11" ECU_ADDRESS 0xD0000025 /end MEASUREMENT
/begin MEASUREMENT B_enlasfx "" UBYTE B_TRUE 1 100 0.00 1.00000000000 BIT_MASK 0x8 FORMAT "%13.11" ECU_ADDRESS 0xD0000024 /end MEASUREMENT
/begin MEASUREMENT B_enlashx "" UBYTE B_TRUE 1 100 0.00 1.00000000000 BIT_MASK 0x10 FORMAT "%13.11" ECU_ADDRESS 0xD0000024 /end MEASUREMENT
/begin MEASUREMENT B_ensad "" UBYTE B_TRUE 1 100 0.00 1.00000000000 BIT_MASK 0x80 FORMAT "%13.11" ECU_ADDRESS 0xD0000026 /end MEASUREMENT
/begin MEASUREMENT B_epsrsg "" UBYTE B_TRUE 1 100 0.00 1.00000000000 BIT_MASK 0x20 FORMAT "%13.11" ECU_ADDRESS 0xD000008C /end MEASUREMENT
/begin MEASUREMENT B_esdluts "" UBYTE B_TRUE 1 100 0.00 1.00000000000 BIT_MASK 0x40 FORMAT "%13.11" ECU_ADDRESS 0xD0000026 /end MEASUREMENT
/begin MEASUREMENT B_evakt "" UBYTE B_TRUE 1 100 0.00 1.00000000000 BIT_MASK 0x4 FORMAT "%13.11" ECU_ADDRESS 0xD0000BD9 /end MEASUREMENT
/begin MEASUREMENT B_evloc "" UBYTE B_TRUE 1 100 0.00 1.00000000000 BIT_MASK 0x8 FORMAT "%13.11" ECU_ADDRESS 0xD0000BD9 /end MEASUREMENT
/begin MEASUREMENT B_fadkoap "" UBYTE B_TRUE 1 100 0.00 1.00000000000 BIT_MASK 0x10 FORMAT "%13.11" ECU_ADDRESS 0xD0000BDF /end MEASUREMENT
/begin MEASUREMENT B_fgabgl "" UBYTE B_TRUE 1 100 0.00 1.00000000000 BIT_MASK 0x20 FORMAT "%13.11" ECU_ADDRESS 0xD0000061 /end MEASUREMENT
/begin MEASUREMENT B_fgabgla "" UBYTE B_TRUE 1 100 0.00 1.00000000000 BIT_MASK 0x80 FORMAT "%13.11" ECU_ADDRESS 0xD000007E /end MEASUREMENT
/begin MEASUREMENT B_fgabglp "" UBYTE B_TRUE 1 100 0.00 1.00000000000 BIT_MASK 0x80 FORMAT "%13.11" ECU_ADDRESS 0xD000005C /end MEASUREMENT
/begin MEASUREMENT B_fganfkw "" UBYTE B_TRUE 1 100 0.00 1.00000000000 BIT_MASK 0x2 FORMAT "%13.11" ECU_ADDRESS 0xD0000B9C /end MEASUREMENT
/begin MEASUREMENT B_fgfnpps "" UBYTE B_TRUE 1 100 0.00 1.00000000000 BIT_MASK 0x80 FORMAT "%13.11" ECU_ADDRESS 0xD0000054 /end MEASUREMENT
/begin MEASUREMENT B_fgsabglp "" UBYTE B_TRUE 1 100 0.00 1.00000000000 BIT_MASK 0x80 FORMAT "%13.11" ECU_ADDRESS 0xD0000096 /end MEASUREMENT
/begin MEASUREMENT B_fkpvdk "" UBYTE B_TRUE 1 100 0.00 1.00000000000 BIT_MASK 0x20 FORMAT "%13.11" ECU_ADDRESS 0xD0000BDF /end MEASUREMENT
/begin MEASUREMENT B_fkpvdkp "" UBYTE B_TRUE 1 100 0.00 1.00000000000 BIT_MASK 0x8 FORMAT "%13.11" ECU_ADDRESS 0xD0000063 /end MEASUREMENT
/begin MEASUREMENT B_gangi "" UBYTE B_TRUE 1 100 0.00 1.00000000000 BIT_MASK 0x1 FORMAT "%13.11" ECU_ADDRESS 0xD0000024 /end MEASUREMENT
/begin MEASUREMENT B_gawec "" UBYTE B_TRUE 1 100 0.00 1.00000000000 BIT_MASK 0x40 FORMAT "%13.11" ECU_ADDRESS 0xD000006E /end MEASUREMENT
/begin MEASUREMENT B_gwhs "" UBYTE B_TRUE 1 100 0.00 1.00000000000 BIT_MASK 0x2 FORMAT "%13.11" ECU_ADDRESS 0xD000009C /end MEASUREMENT
/begin MEASUREMENT B_hedpsr "" UBYTE B_TRUE 1 100 0.00 1.00000000000 BIT_MASK 0x10 FORMAT "%13.11" ECU_ADDRESS 0xD0000097 /end MEASUREMENT
/begin MEASUREMENT B_hepsrsg "" UBYTE B_TRUE 1 100 0.00 1.00000000000 BIT_MASK 0x4 FORMAT "%13.11" ECU_ADDRESS 0xD0000097 /end MEASUREMENT
/begin MEASUREMENT B_hkleer "" UBYTE B_TRUE 1 100 0.00 1.00000000000 BIT_MASK 0x10 FORMAT "%13.11" ECU_ADDRESS 0xD0000BE4 /end MEASUREMENT
/begin MEASUREMENT B_hkvoll "" UBYTE B_TRUE 1 100 0.00 1.00000000000 BIT_MASK 0x40 FORMAT "%13.11" ECU_ADDRESS 0xD0000BE4 /end MEASUREMENT
/begin MEASUREMENT B_hpnmot "" UBYTE B_TRUE 1 100 0.00 1.00000000000 BIT_MASK 0x40 FORMAT "%13.11" ECU_ADDRESS 0xD0000027 /end MEASUREMENT
/begin MEASUREMENT B_inhbadst "" UBYTE B_TRUE 1 100 0.00 1.00000000000 BIT_MASK 0x1 FORMAT "%13.11" ECU_ADDRESS 0xD0000026 /end MEASUREMENT
/begin MEASUREMENT B_inhengro "" UBYTE B_TRUE 1 100 0.00 1.00000000000 BIT_MASK 0x2 FORMAT "%13.11" ECU_ADDRESS 0xD0000026 /end MEASUREMENT
/begin MEASUREMENT B_inhronu "" UBYTE B_TRUE 1 100 0.00 1.00000000000 BIT_MASK 0x4 FORMAT "%13.11" ECU_ADDRESS 0xD0000026 /end MEASUREMENT
/begin MEASUREMENT B_iniabga "" UBYTE B_TRUE 1 100 0.00 1.00000000000 BIT_MASK 0x80 FORMAT "%13.11" ECU_ADDRESS 0xD0000078 /end MEASUREMENT
/begin MEASUREMENT B_inilabgp "" UBYTE B_TRUE 1 100 0.00 1.00000000000 BIT_MASK 0x4 FORMAT "%13.11" ECU_ADDRESS 0xD0000094 /end MEASUREMENT
/begin MEASUREMENT B_inisabgp "" UBYTE B_TRUE 1 100 0.00 1.00000000000 BIT_MASK 0x80 FORMAT "%13.11" ECU_ADDRESS 0xD0000BDE /end MEASUREMENT
/begin MEASUREMENT B_i_ska_fr "" UBYTE B_TRUE 1 100 0.00 1.00000000000 BIT_MASK 0x2 FORMAT "%13.11" ECU_ADDRESS 0xD0000094 /end MEASUREMENT
/begin MEASUREMENT B_kd "" UBYTE B_TRUE 1 100 0.00 1.00000000000 BIT_MASK 0x2 FORMAT "%13.11" ECU_ADDRESS 0xD0000065 /end MEASUREMENT
/begin MEASUREMENT B_kh "" UBYTE B_TRUE 1 100 0.00 1.00000000000 BIT_MASK 0x40 FORMAT "%13.11" ECU_ADDRESS 0xD000008E /end MEASUREMENT
/begin MEASUREMENT B_kha "" UBYTE B_TRUE 1 100 0.00 1.00000000000 BIT_MASK 0x80 FORMAT "%13.11" ECU_ADDRESS 0xD0000058 /end MEASUREMENT
/begin MEASUREMENT B_khabbslv "" UBYTE B_TRUE 1 100 0.00 1.00000000000 BIT_MASK 0x80 FORMAT "%13.11" ECU_ADDRESS 0xD0000020 /end MEASUREMENT
/begin MEASUREMENT B_khabiml "" UBYTE B_TRUE 1 100 0.00 1.00000000000 BIT_MASK 0x4 FORMAT "%13.11" ECU_ADDRESS 0xD0000021 /end MEASUREMENT
/begin MEASUREMENT B_khabll "" UBYTE B_TRUE 1 100 0.00 1.00000000000 BIT_MASK 0x2 FORMAT "%13.11" ECU_ADDRESS 0xD0000021 /end MEASUREMENT
/begin MEASUREMENT B_khabtkh "" UBYTE B_TRUE 1 100 0.00 1.00000000000 BIT_MASK 0x1 FORMAT "%13.11" ECU_ADDRESS 0xD0000021 /end MEASUREMENT
/begin MEASUREMENT B_khakt "" UBYTE B_TRUE 1 100 0.00 1.00000000000 BIT_MASK 0x10 FORMAT "%13.11" ECU_ADDRESS 0xD0000088 /end MEASUREMENT
/begin MEASUREMENT B_khaktini "" UBYTE B_TRUE 1 100 0.00 1.00000000000 BIT_MASK 0x20 FORMAT "%13.11" ECU_ADDRESS 0xD0000020 /end MEASUREMENT
/begin MEASUREMENT B_khaktres "" UBYTE B_TRUE 1 100 0.00 1.00000000000 BIT_MASK 0x10 FORMAT "%13.11" ECU_ADDRESS 0xD0000021 /end MEASUREMENT
/begin MEASUREMENT B_khaktst "" UBYTE B_TRUE 1 100 0.00 1.00000000000 BIT_MASK 0x40 FORMAT "%13.11" ECU_ADDRESS 0xD0000020 /end MEASUREMENT
/begin MEASUREMENT B_khakw "" UBYTE B_TRUE 1 100 0.00 1.00000000000 BIT_MASK 0x1 FORMAT "%13.11" ECU_ADDRESS 0xD0000B9D /end MEASUREMENT
/begin MEASUREMENT B_khan "" UBYTE B_TRUE 1 100 0.00 1.00000000000 BIT_MASK 0x80 FORMAT "%13.11" ECU_ADDRESS 0xD000006C /end MEASUREMENT
/begin MEASUREMENT B_khatrip "" UBYTE B_TRUE 1 100 0.00 1.00000000000 BIT_MASK 0x2 FORMAT "%13.11" ECU_ADDRESS 0xD0000057 /end MEASUREMENT
/begin MEASUREMENT B_kherr "" UBYTE B_TRUE 1 100 0.00 1.00000000000 BIT_MASK 0x2 FORMAT "%13.11" ECU_ADDRESS 0xD0000020 /end MEASUREMENT
/begin MEASUREMENT B_khmr "" UBYTE B_TRUE 1 100 0.00 1.00000000000 BIT_MASK 0x8 FORMAT "%13.11" ECU_ADDRESS 0xD0000088 /end MEASUREMENT
/begin MEASUREMENT B_khstc "" UBYTE B_TRUE 1 100 0.00 1.00000000000 BIT_MASK 0x1 FORMAT "%13.11" ECU_ADDRESS 0xD0000022 /end MEASUREMENT
/begin MEASUREMENT B_khtumg "" UBYTE B_TRUE 1 100 0.00 1.00000000000 BIT_MASK 0x2 FORMAT "%13.11" ECU_ADDRESS 0xD0000022 /end MEASUREMENT
/begin MEASUREMENT B_khtumres "" UBYTE B_TRUE 1 100 0.00 1.00000000000 BIT_MASK 0x8 FORMAT "%13.11" ECU_ADDRESS 0xD0000021 /end MEASUREMENT
/begin MEASUREMENT B_kr "" UBYTE B_TRUE 1 100 0.00 1.00000000000 BIT_MASK 0x80 FORMAT "%13.11" ECU_ADDRESS 0xD0000069 /end MEASUREMENT
/begin MEASUREMENT B_kra "" UBYTE B_TRUE 1 100 0.00 1.00000000000 BIT_MASK 0x10 FORMAT "%13.11" ECU_ADDRESS 0xD0000073 /end MEASUREMENT
/begin MEASUREMENT B_kradap "" UBYTE B_TRUE 1 100 0.00 1.00000000000 BIT_MASK 0x4 FORMAT "%13.11" ECU_ADDRESS 0xD0000080 /end MEASUREMENT
/begin MEASUREMENT B_kraftsch "" UBYTE B_TRUE 1 100 0.00 1.00000000000 BIT_MASK 0x20 FORMAT "%13.11" ECU_ADDRESS 0xD0000071 /end MEASUREMENT
/begin MEASUREMENT B_krdws "" UBYTE B_TRUE 1 100 0.00 1.00000000000 BIT_MASK 0x1 FORMAT "%13.11" ECU_ADDRESS 0xD0000BBD /end MEASUREMENT
/begin MEASUREMENT B_krdyaen "" UBYTE B_TRUE 1 100 0.00 1.00000000000 BIT_MASK 0x8 FORMAT "%13.11" ECU_ADDRESS 0xD0000099 /end MEASUREMENT
/begin MEASUREMENT B_krenfadi "" UBYTE B_TRUE 1 100 0.00 1.00000000000 BIT_MASK 0x2 FORMAT "%13.11" ECU_ADDRESS 0xD0000024 /end MEASUREMENT
/begin MEASUREMENT B_krfdks "" UBYTE B_TRUE 1 100 0.00 1.00000000000 BIT_MASK 0x2 FORMAT "%13.11" ECU_ADDRESS 0xD0000BBD /end MEASUREMENT
/begin MEASUREMENT B_krgz "" UBYTE B_TRUE 1 100 0.00 1.00000000000 BIT_MASK 0x2 FORMAT "%13.11" ECU_ADDRESS 0xD000005E /end MEASUREMENT
/begin MEASUREMENT B_krkez "" UBYTE B_TRUE 1 100 0.00 1.00000000000 BIT_MASK 0x2 FORMAT "%13.11" ECU_ADDRESS 0xD0000063 /end MEASUREMENT
/begin MEASUREMENT B_krldy "" UBYTE B_TRUE 1 100 0.00 1.00000000000 BIT_MASK 0x80 FORMAT "%13.11" ECU_ADDRESS 0xD0000062 /end MEASUREMENT
/begin MEASUREMENT B_krldya "" UBYTE B_TRUE 1 100 0.00 1.00000000000 BIT_MASK 0x10 FORMAT "%13.11" ECU_ADDRESS 0xD0000062 /end MEASUREMENT
/begin MEASUREMENT B_krldyf "" UBYTE B_TRUE 1 100 0.00 1.00000000000 BIT_MASK 0x1 FORMAT "%13.11" ECU_ADDRESS 0xD0000094 /end MEASUREMENT
/begin MEASUREMENT B_krldyv "" UBYTE B_TRUE 1 100 0.00 1.00000000000 BIT_MASK 0x8 FORMAT "%13.11" ECU_ADDRESS 0xD0000082 /end MEASUREMENT
/begin MEASUREMENT B_krndy "" UBYTE B_TRUE 1 100 0.00 1.00000000000 BIT_MASK 0x8 FORMAT "%13.11" ECU_ADDRESS 0xD0000092 /end MEASUREMENT
/begin MEASUREMENT B_krnl "" UBYTE B_TRUE 1 100 0.00 1.00000000000 BIT_MASK 0x4 FORMAT "%13.11" ECU_ADDRESS 0xD0000BBD /end MEASUREMENT
/begin MEASUREMENT B_krsyne "" UBYTE B_TRUE 1 100 0.00 1.00000000000 BIT_MASK 0x2 FORMAT "%13.11" ECU_ADDRESS 0xD0000BA9 /end MEASUREMENT
/begin MEASUREMENT B_kw "" UBYTE B_TRUE 1 100 0.00 1.00000000000 BIT_MASK 0x2 FORMAT "%13.11" ECU_ADDRESS 0xD0000B9D /end MEASUREMENT
/begin MEASUREMENT B_ladap "" UBYTE B_TRUE 1 100 0.00 1.00000000000 BIT_MASK 0x1 FORMAT "%13.11" ECU_ADDRESS 0xD0000BBC /end MEASUREMENT
/begin MEASUREMENT B_lamfa "" UBYTE B_TRUE 1 100 0.00 1.00000000000 BIT_MASK 0x20 FORMAT "%13.11" ECU_ADDRESS 0xD0000088 /end MEASUREMENT
/begin MEASUREMENT B_lamfas "" UBYTE B_TRUE 1 100 0.00 1.00000000000 BIT_MASK 0x1 FORMAT "%13.11" ECU_ADDRESS 0xD0000BDC /end MEASUREMENT
/begin MEASUREMENT B_lcpwfatm "" UBYTE B_TRUE 1 100 0.00 1.00000000000 BIT_MASK 0x1 FORMAT "%13.11" ECU_ADDRESS 0xAFE80153 /end MEASUREMENT
/begin MEASUREMENT B_lzsrhfmp "" UBYTE B_TRUE 1 100 0.00 1.00000000000 BIT_MASK 0x2 FORMAT "%13.11" ECU_ADDRESS 0xD0000027 /end MEASUREMENT
/begin MEASUREMENT B_nbhtr "" UBYTE B_TRUE 1 100 0.00 1.00000000000 BIT_MASK 0x1 FORMAT "%13.11" ECU_ADDRESS 0xD0000BD7 /end MEASUREMENT
/begin MEASUREMENT B_nibhtr "" UBYTE B_TRUE 1 100 0.00 1.00000000000 BIT_MASK 0x2 FORMAT "%13.11" ECU_ADDRESS 0xD0000BD7 /end MEASUREMENT
/begin MEASUREMENT B_nsad "" UBYTE B_TRUE 1 100 0.00 1.00000000000 BIT_MASK 0x1 FORMAT "%13.11" ECU_ADDRESS 0xD000008B /end MEASUREMENT
/begin MEASUREMENT B_nsadend "" UBYTE B_TRUE 1 100 0.00 1.00000000000 BIT_MASK 0x8 FORMAT "%13.11" ECU_ADDRESS 0xD0000086 /end MEASUREMENT
/begin MEASUREMENT B_nsadh "" UBYTE B_TRUE 1 100 0.00 1.00000000000 BIT_MASK 0x1 FORMAT "%13.11" ECU_ADDRESS 0xD0000099 /end MEASUREMENT
/begin MEASUREMENT B_nsadstp "" UBYTE B_TRUE 1 100 0.00 1.00000000000 BIT_MASK 0x10 FORMAT "%13.11" ECU_ADDRESS 0xD0000026 /end MEASUREMENT
/begin MEASUREMENT B_ofmsndk "" UBYTE B_TRUE 1 100 0.00 1.00000000000 BIT_MASK 0x80 FORMAT "%13.11" ECU_ADDRESS 0xD0000BDF /end MEASUREMENT
/begin MEASUREMENT B_ofmsndkp "" UBYTE B_TRUE 1 100 0.00 1.00000000000 BIT_MASK 0x4 FORMAT "%13.11" ECU_ADDRESS 0xD0000BE0 /end MEASUREMENT
/begin MEASUREMENT B_overrun "" UBYTE B_TRUE 1 100 0.00 1.00000000000 BIT_MASK 0x1 FORMAT "%13.11" ECU_ADDRESS 0xD0000027 /end MEASUREMENT
/begin MEASUREMENT B_oxrsthk "" UBYTE B_TRUE 1 100 0.00 1.00000000000 BIT_MASK 0x10 FORMAT "%13.11" ECU_ADDRESS 0xD0000BE2 /end MEASUREMENT
/begin MEASUREMENT B_pnbhtr "" UBYTE B_TRUE 1 100 0.00 1.00000000000 BIT_MASK 0x1 FORMAT "%13.11" ECU_ADDRESS 0xD0000BD4 /end MEASUREMENT
/begin MEASUREMENT B_psinlapu "" UBYTE B_TRUE 1 100 0.00 1.00000000000 BIT_MASK 0x1 FORMAT "%13.11" ECU_ADDRESS 0xAFE80156 /end MEASUREMENT
/begin MEASUREMENT B_pwgnotfr "" UBYTE B_TRUE 1 100 0.00 1.00000000000 BIT_MASK 0x20 FORMAT "%13.11" ECU_ADDRESS 0xD0000081 /end MEASUREMENT
/begin MEASUREMENT B_sab "" UBYTE B_TRUE 1 100 0.00 1.00000000000 BIT_MASK 0x1 FORMAT "%13.11" ECU_ADDRESS 0xD0000054 /end MEASUREMENT
/begin MEASUREMENT B_sabte "" UBYTE B_TRUE 1 100 0.00 1.00000000000 BIT_MASK 0x10 FORMAT "%13.11" ECU_ADDRESS 0xD0000072 /end MEASUREMENT
/begin MEASUREMENT B_sabvor "" UBYTE B_TRUE 1 100 0.00 1.00000000000 BIT_MASK 0x10 FORMAT "%13.11" ECU_ADDRESS 0xD000006F /end MEASUREMENT
/begin MEASUREMENT B_saen "" UBYTE B_TRUE 1 100 0.00 1.00000000000 BIT_MASK 0x40 FORMAT "%13.11" ECU_ADDRESS 0xD0000024 /end MEASUREMENT
/begin MEASUREMENT B_sccnsad "" UBYTE B_TRUE 1 100 0.00 1.00000000000 BIT_MASK 0x4 FORMAT "%13.11" ECU_ADDRESS 0xD0000025 /end MEASUREMENT
/begin MEASUREMENT B_sccnsad2 "" UBYTE B_TRUE 1 100 0.00 1.00000000000 BIT_MASK 0x8 FORMAT "%13.11" ECU_ADDRESS 0xD0000025 /end MEASUREMENT
/begin MEASUREMENT B_schlke "" UBYTE B_TRUE 1 100 0.00 1.00000000000 BIT_MASK 0x20 FORMAT "%13.11" ECU_ADDRESS 0xD0000027 /end MEASUREMENT
/begin MEASUREMENT B_sdluts "" UBYTE B_TRUE 1 100 0.00 1.00000000000 BIT_MASK 0x8 FORMAT "%13.11" ECU_ADDRESS 0xD0000058 /end MEASUREMENT
/begin MEASUREMENT B_sdlutsr "" UBYTE B_TRUE 1 100 0.00 1.00000000000 BIT_MASK 0x4 FORMAT "%13.11" ECU_ADDRESS 0xD000009D /end MEASUREMENT
/begin MEASUREMENT B_st "" UBYTE B_TRUE 1 100 0.00 1.00000000000 BIT_MASK 0x8 FORMAT "%13.11" ECU_ADDRESS 0xD000005A /end MEASUREMENT
/begin MEASUREMENT B_staclr "" UBYTE B_TRUE 1 100 0.00 1.00000000000 BIT_MASK 0x20 FORMAT "%13.11" ECU_ADDRESS 0xD0000092 /end MEASUREMENT
/begin MEASUREMENT B_staneut "" UBYTE B_TRUE 1 100 0.00 1.00000000000 BIT_MASK 0x2 FORMAT "%13.11" ECU_ADDRESS 0xD0000073 /end MEASUREMENT
/begin MEASUREMENT B_stanodec "" UBYTE B_TRUE 1 100 0.00 1.00000000000 BIT_MASK 0x1 FORMAT "%13.11" ECU_ADDRESS 0xD0000071 /end MEASUREMENT
/begin MEASUREMENT B_stanoinc "" UBYTE B_TRUE 1 100 0.00 1.00000000000 BIT_MASK 0x4 FORMAT "%13.11" ECU_ADDRESS 0xD0000060 /end MEASUREMENT
/begin MEASUREMENT B_stanosav "" UBYTE B_TRUE 1 100 0.00 1.00000000000 BIT_MASK 0x80 FORMAT "%13.11" ECU_ADDRESS 0xD0000085 /end MEASUREMENT
/begin MEASUREMENT B_stend "" UBYTE B_TRUE 1 100 0.00 1.00000000000 BIT_MASK 0x10 FORMAT "%13.11" ECU_ADDRESS 0xD0000060 /end MEASUREMENT
/begin MEASUREMENT B_stendes "" UBYTE B_TRUE 1 100 0.00 1.00000000000 BIT_MASK 0x1 FORMAT "%13.11" ECU_ADDRESS 0xD0000084 /end MEASUREMENT
/begin MEASUREMENT B_stendll "" UBYTE B_TRUE 1 100 0.00 1.00000000000 BIT_MASK 0x8 FORMAT "%13.11" ECU_ADDRESS 0xD0000072 /end MEASUREMENT
/begin MEASUREMENT B_stendmd "" UBYTE B_TRUE 1 100 0.00 1.00000000000 BIT_MASK 0x20 FORMAT "%13.11" ECU_ADDRESS 0xD0000084 /end MEASUREMENT
/begin MEASUREMENT B_stendz "" UBYTE B_TRUE 1 100 0.00 1.00000000000 BIT_MASK 0x1 FORMAT "%13.11" ECU_ADDRESS 0xD000009B /end MEASUREMENT
/begin MEASUREMENT B_stendzw "" UBYTE B_TRUE 1 100 0.00 1.00000000000 BIT_MASK 0x20 FORMAT "%13.11" ECU_ADDRESS 0xD0000079 /end MEASUREMENT
/begin MEASUREMENT B_tipin "" UBYTE B_TRUE 1 100 0.00 1.00000000000 BIT_MASK 0x2 FORMAT "%13.11" ECU_ADDRESS 0xD0000BBC /end MEASUREMENT
/begin MEASUREMENT B_tmkr "" UBYTE B_TRUE 1 100 0.00 1.00000000000 BIT_MASK 0x8 FORMAT "%13.11" ECU_ADDRESS 0xD0000BBD /end MEASUREMENT
/begin MEASUREMENT B_tmmn "" UBYTE B_TRUE 1 100 0.00 1.00000000000 BIT_MASK 0x4 FORMAT "%13.11" ECU_ADDRESS 0xD0000BD7 /end MEASUREMENT
/begin MEASUREMENT B_tmsrt "" UBYTE B_TRUE 1 100 0.00 1.00000000000 BIT_MASK 0x8 FORMAT "%13.11" ECU_ADDRESS 0xD0000BD7 /end MEASUREMENT
/begin MEASUREMENT B_tnsezmkg "" UBYTE B_TRUE 1 100 0.00 1.00000000000 BIT_MASK 0x1 FORMAT "%13.11" ECU_ADDRESS 0xAFE80155 /end MEASUREMENT
/begin MEASUREMENT B_totastd "" UBYTE B_TRUE 1 100 0.00 1.00000000000 BIT_MASK 0x10 FORMAT "%13.11" ECU_ADDRESS 0xD0000023 /end MEASUREMENT
/begin MEASUREMENT B_tpnmot "" UBYTE B_TRUE 1 100 0.00 1.00000000000 BIT_MASK 0x80 FORMAT "%13.11" ECU_ADDRESS 0xD0000027 /end MEASUREMENT
/begin MEASUREMENT B_trkh "" UBYTE B_TRUE 1 100 0.00 1.00000000000 BIT_MASK 0x40 FORMAT "%13.11" ECU_ADDRESS 0xD0000085 /end MEASUREMENT
/begin MEASUREMENT B_trkonz "" UBYTE B_TRUE 1 100 0.00 1.00000000000 BIT_MASK 0x80 FORMAT "%13.11" ECU_ADDRESS 0xD0000091 /end MEASUREMENT
/begin MEASUREMENT B_trkz "" UBYTE B_TRUE 1 100 0.00 1.00000000000 BIT_MASK 0x20 FORMAT "%13.11" ECU_ADDRESS 0xD0000021 /end MEASUREMENT
/begin MEASUREMENT B_tvsagng2 "" UBYTE B_TRUE 1 100 0.00 1.00000000000 BIT_MASK 0x20 FORMAT "%13.11" ECU_ADDRESS 0xD0000024 /end MEASUREMENT
/begin MEASUREMENT B_ubkst "" UBYTE B_TRUE 1 100 0.00 1.00000000000 BIT_MASK 0x20 FORMAT "%13.11" ECU_ADDRESS 0xD0000025 /end MEASUREMENT
/begin MEASUREMENT B_wkral "" UBYTE B_TRUE 1 100 0.00 1.00000000000 BIT_MASK 0x4 FORMAT "%13.11" ECU_ADDRESS 0xD0000BBC /end MEASUREMENT
/begin MEASUREMENT B_zwfdka "" UBYTE B_TRUE 1 100 0.00 1.00000000000 BIT_MASK 0x10 FORMAT "%13.11" ECU_ADDRESS 0xD0000078 /end MEASUREMENT
/begin MEASUREMENT B_zwkraa "" UBYTE B_TRUE 1 100 0.00 1.00000000000 BIT_MASK 0x1 FORMAT "%13.11" ECU_ADDRESS 0xD0000068 /end MEASUREMENT
/begin MEASUREMENT B_zwkrum "" UBYTE B_TRUE 1 100 0.00 1.00000000000 BIT_MASK 0x2 FORMAT "%13.11" ECU_ADDRESS 0xD0000085 /end MEASUREMENT
/begin MEASUREMENT catbrctr "" UBYTE dez 1 100 0.00 255.0 FORMAT "%5.1" ECU_ADDRESS 0xD0000B85 /end MEASUREMENT
/begin MEASUREMENT censad "" UBYTE dez 1 100 0.00 255.0 FORMAT "%5.1" ECU_ADDRESS 0xD0000BCA /end MEASUREMENT
/begin MEASUREMENT cesdluts "" UBYTE dez 1 100 0.00 255.0 FORMAT "%5.1" ECU_ADDRESS 0xD0000BCB /end MEASUREMENT
/begin MEASUREMENT cesdlutsr "" UBYTE dez 1 100 0.00 255.0 FORMAT "%5.1" ECU_ADDRESS 0xD0000BCC /end MEASUREMENT
/begin MEASUREMENT clutwmen_w "" UWORD dez 1 100 0.00 65535.00 FORMAT "%8.2" ECU_ADDRESS 0xD0000178 /end MEASUREMENT
/begin MEASUREMENT clutwm_w "" UWORD dez 1 100 0.00 65535.00 FORMAT "%8.2" ECU_ADDRESS 0xD000017A /end MEASUREMENT
/begin MEASUREMENT coxinhk_w "" SWORD fak_sw_b8 1 100 -8.000000 7.999756 FORMAT "%8.6" ECU_ADDRESS 0xD0000212 /end MEASUREMENT
/begin MEASUREMENT cycbgkv_w "" UWORD t_q12p2us 1 100 0.00 799985.7 FORMAT "%8.1" ECU_ADDRESS 0xD00001B6 /end MEASUREMENT
/begin MEASUREMENT dfuelanp_w "" SWORD fak_sw_b1 1 100 -1.000000 0.9999695 FORMAT "%8.6" ECU_ADDRESS 0xD000019C /end MEASUREMENT
/begin MEASUREMENT dfuelsan_w "" SWORD fak_sw_b1 1 100 -1.000000 0.9999695 FORMAT "%8.6" ECU_ADDRESS 0xD000019E /end MEASUREMENT
/begin MEASUREMENT dkpsrmh_w "" SWORD p_sw_q0p078 1 100 -2560.000 2559.922 FORMAT "%8.3" ECU_ADDRESS 0xD00001A0 /end MEASUREMENT
/begin MEASUREMENT dkrpssol "" SBYTE p_q10 1 100 -1280. 1270. FORMAT "%5.0" ECU_ADDRESS 0xD0000BBE /end MEASUREMENT
/begin MEASUREMENT dnmns_w "" UWORD nmot_uw_q0p25 1 100 0.00 16383.75 FORMAT "%8.2" ECU_ADDRESS 0xD0000146 /end MEASUREMENT
/begin MEASUREMENT dnsa "" UBYTE nmot_ub_q40 1 100 0.00 10200. FORMAT "%5.0" ECU_ADDRESS 0xD0000BC2 /end MEASUREMENT
/begin MEASUREMENT dtakr_w "" SWORD temp_q0p0468 1 100 -1536.000 1535.953 FORMAT "%8.3" ECU_ADDRESS 0xD00000BA /end MEASUREMENT
/begin MEASUREMENT dtreaka_w "" SWORD temp_q0p0234 1 100 -768.0000 767.9766 FORMAT "%8.4" ARRAY_SIZE 4 ECU_ADDRESS 0xD00000BC /end MEASUREMENT
/begin MEASUREMENT dwped "" SBYTE rel_q0p39 1 100 -50.00 49.61 FORMAT "%5.2" ECU_ADDRESS 0xD0000B82 /end MEASUREMENT
/begin MEASUREMENT dwped_w "" SWORD rel_sw_b50 1 100 -50.00000 49.99847 FORMAT "%8.5" ECU_ADDRESS 0xD00000B4 /end MEASUREMENT
/begin MEASUREMENT dyespfv "" SBYTE p_q10 1 100 -1280. 1270. FORMAT "%5.0" ECU_ADDRESS 0xD0000BB0 /end MEASUREMENT
/begin MEASUREMENT dyespof "" SBYTE p_q10 1 100 -1280. 1270. FORMAT "%5.0" ECU_ADDRESS 0xD0000BB1 /end MEASUREMENT
/begin MEASUREMENT ESS_rLdAlt "" SWORD DtyCyc 1 100 -327.6800 327.6700 FORMAT "%8.4" ECU_ADDRESS 0xD00034D2 /end MEASUREMENT
/begin MEASUREMENT ESS_uBatt "" SWORD Volt_Batt 1 100 -655360.0 655340.0 FORMAT "%8.1" ECU_ADDRESS 0xD00034D8 /end MEASUREMENT
/begin MEASUREMENT etazwimt "" UBYTE rel_ub_b127p5 1 100 0.00 127.5 FORMAT "%5.1" ECU_ADDRESS 0xD0000B88 /end MEASUREMENT
/begin MEASUREMENT evz_ausold "" UBYTE dez 1 100 0.00 255.0 FORMAT "%5.1" ECU_ADDRESS 0xD0000BD8 /end MEASUREMENT
/begin MEASUREMENT exofbr "" UBYTE fak_ub_b2 1 100 0.00 1.992188 FORMAT "%8.6" ECU_ADDRESS 0xD0000B86 /end MEASUREMENT
/begin MEASUREMENT fanfkwth_w "" UWORD fak_uw_b2 1 100 0.00 1.999969 FORMAT "%8.6" ECU_ADDRESS 0xD0000160 /end MEASUREMENT
/begin MEASUREMENT fanfkw_w "" UWORD fak_uw_b2 1 100 0.00 1.999969 FORMAT "%8.6" ECU_ADDRESS 0xD000016C /end MEASUREMENT
/begin MEASUREMENT fcosawkt_w "" UWORD fak_uw_b2 1 100 0.00 1.999969 FORMAT "%8.6" ECU_ADDRESS 0xD000014E /end MEASUREMENT
/begin MEASUREMENT fetakhllfa "" UBYTE fak_ub_b2 1 100 0.00 1.992188 FORMAT "%8.6" ECU_ADDRESS 0xD0000B8F /end MEASUREMENT
/begin MEASUREMENT fetakhtlfa "" UBYTE fak_ub_b2 1 100 0.00 1.992188 FORMAT "%8.6" ECU_ADDRESS 0xD0000B90 /end MEASUREMENT
/begin MEASUREMENT fkhab "" UBYTE fak_ub_b1 1 100 0.00 0.9961 ECU_ADDRESS 0xD0000B9B /end MEASUREMENT
/begin MEASUREMENT fkmsdkh_w "" UWORD fak_q6p1035Em5 1 100 0.00 3.999939 FORMAT "%8.6" ECU_ADDRESS 0xD00001A2 /end MEASUREMENT
/begin MEASUREMENT fkmsdkp_w "" UWORD fak_q6p1035Em5 1 100 0.00 3.999939 FORMAT "%8.6" ECU_ADDRESS 0xD00001A4 /end MEASUREMENT
/begin MEASUREMENT fkmsdksp_w "" UWORD fak_q6p1035Em5 1 100 0.00 3.999939 FORMAT "%8.6" ECU_ADDRESS 0xD00001A6 /end MEASUREMENT
/begin MEASUREMENT fkmsdks_w "" UWORD fak_q6p1035Em5 1 100 0.00 3.999939 FORMAT "%8.6" ECU_ADDRESS 0xD00001A8 /end MEASUREMENT
/begin MEASUREMENT fkmsdk_w "" UWORD fak_q6p1035Em5 1 100 0.00 3.999939 FORMAT "%8.6" ECU_ADDRESS 0xD00001AA /end MEASUREMENT
/begin MEASUREMENT fkpvdkah_w "" UWORD fak_q6p1035Em5 1 100 0.00 3.999939 FORMAT "%8.6" ECU_ADDRESS 0xAFE80042 /end MEASUREMENT
/begin MEASUREMENT fkpvdkap_w "" UWORD fak_q6p1035Em5 1 100 0.00 3.999939 FORMAT "%8.6" ECU_ADDRESS 0xAFE80044 /end MEASUREMENT
/begin MEASUREMENT fkpvdkh_w "" UWORD fak_q6p1035Em5 1 100 0.00 3.999939 FORMAT "%8.6" ECU_ADDRESS 0xAFE80046 /end MEASUREMENT
/begin MEASUREMENT fkpvdkp_w "" UWORD fak_q6p1035Em5 1 100 0.00 3.999939 FORMAT "%8.6" ECU_ADDRESS 0xAFE8004E /end MEASUREMENT
/begin MEASUREMENT fkpvdk_w "" UWORD fak_q6p1035Em5 1 100 0.00 3.999939 FORMAT "%8.6" ECU_ADDRESS 0xD00001AC /end MEASUREMENT
/begin MEASUREMENT flakh "" UBYTE fak_ub_b1 1 100 0.00 0.9961 ECU_ADDRESS 0xD0000BA0 /end MEASUREMENT
/begin MEASUREMENT flakhvab "" UBYTE fak_ub_b1 1 100 0.00 0.9961 ECU_ADDRESS 0xD0000B9E /end MEASUREMENT
/begin MEASUREMENT flbkhakt "" UBYTE fak_ub_b1 1 100 0.00 0.9961 ECU_ADDRESS 0xD0000B9F /end MEASUREMENT
/begin MEASUREMENT flbkkh "" UBYTE fak_ub_b1 1 100 0.00 0.9961 ECU_ADDRESS 0xD0000BA1 /end MEASUREMENT
/begin MEASUREMENT fnwkha "" UBYTE fak_ub_b2 1 100 0.00 1.992188 FORMAT "%8.6" ECU_ADDRESS 0xD0000BA2 /end MEASUREMENT
/begin MEASUREMENT fnwkhe "" UBYTE fak_ub_b2 1 100 0.00 1.992188 FORMAT "%8.6" ECU_ADDRESS 0xD0000BA3 /end MEASUREMENT
/begin MEASUREMENT fvapskstaa "" UBYTE fak_ub_b2 1 100 0.00 1.992188 FORMAT "%8.6" ECU_ADDRESS 0xD0000BCD /end MEASUREMENT
/begin MEASUREMENT gangi "" UBYTE dez 1 100 0.00 255.0 FORMAT "%5.1" ECU_ADDRESS 0xD0000B92 /end MEASUREMENT
/begin MEASUREMENT gangi1 "" UBYTE dez 1 100 0.00 255.0 FORMAT "%5.1" ECU_ADDRESS 0xD0000B91 /end MEASUREMENT
/begin MEASUREMENT gangist "" UBYTE dez 1 100 0.00 255.0 FORMAT "%5.1" ECU_ADDRESS 0xD0000B93 /end MEASUREMENT
/begin MEASUREMENT gangsist "" SBYTE dez 1 100 -128.0 127.0 FORMAT "%5.1" ECU_ADDRESS 0xD0000B94 /end MEASUREMENT
/begin MEASUREMENT gangsziel "" SBYTE dez 1 100 -128.0 127.0 FORMAT "%5.1" ECU_ADDRESS 0xD0000B95 /end MEASUREMENT
/begin MEASUREMENT gsalt "" UBYTE dez 1 100 0.00 255.0 FORMAT "%5.1" ECU_ADDRESS 0xD0000B96 /end MEASUREMENT
/begin MEASUREMENT gsdat "" UBYTE dez 1 100 0.00 255.0 FORMAT "%5.1" ECU_ADDRESS 0xD0000B97 /end MEASUREMENT
/begin MEASUREMENT imlatmab_w "" UWORD m_uw_b23p3 1 100 0.00 23.30133 FORMAT "%8.5" ECU_ADDRESS 0xAFE80038 /end MEASUREMENT
/begin MEASUREMENT imlatmws_w "" UWORD m_uw_b23p3 1 100 0.00 23.30133 FORMAT "%8.5" ECU_ADDRESS 0xAFE8003A /end MEASUREMENT
/begin MEASUREMENT imlpr_w "" UWORD fak_uw_b1 1 100 0.00 0.9999847 FORMAT "%9.7" ECU_ADDRESS 0xD000015C /end MEASUREMENT
/begin MEASUREMENT imlskgsa_w "" UWORD m_uw_b23p3 1 100 0.00 23.30133 FORMAT "%8.5" ECU_ADDRESS 0xD0000150 /end MEASUREMENT
/begin MEASUREMENT imlskhaw_w "" UWORD m_uw_b23p3 1 100 0.00 23.30133 FORMAT "%8.5" ECU_ADDRESS 0xD0000152 /end MEASUREMENT
/begin MEASUREMENT imlskhgs_w "" UWORD m_uw_b23p3 1 100 0.00 23.30133 FORMAT "%8.5" ECU_ADDRESS 0xD0000154 /end MEASUREMENT
/begin MEASUREMENT imlskhkt_w "" UWORD m_uw_b23p3 1 100 0.00 23.30133 FORMAT "%8.5" ECU_ADDRESS 0xD0000156 /end MEASUREMENT
/begin MEASUREMENT klnnsta "" UBYTE nmot_ub_q40 1 100 0.00 10200. FORMAT "%5.0" ECU_ADDRESS 0xD0000BD2 /end MEASUREMENT
/begin MEASUREMENT klnstnm "" UBYTE nmot_ub_q40 1 100 0.00 10200. FORMAT "%5.0" ECU_ADDRESS 0xD0000BD3 /end MEASUREMENT
/begin MEASUREMENT kral1_b "" UBYTE rel_q0p75 1 100 0.00 191.3 FORMAT "%5.1" ECU_ADDRESS 0xD0000BB2 /end MEASUREMENT
/begin MEASUREMENT kral2_b "" UBYTE rel_q0p75 1 100 0.00 191.3 FORMAT "%5.1" ECU_ADDRESS 0xD0000BB3 /end MEASUREMENT
/begin MEASUREMENT kral3_b "" UBYTE rel_q0p75 1 100 0.00 191.3 FORMAT "%5.1" ECU_ADDRESS 0xD0000BB4 /end MEASUREMENT
/begin MEASUREMENT krdydlyd_l "" ULONG dez 1 100 0.00 4294967295.00 FORMAT "%13.2" ECU_ADDRESS 0xD0001DD0 /end MEASUREMENT
/begin MEASUREMENT krdyndelay "" UBYTE dez 1 100 0.00 31.00 FORMAT "%5.2" ECU_ADDRESS 0xD0000BB5 /end MEASUREMENT
/begin MEASUREMENT krdyofdd_l "" ULONG dez 1 100 0.00 4294967295.00 FORMAT "%13.2" ECU_ADDRESS 0xD0001DD4 /end MEASUREMENT
/begin MEASUREMENT krevz_atot "" UBYTE dez 1 100 0.00 255.0 FORMAT "%5.1" ECU_ADDRESS 0xD0000BBF /end MEASUREMENT
/begin MEASUREMENT laatmlc_w "" UWORD fak_uw_b16 1 100 0.00 15.99976 FORMAT "%8.5" ECU_ADDRESS 0xD00000C4 /end MEASUREMENT
/begin MEASUREMENT lamein_w "" UWORD fak_uw_b16 1 100 0.00 15.99976 FORMAT "%8.5" ECU_ADDRESS 0xD00000C6 /end MEASUREMENT
/begin MEASUREMENT lamfaw_w "" UWORD fak_uw_b16 1 100 0.00 15.99976 FORMAT "%8.5" ECU_ADDRESS 0xD0000194 /end MEASUREMENT
/begin MEASUREMENT lamfa_w "" UWORD fak_uw_b16 1 100 0.00 15.99976 FORMAT "%8.5" ECU_ADDRESS 0xD0000196 /end MEASUREMENT
/begin MEASUREMENT lanhkm_w "" UWORD fak_uw_b16 1 100 0.00 15.99976 FORMAT "%8.5" ECU_ADDRESS 0xD0000214 /end MEASUREMENT
/begin MEASUREMENT lanvkm_w "" UWORD fak_uw_b16 1 100 0.00 15.99976 FORMAT "%8.5" ECU_ADDRESS 0xD0000216 /end MEASUREMENT
/begin MEASUREMENT lasonm_w "" UWORD fak_uw_b16 1 100 0.00 15.99976 FORMAT "%8.5" ECU_ADDRESS 0xD0000208 /end MEASUREMENT
/begin MEASUREMENT lason_w "" UWORD fak_uw_b16 1 100 0.00 15.99976 FORMAT "%8.5" ECU_ADDRESS 0xD0000218 /end MEASUREMENT
/begin MEASUREMENT lavhkm_w "" UWORD fak_uw_b16 1 100 0.00 15.99976 FORMAT "%8.5" ECU_ADDRESS 0xD000021A /end MEASUREMENT
/begin MEASUREMENT lavvkmm_w "" UWORD fak_uw_b16 1 100 0.00 15.99976 FORMAT "%8.5" ECU_ADDRESS 0xD000020A /end MEASUREMENT
/begin MEASUREMENT lavvkm_w "" UWORD fak_uw_b16 1 100 0.00 15.99976 FORMAT "%8.5" ECU_ADDRESS 0xD000021C /end MEASUREMENT
/begin MEASUREMENT lkrhw "" UBYTE rel_q0p75 1 100 0.00 191.3 FORMAT "%5.1" ECU_ADDRESS 0xD0000BB6 /end MEASUREMENT
/begin MEASUREMENT mainloop "" UBYTE dez 1 100 0.00 255.0 FORMAT "%5.1" ECU_ADDRESS 0xD0000B87 /end MEASUREMENT
/begin MEASUREMENT mkuppl_w "" SWORD rel_sw_b100 1 100 -100.0000 99.99695 FORMAT "%8.4" ECU_ADDRESS 0xD00001B4 /end MEASUREMENT
/begin MEASUREMENT moxnvnh_w "" SWORD m_q0p1_mg 1 100 -3276.800 3276.700 FORMAT "%8.3" ECU_ADDRESS 0xD000021E /end MEASUREMENT
/begin MEASUREMENT moxrsth_w "" UWORD m_q0p1_mg 1 100 0.00 6553.500 FORMAT "%8.3" ECU_ADDRESS 0xD000020C /end MEASUREMENT
/begin MEASUREMENT msabein_w "" UWORD m_uw_b6553p5 1 100 0.00 6553.500 FORMAT "%8.3" ECU_ADDRESS 0xD00000C8 /end MEASUREMENT
/begin MEASUREMENT nbfbrkc1 "" UBYTE dez 1 100 0.00 255.0 FORMAT "%5.1" ECU_ADDRESS 0xD0000B89 /end MEASUREMENT
/begin MEASUREMENT nbfbrkc2 "" UBYTE dez 1 100 0.00 255.0 FORMAT "%5.1" ECU_ADDRESS 0xD0000B8A /end MEASUREMENT
/begin MEASUREMENT nbfbrkc3 "" UBYTE dez 1 100 0.00 255.0 FORMAT "%5.1" ECU_ADDRESS 0xD0000B8B /end MEASUREMENT
/begin MEASUREMENT nbrcat1 "" UBYTE dez 1 100 0.00 255.0 FORMAT "%5.1" ECU_ADDRESS 0xD0000B8C /end MEASUREMENT
/begin MEASUREMENT nbrcat2 "" UBYTE dez 1 100 0.00 255.0 FORMAT "%5.1" ECU_ADDRESS 0xD0000B8D /end MEASUREMENT
/begin MEASUREMENT nbrcat3 "" UBYTE dez 1 100 0.00 255.0 FORMAT "%5.1" ECU_ADDRESS 0xD0000B8E /end MEASUREMENT
/begin MEASUREMENT ngkrv "" SBYTE nmotg_sb_q100 1 100 -12800. 12700. FORMAT "%5.0" ECU_ADDRESS 0xD0000BB7 /end MEASUREMENT
/begin MEASUREMENT nmitt4_w "" UWORD nmot_uw_q0p25 1 100 0.00 16383.75 FORMAT "%8.2" ECU_ADDRESS 0xD0000148 /end MEASUREMENT
/begin MEASUREMENT nsa "" UBYTE nmot_ub_q40 1 100 0.00 10200. FORMAT "%5.0" ECU_ADDRESS 0xD0000BC3 /end MEASUREMENT
/begin MEASUREMENT nwe "" UBYTE nmot_ub_q40 1 100 0.00 10200. FORMAT "%5.0" ECU_ADDRESS 0xD0000BC9 /end MEASUREMENT
/begin MEASUREMENT nwema "" UBYTE nmot_ub_q40 1 100 0.00 10200. FORMAT "%5.0" ECU_ADDRESS 0xD0000BC4 /end MEASUREMENT
/begin MEASUREMENT ofmsndah_w "" SWORD m_q0p1 1 100 -3276.800 3276.700 FORMAT "%8.3" ECU_ADDRESS 0xAFE80048 /end MEASUREMENT
/begin MEASUREMENT ofmsndap_w "" SWORD m_q0p1 1 100 -3276.800 3276.700 FORMAT "%8.3" ECU_ADDRESS 0xAFE8004A /end MEASUREMENT
/begin MEASUREMENT ofmsndkh_w "" SWORD m_q0p1 1 100 -3276.800 3276.700 FORMAT "%8.3" ECU_ADDRESS 0xAFE8004C /end MEASUREMENT
/begin MEASUREMENT ofmsndkp_w "" SWORD m_q0p1 1 100 -3276.800 3276.700 FORMAT "%8.3" ECU_ADDRESS 0xAFE80050 /end MEASUREMENT
/begin MEASUREMENT ofmsndk_w "" SWORD m_q0p1 1 100 -3276.800 3276.700 FORMAT "%8.3" ECU_ADDRESS 0xD00001AE /end MEASUREMENT
/begin MEASUREMENT ofpndk_w "" SWORD p_sw_q0p039 1 100 -1280.000 1279.961 FORMAT "%8.3" ECU_ADDRESS 0xD0000186 /end MEASUREMENT
/begin MEASUREMENT ofpsr2_w "" SWORD p_sw_q0p039 1 100 -1280.000 1279.961 FORMAT "%8.3" ECU_ADDRESS 0xD0000188 /end MEASUREMENT
/begin MEASUREMENT ofpsr_w "" SWORD p_sw_q0p039 1 100 -1280.000 1279.961 FORMAT "%8.3" ECU_ADDRESS 0xD000018A /end MEASUREMENT
/begin MEASUREMENT ofpu_w "" SWORD p_sw_q0p039 1 100 -1280.000 1279.961 FORMAT "%8.3" ECU_ADDRESS 0xAFE80040 /end MEASUREMENT
/begin MEASUREMENT ofpv2v_w "" SWORD p_sw_q0p039 1 100 -1280.000 1279.961 FORMAT "%8.3" ECU_ADDRESS 0xD000018C /end MEASUREMENT
/begin MEASUREMENT ofpvd_w "" SWORD p_sw_q0p039 1 100 -1280.000 1279.961 FORMAT "%8.3" ECU_ADDRESS 0xD000018E /end MEASUREMENT
/begin MEASUREMENT ofpvv2_w "" SWORD p_sw_q0p039 1 100 -1280.000 1279.961 FORMAT "%8.3" ECU_ADDRESS 0xD0000190 /end MEASUREMENT
/begin MEASUREMENT ofpvv_w "" SWORD p_sw_q0p039 1 100 -1280.000 1279.961 FORMAT "%8.3" ECU_ADDRESS 0xD0000192 /end MEASUREMENT
/begin MEASUREMENT oxinhk_w "" SWORD m_q0p1_mgs 1 100 -3276.800 3276.700 FORMAT "%8.3" ECU_ADDRESS 0xD0000220 /end MEASUREMENT
/begin MEASUREMENT oxysthk_w "" UWORD m_q0p1_mg 1 100 0.00 6553.500 FORMAT "%8.3" ECU_ADDRESS 0xD0000222 /end MEASUREMENT
/begin MEASUREMENT PT_bGrip "" UBYTE dez 1 100 0.00 255.0 BIT_MASK 0x1 FORMAT "%5.1" ECU_ADDRESS 0xD0003CD5 /end MEASUREMENT
/begin MEASUREMENT PT_rTraV2N "" SWORD VelToN 1 100 -0.3276800 0.3276700 FORMAT "%9.7" ECU_ADDRESS 0xD0003570 /end MEASUREMENT
/begin MEASUREMENT PT_rTrq "" SWORD TransR 1 100 -327.6800 327.6700 FORMAT "%8.4" ECU_ADDRESS 0xD0003572 /end MEASUREMENT
/begin MEASUREMENT PT_rTrqWoConvRat "" SWORD TransR 1 100 -327.6800 327.6700 FORMAT "%8.4" ECU_ADDRESS 0xD0003574 /end MEASUREMENT
/begin MEASUREMENT redist "" UBYTE dez 1 100 0.00 255.0 FORMAT "%5.1" ECU_ADDRESS 0xD0000BDA /end MEASUREMENT
/begin MEASUREMENT redistb1 "" UBYTE dez 1 100 0.00 126.0 FORMAT "%5.1" ECU_ADDRESS 0xD0000BDB /end MEASUREMENT
/begin MEASUREMENT rksumev_w "" UWORD rel_uw_b491520 1 100 0.00 491512.5 FORMAT "%8.1" ECU_ADDRESS 0xD00001B8 /end MEASUREMENT
/begin MEASUREMENT rksum_w "" UWORD rel_uw_b491520 1 100 0.00 491512.5 FORMAT "%8.1" ECU_ADDRESS 0xD00001BA /end MEASUREMENT
/begin MEASUREMENT rktesum_w "" UWORD rel_uw_b491520 1 100 0.00 491512.5 FORMAT "%8.1" ECU_ADDRESS 0xD00001BC /end MEASUREMENT
/begin MEASUREMENT rlkatm_w "" UWORD rel_uw_b3072 1 100 0.00 3071.953 FORMAT "%8.3" ECU_ADDRESS 0xD00000CA /end MEASUREMENT
/begin MEASUREMENT rolhk_w "" UWORD fak_uw_b2 1 100 0.00 1.999969 FORMAT "%8.6" ECU_ADDRESS 0xD0000224 /end MEASUREMENT
/begin MEASUREMENT sdlutact_w "" SWORD lu_MEx 1 100 -149.0116 149.0071 FORMAT "%8.4" ECU_ADDRESS 0xD000017C /end MEASUREMENT
/begin MEASUREMENT STENDES_FF.status "" UBYTE B_TRUE 1 100 0.00 1.00000000000 BIT_MASK 0x1 FORMAT "%13.11" ECU_ADDRESS 0xD0001016 /end MEASUREMENT
/begin MEASUREMENT STENDMD_FF.status "" UBYTE B_TRUE 1 100 0.00 1.00000000000 BIT_MASK 0x1 FORMAT "%13.11" ECU_ADDRESS 0xD0001017 /end MEASUREMENT
/begin MEASUREMENT STEND_FF.status "" UBYTE B_TRUE 1 100 0.00 1.00000000000 BIT_MASK 0x1 FORMAT "%13.11" ECU_ADDRESS 0xD0001018 /end MEASUREMENT
/begin MEASUREMENT stkraidx_w "" UWORD dez 1 100 0.00 65535.00 FORMAT "%8.2" ECU_ADDRESS 0xD0000170 /end MEASUREMENT
/begin MEASUREMENT stkrkserr "" UBYTE dez 1 100 0.00 255.0 FORMAT "%5.1" ECU_ADDRESS 0xD0000BC0 /end MEASUREMENT
/begin MEASUREMENT stkrlx "" UBYTE dez 1 100 0.00 255.0 FORMAT "%5.1" ECU_ADDRESS 0xD0000BB8 /end MEASUREMENT
/begin MEASUREMENT stkrnx "" UBYTE dez 1 100 0.00 255.0 FORMAT "%5.1" ECU_ADDRESS 0xD0000BC1 /end MEASUREMENT
/begin MEASUREMENT taatmkr_w "" SWORD tempg_q0p0234 1 100 -768.0000 767.9766 FORMAT "%8.4" ECU_ADDRESS 0xD00000CC /end MEASUREMENT
/begin MEASUREMENT tababar_w "" UWORD temp_q0p0234_o273 1 100 -273.1500 1262.827 FORMAT "%8.3" ARRAY_SIZE 13 ECU_ADDRESS 0xAFE8001C /end MEASUREMENT
/begin MEASUREMENT tabatmlc_w "" UWORD t1sxs_uw_q1 1 100 0.00 65535.00 FORMAT "%8.2" ECU_ADDRESS 0xD00000CE /end MEASUREMENT
/begin MEASUREMENT tabcorat_w "" UWORD t_q0p05 1 100 0.00 3276.750 FORMAT "%8.3" ECU_ADDRESS 0xD00000D0 /end MEASUREMENT
/begin MEASUREMENT tabgar_w "" UWORD temp_q0p0234_o273 1 100 -273.1500 1262.827 FORMAT "%8.3" ARRAY_SIZE 13 ECU_ADDRESS 0xD00000DC /end MEASUREMENT
/begin MEASUREMENT tafso_w "" UWORD temp_q0p0234_o273 1 100 -273.1500 1262.827 FORMAT "%8.3" ECU_ADDRESS 0xD00000F8 /end MEASUREMENT
/begin MEASUREMENT tahso_w "" UWORD temp_q0p0234_o273 1 100 -273.1500 1262.827 FORMAT "%8.3" ECU_ADDRESS 0xD00000FA /end MEASUREMENT
/begin MEASUREMENT taikrm_w "" UWORD temp_q0p0234_o273 1 100 -273.1500 1262.827 FORMAT "%8.3" ECU_ADDRESS 0xD00000FC /end MEASUREMENT
/begin MEASUREMENT taikr_w "" UWORD temp_q0p0234_o273 1 100 -273.1500 1262.827 FORMAT "%8.3" ECU_ADDRESS 0xD00000FE /end MEASUREMENT
/begin MEASUREMENT tanavkf_w "" UWORD temp_q0p0234_o273 1 100 -273.1500 1262.827 FORMAT "%8.3" ECU_ADDRESS 0xD00000D2 /end MEASUREMENT
/begin MEASUREMENT tanavkh_w "" UWORD temp_q0p0234_o273 1 100 -273.1500 1262.827 FORMAT "%8.3" ECU_ADDRESS 0xD00000D4 /end MEASUREMENT
/begin MEASUREMENT tanavm_w "" UWORD temp_q0p0234_o273 1 100 -273.1500 1262.827 FORMAT "%8.3" ECU_ADDRESS 0xD00000F6 /end MEASUREMENT
/begin MEASUREMENT tanavsto_w "" UWORD temp_q0p0234_o273 1 100 -273.1500 1262.827 FORMAT "%8.3" ECU_ADDRESS 0xD00000D6 /end MEASUREMENT
/begin MEASUREMENT tanavst_w "" UWORD temp_q0p0234_o273 1 100 -273.1500 1262.827 FORMAT "%8.3" ECU_ADDRESS 0xD00000D8 /end MEASUREMENT
/begin MEASUREMENT tanhkm_w "" UWORD temp_q0p0234_o273 1 100 -273.1500 1262.827 FORMAT "%8.3" ECU_ADDRESS 0xD0000100 /end MEASUREMENT
/begin MEASUREMENT tanvkm_w "" UWORD temp_q0p0234_o273 1 100 -273.1500 1262.827 FORMAT "%8.3" ECU_ADDRESS 0xD0000102 /end MEASUREMENT
/begin MEASUREMENT tanvk_w "" UWORD temp_q0p0234_o273 1 100 -273.1500 1262.827 FORMAT "%8.3" ECU_ADDRESS 0xD0000104 /end MEASUREMENT
/begin MEASUREMENT tanym_w "" UWORD temp_q0p0234_o273 1 100 -273.1500 1262.827 FORMAT "%8.3" ECU_ADDRESS 0xD0000106 /end MEASUREMENT
/begin MEASUREMENT tavav_w "" UWORD temp_q0p0234_o273 1 100 -273.1500 1262.827 FORMAT "%8.3" ECU_ADDRESS 0xD00000DA /end MEASUREMENT
/begin MEASUREMENT tavhkmm_w "" UWORD temp_q0p0234_o273 1 100 -273.1500 1262.827 FORMAT "%8.3" ECU_ADDRESS 0xD0000108 /end MEASUREMENT
/begin MEASUREMENT tavhkm_w "" UWORD temp_q0p0234_o273 1 100 -273.1500 1262.827 FORMAT "%8.3" ECU_ADDRESS 0xD000010A /end MEASUREMENT
/begin MEASUREMENT tavhk_w "" UWORD temp_q0p0234_o273 1 100 -273.1500 1262.827 FORMAT "%8.3" ECU_ADDRESS 0xD000010C /end MEASUREMENT
/begin MEASUREMENT tavrom_w "" UWORD temp_q0p0234_o273 1 100 -273.1500 1262.827 FORMAT "%8.3" ECU_ADDRESS 0xD000010E /end MEASUREMENT
/begin MEASUREMENT tavsomn_w "" UWORD temp_q0p0234_o273 1 100 -273.1500 1262.827 FORMAT "%8.3" ECU_ADDRESS 0xD0000162 /end MEASUREMENT
/begin MEASUREMENT tavso_w "" UWORD temp_q0p0234_o273 1 100 -273.1500 1262.827 FORMAT "%8.3" ECU_ADDRESS 0xD0000110 /end MEASUREMENT
/begin MEASUREMENT tavvkmm_w "" UWORD temp_q0p0234_o273 1 100 -273.1500 1262.827 FORMAT "%8.3" ECU_ADDRESS 0xD0000112 /end MEASUREMENT
/begin MEASUREMENT tavvkm_w "" UWORD temp_q0p0234_o273 1 100 -273.1500 1262.827 FORMAT "%8.3" ECU_ADDRESS 0xD0000114 /end MEASUREMENT
/begin MEASUREMENT tavvk_w "" UWORD temp_q0p0234_o273 1 100 -273.1500 1262.827 FORMAT "%8.3" ECU_ADDRESS 0xD0000116 /end MEASUREMENT
/begin MEASUREMENT tavymm_w "" UWORD temp_q0p0234_o273 1 100 -273.1500 1262.827 FORMAT "%8.3" ECU_ADDRESS 0xD0000118 /end MEASUREMENT
/begin MEASUREMENT tbhsw "" UBYTE temp_ub_q0p75_o48 1 100 -48.00 143.3 FORMAT "%5.1" ECU_ADDRESS 0xD0000BD5 /end MEASUREMENT
/begin MEASUREMENT tcat_l "" ULONG temp_q3p57Em7_om273 1 100 -273.150000000 1262.84999964 FORMAT "%13.8" ARRAY_SIZE 4 ECU_ADDRESS 0xD0001D80 /end MEASUREMENT
/begin MEASUREMENT thkmax_w "" UWORD temp_q0p0234_o273 1 100 -273.1500 1262.827 FORMAT "%8.3" ECU_ADDRESS 0xD000011A /end MEASUREMENT
/begin MEASUREMENT thkmid_w "" UWORD temp_q0p0234_o273 1 100 -273.1500 1262.827 FORMAT "%8.3" ECU_ADDRESS 0xD000011C /end MEASUREMENT
/begin MEASUREMENT thkmin_w "" UWORD temp_q0p0234_o273 1 100 -273.1500 1262.827 FORMAT "%8.3" ECU_ADDRESS 0xD000011E /end MEASUREMENT
/begin MEASUREMENT tikatst_w "" UWORD temp_q0p0234_o273 1 100 -273.1500 1262.827 FORMAT "%8.3" ECU_ADDRESS 0xD0000158 /end MEASUREMENT
/begin MEASUREMENT tkattmp "" UBYTE temp_ub_q5_o50 1 100 -50.00 1225. FORMAT "%5.0" ECU_ADDRESS 0xD0000BC5 /end MEASUREMENT
/begin MEASUREMENT tkehkm_w "" UWORD temp_q0p0234_o273 1 100 -273.1500 1262.827 FORMAT "%8.3" ECU_ADDRESS 0xD0000120 /end MEASUREMENT
/begin MEASUREMENT tkevkm_w "" UWORD temp_q0p0234_o273 1 100 -273.1500 1262.827 FORMAT "%8.3" ECU_ADDRESS 0xD0000122 /end MEASUREMENT
/begin MEASUREMENT tkhakt_w "" UWORD t100msxs_uw_b6553p5 1 100 0.00 6553.500 FORMAT "%8.3" ECU_ADDRESS 0xD000015A /end MEASUREMENT
/begin MEASUREMENT tkihkmmn_w "" UWORD temp_q0p0234_o273 1 100 -273.1500 1262.827 FORMAT "%8.3" ECU_ADDRESS 0xD0000164 /end MEASUREMENT
/begin MEASUREMENT tkihkmm_w "" UWORD temp_q0p0234_o273 1 100 -273.1500 1262.827 FORMAT "%8.3" ECU_ADDRESS 0xD0000124 /end MEASUREMENT
/begin MEASUREMENT tkihkm_w "" UWORD temp_q0p0234_o273 1 100 -273.1500 1262.827 FORMAT "%8.3" ECU_ADDRESS 0xD0000126 /end MEASUREMENT
/begin MEASUREMENT tkivkmm_w "" UWORD temp_q0p0234_o273 1 100 -273.1500 1262.827 FORMAT "%8.3" ECU_ADDRESS 0xD0000128 /end MEASUREMENT
/begin MEASUREMENT tkivkm_w "" UWORD temp_q0p0234_o273 1 100 -273.1500 1262.827 FORMAT "%8.3" ECU_ADDRESS 0xD000012A /end MEASUREMENT
/begin MEASUREMENT tmatar_l "" ULONG temp_q3p57Em7_om273 1 100 -273.150000000 1262.84999964 FORMAT "%13.8" ARRAY_SIZE 13 ECU_ADDRESS 0xD0001D94 /end MEASUREMENT
/begin MEASUREMENT tmbbstt "" UBYTE Temp_Cels_Short 1 100 -48.00 143.3 FORMAT "%5.1" ECU_ADDRESS 0xD0000BD1 /end MEASUREMENT
/begin MEASUREMENT tmmxbh "" UBYTE temp_ub_q0p75_o48 1 100 -48.00 143.3 FORMAT "%5.1" ECU_ADDRESS 0xD0000BD6 /end MEASUREMENT
/begin MEASUREMENT tmotbstnsd "" UBYTE temp_ub_q0p75_o48 1 100 -48.00 143.3 FORMAT "%5.1" ECU_ADDRESS 0xD0000BCE /end MEASUREMENT
/begin MEASUREMENT tmotk_w "" UWORD temp_q0p0234_o273 1 100 -273.1500 1262.827 FORMAT "%8.3" ECU_ADDRESS 0xD000012C /end MEASUREMENT
/begin MEASUREMENT tmstbstnsd "" UBYTE temp_ub_q0p75_o48 1 100 -48.00 143.3 FORMAT "%5.1" ECU_ADDRESS 0xD0000BCF /end MEASUREMENT
/begin MEASUREMENT tnseldcy_w "" UWORD t_q0p1 1 100 0.00 6553.500 FORMAT "%8.3" ECU_ADDRESS 0xAFE8003C /end MEASUREMENT
/begin MEASUREMENT tnsezmks_w "" UWORD t100msxs_uw_b6553p5 1 100 0.00 6553.500 FORMAT "%8.3" ECU_ADDRESS 0xAFE8003E /end MEASUREMENT
/begin MEASUREMENT tnsezmot_w "" UWORD t100msxs_uw_b6553p5 1 100 0.00 6553.500 FORMAT "%8.3" ECU_ADDRESS 0xD000017E /end MEASUREMENT
/begin MEASUREMENT tnsez_w "" UWORD t100msxs_uw_b6553p5 1 100 0.00 6553.500 FORMAT "%8.3" ECU_ADDRESS 0xD0000180 /end MEASUREMENT
/begin MEASUREMENT tnse_w "" UWORD t100msxs_uw_b6553p5 1 100 0.00 6553.500 FORMAT "%8.3" ECU_ADDRESS 0xD0000182 /end MEASUREMENT
/begin MEASUREMENT tnst_w "" UWORD t10msxs_uw_b655p35 1 100 0.00 655.3500 FORMAT "%8.4" ECU_ADDRESS 0xD0000184 /end MEASUREMENT
/begin MEASUREMENT tnvkvhk_w "" UWORD t20msxs_uw_b1310 1 100 0.00 1310.700 FORMAT "%8.3" ECU_ADDRESS 0xD000020E /end MEASUREMENT
/begin MEASUREMENT Tra_numGear "" SBYTE OneToOne 1 100 -128.0 127.0 FORMAT "%5.1" ECU_ADDRESS 0xD0000B98 /end MEASUREMENT
/begin MEASUREMENT tsk15oat_w "" UWORD t_q0p05 1 100 0.00 3276.750 FORMAT "%8.3" ECU_ADDRESS 0xAFE80036 /end MEASUREMENT
/begin MEASUREMENT tsovhk_w "" UWORD t20msxs_q0p0002 1 100 0.00 13.10700 FORMAT "%8.5" ECU_ADDRESS 0xD0000226 /end MEASUREMENT
/begin MEASUREMENT tstgav_l "" ULONG temp_q3p57Em7_om273 1 100 -273.150000000 1262.84999964 FORMAT "%13.8" ECU_ADDRESS 0xD0001D90 /end MEASUREMENT
/begin MEASUREMENT ttafso_w "" UWORD temp_q0p0234_o273 1 100 -273.1500 1262.827 FORMAT "%8.3" ECU_ADDRESS 0xD000012E /end MEASUREMENT
/begin MEASUREMENT ttahso_w "" UWORD temp_q0p0234_o273 1 100 -273.1500 1262.827 FORMAT "%8.3" ECU_ADDRESS 0xD0000130 /end MEASUREMENT
/begin MEASUREMENT ttaikrm_w "" UWORD temp_q0p0234_o273 1 100 -273.1500 1262.827 FORMAT "%8.3" ECU_ADDRESS 0xD0000132 /end MEASUREMENT
/begin MEASUREMENT ttaikr_w "" UWORD temp_q0p0234_o273 1 100 -273.1500 1262.827 FORMAT "%8.3" ECU_ADDRESS 0xD0000134 /end MEASUREMENT
/begin MEASUREMENT ttavrom_w "" UWORD temp_q0p0234_o273 1 100 -273.1500 1262.827 FORMAT "%8.3" ECU_ADDRESS 0xD0000136 /end MEASUREMENT
/begin MEASUREMENT ttavso_w "" UWORD temp_q0p0234_o273 1 100 -273.1500 1262.827 FORMAT "%8.3" ECU_ADDRESS 0xD0000138 /end MEASUREMENT
/begin MEASUREMENT ttavvkm_w "" UWORD temp_q0p0234_o273 1 100 -273.1500 1262.827 FORMAT "%8.3" ECU_ADDRESS 0xD000013A /end MEASUREMENT
/begin MEASUREMENT ttavvk_w "" UWORD temp_q0p0234_o273 1 100 -273.1500 1262.827 FORMAT "%8.3" ECU_ADDRESS 0xD000013C /end MEASUREMENT
/begin MEASUREMENT tvsaa "" UBYTE t_q0p01 1 100 0.00 2.550 FORMAT "%5.3" ECU_ADDRESS 0xD0000BC6 /end MEASUREMENT
/begin MEASUREMENT tvsab_w "" UWORD t_q0p01 1 100 0.00 655.3500 FORMAT "%8.4" ECU_ADDRESS 0xD0000176 /end MEASUREMENT
/begin MEASUREMENT tvsag_w "" UWORD t_q0p01 1 100 0.00 655.3500 FORMAT "%8.4" ECU_ADDRESS 0xD0000172 /end MEASUREMENT
/begin MEASUREMENT tvsakat "" UBYTE t_q0p04 1 100 0.00 10.20 FORMAT "%5.2" ECU_ADDRESS 0xD0000BC7 /end MEASUREMENT
/begin MEASUREMENT tvsans_w "" UWORD t_q0p01 1 100 0.00 655.3500 FORMAT "%8.4" ECU_ADDRESS 0xD0000174 /end MEASUREMENT
/begin MEASUREMENT tvsavg "" UBYTE t_q0p04 1 100 0.00 10.20 FORMAT "%5.2" ECU_ADDRESS 0xD0000BC8 /end MEASUREMENT
/begin MEASUREMENT twfso_w "" UWORD temp_q0p0234_o273 1 100 -273.1500 1262.827 FORMAT "%8.3" ECU_ADDRESS 0xD000013E /end MEASUREMENT
/begin MEASUREMENT twhso_w "" UWORD temp_q0p0234_o273 1 100 -273.1500 1262.827 FORMAT "%8.3" ECU_ADDRESS 0xD0000140 /end MEASUREMENT
/begin MEASUREMENT twskwatm_w "" UWORD t_q0p1 1 100 0.00 6553.500 FORMAT "%8.3" ECU_ADDRESS 0xD0000166 /end MEASUREMENT
/begin MEASUREMENT twskwtt_w "" UWORD t_q0p1 1 100 0.00 6553.500 FORMAT "%8.3" ECU_ADDRESS 0xD0000168 /end MEASUREMENT
/begin MEASUREMENT twvsomn_w "" UWORD temp_q0p0234_o273 1 100 -273.1500 1262.827 FORMAT "%8.3" ECU_ADDRESS 0xD000016A /end MEASUREMENT
/begin MEASUREMENT twvso_w "" UWORD temp_q0p0234_o273 1 100 -273.1500 1262.827 FORMAT "%8.3" ECU_ADDRESS 0xD0000142 /end MEASUREMENT
/begin MEASUREMENT uebver "" UBYTE fak_b0p051 1 100 0.00 0.05100 FORMAT "%7.5" ECU_ADDRESS 0xD0000B99 /end MEASUREMENT
/begin MEASUREMENT uevges_w "" UWORD fak_q0p02 1 100 0.00 1310.700 FORMAT "%8.3" ECU_ADDRESS 0xD000014A /end MEASUREMENT
/begin MEASUREMENT upwg1_w "" UWORD spg_q0p00488 1 100 0.00 319.9951 FORMAT "%8.4" ECU_ADDRESS 0xD000363E /end MEASUREMENT
/begin MEASUREMENT upwg2_w "" UWORD spg_q0p00488 1 100 0.00 319.9951 FORMAT "%8.4" ECU_ADDRESS 0xD0003640 /end MEASUREMENT
/begin MEASUREMENT vapp_w "" UWORD vol_q0p002146 1 100 0.00 140.6229 FORMAT "%8.4" ECU_ADDRESS 0xD00001BE /end MEASUREMENT
/begin MEASUREMENT vpsrvd_w "" UWORD fak_uw_b2 1 100 0.00 1.999969 FORMAT "%8.6" ECU_ADDRESS 0xD00001B0 /end MEASUREMENT
/begin MEASUREMENT vsabvhk_w "" UWORD vs_q6p1 1 100 0.00 399993.9 FORMAT "%8.1" ECU_ADDRESS 0xD0000210 /end MEASUREMENT
/begin MEASUREMENT vsksev_w "" UWORD volgrd_q5p96Em7 1 100 0.00 0.03906190 FORMAT "%10.8" ECU_ADDRESS 0xD00001C0 /end MEASUREMENT
/begin MEASUREMENT vsksmlt_w "" UWORD volgrd_q5p96Em7 1 100 0.00 0.03906190 FORMAT "%10.8" ECU_ADDRESS 0xD00001C2 /end MEASUREMENT
/begin MEASUREMENT vsksml_w "" UWORD volgrd_q5p96Em4 1 100 0.00 39.06190 FORMAT "%8.5" ECU_ADDRESS 0xD00001C4 /end MEASUREMENT
/begin MEASUREMENT vsks_w "" UWORD volgrd_q5p96Em7 1 100 0.00 0.03906190 FORMAT "%10.8" ECU_ADDRESS 0xD00001C6 /end MEASUREMENT
/begin MEASUREMENT vtrip_w "" UWORD vol_q3p90625Em3_l 1 100 0.00 255.9961 FORMAT "%8.4" ECU_ADDRESS 0xD00001C8 /end MEASUREMENT
/begin MEASUREMENT wistr_w "" UWORD fak_uw_b1 1 100 0.00 0.9999847 FORMAT "%9.7" ECU_ADDRESS 0xD000015E /end MEASUREMENT
/begin MEASUREMENT wped "" UBYTE relPED_ub_b100 1 100 0.00 100.0 FORMAT "%5.1" ECU_ADDRESS 0xD0000B83 /end MEASUREMENT
/begin MEASUREMENT wped_w "" UWORD relPED_q0p00153 1 100 0.00 100.0000 FORMAT "%8.4" ECU_ADDRESS 0xD00000B6 /end MEASUREMENT
/begin MEASUREMENT zaeldy "" UBYTE t_q0p01 1 100 0.00 2.550 FORMAT "%5.3" ECU_ADDRESS 0xD0000BB9 /end MEASUREMENT
/begin MEASUREMENT zaeldyke "" UBYTE t_q0p01 1 100 0.00 2.550 FORMAT "%5.3" ECU_ADDRESS 0xD0000BBA /end MEASUREMENT
/begin MEASUREMENT zaendy "" UBYTE t_q0p01 1 100 0.00 2.550 FORMAT "%5.3" ECU_ADDRESS 0xD0000BBB /end MEASUREMENT
/begin MEASUREMENT zubkst "" UBYTE dez 1 100 0.00 255.0 FORMAT "%5.1" ECU_ADDRESS 0xD0000BD0 /end MEASUREMENT
/begin FUNCTION Alt_Demand "1.15.0"
 /begin DEF_CHARACTERISTIC Alt_facAdjValMax_C Alt_facAdjValMin_C Alt_facCorTemp_CUR Alt_facCorT_CUR Alt_pwrCanMax_C Alt_pwrCanMin_C Alt_stTrqMode_CW Alt_tiCldStrtDel_MAP Alt_tiLRAlt_CUR Alt_tiPT1Del_C Alt_trqCalcVar2_MAP Alt_trqCalcVar3_MAP Alt_trqCalc_MAP Alt_trqCanErr_MAP Alt_trqRmpSlpDes.Pos_C Alt_trqRmpSlpDes.Neg_C /end DEF_CHARACTERISTIC
 /begin IN_MEASUREMENT AltIO_rAltLoad AltIO_stAltExcSt AltIO_tiLRAlt BasSvrAppl_stFCodPresent BasSvrAppl_swtFCodAlt CEngDsT_t CoEng_tiNormalRed EEM_pwrAltDes EngDa_tEng EnvP_p EnvT_t Epm_nEng /end IN_MEASUREMENT
 /begin OUT_MEASUREMENT Alt_stCldStrtRls Alt_trqDes Alt_trqResv ESS_rLdAlt /end OUT_MEASUREMENT
 /begin LOC_MEASUREMENT Alt_facDemandEEP_mp Alt_trqCalc_mp Alt_trqCor_mp Alt_trqFlt_mp /end LOC_MEASUREMENT
 FUNCTION_VERSION "1.15.0" /end FUNCTION
/begin FUNCTION Amd29BDD160 "1.10.0" FUNCTION_VERSION "1.10.0" /end FUNCTION
/begin FUNCTION Amd29BDD320 "1.10.0" FUNCTION_VERSION "1.10.0" /end FUNCTION
/begin FUNCTION APP2MED "4.2.0"
 /begin IN_MEASUREMENT APP_drUnFlt APP_r APP_stKD APP_stSigSrc APP_uRaw1unLim APP_uRaw2unLimWoNTP /end IN_MEASUREMENT
 /begin OUT_MEASUREMENT B_kd B_pwgnotfr dwped dwped_w upwg1_w upwg2_w wped wped_w /end OUT_MEASUREMENT
 FUNCTION_VERSION "4.2.0" /end FUNCTION
/begin FUNCTION APP_ChkSig "3.1.0"
 /begin DEF_CHARACTERISTIC APP_AliveDeb.tiHiLo_C APP_AliveDeb.tiLoHi_C APP_drLim.Pos_C APP_drLim.Neg_C APP_drLimpMax_C APP_rLimpMax_C APP_rPlaMaxVal_C APP_rThresAliveDet_C APP_swtAliveDetEna_C APP_swtPlaChkEna_C /end DEF_CHARACTERISTIC
 /begin IN_MEASUREMENT Brk_st /end IN_MEASUREMENT
 /begin LOC_MEASUREMENT APP_rPla_mp APP_rUnLim_mp APP_stAlive_mp /end LOC_MEASUREMENT
 FUNCTION_VERSION "3.1.0" /end FUNCTION
/begin FUNCTION APP_DD1 "3.0.0" /begin DEF_CHARACTERISTIC APP_uRaw1SRCHigh_C APP_uRaw1SRCLow_C /end DEF_CHARACTERISTIC /begin IN_MEASUREMENT MoCADC_stMsg /end IN_MEASUREMENT FUNCTION_VERSION "3.0.0" /end FUNCTION
/begin FUNCTION APP_DD2 "3.1.0" /begin DEF_CHARACTERISTIC APP_uRaw2SRCHigh_C APP_uRaw2SRCLow_C /end DEF_CHARACTERISTIC /begin IN_MEASUREMENT MoCADC_stMsg /end IN_MEASUREMENT FUNCTION_VERSION "3.1.0" /end FUNCTION
/begin FUNCTION APP_Kickdown "3.1.0" /begin DEF_CHARACTERISTIC APP_uKDHighAPP_C APP_uKDLowAPP_C /end DEF_CHARACTERISTIC FUNCTION_VERSION "3.1.0" /end FUNCTION
/begin FUNCTION APP_Plaus12 "3.1.0" /begin DEF_CHARACTERISTIC APP_uSyncMin_C APP_uSync_CUR /end DEF_CHARACTERISTIC /begin LOC_MEASUREMENT APP_uDiffMax_mp APP_uDiff_mp APP_uMin12half_mp /end LOC_MEASUREMENT FUNCTION_VERSION "3.1.0" /end FUNCTION
/begin FUNCTION APP_PlausBrk "3.2.0"
 /begin DEF_CHARACTERISTIC APP_drUnFltLim_C APP_GradCondDeb.tiHiLo_C APP_GradCondDeb.tiLoHi_C APP_nLim_C APP_swtAppGradEna_C APP_swtBrkDet_C APP_swtRstCon_C APP_swtVehDynReqd_C APP_tiPlaBrkDetDeb_C APP_tiPlaBrkRstDeb_C APP_vLim_C /end DEF_CHARACTERISTIC
 /begin IN_MEASUREMENT Brk_st Brk_stMn Brk_stRed Epm_nEng GlbDa_stTrqDem VehV_v /end IN_MEASUREMENT
 /begin LOC_MEASUREMENT APP_stPlaBrkDet_mp APP_stPlaBrkRst_mp /end LOC_MEASUREMENT
 FUNCTION_VERSION "3.2.0" /end FUNCTION
/begin FUNCTION APP_SelSig "3.1.0"
 /begin DEF_CHARACTERISTIC APP_duLimErr.Pos_C APP_duLimErr.Neg_C APP_uAPPDef_C APP_uRaw2Offset_C /end DEF_CHARACTERISTIC
 /begin IN_MEASUREMENT MoFAPP_stLimpMsg /end IN_MEASUREMENT
 /begin LOC_MEASUREMENT APP_stTempErr_mp /end LOC_MEASUREMENT
 FUNCTION_VERSION "3.1.0" /end FUNCTION
/begin FUNCTION APP_VD "3.2.0"
 /begin DEF_CHARACTERISTIC APP_dRawSigFac_C APP_rLinAPP_CUR APP_rThresFltLowNeg_C APP_rThresFltLowPos_C APP_rThresFltMidNeg_C APP_rThresFltMidPos_C APP_swtEnaUnJit_C APP_swtNoFlt_C APP_tiLowNegPT1_C APP_tiLowPosPT1_C APP_tiMidNegPT1_C APP_tiMidPosPT1_C APP_tiUppNegPT1_C APP_tiUppPosPT1_C APP_uJitter_C APP_uRaw1Def_C APP_uRaw2Def_C APP_uSply_C /end DEF_CHARACTERISTIC
 /begin IN_MEASUREMENT Brk_st MoCADC_stMsg PT_bGrip /end IN_MEASUREMENT
 /begin OUT_MEASUREMENT APP_drUnFlt APP_r APP_rOBDPID5A APP_rUnFlt APP_stKD APP_stSigSrc APP_uRaw1 APP_uRaw1unLim APP_uRaw2 APP_uRaw2unLim APP_uRaw2unLimWoNTP /end OUT_MEASUREMENT
 /begin LOC_MEASUREMENT APP_rFlt_mp APP_stPlaBrk_mp APP_uRaw_mp APP_uUnJit_mp /end LOC_MEASUREMENT
 FUNCTION_VERSION "3.2.0" /end FUNCTION
/begin FUNCTION ATCADAP "1.2.0" /begin DEF_CHARACTERISTIC PSPVDKUG /end DEF_CHARACTERISTIC /begin OUT_MEASUREMENT B_dknolu B_dkpiu B_i_ska_fr /end OUT_MEASUREMENT FUNCTION_VERSION "1.2.0" /end FUNCTION
/begin FUNCTION ATM "2.13.0"
 /begin DEF_CHARACTERISTIC ATMINIAR ATMINISEKA ATMKHK ATMKVK ATMSTAR CATMBRX CATMPIX CWATMEXFB CWATMINT CWATMINT1 CWATMSTAR CWATMSTAR2 CWATMSTD CWATMTABST KATMCPAV KFATAPIX KFATLAMS KFATMKRH KFATVBRX KFATVPIX KFATZWMS KFEHBRX KFEXLACTX KFTATMSA STS06TAMUW TAAMNCTX TATMABIPWF TEXOHALTN TOEXCTX TSABGE TSABGEAR ZATMSAMS /end DEF_CHARACTERISTIC
 /begin REF_CHARACTERISTIC ATMOUTCFG /end REF_CHARACTERISTIC
 /begin IN_MEASUREMENT B_abstgp B_eepwf B_kl15 B_nachl B_sa B_stend B_stendz etazwist_w lamsbg_w lamsons_w lavhkm_w mabnavs_w msabgar_w msabnav_w nmot_w rkg_w rl_w tabst_w tmotk_w tumgk_w vfzg_w /end IN_MEASUREMENT
 /begin OUT_MEASUREMENT B_atmng etazwimt nbfbrkc1 nbfbrkc2 nbfbrkc3 nbrcat1 nbrcat2 nbrcat3 tabgar_w tanavm_w tmatar_l /end OUT_MEASUREMENT
 /begin LOC_MEASUREMENT B_lcpwfatm B_totastd catbrctr dtakr_w dtreaka_w exofbr laatmlc_w lamein_w mainloop msabein_w rlkatm_w taatmkr_w tababar_w tabatmlc_w tabcorat_w tanavkf_w tanavkh_w tanavsto_w tanavst_w tavav_w tcat_l tsk15oat_w tstgav_l /end LOC_MEASUREMENT
 FUNCTION_VERSION "2.13.0" /end FUNCTION
/begin FUNCTION ATMIFACE "2.4.0"
 /begin DEF_CHARACTERISTIC ATMOUTCFG CWATMIFAC TAIKRAP TAUTAFSO TAUTAHSO TAUTAIKR TAUTAIKRM TAUTAVROM TAUTAVSO TAUTAVVK TAUTAVVKM TAVHKAP TAVVKAP TKIHKAP TKIVKAP ZATMTKR /end DEF_CHARACTERISTIC
 /begin IN_MEASUREMENT B_stend msabikr_w nbfbrkc1 nbrcat1 tabgar_w tmatar_l tmot /end IN_MEASUREMENT
 /begin OUT_MEASUREMENT tafso_w tahso_w taikrm_w taikr_w tanhkm_w tanvkm_w tanvk_w tanym_w tavhkmm_w tavhkm_w tavhk_w tavrom_w tavso_w tavvkmm_w tavvkm_w tavvk_w tavymm_w thkmax_w thkmid_w thkmin_w tkehkm_w tkevkm_w tkihkmm_w tkihkm_w tkivkmm_w tkivkm_w tmotk_w ttafso_w ttahso_w ttaikrm_w ttaikr_w ttavrom_w ttavso_w ttavvkm_w ttavvk_w twfso_w twhso_w twvso_w /end OUT_MEASUREMENT
 FUNCTION_VERSION "2.4.0" /end FUNCTION
/begin FUNCTION ATSADAPT "2.0.0" FUNCTION_VERSION "2.0.0" /end FUNCTION
/begin FUNCTION ATS_Std "1.14.0"
 /begin DEF_CHARACTERISTIC AirCCmpr_ATS.LimitTypeMsk_C AirCCmpr_ATS.CnvNorm_C AirCCmpr_ATS.LowLim_C AirCCmpr_ATS.UpLim_C AirCCmpr_ATS.CnvFac_C AirCCmpr_ATS.CnvOfs_C AirCCmpr_ATS.DfltVal_C AltIO_ATS.LimitTypeMsk_C AltIO_ATS.CnvNorm_C AltIO_ATS.LowLim_C AltIO_ATS.UpLim_C AltIO_ATS.CnvFac_C AltIO_ATS.CnvOfs_C AltIO_ATS.DfltVal_C ATS_Standby_Disabled_C ATS_tiTstDemHeal_C ATS_tiTstDemMax_C ATS_TmrBehaviour_C ATS_TstDemMaxEngN_C ATS_TstDemMaxVSSCDV_C FanDig0_ATS.LimitTypeMsk_C FanDig0_ATS.CnvNorm_C FanDig0_ATS.LowLim_C FanDig0_ATS.UpLim_C FanDig0_ATS.CnvFac_C FanDig0_ATS.CnvOfs_C FanDig0_ATS.DfltVal_C IdleChrgActr_ATS.LimitTypeMsk_C IdleChrgActr_ATS.CnvNorm_C IdleChrgActr_ATS.LowLim_C IdleChrgActr_ATS.UpLim_C IdleChrgActr_ATS.CnvFac_C IdleChrgActr_ATS.CnvOfs_C IdleChrgActr_ATS.DfltVal_C /end DEF_CHARACTERISTIC
 /begin IN_MEASUREMENT APP_r Brk_st Epm_nEngLRes VehV_v /end IN_MEASUREMENT
 /begin OUT_MEASUREMENT ATS_ctCurRunTst ATS_stMon ATS_stMonTimeLimit /end OUT_MEASUREMENT
 /begin LOC_MEASUREMENT ATS_IntvVal_mp ATS_TstStatus_mp /end LOC_MEASUREMENT
 FUNCTION_VERSION "1.14.0" /end FUNCTION
/begin FUNCTION AVS2DETAKH "1.1.0" /begin OUT_MEASUREMENT fetakhllfa fetakhtlfa /end OUT_MEASUREMENT FUNCTION_VERSION "1.1.0" /end FUNCTION
/begin FUNCTION AVS_Std "1.12.0" /begin DEF_CHARACTERISTIC BasSvrAppl_EepAltAdap_C /end DEF_CHARACTERISTIC FUNCTION_VERSION "1.12.0" /end FUNCTION
/begin FUNCTION BasSvrAppl_EDat "4.0.0"
 /begin DEF_CHARACTERISTIC BasSvrAppl_EepHwPartNum_C BasSvrAppl_EepODXFileID_C BasSvrAppl_EepODXFileVer_C BasSvrAppl_EepPartNr_C BasSvrAppl_EepPrgVer_C BasSvrAppl_EepSysName2_C BasSvrAppl_EepSysName_C BasSvrAppl_EngineCodeL_C BasSvrAppl_numValofSysName_C BasSvrAppl_VWWorkShopSysN_C /end DEF_CHARACTERISTIC
 FUNCTION_VERSION "4.0.0" /end FUNCTION
/begin FUNCTION BasSvrAppl_Std "14.0.0" /begin IN_MEASUREMENT Epm_nEng /end IN_MEASUREMENT FUNCTION_VERSION "14.0.0" /end FUNCTION
/begin FUNCTION BasUtil "20.0.0" FUNCTION_VERSION "20.0.0" /end FUNCTION
/begin FUNCTION Batt_DataAcq "1.11.1" /begin IN_MEASUREMENT BattU_u /end IN_MEASUREMENT /begin OUT_MEASUREMENT ESS_uBatt /end OUT_MEASUREMENT FUNCTION_VERSION "1.11.1" /end FUNCTION
/begin FUNCTION BBGANG "2.0.0"
 /begin DEF_CHARACTERISTIC BFZGLCR BFZGLNCH CWDNMNSIL DBFZGLNCH DNMNSIL FUGKUE NMOTNCHMX TDCN TDGC TDGC1 TDNCHOFF TDNCHON TVVFZGNOI TVVFZGNOST UEVGANG VFZGMINNOI VFZGNCHMX ZCRDETEC ZGKLL ZGKTL ZKBFZGLNCH /end DEF_CHARACTERISTIC
 /begin IN_MEASUREMENT bfzgl_w B_autget B_kuppl B_kupsch B_ll gangauti nmot_w nstat tnst_w vfzg_w /end IN_MEASUREMENT
 /begin OUT_MEASUREMENT B_gawec B_gwhs gangi gangist gangsist gangsziel gsalt gsdat PT_rTraV2N PT_rTrq PT_rTrqWoConvRat Tra_numGear uebver uevges_w /end OUT_MEASUREMENT
 /begin LOC_MEASUREMENT bfzglflt_b B_bsconch B_gangi dnmns_w gangi1 nmitt4_w /end LOC_MEASUREMENT
 FUNCTION_VERSION "2.0.0" /end FUNCTION
/begin FUNCTION BBKHA "2.4.1" /begin IN_MEASUREMENT B_khakt B_khakw B_khatrip B_nmot B_stend /end IN_MEASUREMENT /begin OUT_MEASUREMENT B_kh B_kha B_khan B_khmr /end OUT_MEASUREMENT FUNCTION_VERSION "2.4.1" /end FUNCTION
/begin FUNCTION BBKHAKT "2.9.0"
 /begin DEF_CHARACTERISTIC ABKKATTAB BTRKHTMS CWBBKHAKT DTMABKH FHOKH FKHABMN IMLATMMX IMLATWS IMLPRMX KLMLSKHAGE KLSIMLKHKT KLTKHMXHAG TABSTKHMX TANSMNKH TDIFKH TIFKATMN TKHMXFHO TKHMXLL TNSELDCYMX TUMGMNKH TVFGKHTUM ZKHABB /end DEF_CHARACTERISTIC
 /begin IN_MEASUREMENT B_abstgp B_kh B_khakw B_ll B_stend fcoschmn_w fho_w imlatm_w nbfbrkc1 tabgar_w tabst_w tans tmotab tmst tnse_w tumg /end IN_MEASUREMENT
 /begin OUT_MEASUREMENT B_khakt B_trkh B_trkonz fkhab imlpr_w wistr_w /end OUT_MEASUREMENT
 /begin LOC_MEASUREMENT btrkht B_atikatst B_cwkhakt1 B_cwkhakt3 B_cwkhakt4 B_cwkhakt5 B_cwkhakt6 B_khabbslv B_khabiml B_khabll B_khabtkh B_khaktini B_khaktres B_khaktst B_kherr B_khstc B_khtumg B_khtumres B_trkz fcosawkt_w imlatmab_w imlatmws_w imlskgsa_w imlskhaw_w imlskhgs_w imlskhkt_w tikatst_w tkhakt_w tnseldcy_w /end LOC_MEASUREMENT
 FUNCTION_VERSION "2.9.0" /end FUNCTION
/begin FUNCTION BBKHAKW "3.4.0"
 /begin DEF_CHARACTERISTIC CWBBKHAKW KLFKWTIHK KLTWSKWTMS KLWSATAVS KLWSATWVSO KWVFZGRS KWVFZGST NMAXKW TWSKWATMMX /end DEF_CHARACTERISTIC
 /begin IN_MEASUREMENT B_atmtpa B_khakt B_nmot B_stendz nmot_w tavso_w tkihkm_w tmst tnsez_w twvso_w vfzg_w /end IN_MEASUREMENT
 /begin OUT_MEASUREMENT B_khakw B_kw fanfkw_w /end OUT_MEASUREMENT
 /begin LOC_MEASUREMENT B_anfkwtp B_cwkhakw0 B_fganfkw fanfkwth_w tavsomn_w tkihkmmn_w twskwatm_w twskwtt_w twvsomn_w /end LOC_MEASUREMENT
 FUNCTION_VERSION "3.4.0" /end FUNCTION
/begin FUNCTION BBKHATRIP "1.2.0" /begin OUT_MEASUREMENT B_khatrip /end OUT_MEASUREMENT FUNCTION_VERSION "1.2.0" /end FUNCTION
/begin FUNCTION BBKHFES "1.3.0" /begin DEF_CHARACTERISTIC KFFNWEKHAS KFFNWEKHHS KLFLAKH KLFLBKKH STN08KHUW STS08KHUB /end DEF_CHARACTERISTIC /begin IN_MEASUREMENT B_kh fkhab tmst tnse_w /end IN_MEASUREMENT /begin OUT_MEASUREMENT flakh flbkkh fnwkha fnwkhe /end OUT_MEASUREMENT /begin LOC_MEASUREMENT flakhvab flbkhakt /end LOC_MEASUREMENT FUNCTION_VERSION "1.3.0" /end FUNCTION
/begin FUNCTION BBKR "8.0.0"
 /begin DEF_CHARACTERISTIC DYESPFFKT KFDYESPF KRAL1N KRAL2N KRAL3N KRALH KRAN1 KRAN2 KRAN3 KRAN4 KRANH KRDYDELAY LKRN NGKRWN TMKR TMKRA ZKRDYDELAY ZKREGLDYN ZKRKELDYN ZKRKENDYN /end DEF_CHARACTERISTIC
 /begin REF_CHARACTERISTIC SNMKRA SNMKRB SRL04DYUB /end REF_CHARACTERISTIC
 /begin IN_MEASUREMENT B_dopzue B_kl B_krdwslz B_kuppl B_ll B_nldg B_nmax B_stend B_vnull B_wkralcpy Epm_stSync evz_austot krngfil kr_monitor maskgz nmot pssol_w rl tmot wkrdyv zwkrafld zzylkr /end IN_MEASUREMENT
 /begin OUT_MEASUREMENT B_kr B_kra B_kradap B_krdws B_krdyaen B_krfdks B_krgz B_krkez B_krldy B_krldya B_krldyf B_krldyv B_krndy B_krnl B_ladap B_tipin B_tmkr B_wkral B_zwkraa B_zwkrum dkrpssol krevz_atot stkraidx_w stkrkserr stkrnx /end OUT_MEASUREMENT
 /begin LOC_MEASUREMENT actkeldyn actkendyn actldyn B_delayhld B_eks B_krenfadi B_krsyne dyespfv dyespof kral1_b kral2_b kral3_b krdydlyd_l krdyndelay krdyofdd_l lkrhw ngkrv stkrlx zaeldy zaeldyke zaendy /end LOC_MEASUREMENT
 FUNCTION_VERSION "8.0.0" /end FUNCTION
/begin FUNCTION BBSAFG "4.0.0"
 /begin DEF_CHARACTERISTIC CWSAFG CWSAWE DNSAH DNSAL DNSALH DNSLL DNSLLK DNWEK DNWEKFS DNWEOFF ENSAKHG KFNWEGM KFTSAVGRL KFTVSA KFTVSAGNG KFTVSAGNG2 KFTVSAKAT KLDNVSA NGDNSA NGDNSAL NWEMIN NWENG NWENGFS SAVGANGI SGZ08MDUB SNM08SAUB STK04SAUB STM05SAUB TVBGSCH TVSABFA TVSABTE TVSAGSCH TVSATM /end DEF_CHARACTERISTIC
 /begin REF_CHARACTERISTIC IMSDTEVA TDTEZAM /end REF_CHARACTERISTIC
 /begin IN_MEASUREMENT B_dash B_dteenf B_dtemsfr B_dtephm B_fa B_fs B_gsch B_kh B_koe B_kuppl B_ll B_savfgr B_savmd B_savmsr B_spdtevh B_tatmsa B_te B_vllr gangsist imsteini ngfil nmot nstat rl_w tkihkm_w tmot tmst tnse_w tnst_w vfzg /end IN_MEASUREMENT
 /begin OUT_MEASUREMENT B_sab B_sabte B_sabvor nwe tvsab_w /end OUT_MEASUREMENT
 /begin LOC_MEASUREMENT B_dnsll B_dtevlb B_enlasfx B_enlashx B_saen B_tvsagng2 dnsa nsa nwema tkattmp tvsaa tvsag_w tvsakat tvsans_w tvsavg /end LOC_MEASUREMENT
 FUNCTION_VERSION "4.0.0" /end FUNCTION
/begin FUNCTION BBSTNSAD "1.9.0"
 /begin DEF_CHARACTERISTIC AHENSADMX ANZTIMNSAD CLUTWMENMN CWBBSTNSAD DSDLUTSR ENSAD ESDLUTS FSDLUSOL KFTNSEADMX KSTANSAD MNCLUTWM MXCLUTWM NMXNSAD TENGSDECR TMNSADMN TMNSADMX TMOTMNSAD TVNSADLROF TVNSKUPPEF TVNSKUPPER TVTOFLUT UBKST UBKSTMX /end DEF_CHARACTERISTIC
 /begin IN_MEASUREMENT anztib_w B_ad B_dlutsk B_edkvs B_eev B_evloc B_kuppl B_ll B_lrnda B_lutsk B_nmin B_pug B_stend B_tal B_tsroov B_umsync B_vbmg B_wst Epm_stOpMode fofstat fzabgs_w kstaa lutsinvala nmot sdlutsol_w sdluts_w tengsq1_w tmot tmst tnse_w ubsq vfzg /end IN_MEASUREMENT
 /begin OUT_MEASUREMENT B_nsad B_nsadend B_nsadh B_sdluts B_sdlutsr B_staclr B_staneut B_stanodec B_stanoinc B_stanosav /end OUT_MEASUREMENT
 /begin LOC_MEASUREMENT B_adneusyn B_adstopnd B_engroads B_engroold B_ensad B_esdluts B_inhbadst B_inhengro B_inhronu B_nsadstp B_sccnsad B_sccnsad2 B_ubkst censad cesdluts cesdlutsr clutwmen_w clutwm_w fvapskstaa sdlutact_w tmotbstnsd tmstbstnsd zubkst /end LOC_MEASUREMENT
 FUNCTION_VERSION "1.9.0" /end FUNCTION
/begin FUNCTION BBSTT "1.10.0"
 /begin DEF_CHARACTERISTIC CWBBSTT DTMTNSEZMK NLLREIN NNSTA NSTNM TMORSTE TMTNSEZMK TMURSTE TVLLRSTE /end DEF_CHARACTERISTIC
 /begin IN_MEASUREMENT anztib B_eepwf B_nmin B_nmot Epm_stSpd nmot nmotll nmot_w nstat tans tmot tumg /end IN_MEASUREMENT
 /begin OUT_MEASUREMENT B_st B_stend B_stendes B_stendll B_stendmd B_stendz B_stendzw B_tnsezmkg klnnsta klnstnm tnsezmks_w tnsezmot_w tnsez_w tnse_w tnst_w /end OUT_MEASUREMENT
 /begin LOC_MEASUREMENT B_overrun STENDES_FF.status STENDMD_FF.status STEND_FF.status tmbbstt /end LOC_MEASUREMENT
 FUNCTION_VERSION "1.10.0" /end FUNCTION
/begin FUNCTION BGADAP "2.2.0"
 /begin DEF_CHARACTERISTIC DFKMSDELSR LZSRPUMN LZSRTMOTMN LZSRTMOTMX OMSNDKLSMX TDLZSR /end DEF_CHARACTERISTIC
 /begin IN_MEASUREMENT B_adkose B_fkpvdkp B_ofmsndkp B_psrgg B_psrmhg fkmsdksp_w ofmsndkp_w pu_w tmot /end IN_MEASUREMENT
 /begin OUT_MEASUREMENT B_apslmds B_apslmdse /end OUT_MEASUREMENT
 /begin LOC_MEASUREMENT B_lzsrhfmp /end LOC_MEASUREMENT
 FUNCTION_VERSION "2.2.0" /end FUNCTION
/begin FUNCTION BGBH "1.2.0" /begin DEF_CHARACTERISTIC CWBH DTMSRT TMMXRT TNSRT /end DEF_CHARACTERISTIC /begin IN_MEASUREMENT B_nmot B_tmotgg tmotlinf /end IN_MEASUREMENT /begin OUT_MEASUREMENT B_enbhtr B_nbhtr B_nibhtr B_tmmn B_tmsrt /end OUT_MEASUREMENT /begin LOC_MEASUREMENT B_clcbh B_pnbhtr tbhsw tmmxbh /end LOC_MEASUREMENT FUNCTION_VERSION "1.2.0" /end FUNCTION
/begin FUNCTION BGDSAD "2.4.0" /begin DEF_CHARACTERISTIC NMNDDS2A3 PDSUMX /end DEF_CHARACTERISTIC /begin IN_MEASUREMENT B_psrrg nmot_w psrr_w /end IN_MEASUREMENT
 /begin OUT_MEASUREMENT B_edpsrmn B_edpsrmx B_epsrsg B_fgfnpps B_hedpsr B_hepsrsg ofpndk_w ofpsr2_w ofpsr_w ofpu_w ofpv2v_w ofpvd_w ofpvv2_w ofpvv_w /end OUT_MEASUREMENT
 /begin LOC_MEASUREMENT B_psinlapu /end LOC_MEASUREMENT
 FUNCTION_VERSION "2.4.0" /end FUNCTION
/begin FUNCTION BGEDKVS "1.4.0" /begin DEF_CHARACTERISTIC SF_DKVS /end DEF_CHARACTERISTIC FUNCTION_VERSION "1.4.0" /end FUNCTION
/begin FUNCTION BGETADZW "1.3.0" /begin DEF_CHARACTERISTIC DZWETA ETADZW /end DEF_CHARACTERISTIC /begin IN_MEASUREMENT dzwi etazwsol /end IN_MEASUREMENT FUNCTION_VERSION "1.3.0" /end FUNCTION
/begin FUNCTION BGEVAB "1.1.0" /begin IN_MEASUREMENT evz_austot stateaevab zzbank /end IN_MEASUREMENT /begin OUT_MEASUREMENT bgevabAusBits10ms B_bevab B_evakt B_evloc redist redistb1 /end OUT_MEASUREMENT /begin LOC_MEASUREMENT evz_ausold /end LOC_MEASUREMENT FUNCTION_VERSION "1.1.0" /end FUNCTION
/begin FUNCTION BGFAWU "8.0.0" /begin DEF_CHARACTERISTIC CWLAMFAW DLAMFAW LAMFA TLAFA WDKBALAMFA ZKLAMFAW /end DEF_CHARACTERISTIC /begin IN_MEASUREMENT mifafu_w milsol_w mrfa_w nmot wdkba_w /end IN_MEASUREMENT /begin OUT_MEASUREMENT B_lamfa lamfa_w /end OUT_MEASUREMENT /begin LOC_MEASUREMENT B_lamfas lamfaw_w /end LOC_MEASUREMENT FUNCTION_VERSION "8.0.0" /end FUNCTION
/begin FUNCTION BGFKMS "3.10.0"
 /begin DEF_CHARACTERISTIC CWBGFKMS DFAOMSNDE DFEADKE DFKMSDSTZ DTAOMSNDKE FKMSDKMN FKMSDKMX FKPVDKMSMN FKPVDKPMN FKPVDKPUGD KIMSALL KIMSALLGA KIMSALLKT NDKADVSLMX NMOTFADKMN NMOTFADKMX NMOTOFDKMN NMOTOFDKMX OFMSNDKINI OFMSNDKMN OFMSNDKMX OFMSNDMSMN OFMSNDMSMX TAOFMSNDKE TDABGLST TDDTEVFGAB TDSAFGABGL TDSAOFMNDP TDWDKSUGD VPSPVDMNFA ZFKMSDKSNW ZKMSDKDSKT ZKMSDKT ZRFKMSDK ZROFMSNDK /end DEF_CHARACTERISTIC
 /begin IN_MEASUREMENT B_dsshfs B_dteaam B_dtest B_edks B_eepwf B_falzsr B_fgdkabgs B_ll B_msddkg B_msdkdsg B_psrgg B_pwf B_sa dmsnte_w msdkds_w msdk_w msndk_w nmot nmot_w psr_w pvd_w tnst_w /end IN_MEASUREMENT
 /begin OUT_MEASUREMENT B_adkose B_adkospe B_adkpe B_afkpvdke B_afkpvdpe B_amsndkoe B_aomsndpe B_dschlldk B_fadkoap B_fgabgl B_fgabgla B_fgabglp B_fgsabglp B_fkpvdk B_fkpvdkp B_iniabga B_inilabgp B_ofmsndk B_ofmsndkp B_zwfdka dfuelsan_w dkpsrmh_w fkmsdkh_w fkmsdkp_w fkmsdksp_w fkmsdks_w fkmsdk_w fkpvdkp_w fkpvdk_w ofmsndkp_w ofmsndk_w vpsrvd_w /end OUT_MEASUREMENT
 /begin LOC_MEASUREMENT B_afkpvdei B_inisabgp dfuelanp_w fkpvdkah_w fkpvdkap_w fkpvdkh_w ofmsndah_w ofmsndap_w ofmsndkh_w /end LOC_MEASUREMENT
 FUNCTION_VERSION "3.10.0" /end FUNCTION
/begin FUNCTION BGKFPVHE "3.1.0" FUNCTION_VERSION "3.1.0" /end FUNCTION
/begin FUNCTION BGKSE "2.0.0" /begin DEF_CHARACTERISTIC CWBGKSE CWKSEAG MKARO MKARU /end DEF_CHARACTERISTIC
 /begin IN_MEASUREMENT B_autget B_gsch B_gwhs B_kuppl B_wk B_wkauf B_wkr mdytragm_w mkfanb_w nmot_w /end IN_MEASUREMENT
 /begin OUT_MEASUREMENT B_kraftsch PT_bGrip /end OUT_MEASUREMENT
 /begin LOC_MEASUREMENT bitmuster B_egwhs B_hpnmot B_schlke B_tpnmot mkuppl_w /end LOC_MEASUREMENT
 FUNCTION_VERSION "2.0.0" /end FUNCTION
/begin FUNCTION BGKV "1.3.2" /begin REF_CHARACTERISTIC KUMSIRL /end REF_CHARACTERISTIC /begin IN_MEASUREMENT evz_austot nmot_w rkte_w rk_w zzyl /end IN_MEASUREMENT /begin OUT_MEASUREMENT vsksev_w vsksmlt_w vsksml_w vsks_w vtrip_w /end OUT_MEASUREMENT /begin LOC_MEASUREMENT cycbgkv_w rksumev_w rksum_w rktesum_w vapp_w /end LOC_MEASUREMENT FUNCTION_VERSION "1.3.2" /end FUNCTION
/begin FUNCTION BGLAMABM "1.2.1" /begin DEF_CHARACTERISTIC CWLAMABM DOXSG RSOXABST VNVKVHK /end DEF_CHARACTERISTIC /begin REF_CHARACTERISTIC CWBGLASO /end REF_CHARACTERISTIC
 /begin IN_MEASUREMENT B_abstgp B_sbbvk B_stend dfrzaf_w lamsons_w lassa_w msabvhk_w msaovhk_w oschkm_w pabvhk_w tabst_w tavhkmm_w usvk_w zlrs_w /end IN_MEASUREMENT
 /begin OUT_MEASUREMENT B_hkleer B_hkvoll coxinhk_w lanhkm_w lanvkm_w lason_w lavhkm_w lavvkm_w moxnvnh_w oxinhk_w oxysthk_w rolhk_w tsovhk_w /end OUT_MEASUREMENT
 /begin LOC_MEASUREMENT B_oxrsthk lasonm_w lavvkmm_w moxrsth_w tnvkvhk_w vsabvhk_w /end LOC_MEASUREMENT
 FUNCTION_VERSION "1.2.1" /end FUNCTION
/begin COMPU_METHOD BATTSENS_SY_Compu "" TAB_VERB "%6.3" "" COMPU_TAB_REF BATTSENS_SY_Compu /end COMPU_METHOD
/begin COMPU_VTAB BATTSENS_SY_Compu "" TAB_VERB 2 0 "False" 1 "True" /end COMPU_VTAB
/begin COMPU_METHOD BBSAFG_CESGEAR_MAX_SY_Compu "" RAT_FUNC "%6.2" "" COEFFS 0 1 0 0 0 1 /end COMPU_METHOD
/begin COMPU_METHOD BBSTVE_SY_Compu "" TAB_VERB "%6.3" "" COMPU_TAB_REF BBSTVE_SY_Compu /end COMPU_METHOD
/begin COMPU_VTAB BBSTVE_SY_Compu "" TAB_VERB 2 0 "False" 1 "True" /end COMPU_VTAB
/begin COMPU_METHOD bfzg_sb_q0p217 "" RAT_FUNC "%6.3" "m/s^2" COEFFS 0 1 0 0 0 0.217 /end COMPU_METHOD
/begin COMPU_METHOD bfzg_sw_q4p239Em4 "" RAT_FUNC "%10.7" "m/s^2" COEFFS 0 1 0 0 0 0.0004239 /end COMPU_METHOD
/begin COMPU_METHOD BGOSC_IPOL_SY_Compu "" TAB_VERB "%6.3" "" COMPU_TAB_REF BGOSC_IPOL_SY_Compu /end COMPU_METHOD
/begin COMPU_VTAB BGOSC_IPOL_SY_Compu "" TAB_VERB 3 0 "0" 1 "1" 2 "2" /end COMPU_VTAB
/begin COMPU_METHOD BGTMPK_SY_Compu "" TAB_VERB "%6.3" "" COMPU_TAB_REF BGTMPK_SY_Compu /end COMPU_METHOD
/begin COMPU_VTAB BGTMPK_SY_Compu "" TAB_VERB 7 0 "0" 1 "1" 2 "2" 3 "3" 4 "4" 5 "5" 6 "6" /end COMPU_VTAB
/begin COMPU_METHOD BKVP_SY_Compu "" TAB_VERB "%6.3" "" COMPU_TAB_REF BKVP_SY_Compu /end COMPU_METHOD
/begin COMPU_VTAB BKVP_SY_Compu "" TAB_VERB 4 0 "0" 1 "1" 2 "2" 3 "3" /end COMPU_VTAB
/begin COMPU_METHOD BRKP_PHYSRNGCHK_SY_Compu "" TAB_VERB "%6.3" "" COMPU_TAB_REF BRKP_PHYSRNGCHK_SY_Compu /end COMPU_METHOD
/begin COMPU_VTAB BRKP_PHYSRNGCHK_SY_Compu "" TAB_VERB 2 0 "False" 1 "True" /end COMPU_VTAB
/begin COMPU_METHOD BRKR_ADC_SY_Compu "" TAB_VERB "%6.3" "" COMPU_TAB_REF BRKR_ADC_SY_Compu /end COMPU_METHOD
/begin COMPU_VTAB BRKR_ADC_SY_Compu "" TAB_VERB 2 0 "FALSE" 1 "TRUE" /end COMPU_VTAB
/begin COMPU_METHOD BRKR_PWM_SY_Compu "" TAB_VERB "%6.3" "" COMPU_TAB_REF BRKR_PWM_SY_Compu /end COMPU_METHOD
/begin COMPU_VTAB BRKR_PWM_SY_Compu "" TAB_VERB 2 1 "TRUE" 0 "FALSE" /end COMPU_VTAB
/begin COMPU_METHOD BRK_ATS_SY_Compu "" TAB_VERB "%6.3" "" COMPU_TAB_REF BRK_ATS_SY_Compu /end COMPU_METHOD
/begin COMPU_VTAB BRK_ATS_SY_Compu "" TAB_VERB 2 0 "ATS disabled" 1 "ATS enabled" /end COMPU_VTAB
/begin COMPU_METHOD BRK_BRKR_SY_Compu "" TAB_VERB "%6.3" "" COMPU_TAB_REF BRK_BRKR_SY_Compu /end COMPU_METHOD
/begin COMPU_VTAB BRK_BRKR_SY_Compu "" TAB_VERB 4 0 "BRKR_OFF" 1 "BRKR_ADC_ON" 2 "BRKR_PWM_ON" 3 "BRKR_ADCPWM_ON" /end COMPU_VTAB
/begin COMPU_METHOD BRK_CANCHKENA_SC_Compu "" TAB_VERB "%6.3" "" COMPU_TAB_REF BRK_CANCHKENA_SC_Compu /end COMPU_METHOD
/begin COMPU_VTAB BRK_CANCHKENA_SC_Compu "" TAB_VERB 2 0 "False" 1 "True" /end COMPU_VTAB
/begin COMPU_METHOD BRK_MNBRK_FLTENA_SY_Compu "" TAB_VERB "%6.3" "" COMPU_TAB_REF BRK_MNBRK_FLTENA_SY_Compu /end COMPU_METHOD
/begin COMPU_VTAB BRK_MNBRK_FLTENA_SY_Compu "" TAB_VERB 2 0 "FALSE" 1 "TRUE" /end COMPU_VTAB
/begin COMPU_METHOD BRK_OPTNSWTSEL_SY_Compu "" TAB_VERB "%6.3" "" COMPU_TAB_REF BRK_OPTNSWTSEL_SY_Compu /end COMPU_METHOD
/begin COMPU_VTAB BRK_OPTNSWTSEL_SY_Compu "" TAB_VERB 2 0 "False" 1 "True" /end COMPU_VTAB
/begin COMPU_METHOD BRK_REDBRK_FLTENA_SY_Compu "" TAB_VERB "%6.3" "" COMPU_TAB_REF BRK_REDBRK_FLTENA_SY_Compu /end COMPU_METHOD
/begin COMPU_VTAB BRK_REDBRK_FLTENA_SY_Compu "" TAB_VERB 2 0 "FALSE" 1 "TRUE" /end COMPU_VTAB
/begin COMPU_METHOD BRK_ZEROLRNGENA_SC_Compu "" TAB_VERB "%6.3" "" COMPU_TAB_REF BRK_ZEROLRNGENA_SC_Compu /end COMPU_METHOD
/begin COMPU_VTAB BRK_ZEROLRNGENA_SC_Compu "" TAB_VERB 2 0 "False" 1 "True" /end COMPU_VTAB
/begin COMPU_METHOD BSP742_SY_Compu "" TAB_VERB "%6.3" "" COMPU_TAB_REF BSP742_SY_Compu /end COMPU_METHOD
/begin COMPU_VTAB BSP742_SY_Compu "" TAB_VERB 3 1 "one BSP742" 0 "no BSP742" 2 "two BSP742" /end COMPU_VTAB
/begin COMPU_METHOD BUEK_SY_Compu "" TAB_VERB "%6.3" "" COMPU_TAB_REF BUEK_SY_Compu /end COMPU_METHOD
/begin COMPU_VTAB BUEK_SY_Compu "" TAB_VERB 2 0 "False" 1 "True" /end COMPU_VTAB
/begin COMPU_METHOD BYPASS_SY_Compu "" TAB_VERB "%6.3" "" COMPU_TAB_REF BYPASS_SY_Compu /end COMPU_METHOD
/begin COMPU_VTAB BYPASS_SY_Compu "" TAB_VERB 2 0 "No Bypass" 1 "Bypass" /end COMPU_VTAB
/begin COMPU_METHOD B_TRUE "" TAB_VERB "%6.3" "" COMPU_TAB_REF B_TRUE /end COMPU_METHOD
/begin COMPU_VTAB B_TRUE "" TAB_VERB 2 0 "----" 1 "TRUE" /end COMPU_VTAB
/begin COMPU_METHOD CALWUP_SY_Compu "" TAB_VERB "%6.3" "" COMPU_TAB_REF CALWUP_SY_Compu /end COMPU_METHOD
/begin COMPU_VTAB CALWUP_SY_Compu "" TAB_VERB 2 1 "calibration wake up" 0 "no calibration wake up" /end COMPU_VTAB
/begin COMPU_METHOD CANTXMUX_SY_Compu "" TAB_VERB "%6.3" "" COMPU_TAB_REF CANTXMUX_SY_Compu /end COMPU_METHOD
/begin COMPU_VTAB CANTXMUX_SY_Compu "" TAB_VERB 2 0 "False" 1 "True" /end COMPU_VTAB
/begin COMPU_METHOD CANVER_SY_Compu "" TAB_VERB "%6.3" "" COMPU_TAB_REF CANVER_SY_Compu /end COMPU_METHOD
/begin COMPU_VTAB CANVER_SY_Compu "" TAB_VERB 3 0 "CANVER_V4V5" 1 "CANVER_MLB" 2 "CANVER_MQB" /end COMPU_VTAB
/begin COMPU_METHOD CAN_OFSTRQCOR_SY_Compu "" TAB_VERB "%6.3" "" COMPU_TAB_REF CAN_OFSTRQCOR_SY_Compu /end COMPU_METHOD
/begin COMPU_VTAB CAN_OFSTRQCOR_SY_Compu "" TAB_VERB 2 1 "CAN_OFSTRQCOR_ENA" 0 "CAN_OFSTRQCOR_DISBL" /end COMPU_VTAB
/begin COMPU_METHOD CAN_TRQLAMCOR_SY_Compu "" TAB_VERB "%6.3" "" COMPU_TAB_REF CAN_TRQLAMCOR_SY_Compu /end COMPU_METHOD
/begin COMPU_VTAB CAN_TRQLAMCOR_SY_Compu "" TAB_VERB 2 0 "CAN_TRQLAMCOR_DISBL" 1 "CAN_TRQLAMCOR_ENA" /end COMPU_VTAB
/begin COMPU_METHOD CASI1_SSP_SY_Compu "" TAB_VERB "%6.3" "" COMPU_TAB_REF CASI1_SSP_SY_Compu /end COMPU_METHOD
/begin COMPU_VTAB CASI1_SSP_SY_Compu "" TAB_VERB 4 0 "NO_CAS_SSPMON" 1 "SSPMON1" 2 "SSPMON2" 3 "SSPMON3" /end COMPU_VTAB
/begin COMPU_METHOD CASI2_SSP_SY_Compu "" TAB_VERB "%6.3" "" COMPU_TAB_REF CASI2_SSP_SY_Compu /end COMPU_METHOD
/begin COMPU_VTAB CASI2_SSP_SY_Compu "" TAB_VERB 4 0 "NO_CAS_SSPMON" 1 "SSPMON1" 2 "SSPMON2" 3 "SSPMON3" /end COMPU_VTAB
/begin COMPU_METHOD CASO1_SSP_SY_Compu "" TAB_VERB "%6.3" "" COMPU_TAB_REF CASO1_SSP_SY_Compu /end COMPU_METHOD
/begin COMPU_VTAB CASO1_SSP_SY_Compu "" TAB_VERB 4 0 "NO_CAS_SSPMON" 1 "SSPMON1" 2 "SSPMON2" 3 "SSPMON3" /end COMPU_VTAB
/begin COMPU_METHOD CASO2_SSP_SY_Compu "" TAB_VERB "%6.3" "" COMPU_TAB_REF CASO2_SSP_SY_Compu /end COMPU_METHOD
/begin COMPU_VTAB CASO2_SSP_SY_Compu "" TAB_VERB 4 0 "NO_CAS_SSPMON" 1 "SSPMON1" 2 "SSPMON2" 3 "SSPMON3" /end COMPU_VTAB
/begin COMPU_METHOD CASTYP_SY_Compu "" TAB_VERB "%6.3" "" COMPU_TAB_REF CASTYP_SY_Compu /end COMPU_METHOD
/begin COMPU_VTAB CASTYP_SY_Compu "" TAB_VERB 7 4 "CAS_HALFMOON" 1 "CAS_GS_STD_4TOOTH" 2 "CAS_3TOOTH" 3 "CAS_PULSE" 0 "INDIVIDUAL" 5 "CAS_5TOOH" 6 "CAS_DS_STD_3TEETH" /end COMPU_VTAB
/begin COMPU_METHOD CAS_ADAP_SY_Compu "" TAB_VERB "%6.3" "" COMPU_TAB_REF CAS_ADAP_SY_Compu /end COMPU_METHOD
/begin COMPU_VTAB CAS_ADAP_SY_Compu "" TAB_VERB 4 0 "NO_ADAP" 1 "ADAP" 2 "ADAP_MNTCHK" 3 "ADAP_MNTCHK_INDEDGE" /end COMPU_VTAB
/begin COMPU_METHOD CAS_ANGLE_SY_Compu "" TAB_VERB "%6.3" "" COMPU_TAB_REF CAS_ANGLE_SY_Compu /end COMPU_METHOD
/begin COMPU_VTAB CAS_ANGLE_SY_Compu "" TAB_VERB 3 0 "NO_ANGLE" 1 "VIA_MESSAGE" 2 "VIA_SERVICE" /end COMPU_VTAB
/begin COMPU_METHOD CAS_BACKUP_SY_Compu "" TAB_VERB "%6.3" "" COMPU_TAB_REF CAS_BACKUP_SY_Compu /end COMPU_METHOD
/begin COMPU_VTAB CAS_BACKUP_SY_Compu "" TAB_VERB 3 2 "DOUBLE_IGN" 1 "TST_INJ" 0 "NO_BACKUP" /end COMPU_VTAB
/begin COMPU_METHOD CAS_DIAG_SY_Compu "" TAB_VERB "%6.3" "" COMPU_TAB_REF CAS_DIAG_SY_Compu /end COMPU_METHOD
/begin COMPU_VTAB CAS_DIAG_SY_Compu "" TAB_VERB 4 2 "ADD_MINMAX" 1 "ADD_OFFS" 0 "STD" 3 "ADD_IUMPR" /end COMPU_VTAB
/begin COMPU_METHOD CAS_I1_SY_Compu "" TAB_VERB "%6.3" "" COMPU_TAB_REF CAS_I1_SY_Compu /end COMPU_METHOD
/begin COMPU_VTAB CAS_I1_SY_Compu "" TAB_VERB 2 0 "NO_SIGNAL" 1 "SIGNAL_AVAILABLE" /end COMPU_VTAB
/begin COMPU_METHOD CAS_I2_SY_Compu "" TAB_VERB "%6.3" "" COMPU_TAB_REF CAS_I2_SY_Compu /end COMPU_METHOD
/begin COMPU_VTAB CAS_I2_SY_Compu "" TAB_VERB 2 0 "NO_SIGNAL" 1 "SIGNAL_AVAILABLE" /end COMPU_VTAB
/begin COMPU_METHOD CAS_O1_SY_Compu "" TAB_VERB "%6.3" "" COMPU_TAB_REF CAS_O1_SY_Compu /end COMPU_METHOD
/begin COMPU_VTAB CAS_O1_SY_Compu "" TAB_VERB 2 0 "NO_SIGNAL" 1 "SIGNAL_AVAILABLE" /end COMPU_VTAB
/begin COMPU_METHOD CAS_O2_SY_Compu "" TAB_VERB "%6.3" "" COMPU_TAB_REF CAS_O2_SY_Compu /end COMPU_METHOD
/begin COMPU_VTAB CAS_O2_SY_Compu "" TAB_VERB 2 0 "NO_SIGNAL" 1 "SIGNAL_AVAILABLE" /end COMPU_VTAB
/begin COMPU_METHOD CAS_OUT_SY_Compu "" TAB_VERB "%6.3" "" COMPU_TAB_REF CAS_OUT_SY_Compu /end COMPU_METHOD
/begin COMPU_VTAB CAS_OUT_SY_Compu "" TAB_VERB 3 0 "NO_CAS_OUTPUT" 1 "OUTPUT_VAR1" 2 "OUTPUT_VAR2" /end COMPU_VTAB
/begin COMPU_METHOD CAS_SEGCOR_SY_Compu "" TAB_VERB "%6.3" "" COMPU_TAB_REF CAS_SEGCOR_SY_Compu /end COMPU_METHOD
/begin COMPU_VTAB CAS_SEGCOR_SY_Compu "" TAB_VERB 2 0 "NO_SEGCOR" 1 "SEGCOR1" /end COMPU_VTAB
/begin COMPU_METHOD CHDT_SENS_SY_Compu "" TAB_VERB "%6.3" "" COMPU_TAB_REF CHDT_SENS_SY_Compu /end COMPU_METHOD
/begin COMPU_VTAB CHDT_SENS_SY_Compu "" TAB_VERB 3 0 "CHDTNO" 2 "CHDTADC" 1 "CHDTMOD" /end COMPU_VTAB
/begin COMPU_METHOD CHDT_SY_Compu "" TAB_VERB "%6.3" "" COMPU_TAB_REF CHDT_SY_Compu /end COMPU_METHOD
/begin COMPU_VTAB CHDT_SY_Compu "" TAB_VERB 2 0 "False" 1 "True" /end COMPU_VTAB
/begin COMPU_METHOD CHRGEXCHMDLCORDPDCHR_SC_Compu "" TAB_VERB "%6.3" "" COMPU_TAB_REF CHRGEXCHMDLCORDPDCHR_SC_Compu /end COMPU_METHOD
/begin COMPU_VTAB CHRGEXCHMDLCORDPDCHR_SC_Compu "" TAB_VERB 2 0 "0" 1 "1" /end COMPU_VTAB
/begin COMPU_METHOD CHRSET_VAR_SY_Compu "" TAB_VERB "%6.3" "" COMPU_TAB_REF CHRSET_VAR_SY_Compu /end COMPU_METHOD
/begin COMPU_VTAB CHRSET_VAR_SY_Compu "" TAB_VERB 32 1 "DAI" 3 "VWW" 5 "AUD" 22 "FOR" 147 "HYU" 999 "ALL" 214 "AVT" 9 "FIA" 21 "GMU" 159 "HON" 160 "MAZ" 123 "MIT" 20 "NIS" 14 "PSA" 4 "POR" 15 "REN" 248 "SUZ" 308 "TAT" 72 "TOY" 6 "OPE" 19 "VOL" 55 "ROL" 18 "SAB" 69 "FER" 51 "SEA" 204 "VVW" 17 "ALF" 289 "AMG" 11 "BMW" 183 "CU" 385 "UAES" 243 "DMC" /end COMPU_VTAB
/begin COMPU_METHOD Ch_Ah_q0p5_COMPU "" RAT_FUNC "%6.3" "Ah" COEFFS 0 2 0 0 0 1 /end COMPU_METHOD
/begin COMPU_METHOD CIC751_SY_Compu "" TAB_VERB "%6.3" "" COMPU_TAB_REF CIC751_SY_Compu /end COMPU_METHOD
/begin COMPU_VTAB CIC751_SY_Compu "" TAB_VERB 3 0 "NO_CIC751" 1 "1_CIC751" 2 "2_CIC751" /end COMPU_VTAB
/begin COMPU_METHOD CIVVL_SY_Compu "" TAB_VERB "%6.3" "" COMPU_TAB_REF CIVVL_SY_Compu /end COMPU_METHOD
/begin COMPU_VTAB CIVVL_SY_Compu "" TAB_VERB 3 1 "CIVVL_INLET" 0 "NO_CIVVL" 2 "CIVVL_OUTLET" /end COMPU_VTAB
/begin COMPU_METHOD CJ930_NUMCHP_SY_Compu "" TAB_VERB "%6.3" "" COMPU_TAB_REF CJ930_NUMCHP_SY_Compu /end COMPU_METHOD
/begin COMPU_VTAB CJ930_NUMCHP_SY_Compu "" TAB_VERB 2 0 "no CJ930 in ECU" 1 "one CJ930 in ECU" /end COMPU_VTAB
/begin COMPU_METHOD CJ930_SY_Compu "" TAB_VERB "%6.3" "" COMPU_TAB_REF CJ930_SY_Compu /end COMPU_METHOD
/begin COMPU_VTAB CJ930_SY_Compu "" TAB_VERB 2 0 "no CJ930" 1 "one CJ930" /end COMPU_VTAB
/begin COMPU_METHOD CJ945_SY_Compu "" TAB_VERB "%6.3" "" COMPU_TAB_REF CJ945_SY_Compu /end COMPU_METHOD
/begin COMPU_VTAB CJ945_SY_Compu "" TAB_VERB 3 0 "no CJ945" 2 "two CJ945" 1 "one CJ945" /end COMPU_VTAB
/begin COMPU_METHOD CLNTOUTSENS_SY_Compu "" TAB_VERB "%6.3" "" COMPU_TAB_REF CLNTOUTSENS_SY_Compu /end COMPU_METHOD
/begin COMPU_VTAB CLNTOUTSENS_SY_Compu "" TAB_VERB 2 0 "FALSE" 1 "TRUE" /end COMPU_VTAB
/begin COMPU_METHOD CLNTVLV_SY_Compu "" TAB_VERB "%6.3" "" COMPU_TAB_REF CLNTVLV_SY_Compu /end COMPU_METHOD
/begin COMPU_VTAB CLNTVLV_SY_Compu "" TAB_VERB 2 0 "False" 1 "True" /end COMPU_VTAB
/begin COMPU_METHOD CMBENGSLFRUN_SY_Compu "" TAB_VERB "%6.3" "" COMPU_TAB_REF CMBENGSLFRUN_SY_Compu /end COMPU_METHOD
/begin COMPU_VTAB CMBENGSLFRUN_SY_Compu "" TAB_VERB 2 0 "CMBENGSLFRUN_SY" 1 "CMBENGSLFRUN_SY" /end COMPU_VTAB
/begin COMPU_METHOD CMBTYP_SY_Compu "" TAB_VERB "%6.3" "" COMPU_TAB_REF CMBTYP_SY_Compu /end COMPU_METHOD
/begin COMPU_VTAB CMBTYP_SY_Compu "" TAB_VERB 2 0 "CMBTYP_DS" 1 "CMBTYP_GS" /end COMPU_VTAB
/begin COMPU_METHOD CoeffA "" RAT_FUNC "%6.4" "1/(s*Nm)" COEFFS 0 204.8 0 0 0 1 /end COMPU_METHOD
/begin COMPU_METHOD COENGSTRT_SY_Compu "" TAB_VERB "%6.3" "" COMPU_TAB_REF COENGSTRT_SY_Compu /end COMPU_METHOD
/begin COMPU_VTAB COENGSTRT_SY_Compu "" TAB_VERB 2 0 "False" 1 "True" /end COMPU_VTAB
/begin COMPU_METHOD COESS_ENASSE_SY_Compu "" TAB_VERB "%6.3" "" COMPU_TAB_REF COESS_ENASSE_SY_Compu /end COMPU_METHOD
/begin COMPU_VTAB COESS_ENASSE_SY_Compu "" TAB_VERB 3 0 "COESS_ENASSE_OFF" 1 "COESS_ENASSE_INTERNAL" 2 "COESS_ENASSE_EXTERNAL" /end COMPU_VTAB
/begin COMPU_METHOD COESS_RCPTMNG_SY_Compu "" TAB_VERB "%6.3" "" COMPU_TAB_REF COESS_RCPTMNG_SY_Compu /end COMPU_METHOD
/begin COMPU_VTAB COESS_RCPTMNG_SY_Compu "" TAB_VERB 2 0 "False" 1 "True" /end COMPU_VTAB
/begin COMPU_METHOD COMCIL_WKUP_SY_Compu "" TAB_VERB "%6.3" "" COMPU_TAB_REF COMCIL_WKUP_SY_Compu /end COMPU_METHOD
/begin COMPU_VTAB COMCIL_WKUP_SY_Compu "" TAB_VERB 2 1 "TRUE" 0 "FALSE" /end COMPU_VTAB
/begin COMPU_METHOD COM_STCANVERMSK_SY_Compu "" RAT_FUNC "%6.2" "" COEFFS 0 1 0 0 0 1 /end COMPU_METHOD
/begin COMPU_METHOD CONV_OVHPRT_SY_Compu "" TAB_VERB "%6.3" "" COMPU_TAB_REF CONV_OVHPRT_SY_Compu /end COMPU_METHOD
/begin COMPU_VTAB CONV_OVHPRT_SY_Compu "" TAB_VERB 2 0 "False" 1 "True" /end COMPU_VTAB
/begin COMPU_METHOD CORRZLRSTMOT_SY_Compu "" TAB_VERB "%6.3" "" COMPU_TAB_REF CORRZLRSTMOT_SY_Compu /end COMPU_METHOD
/begin COMPU_VTAB CORRZLRSTMOT_SY_Compu "" TAB_VERB 2 0 "False" 1 "True" /end COMPU_VTAB
/begin COMPU_METHOD COVOM_STUB_SY_Compu "" TAB_VERB "%6.3" "" COMPU_TAB_REF COVOM_STUB_SY_Compu /end COMPU_METHOD
/begin COMPU_VTAB COVOM_STUB_SY_Compu "" TAB_VERB 2 0 "False" 1 "True" /end COMPU_VTAB
/begin COMPU_METHOD CRCTL_SY_Compu "" TAB_VERB "%6.3" "" COMPU_TAB_REF CRCTL_SY_Compu /end COMPU_METHOD
/begin COMPU_VTAB CRCTL_SY_Compu "" TAB_VERB 2 0 "FALSE" 1 "TRUE" /end COMPU_VTAB
/begin COMPU_METHOD CRSSENSTYP_SY_Compu "" TAB_VERB "%6.3" "" COMPU_TAB_REF CRSSENSTYP_SY_Compu /end COMPU_METHOD
/begin COMPU_VTAB CRSSENSTYP_SY_Compu "" TAB_VERB 2 0 "STD" 1 "DGI" /end COMPU_VTAB
/begin COMPU_METHOD CRSTYP_SY_Compu "" TAB_VERB "%6.3" "" COMPU_TAB_REF CRSTYP_SY_Compu /end COMPU_METHOD
/begin COMPU_VTAB CRSTYP_SY_Compu "" TAB_VERB 4 0 "SYMMETRIC_GAP" 1 "SHORT_GAP" 2 "CODED_GAP" 3 "ASYMMETRIC_GAP" /end COMPU_VTAB
/begin COMPU_METHOD CRS_ALTPIN_SY_Compu "" TAB_VERB "%6.3" "" COMPU_TAB_REF CRS_ALTPIN_SY_Compu /end COMPU_METHOD
/begin COMPU_VTAB CRS_ALTPIN_SY_Compu "" TAB_VERB 2 0 "ONE_CRS_INPUT" 1 "TWO_CRS_INPUTS" /end COMPU_VTAB
/begin COMPU_METHOD CRS_ANGLECOR_SY_Compu "" TAB_VERB "%6.3" "" COMPU_TAB_REF CRS_ANGLECOR_SY_Compu /end COMPU_METHOD
/begin COMPU_VTAB CRS_ANGLECOR_SY_Compu "" TAB_VERB 4 0 "NO_COR" 1 "IAS" 2 "IAP" 3 "IAS_IAP" /end COMPU_VTAB
/begin COMPU_METHOD CRS_BACKUP_CASTYP_SY_Compu "" TAB_VERB "%6.3" "" COMPU_TAB_REF CRS_BACKUP_CASTYP_SY_Compu /end COMPU_METHOD
/begin COMPU_VTAB CRS_BACKUP_CASTYP_SY_Compu "" TAB_VERB 4 0 "ZN_PLUS_1_WHEEL" 1 "DS_STD_WHEEL" 2 "GS_STD_WHEEL" 3 "HALFMOON_WHEEL" /end COMPU_VTAB
/begin COMPU_METHOD CRS_BACKUP_DYN_SY_Compu "" TAB_VERB "%6.3" "" COMPU_TAB_REF CRS_BACKUP_DYN_SY_Compu /end COMPU_METHOD
/begin COMPU_VTAB CRS_BACKUP_DYN_SY_Compu "" TAB_VERB 2 0 "CAL_DYNCOR" 1 "ADAP_DYNCAOR" /end COMPU_VTAB
/begin COMPU_METHOD CRS_BACKUP_SY_Compu "" TAB_VERB "%6.3" "" COMPU_TAB_REF CRS_BACKUP_SY_Compu /end COMPU_METHOD
/begin COMPU_VTAB CRS_BACKUP_SY_Compu "" TAB_VERB 4 0 "NO_BCR" 1 "BCR" 2 "BCR_DYNCOR_START" 3 "BCR_DYNCOR_ALWAYS" /end COMPU_VTAB
/begin COMPU_METHOD CRS_CY30CONF_SY_Compu "" TAB_VERB "%6.3" "" COMPU_TAB_REF CRS_CY30CONF_SY_Compu /end COMPU_METHOD
/begin COMPU_VTAB CRS_CY30CONF_SY_Compu "" TAB_VERB 4 0 "HARD_WIRED" 1 "CONF_TH_VIA_SW" 2 "CONF_K_VIA_SW" 3 "CONF_TH_K_VIA_SW" /end COMPU_VTAB
/begin COMPU_METHOD CRS_DIAG_DETAIL_SY_Compu "" TAB_VERB "%6.3" "" COMPU_TAB_REF CRS_DIAG_DETAIL_SY_Compu /end COMPU_METHOD
/begin COMPU_VTAB CRS_DIAG_DETAIL_SY_Compu "" TAB_VERB 3 0 "NO_DETAIL" 1 "DETAIL_ERRSIG" 2 "DETAIL_ERRSIG_GLITCH" /end COMPU_VTAB
/begin COMPU_METHOD CRS_DIAG_SYNCINJLOST_SY_Compu "" TAB_VERB "%6.3" "" COMPU_TAB_REF CRS_DIAG_SYNCINJLOST_SY_Compu /end COMPU_METHOD
/begin COMPU_VTAB CRS_DIAG_SYNCINJLOST_SY_Compu "" TAB_VERB 2 0 "NO_ADD_DIAG" 1 "ACTIVATED" /end COMPU_VTAB
/begin COMPU_METHOD CRS_MIAP_SY_Compu "" TAB_VERB "%6.3" "" COMPU_TAB_REF CRS_MIAP_SY_Compu /end COMPU_METHOD
/begin COMPU_VTAB CRS_MIAP_SY_Compu "" TAB_VERB 2 0 "NO_COR" 1 "MIAP" /end COMPU_VTAB
/begin COMPU_METHOD CRS_SSP_SY_Compu "" TAB_VERB "%6.3" "" COMPU_TAB_REF CRS_SSP_SY_Compu /end COMPU_METHOD
/begin COMPU_VTAB CRS_SSP_SY_Compu "" TAB_VERB 4 0 "NO_CRS_SSPMON" 1 "CRS_SSPMON1" 2 "CRS_SSPMON2" 3 "CRS_SSPMON3" /end COMPU_VTAB
/begin COMPU_METHOD CRS_TAA_SY_Compu "" TAB_VERB "%6.3" "" COMPU_TAB_REF CRS_TAA_SY_Compu /end COMPU_METHOD
/begin COMPU_VTAB CRS_TAA_SY_Compu "" TAB_VERB 2 0 "NO_COR" 1 "TAA" /end COMPU_VTAB
/begin COMPU_METHOD CRS_TOOTHAVRG_SY_Compu "" TAB_VERB "%6.3" "" COMPU_TAB_REF CRS_TOOTHAVRG_SY_Compu /end COMPU_METHOD
/begin COMPU_VTAB CRS_TOOTHAVRG_SY_Compu "" TAB_VERB 2 0 "NO_AVRG" 1 "TOOTH_AVERAGE" /end COMPU_VTAB
/begin COMPU_METHOD CTTCTL_SY_Compu "" TAB_VERB "%6.3" "" COMPU_TAB_REF CTTCTL_SY_Compu /end COMPU_METHOD
/begin COMPU_VTAB CTTCTL_SY_Compu "" TAB_VERB 2 0 "False" 1 "True" /end COMPU_VTAB
/begin COMPU_METHOD CTTMON_TEMP_SY_Compu "" TAB_VERB "%6.3" "" COMPU_TAB_REF CTTMON_TEMP_SY_Compu /end COMPU_METHOD
/begin COMPU_VTAB CTTMON_TEMP_SY_Compu "" TAB_VERB 2 1 "TRUE" 0 "ENVT" /end COMPU_VTAB
/begin COMPU_METHOD CTTMON_TYPE_SY_Compu "" TAB_VERB "%6.3" "" COMPU_TAB_REF CTTMON_TYPE_SY_Compu /end COMPU_METHOD
/begin COMPU_VTAB CTTMON_TYPE_SY_Compu "" TAB_VERB 3 0 "0" 1 "1" 255 "2" /end COMPU_VTAB
/begin COMPU_METHOD CT_REPLVALSRC_SY_Compu "" TAB_VERB "%6.3" "" COMPU_TAB_REF CT_REPLVALSRC_SY_Compu /end COMPU_METHOD
/begin COMPU_VTAB CT_REPLVALSRC_SY_Compu "" TAB_VERB 2 2 "TFA2LINF_CALC" 1 "TFA1LINF_CALC" /end COMPU_VTAB
/begin COMPU_METHOD CubMtrPerHr "" RAT_FUNC "%6.3" "m^3/h" COEFFS 0 10 0 0 0 1 /end COMPU_METHOD
/begin COMPU_METHOD Curr "" RAT_FUNC "%6.2" "mA" COEFFS 0 1 0 0 0 1 /end COMPU_METHOD
/begin COMPU_METHOD Curr_A "" RAT_FUNC "%6.4" "A" COEFFS 0 100 0 0 0 1 /end COMPU_METHOD
/begin COMPU_METHOD Curr_A_q0p03125_COMPU "" RAT_FUNC "%6.4" "A" COEFFS 0 32 0 0 0 1 /end COMPU_METHOD
/begin COMPU_METHOD CVC_SY_Compu "" TAB_VERB "%6.3" "" COMPU_TAB_REF CVC_SY_Compu /end COMPU_METHOD
/begin COMPU_VTAB CVC_SY_Compu "" TAB_VERB 2 0 "False" 1 "True" /end COMPU_VTAB
/begin COMPU_METHOD CVOCFG_SC_Compu "" TAB_VERB "%6.3" "" COMPU_TAB_REF CVOCFG_SC_Compu /end COMPU_METHOD
/begin COMPU_VTAB CVOCFG_SC_Compu "" TAB_VERB 2 0 "NO_CVO" 1 "BASC_CVO" /end COMPU_VTAB
/begin COMPU_METHOD CVT_SY_Compu "" TAB_VERB "%6.3" "" COMPU_TAB_REF CVT_SY_Compu /end COMPU_METHOD
/begin COMPU_VTAB CVT_SY_Compu "" TAB_VERB 2 0 "no CVT gear active" 1 "CVT gear active" /end COMPU_VTAB
/begin COMPU_METHOD CY100_SY_Compu "" TAB_VERB "%6.3" "" COMPU_TAB_REF CY100_SY_Compu /end COMPU_METHOD
/begin COMPU_VTAB CY100_SY_Compu "" TAB_VERB 3 1 "one CY100" 0 "no CY100" 2 "two CY100" /end COMPU_VTAB
/begin COMPU_METHOD CY141_SY_Compu "" TAB_VERB "%6.3" "" COMPU_TAB_REF CY141_SY_Compu /end COMPU_METHOD
/begin COMPU_VTAB CY141_SY_Compu "" TAB_VERB 2 0 "no CY141" 1 "one CY141" /end COMPU_VTAB
/begin COMPU_METHOD CY146_SY_Compu "" TAB_VERB "%6.3" "" COMPU_TAB_REF CY146_SY_Compu /end COMPU_METHOD
/begin COMPU_VTAB CY146_SY_Compu "" TAB_VERB 2 0 "no CY146" 1 "one CY146" /end COMPU_VTAB
/begin COMPU_METHOD CY320_SY_Compu "" TAB_VERB "%6.3" "" COMPU_TAB_REF CY320_SY_Compu /end COMPU_METHOD
/begin COMPU_VTAB CY320_SY_Compu "" TAB_VERB 2 1 "1" 0 "0" /end COMPU_VTAB
/begin COMPU_METHOD CY327_SY_Compu "" TAB_VERB "%6.3" "" COMPU_TAB_REF CY327_SY_Compu /end COMPU_METHOD
/begin COMPU_VTAB CY327_SY_Compu "" TAB_VERB 3 0 "No CY327" 1 "One CY327" 2 "Two CY327" /end COMPU_VTAB
/begin COMPU_METHOD CylK1 "" RAT_FUNC "%6.4" "10^-5m^3/AgCA" COEFFS 0 128 0 0 0 1 /end COMPU_METHOD
/begin COMPU_METHOD CylK2 "" RAT_FUNC "%7.6" "-" COEFFS 0 16384 0 0 0 1 /end COMPU_METHOD
/begin COMPU_METHOD CylPres "" RAT_FUNC "%6.4" "bar" COEFFS 0 128 0 0 0 1 /end COMPU_METHOD
/begin COMPU_METHOD DAcc_20ms "" RAT_FUNC "%6.4" "m/s^2/s" COEFFS 0 100 0 0 0 1 /end COMPU_METHOD
/begin COMPU_METHOD DCSOVRDSDFFTLPRT_SY_Compu "" TAB_VERB "%6.3" "" COMPU_TAB_REF DCSOVRDSDFFTLPRT_SY_Compu /end COMPU_METHOD
/begin COMPU_VTAB DCSOVRDSDFFTLPRT_SY_Compu "" TAB_VERB 2 0 "Differential protection has higher Priotity as DCS" 1 "DCS has higher Priotity as differential protection" /end COMPU_VTAB
/begin COMPU_METHOD DCSOVRDSENGPRT_SY_Compu "" TAB_VERB "%6.3" "" COMPU_TAB_REF DCSOVRDSENGPRT_SY_Compu /end COMPU_METHOD
/begin COMPU_VTAB DCSOVRDSENGPRT_SY_Compu "" TAB_VERB 2 0 "higher priority to engine protection" 1 "higher priority to drag control system" /end COMPU_VTAB
/begin COMPU_METHOD DCSOVRDSTRAPRT_SY_Compu "" TAB_VERB "%6.3" "" COMPU_TAB_REF DCSOVRDSTRAPRT_SY_Compu /end COMPU_METHOD
/begin COMPU_VTAB DCSOVRDSTRAPRT_SY_Compu "" TAB_VERB 2 1 "TRUE" 0 "FALSE" /end COMPU_VTAB
/begin COMPU_METHOD DCSOVRDSTSCDEC_SY_Compu "" TAB_VERB "%6.3" "" COMPU_TAB_REF DCSOVRDSTSCDEC_SY_Compu /end COMPU_METHOD
/begin COMPU_VTAB DCSOVRDSTSCDEC_SY_Compu "" TAB_VERB 2 1 "TRUE" 0 "FALSE" /end COMPU_VTAB
/begin COMPU_METHOD DDRC_DTRFRZINFHEALDEB_SY_Compu "" TAB_VERB "%6.3" "" COMPU_TAB_REF DDRC_DTRFRZINFHEALDEB_SY_Compu /end COMPU_METHOD
/begin COMPU_VTAB DDRC_DTRFRZINFHEALDEB_SY_Compu "" TAB_VERB 2 0 "False" 1 "True" /end COMPU_VTAB
/begin COMPU_METHOD DDRC_DTRUPDSUP_SY_Compu "" TAB_VERB "%6.3" "" COMPU_TAB_REF DDRC_DTRUPDSUP_SY_Compu /end COMPU_METHOD
/begin COMPU_VTAB DDRC_DTRUPDSUP_SY_Compu "" TAB_VERB 2 0 "False" 1 "True" /end COMPU_VTAB
/begin COMPU_METHOD DECOMP_SY_Compu "" TAB_VERB "%6.3" "" COMPU_TAB_REF DECOMP_SY_Compu /end COMPU_METHOD
/begin COMPU_VTAB DECOMP_SY_Compu "" TAB_VERB 2 0 "no availibility of drag error compensation in ASDr" 1 "activiation of drag error compensation possible in" /end COMPU_VTAB
/begin COMPU_METHOD DEDIA_VRNTCONF_SY_Compu "" TAB_VERB "%6.3" "" COMPU_TAB_REF DEDIA_VRNTCONF_SY_Compu /end COMPU_METHOD
/begin COMPU_VTAB DEDIA_VRNTCONF_SY_Compu "" TAB_VERB 3 2 "DEDIA_VRNTCONF_GS" 1 "DEDIA_VRNTCONF_DS" 0 "DEDIA_VRNTCONF_ALL" /end COMPU_VTAB
/begin COMPU_METHOD DEVLIB_4WINDIACMPNENA_SY_Compu "" TAB_VERB "%6.3" "" COMPU_TAB_REF DEVLIB_4WINDIACMPNENA_SY_Compu /end COMPU_METHOD
/begin COMPU_VTAB DEVLIB_4WINDIACMPNENA_SY_Compu "" TAB_VERB 2 1 "True" 0 "False" /end COMPU_VTAB
/begin COMPU_METHOD DEVLIB_ACTRPRTCMPNENA_SY_Compu "" TAB_VERB "%6.3" "" COMPU_TAB_REF DEVLIB_ACTRPRTCMPNENA_SY_Compu /end COMPU_METHOD
/begin COMPU_VTAB DEVLIB_ACTRPRTCMPNENA_SY_Compu "" TAB_VERB 2 0 "False" 1 "True" /end COMPU_VTAB
/begin COMPU_METHOD DEVLIB_DBG_SY_Compu "" TAB_VERB "%6.3" "" COMPU_TAB_REF DEVLIB_DBG_SY_Compu /end COMPU_METHOD
/begin COMPU_VTAB DEVLIB_DBG_SY_Compu "" TAB_VERB 2 1 "True" 0 "False" /end COMPU_VTAB
/begin COMPU_METHOD DEVLIB_DIACTLLINECMPNENA_SY_Compu "" TAB_VERB "%6.3" "" COMPU_TAB_REF DEVLIB_DIACTLLINECMPNENA_SY_Compu /end COMPU_METHOD
/begin COMPU_VTAB DEVLIB_DIACTLLINECMPNENA_SY_Compu "" TAB_VERB 2 0 "False" 1 "True" /end COMPU_VTAB
/begin COMPU_METHOD DEVLIB_HBRGENA_SY_Compu "" TAB_VERB "%6.3" "" COMPU_TAB_REF DEVLIB_HBRGENA_SY_Compu /end COMPU_METHOD
/begin COMPU_VTAB DEVLIB_HBRGENA_SY_Compu "" TAB_VERB 2 0 "0" 1 "1" /end COMPU_VTAB
/begin COMPU_METHOD DEVLIB_PHYSRNGCHK_SY_Compu "" TAB_VERB "%6.3" "" COMPU_TAB_REF DEVLIB_PHYSRNGCHK_SY_Compu /end COMPU_METHOD
/begin COMPU_VTAB DEVLIB_PHYSRNGCHK_SY_Compu "" TAB_VERB 2 0 "FALSE" 1 "TRUE" /end COMPU_VTAB
/begin COMPU_METHOD DEVLIB_PSOFFOPNLD_SY_Compu "" TAB_VERB "%6.3" "" COMPU_TAB_REF DEVLIB_PSOFFOPNLD_SY_Compu /end COMPU_METHOD
/begin COMPU_VTAB DEVLIB_PSOFFOPNLD_SY_Compu "" TAB_VERB 2 0 "FALSE" 1 "TRUE" /end COMPU_VTAB
/begin COMPU_METHOD dez "" RAT_FUNC "%6.2" "" COEFFS 0 1 0 0 0 1 /end COMPU_METHOD
/begin COMPU_METHOD DFC_CTLDISBLLAYOUT_SY_Compu "" RAT_FUNC "%6.2" "" COEFFS 0 1 0 0 0 1 /end COMPU_METHOD
/begin COMPU_METHOD DFC_CTLMSKBYTES_SY_Compu "" TAB_VERB "%6.3" "" COMPU_TAB_REF DFC_CTLMSKBYTES_SY_Compu /end COMPU_METHOD
/begin COMPU_VTAB DFC_CTLMSKBYTES_SY_Compu "" TAB_VERB 2 1 "SIZE_1_BYTE" 2 "SIZE_2_BYTES" /end COMPU_VTAB
/begin COMPU_METHOD DFC_DISBLMSKBYTES_SY_Compu "" TAB_VERB "%6.3" "" COMPU_TAB_REF DFC_DISBLMSKBYTES_SY_Compu /end COMPU_METHOD
/begin COMPU_VTAB DFC_DISBLMSKBYTES_SY_Compu "" TAB_VERB 2 1 "SIZE_1_BYTE" 2 "SIZE_2_BYTES" /end COMPU_VTAB
/begin COMPU_METHOD DFES_BLKENTRY_SY_Compu "" TAB_VERB "%6.3" "" COMPU_TAB_REF DFES_BLKENTRY_SY_Compu /end COMPU_METHOD
/begin COMPU_VTAB DFES_BLKENTRY_SY_Compu "" TAB_VERB 2 0 "False" 1 "True" /end COMPU_VTAB
/begin COMPU_METHOD DFES_COMMILDEB_SY_Compu "" TAB_VERB "%6.3" "" COMPU_TAB_REF DFES_COMMILDEB_SY_Compu /end COMPU_METHOD
/begin COMPU_VTAB DFES_COMMILDEB_SY_Compu "" TAB_VERB 2 0 "DISABLED" 1 "ENABLED" /end COMPU_VTAB
/begin COMPU_METHOD DFES_DTC_TSTFAIL_SY_Compu "" TAB_VERB "%6.3" "" COMPU_TAB_REF DFES_DTC_TSTFAIL_SY_Compu /end COMPU_METHOD
/begin COMPU_VTAB DFES_DTC_TSTFAIL_SY_Compu "" TAB_VERB 2 0 "0" 1 "1" /end COMPU_VTAB
/begin COMPU_METHOD DFES_EOBDCV_SY_Compu "" TAB_VERB "%6.3" "" COMPU_TAB_REF DFES_EOBDCV_SY_Compu /end COMPU_METHOD
/begin COMPU_VTAB DFES_EOBDCV_SY_Compu "" TAB_VERB 2 1 "TRUE" 0 "FALSE" /end COMPU_VTAB
/begin COMPU_METHOD DFES_EOLCLR_SY_Compu "" TAB_VERB "%6.3" "" COMPU_TAB_REF DFES_EOLCLR_SY_Compu /end COMPU_METHOD
/begin COMPU_VTAB DFES_EOLCLR_SY_Compu "" TAB_VERB 2 0 "False" 1 "True" /end COMPU_VTAB
/begin COMPU_METHOD DFES_EXTDFLT_SY_Compu "" TAB_VERB "%6.3" "" COMPU_TAB_REF DFES_EXTDFLT_SY_Compu /end COMPU_METHOD
/begin COMPU_VTAB DFES_EXTDFLT_SY_Compu "" TAB_VERB 2 0 "DISABLED" 1 "ENABLED" /end COMPU_VTAB
/begin COMPU_METHOD DFES_IRV_SY_Compu "" TAB_VERB "%6.3" "" COMPU_TAB_REF DFES_IRV_SY_Compu /end COMPU_METHOD
/begin COMPU_VTAB DFES_IRV_SY_Compu "" TAB_VERB 2 0 "DFES_IRV_DISBL" 1 "DFES_IRV_ENA" /end COMPU_VTAB
/begin COMPU_METHOD DFES_PDTC_SY_Compu "" TAB_VERB "%6.3" "" COMPU_TAB_REF DFES_PDTC_SY_Compu /end COMPU_METHOD
/begin COMPU_VTAB DFES_PDTC_SY_Compu "" TAB_VERB 2 0 "False" 1 "True" /end COMPU_VTAB
/begin COMPU_METHOD DFES_PRVTSTRDLT_SY_Compu "" TAB_VERB "%6.3" "" COMPU_TAB_REF DFES_PRVTSTRDLT_SY_Compu /end COMPU_METHOD
/begin COMPU_VTAB DFES_PRVTSTRDLT_SY_Compu "" TAB_VERB 2 0 "False" 1 "True" /end COMPU_VTAB
/begin COMPU_METHOD DFES_SIMCOND_SY_Compu "" TAB_VERB "%6.3" "" COMPU_TAB_REF DFES_SIMCOND_SY_Compu /end COMPU_METHOD
/begin COMPU_VTAB DFES_SIMCOND_SY_Compu "" TAB_VERB 2 0 "DISABLED" 1 "ENABLED" /end COMPU_VTAB
/begin COMPU_METHOD DFES_VIS_BUF_SY_Compu "" TAB_VERB "%6.3" "" COMPU_TAB_REF DFES_VIS_BUF_SY_Compu /end COMPU_METHOD
/begin COMPU_VTAB DFES_VIS_BUF_SY_Compu "" TAB_VERB 2 0 "0" 1 "1" /end COMPU_VTAB
/begin COMPU_METHOD DFFTLPRTOVRDSTSCINC_SY_Compu "" TAB_VERB "%6.3" "" COMPU_TAB_REF DFFTLPRTOVRDSTSCINC_SY_Compu /end COMPU_METHOD
/begin COMPU_VTAB DFFTLPRTOVRDSTSCINC_SY_Compu "" TAB_VERB 2 0 "FALSE" 1 "TRUE" /end COMPU_VTAB
/begin COMPU_METHOD DFFV_SY_Compu "" TAB_VERB "%6.3" "" COMPU_TAB_REF DFFV_SY_Compu /end COMPU_METHOD
/begin COMPU_VTAB DFFV_SY_Compu "" TAB_VERB 2 0 "False" 1 "True" /end COMPU_VTAB
/begin COMPU_METHOD DFPNUM_FLMA_SY_Compu "" RAT_FUNC "%6.2" "" COEFFS 0 1 0 0 0 1 /end COMPU_METHOD
/begin COMPU_METHOD dfp_verbal "" TAB_VERB "%2.1" "-" COMPU_TAB_REF dfp_verbal /end COMPU_METHOD
/begin COMPU_VTAB dfp_verbal "" TAB_VERB 87 0 "DFP_AAA" 1 "DFP_BM" 2 "DFP_DK" 3 "DFP_DKVS" 4 "DFP_DSS" 5 "DFP_DVEV" 6 "DFP_DYLSU" 7 "DFP_DZKU0" 8 "DFP_DZKU1" 9 "DFP_DZKU2" 10 "DFP_EGFE" 11 "DFP_ENWS" 12 "DFP_ENWSE" 13 "DFP_EV1" 14 "DFP_EV2" 15 "DFP_EV3" 16 "DFP_FMAS" 17 "DFP_FP1P" 18 "DFP_FP2P" 19 "DFP_FRA" 20 "DFP_FRAU" 21 "DFP_FTDLA" 22 "DFP_HELSU" 23 "DFP_HRE" 24 "DFP_HSH" 25 "DFP_HSHE" 26 "DFP_HSV" 27 "DFP_HSVE" 28 "DFP_HSVSA" 29 "DFP_ICLSU" 30 "DFP_KAT" 31 "DFP_KATF" 32 "DFP_KPE" 33 "DFP_KRNT" 34 "DFP_KROF" 35 "DFP_KRTP" 36 "DFP_KUPPL" 37 "DFP_LASH" 38 "DFP_LLR" 39 "DFP_LLRKH" 40 "DFP_LM" 41 "DFP_LSH" 42 "DFP_LSUKS" 43 "DFP_LSUUN" 44 "DFP_LSV" 45 "DFP_LUES1E" 46 "DFP_LZSR" 47 "DFP_MD" 48 "DFP_N" 49 "DFP_NWKW" 50 "DFP_NWKWE" 51 "DFP_ORA" 52 "DFP_PH" 53 "DFP_PHE" 54 "DFP_PLLSU" 55 "DFP_PS1E" 56 "DFP_PS2E" 57 "DFP_PS3E" 58 "DFP_PSR" 59 "DFP_PSR1" 60 "DFP_PSRB" 61 "DFP_PSRE" 62 "DFP_PSRP" 63 "DFP_PVD" 64 "DFP_RKAT" 65 "DFP_RKAZ" 66 "DFP_STKLSV" 67 "DFP_TA" 68 "DFP_TACS" 69 "DFP_TAR" 70 "DFP_TASR" 71 "DFP_TASRE" 72 "DFP_TES" 73 "DFP_TEVE" 74 "DFP_THM" 75 "DFP_TM" 76 "DFP_TMCS" 77 "DFP_TME" 78 "DFP_TMKI" 79 "DFP_TMP" 80 "DFP_TUM" 81 "DFP_UB" 82 "DFP_UBR" 83 "DFP_ULSU" 84 "DFP_VFZ" 85 "DFP_VFZG" 86 "DFP_ZZZ" DEFAULT_VALUE "---" /end COMPU_VTAB
/begin COMPU_METHOD Dia "" RAT_FUNC "%7.6" "m" COEFFS 0 10000 0 0 0 1 /end COMPU_METHOD
/begin COMPU_METHOD DIABAS_ATSTST_SY_Compu "" TAB_VERB "%6.3" "" COMPU_TAB_REF DIABAS_ATSTST_SY_Compu /end COMPU_METHOD
/begin COMPU_VTAB DIABAS_ATSTST_SY_Compu "" TAB_VERB 2 1 "TRUE" 0 "FALSE" /end COMPU_VTAB
/begin COMPU_METHOD DtyCyc "" RAT_FUNC "%6.4" "%" COEFFS 0 100 0 0 0 1 /end COMPU_METHOD
/begin COMPU_METHOD EngN "" RAT_FUNC "%6.3" "rpm" COEFFS 0 2 0 0 0 1 /end COMPU_METHOD
/begin COMPU_METHOD EngN_LRes "" RAT_FUNC "%6.1" "rpm" COEFFS 0 0.025 0 0 0 1 /end COMPU_METHOD
/begin COMPU_METHOD Fact "" RAT_FUNC "%6.5" "-" COEFFS 0 8192 0 0 0 1 /end COMPU_METHOD
/begin COMPU_METHOD Fact1 "" RAT_FUNC "%6.4" "-" COEFFS 0 128 0 0 0 1 /end COMPU_METHOD
/begin COMPU_METHOD FactHigh1 "" RAT_FUNC "%7.6" "-" COEFFS 0 10000 0 0 0 1 /end COMPU_METHOD
/begin COMPU_METHOD fak_b0p051 "" RAT_FUNC "%6.5" "" COEFFS 0 255 0 0 0 0.051 /end COMPU_METHOD
/begin COMPU_METHOD fak_q0p00174_JsK "" RAT_FUNC "%6.4" "J/sK" COEFFS 0 576 0 0 0 1 /end COMPU_METHOD
/begin COMPU_METHOD fak_q0p02 "" RAT_FUNC "%6.4" "" COEFFS 0 50 0 0 0 1 /end COMPU_METHOD
/begin COMPU_METHOD fak_q0p2222_JK "" RAT_FUNC "%6.3" "J/K" COEFFS 0 9 0 0 0 2 /end COMPU_METHOD
/begin COMPU_METHOD fak_q6p1035Em5 "" RAT_FUNC "%7.6" "-" COEFFS 0 65536 0 0 0 4 /end COMPU_METHOD
/begin COMPU_METHOD fak_sw_b1 "" RAT_FUNC "%7.6" "-" COEFFS 0 65536 0 0 0 2 /end COMPU_METHOD
/begin COMPU_METHOD fak_sw_b8 "" RAT_FUNC "%6.5" "-" COEFFS 0 65536 0 0 0 16 /end COMPU_METHOD
/begin COMPU_METHOD fak_ub_b1 "" RAT_FUNC "%6.4" "-" COEFFS 0 256 0 0 0 1 /end COMPU_METHOD
/begin COMPU_METHOD fak_ub_b2 "" RAT_FUNC "%8.5" "-" COEFFS 0 256 0 0 0 2 /end COMPU_METHOD
/begin COMPU_METHOD fak_ub_b4 "" RAT_FUNC "%6.4" "-" COEFFS 0 256 0 0 0 4 /end COMPU_METHOD
/begin COMPU_METHOD fak_uw_b1 "" RAT_FUNC "%7.6" "-" COEFFS 0 65536 0 0 0 1 /end COMPU_METHOD
/begin COMPU_METHOD fak_uw_b16 "" RAT_FUNC "%6.5" "-" COEFFS 0 65536 0 0 0 16 /end COMPU_METHOD
/begin COMPU_METHOD fak_uw_b2 "" RAT_FUNC "%7.6" "-" COEFFS 0 65536 0 0 0 2 /end COMPU_METHOD
/begin COMPU_METHOD fak_uw_b4 "" RAT_FUNC "%7.6" "-" COEFFS 0 65536 0 0 0 4 /end COMPU_METHOD
/begin COMPU_METHOD kw_q0p75 "" RAT_FUNC "%6.3" "Grad KW" COEFFS 0 4 0 0 0 3 /end COMPU_METHOD
/begin COMPU_METHOD lu_MEx "" RAT_FUNC "%6.4" "(Umdr./sec)^2" COEFFS 0 219.9023255552 0 0 0 1 /end COMPU_METHOD
/begin COMPU_METHOD mk100msxs_uw_b256 "" RAT_FUNC "%8.3" "s/(kg/h)" COEFFS 0 0 256 0 1 0 /end COMPU_METHOD
/begin COMPU_METHOD m_q0p0125_mg_DIV_s "" RAT_FUNC "%6.4" "mg/s" COEFFS 0 80 0 0 0 1 /end COMPU_METHOD
/begin COMPU_METHOD m_q0p1 "" RAT_FUNC "%6.3" "kg/h" COEFFS 0 10 0 0 0 1 /end COMPU_METHOD
/begin COMPU_METHOD m_q0p1_mg "" RAT_FUNC "%6.3" "mg" COEFFS 0 1 0 0 0 0.1 /end COMPU_METHOD
/begin COMPU_METHOD m_q0p1_mgs "" RAT_FUNC "%6.3" "mg/s" COEFFS 0 1 0 0 0 0.1 /end COMPU_METHOD
/begin COMPU_METHOD m_uw_b23p3 "" RAT_FUNC "%6.5" "kg" COEFFS 0 2812.5 0 0 0 1 /end COMPU_METHOD
/begin COMPU_METHOD m_uw_b6553p5 "" RAT_FUNC "%6.3" "kg/h" COEFFS 0 1 0 0 0 0.1 /end COMPU_METHOD
/begin COMPU_METHOD nmotg_sb_q100 "" RAT_FUNC "%6.0" "1/(min*s)" COEFFS 0 1 0 0 0 100 /end COMPU_METHOD
/begin COMPU_METHOD nmotg_sw_q0p15625 "" RAT_FUNC "%6.3" "1/(min*s)" COEFFS 0 1 0 0 0 0.15625 /end COMPU_METHOD
/begin COMPU_METHOD nmot_ub_q40 "" RAT_FUNC "%6.1" "1/min" COEFFS 0 1 0 0 0 40 /end COMPU_METHOD
/begin COMPU_METHOD nmot_uw_q0p25 "" RAT_FUNC "%6.3" "1/min" COEFFS 0 1 0 0 0 0.25 /end COMPU_METHOD
/begin COMPU_METHOD OneToOne "" RAT_FUNC "%6.2" "-" COEFFS 0 1 0 0 0 1 /end COMPU_METHOD
/begin COMPU_METHOD Prc "" RAT_FUNC "%6.4" "%" COEFFS 0 81.92 0 0 0 1 /end COMPU_METHOD
/begin COMPU_METHOD PrcPerSec "" RAT_FUNC "%6.3" "%/s" COEFFS 0 1.6384 0 0 0 1 /end COMPU_METHOD
/begin COMPU_METHOD Pres_hPa "" RAT_FUNC "%6.2" "hPa" COEFFS 0 1 0 0 0 1 /end COMPU_METHOD
/begin COMPU_METHOD Pwr "" RAT_FUNC "%6.2" "W" COEFFS 0 0.10610329539459 0 0 0 1 /end COMPU_METHOD
/begin COMPU_METHOD p_q0p039 "" RAT_FUNC "%6.4" "hPa" COEFFS 0 256 0 0 0 10 /end COMPU_METHOD
/begin COMPU_METHOD p_q10 "" RAT_FUNC "%6.1" "hPa" COEFFS 0 1 0 0 0 10 /end COMPU_METHOD
/begin COMPU_METHOD p_sw_q0p039 "" RAT_FUNC "%6.4" "hPa" COEFFS 0 256 0 0 0 10 /end COMPU_METHOD
/begin COMPU_METHOD p_sw_q0p078 "" RAT_FUNC "%6.4" "hPa" COEFFS 0 65536 0 0 0 5120 /end COMPU_METHOD
/begin COMPU_METHOD p_uw_q0p078 "" RAT_FUNC "%6.4" "hPa" COEFFS 0 256 0 0 0 20 /end COMPU_METHOD
/begin COMPU_METHOD q5p922Em2_JK "" RAT_FUNC "%6.4" "J/K" COEFFS 0 2304000 0 0 0 136448 /end COMPU_METHOD
/begin COMPU_METHOD relDK_q0p02441 "" RAT_FUNC "%6.4" "%DK" COEFFS 0 65536 0 0 0 1600 /end COMPU_METHOD
/begin COMPU_METHOD relPED_q0p00153 "" RAT_FUNC "%6.4" "% PED" COEFFS 0 65535 0 0 0 100 /end COMPU_METHOD
/begin COMPU_METHOD relPED_ub_b100 "" RAT_FUNC "%6.3" "%PED" COEFFS 0 255 0 0 0 100 /end COMPU_METHOD
/begin COMPU_METHOD rel_q0p39 "" RAT_FUNC "%6.3" "%" COEFFS 0 256 0 0 0 100 /end COMPU_METHOD
/begin COMPU_METHOD rel_q0p75 "" RAT_FUNC "%6.3" "%" COEFFS 0 4 0 0 0 3 /end COMPU_METHOD
/begin COMPU_METHOD rel_sw_b100 "" RAT_FUNC "%6.4" "%" COEFFS 0 32768 0 0 0 100 /end COMPU_METHOD
/begin COMPU_METHOD rel_sw_b50 "" RAT_FUNC "%6.4" "%" COEFFS 0 65536 0 0 0 100 /end COMPU_METHOD
/begin COMPU_METHOD rel_ub_b127p5 "" RAT_FUNC "%6.3" "%" COEFFS 0 2 0 0 0 1 /end COMPU_METHOD
/begin COMPU_METHOD rel_ub_q0p75 "" RAT_FUNC "%6.3" "%" COEFFS 0 1 0 0 0 0.75 /end COMPU_METHOD
/begin COMPU_METHOD rel_uw_b200 "" RAT_FUNC "%6.4" "%" COEFFS 0 65536 0 0 0 200 /end COMPU_METHOD
/begin COMPU_METHOD rel_uw_b3072 "" RAT_FUNC "%6.4" "%" COEFFS 0 65536 0 0 0 3072 /end COMPU_METHOD
/begin COMPU_METHOD rel_uw_b491520 "" RAT_FUNC "%6.2" "%/s" COEFFS 0 65536 0 0 0 491520 /end COMPU_METHOD
/begin COMPU_METHOD rel_uw_q0p0234 "" RAT_FUNC "%6.4" "%" COEFFS 0 32 0 0 0 0.75 /end COMPU_METHOD
/begin COMPU_METHOD RmpPrc "" RAT_FUNC "%6.5" "%/s" COEFFS 0 5368.70912 0 0 0 1 /end COMPU_METHOD
/begin COMPU_METHOD RmpTrq "" RAT_FUNC "%6.4" "Nm/s" COEFFS 0 655.36 0 0 0 1 /end COMPU_METHOD
/begin COMPU_METHOD RmpVolt "" RAT_FUNC "%6.4" "mV/s" COEFFS 0 327.68 0 0 0 1 /end COMPU_METHOD
/begin COMPU_METHOD spg_q0p00488 "" RAT_FUNC "%6.4" "V" COEFFS 0 1024 0 0 0 5 /end COMPU_METHOD
/begin COMPU_METHOD spg_q0p1 "" RAT_FUNC "%6.3" "V" COEFFS 0 1 0 0 0 0.1 /end COMPU_METHOD
/begin COMPU_METHOD t100msxs_ub_b25p5 "" RAT_FUNC "%6.3" "s" COEFFS 0 1 0 0 0 0.1 /end COMPU_METHOD
/begin COMPU_METHOD t100msxs_uw_b6553p5 "" RAT_FUNC "%6.3" "s" COEFFS 0 1 0 0 0 0.1 /end COMPU_METHOD
/begin COMPU_METHOD t10msxs_ub_b2p55 "" RAT_FUNC "%6.4" "s" COEFFS 0 1 0 0 0 0.01 /end COMPU_METHOD
/begin COMPU_METHOD t10msxs_uw_b655p35 "" RAT_FUNC "%6.4" "s" COEFFS 0 1 0 0 0 0.01 /end COMPU_METHOD
/begin COMPU_METHOD t1sxs_uw_q1 "" RAT_FUNC "%6.2" "s" COEFFS 0 1 0 0 0 1 /end COMPU_METHOD
/begin COMPU_METHOD t20msxs_q0p0002 "" RAT_FUNC "%6.5" "s" COEFFS 0 1 0 0 0 0.0002 /end COMPU_METHOD
/begin COMPU_METHOD t20msxs_uw_b1310 "" RAT_FUNC "%6.4" "s" COEFFS 0 1 0 0 0 0.02 /end COMPU_METHOD
/begin COMPU_METHOD tempg_q0p0234 "" RAT_FUNC "%6.4" "Grad C/s" COEFFS 0 256 0 0 0 6 /end COMPU_METHOD
/begin COMPU_METHOD Temp_Cels "" RAT_FUNC "%6.1" "deg C" COEFFS 0 10 2731.4 0 0 1 /end COMPU_METHOD
/begin COMPU_METHOD Temp_Cels_Short "" RAT_FUNC "%6.2" "deg C" COEFFS 0 4 192 0 0 3 /end COMPU_METHOD
/begin COMPU_METHOD temp_q0p0234 "" RAT_FUNC "%6.4" "K" COEFFS 0 256 0 0 0 6 /end COMPU_METHOD
/begin COMPU_METHOD temp_q0p0234_o273 "" RAT_FUNC "%6.1" "Grad C" COEFFS 0 1 273.15 0 0 0.0234375 /end COMPU_METHOD
/begin COMPU_METHOD temp_q0p0468 "" RAT_FUNC "%6.4" "Grad C" COEFFS 0 256 0 0 0 12 /end COMPU_METHOD
/begin COMPU_METHOD temp_q0p75 "" RAT_FUNC "%6.3" "GradC" COEFFS 0 4 0 0 0 3 /end COMPU_METHOD
/begin COMPU_METHOD temp_q0p75_om48 "" RAT_FUNC "%6.2" "Grad C" COEFFS 0 4 192 0 0 3 /end COMPU_METHOD
/begin COMPU_METHOD temp_q3p57Em7_om273 "" RAT_FUNC "%6.1" "Grad C" COEFFS 0 8388608 2291348275.2 0 0 3 /end COMPU_METHOD
/begin COMPU_METHOD temp_ub_b191p25 "" RAT_FUNC "%6.3" "Grad C" COEFFS 0 1 0 0 0 0.75 /end COMPU_METHOD
/begin COMPU_METHOD temp_ub_q0p75_o48 "" RAT_FUNC "%6.2" "Grad C" COEFFS 0 1 48 0 0 0.75 /end COMPU_METHOD
/begin COMPU_METHOD temp_ub_q5_o50 "" RAT_FUNC "%6.2" "Grad C" COEFFS 0 1 50 0 0 5 /end COMPU_METHOD
/begin COMPU_METHOD TimeDelay_s "" RAT_FUNC "%12.4" "s" COEFFS 0 0 1 0 0.00023283064365387 0 /end COMPU_METHOD
/begin COMPU_METHOD TimeDT "" RAT_FUNC "%6.2" "us" COEFFS 0 1 0 0 0 1 /end COMPU_METHOD
/begin COMPU_METHOD TimeRed "" RAT_FUNC "%6.3" "s" COEFFS 0 6.25 0 0 0 1 /end COMPU_METHOD
/begin COMPU_METHOD Time_ms "" RAT_FUNC "%6.1" "ms" COEFFS 0 0.1 0 0 0 1 /end COMPU_METHOD
/begin COMPU_METHOD Time_s "" RAT_FUNC "%6.4" "s" COEFFS 0 100 0 0 0 1 /end COMPU_METHOD
/begin COMPU_METHOD TransR "" RAT_FUNC "%6.4" "-" COEFFS 0 100 0 0 0 1 /end COMPU_METHOD
/begin COMPU_METHOD Trq "" RAT_FUNC "%6.3" "Nm" COEFFS 0 10 0 0 0 1 /end COMPU_METHOD
/begin COMPU_METHOD t_q0p01 "" RAT_FUNC "%6.4" "" COEFFS 0 100 0 0 0 1 /end COMPU_METHOD
/begin COMPU_METHOD t_q0p02 "" RAT_FUNC "%6.4" "s" COEFFS 0 100 0 0 0 2 /end COMPU_METHOD
/begin COMPU_METHOD t_q0p04 "" RAT_FUNC "%6.4" "s" COEFFS 0 100 0 0 0 4 /end COMPU_METHOD
/begin COMPU_METHOD t_q0p05 "" RAT_FUNC "%6.4" "s" COEFFS 0 100 0 0 0 5 /end COMPU_METHOD
/begin COMPU_METHOD t_q0p1 "" RAT_FUNC "%6.3" "s" COEFFS 0 10 0 0 0 1 /end COMPU_METHOD
/begin COMPU_METHOD t_q0p2 "" RAT_FUNC "%6.3" "s" COEFFS 0 10 0 0 0 2 /end COMPU_METHOD
/begin COMPU_METHOD t_q1 "" RAT_FUNC "%6.2" "s" COEFFS 0 1 0 0 0 1 /end COMPU_METHOD
/begin COMPU_METHOD t_q12p2us "" RAT_FUNC "%6.1" "us" COEFFS 0 1000 0 0 0 12207 /end COMPU_METHOD
/begin COMPU_METHOD t_q4_s "" RAT_FUNC "%6.2" "s" COEFFS 0 1 0 0 0 4 /end COMPU_METHOD
/begin COMPU_METHOD Vel "" RAT_FUNC "%6.4" "km/h" COEFFS 0 100 0 0 0 1 /end COMPU_METHOD
/begin COMPU_METHOD VelToN "" RAT_FUNC "%8.7" "(km/h)/rpm" COEFFS 0 100000 0 0 0 1 /end COMPU_METHOD
/begin COMPU_METHOD vfzg_ub_q1p25 "" RAT_FUNC "%6.2" "km/h" COEFFS 0 1 0 0 0 1.25 /end COMPU_METHOD
/begin COMPU_METHOD vfzg_uw_b512 "" RAT_FUNC "%6.4" "km/h" COEFFS 0 65536 0 0 0 512 /end COMPU_METHOD
/begin COMPU_METHOD volgrd_q5p96Em4 "" RAT_FUNC "%6.5" "ml/s" COEFFS 0 65536 0 0 0 39.0625 /end COMPU_METHOD
/begin COMPU_METHOD volgrd_q5p96Em7 "" RAT_FUNC "%9.8" "l/s" COEFFS 0 65536 0 0 0 0.0390625 /end COMPU_METHOD
/begin COMPU_METHOD Volt "" RAT_FUNC "%6.3" "mV" COEFFS 0 5 0 0 0 1 /end COMPU_METHOD
/begin COMPU_METHOD Volt_Batt "" RAT_FUNC "%6.1" "mV" COEFFS 0 0.05 0 0 0 1 /end COMPU_METHOD
/begin COMPU_METHOD vol_q0p002146 "" RAT_FUNC "%6.4" "l/h" COEFFS 0 65536 0 0 0 140.625 /end COMPU_METHOD
/begin COMPU_METHOD vol_q0p306_cme3 "" RAT_FUNC "%6.3" "cm^3" COEFFS 0 6.5536 0 0 0 2 /end COMPU_METHOD
/begin COMPU_METHOD vol_q3p90625Em3_l "" RAT_FUNC "%6.4" "l" COEFFS 0 65536 0 0 0 256 /end COMPU_METHOD
/begin COMPU_METHOD vs_q6p1 "" RAT_FUNC "%6.2" "cm^3/s" COEFFS 0 65536 0 0 0 400000 /end COMPU_METHOD
/begin COMPU_METHOD zk100msxs_ub_b25p5 "" RAT_FUNC "%6.3" "s" COEFFS 0 0 256 0 10 0 /end COMPU_METHOD
/begin COMPU_METHOD zk100msxs_uw_b6553 "" RAT_FUNC "%6.1" "s" COEFFS 0 0 65536 0 10 0 /end COMPU_METHOD
/begin COMPU_METHOD zk10msxs_uw_b655 "" RAT_FUNC "%6.2" "s" COEFFS 0 0 65536 0 100 0 /end COMPU_METHOD
/begin COMPU_METHOD zk50msxs_uw_b3276p8 "" RAT_FUNC "%6.1" "s" COEFFS 0 0 65536 0 20 0 /end COMPU_METHOD
/begin RECORD_LAYOUT Cur_Xs16Ws16 NO_AXIS_PTS_X 1 SWORD AXIS_PTS_X 2 SWORD INDEX_INCR DIRECT FNC_VALUES 3 SWORD COLUMN_DIR DIRECT /end RECORD_LAYOUT
/begin RECORD_LAYOUT FklWS8 FNC_VALUES 1 SBYTE COLUMN_DIR DIRECT /end RECORD_LAYOUT
/begin RECORD_LAYOUT FklWU16 FNC_VALUES 1 UWORD COLUMN_DIR DIRECT /end RECORD_LAYOUT
/begin RECORD_LAYOUT GkfWS8 FNC_VALUES 1 SBYTE COLUMN_DIR DIRECT /end RECORD_LAYOUT
/begin RECORD_LAYOUT GkfWU8 FNC_VALUES 1 UBYTE COLUMN_DIR DIRECT /end RECORD_LAYOUT
/begin RECORD_LAYOUT GklWS8 FNC_VALUES 1 SBYTE COLUMN_DIR DIRECT /end RECORD_LAYOUT
/begin RECORD_LAYOUT GklWU16 FNC_VALUES 1 UWORD COLUMN_DIR DIRECT /end RECORD_LAYOUT
/begin RECORD_LAYOUT GklWU8 FNC_VALUES 1 UBYTE COLUMN_DIR DIRECT /end RECORD_LAYOUT
/begin RECORD_LAYOUT KfAxU8AyU8SstxS16SstyU8WU16 NO_AXIS_PTS_X 1 UBYTE NO_AXIS_PTS_Y 2 UBYTE AXIS_PTS_X 3 SWORD INDEX_INCR DIRECT AXIS_PTS_Y 4 UBYTE INDEX_INCR DIRECT FNC_VALUES 5 UWORD COLUMN_DIR DIRECT /end RECORD_LAYOUT
/begin RECORD_LAYOUT KfAxU8AyU8SstxU16SstyU16WS16 NO_AXIS_PTS_X 1 UWORD NO_AXIS_PTS_Y 2 UWORD AXIS_PTS_X 3 UWORD INDEX_INCR DIRECT AXIS_PTS_Y 4 UWORD INDEX_INCR DIRECT FNC_VALUES 5 SWORD COLUMN_DIR DIRECT /end RECORD_LAYOUT
/begin RECORD_LAYOUT KfAxU8AyU8SstxU16SstyU16WU16 NO_AXIS_PTS_X 1 UWORD NO_AXIS_PTS_Y 2 UWORD AXIS_PTS_X 3 UWORD INDEX_INCR DIRECT AXIS_PTS_Y 4 UWORD INDEX_INCR DIRECT FNC_VALUES 5 UWORD COLUMN_DIR DIRECT /end RECORD_LAYOUT
/begin RECORD_LAYOUT KfAxU8AyU8SstxU16SstyU8WU8 NO_AXIS_PTS_X 1 UBYTE NO_AXIS_PTS_Y 2 UBYTE AXIS_PTS_X 3 UWORD INDEX_INCR DIRECT AXIS_PTS_Y 4 UBYTE INDEX_INCR DIRECT FNC_VALUES 5 UBYTE COLUMN_DIR DIRECT /end RECORD_LAYOUT
/begin RECORD_LAYOUT KfAxU8AyU8SstxU8SstyU16WU16 NO_AXIS_PTS_X 1 UBYTE NO_AXIS_PTS_Y 2 UBYTE AXIS_PTS_X 3 UBYTE INDEX_INCR DIRECT AXIS_PTS_Y 4 UWORD INDEX_INCR DIRECT FNC_VALUES 5 UWORD COLUMN_DIR DIRECT /end RECORD_LAYOUT
/begin RECORD_LAYOUT KfAxU8AyU8SstxU8SstyU16WU8 NO_AXIS_PTS_X 1 UBYTE NO_AXIS_PTS_Y 2 UBYTE AXIS_PTS_X 3 UBYTE INDEX_INCR DIRECT AXIS_PTS_Y 4 UWORD INDEX_INCR DIRECT FNC_VALUES 5 UBYTE COLUMN_DIR DIRECT /end RECORD_LAYOUT
/begin RECORD_LAYOUT KfAxU8AyU8SstxU8SstyU8WU8 NO_AXIS_PTS_X 1 UBYTE NO_AXIS_PTS_Y 2 UBYTE AXIS_PTS_X 3 UBYTE INDEX_INCR DIRECT AXIS_PTS_Y 4 UBYTE INDEX_INCR DIRECT FNC_VALUES 5 UBYTE COLUMN_DIR DIRECT /end RECORD_LAYOUT
/begin RECORD_LAYOUT KfAxUbAyUbSstxUbSstyUwWUb NO_AXIS_PTS_X 1 UBYTE NO_AXIS_PTS_Y 2 UBYTE AXIS_PTS_X 3 UBYTE INDEX_INCR DIRECT AXIS_PTS_Y 4 UWORD INDEX_INCR DIRECT FNC_VALUES 5 UBYTE COLUMN_DIR DIRECT /end RECORD_LAYOUT
/begin RECORD_LAYOUT KlAxU8SstxS8WU8 NO_AXIS_PTS_X 1 UBYTE AXIS_PTS_X 2 SBYTE INDEX_INCR DIRECT FNC_VALUES 3 UBYTE COLUMN_DIR DIRECT /end RECORD_LAYOUT
/begin RECORD_LAYOUT KlAxU8SstxU16WS16 NO_AXIS_PTS_X 1 UWORD AXIS_PTS_X 2 UWORD INDEX_INCR DIRECT FNC_VALUES 3 SWORD COLUMN_DIR DIRECT /end RECORD_LAYOUT
/begin RECORD_LAYOUT KlAxU8SstxU16WU16 NO_AXIS_PTS_X 1 UWORD AXIS_PTS_X 2 UWORD INDEX_INCR DIRECT FNC_VALUES 3 UWORD COLUMN_DIR DIRECT /end RECORD_LAYOUT
/begin RECORD_LAYOUT KlAxU8SstxU16WU8 NO_AXIS_PTS_X 1 UWORD AXIS_PTS_X 2 UWORD INDEX_INCR DIRECT FNC_VALUES 3 UBYTE COLUMN_DIR DIRECT /end RECORD_LAYOUT
/begin RECORD_LAYOUT KlAxU8SstxU8WU16 NO_AXIS_PTS_X 1 UBYTE AXIS_PTS_X 2 UBYTE INDEX_INCR DIRECT FNC_VALUES 3 UWORD COLUMN_DIR DIRECT /end RECORD_LAYOUT
/begin RECORD_LAYOUT KlAxU8SstxU8WU8 NO_AXIS_PTS_X 1 UBYTE AXIS_PTS_X 2 UBYTE INDEX_INCR DIRECT FNC_VALUES 3 UBYTE COLUMN_DIR DIRECT /end RECORD_LAYOUT
/begin RECORD_LAYOUT KwbWU16 FNC_VALUES 1 UWORD COLUMN_DIR DIRECT /end RECORD_LAYOUT
/begin RECORD_LAYOUT KwbWU8 FNC_VALUES 1 UBYTE COLUMN_DIR DIRECT /end RECORD_LAYOUT
/begin RECORD_LAYOUT KwSw FNC_VALUES 1 SWORD COLUMN_DIR DIRECT /end RECORD_LAYOUT
/begin RECORD_LAYOUT KwUb FNC_VALUES 1 UBYTE COLUMN_DIR DIRECT /end RECORD_LAYOUT
/begin RECORD_LAYOUT KwUw FNC_VALUES 1 UWORD COLUMN_DIR DIRECT /end RECORD_LAYOUT
/begin RECORD_LAYOUT KwWS16 FNC_VALUES 1 SWORD COLUMN_DIR DIRECT /end RECORD_LAYOUT
/begin RECORD_LAYOUT KwWS8 FNC_VALUES 1 SBYTE COLUMN_DIR DIRECT /end RECORD_LAYOUT
/begin RECORD_LAYOUT KwWU16 FNC_VALUES 1 UWORD COLUMN_DIR DIRECT /end RECORD_LAYOUT
/begin RECORD_LAYOUT KwWU8 FNC_VALUES 1 UBYTE COLUMN_DIR DIRECT /end RECORD_LAYOUT
/begin RECORD_LAYOUT Kw_Ws16 FNC_VALUES 1 SWORD COLUMN_DIR DIRECT /end RECORD_LAYOUT
/begin RECORD_LAYOUT Kw_Ws32 FNC_VALUES 1 SLONG COLUMN_DIR DIRECT /end RECORD_LAYOUT
/begin RECORD_LAYOUT Map_Xs16Ys16Ws16 NO_AXIS_PTS_X 1 SWORD NO_AXIS_PTS_Y 2 SWORD AXIS_PTS_X 3 SWORD INDEX_INCR DIRECT AXIS_PTS_Y 4 SWORD INDEX_INCR DIRECT FNC_VALUES 5 SWORD COLUMN_DIR DIRECT /end RECORD_LAYOUT
/begin RECORD_LAYOUT SstAU8SstS8 NO_AXIS_PTS_X 1 SBYTE AXIS_PTS_X 2 SBYTE INDEX_INCR DIRECT /end RECORD_LAYOUT
/begin RECORD_LAYOUT SstAU8SstU16 NO_AXIS_PTS_X 1 UWORD AXIS_PTS_X 2 UWORD INDEX_INCR DIRECT /end RECORD_LAYOUT
/begin RECORD_LAYOUT SstAU8SstU8 NO_AXIS_PTS_X 1 UBYTE AXIS_PTS_X 2 UBYTE INDEX_INCR DIRECT /end RECORD_LAYOUT
/begin RECORD_LAYOUT ValA_Wu8 FNC_VALUES 1 UBYTE COLUMN_DIR DIRECT /end RECORD_LAYOUT
/begin RECORD_LAYOUT Val_Ws16 FNC_VALUES 1 SWORD COLUMN_DIR DIRECT /end RECORD_LAYOUT
/begin RECORD_LAYOUT Val_Ws32 FNC_VALUES 1 SLONG COLUMN_DIR DIRECT /end RECORD_LAYOUT
/begin RECORD_LAYOUT Val_Wu16 FNC_VALUES 1 UWORD COLUMN_DIR DIRECT /end RECORD_LAYOUT
/begin RECORD_LAYOUT Val_Wu8 FNC_VALUES 1 UBYTE COLUMN_DIR DIRECT /end RECORD_LAYOUT
/end MODULE
/end PROJECT
