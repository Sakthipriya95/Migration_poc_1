ASAP2_VERSION 1 4
/begin PROJECT M17955S3CC411_110Y0320 "M17955S3CC411_110Y0320"
/begin HEADER "" VERSION "M17955S3CC411_110Y0320" PROJECT_NO M17955S3CC411_110Y0320 /end HEADER
/begin MODULE DIM ""
/begin MOD_COMMON "" BYTE_ORDER MSB_LAST ALIGNMENT_BYTE 1 ALIGNMENT_WORD 2 ALIGNMENT_LONG 4 ALIGNMENT_FLOAT32_IEEE 4 /end MOD_COMMON
/begin CHARACTERISTIC DFES_DbLv.DFC_AirCSwtNpl_C "" VALUE 0x8004185C Val_Wu8 15.00 DFES_OneToOne 0.00 15.00 FORMAT "%5.2" /end CHARACTERISTIC
/begin CHARACTERISTIC DFES_DbLv.DFC_AirCSwtSig_C "" VALUE 0x8004185D Val_Wu8 15.00 DFES_OneToOne 0.00 15.00 FORMAT "%5.2" /end CHARACTERISTIC
/begin CHARACTERISTIC DFES_DbLv.DFC_AltIOLdSRCMax_C "" VALUE 0x8004185E Val_Wu8 15.00 DFES_OneToOne 0.00 15.00 FORMAT "%5.2" /end CHARACTERISTIC
/begin CHARACTERISTIC DFES_DbLv.DFC_BrkSig_C "" VALUE 0x8004185F Val_Wu8 15.00 DFES_OneToOne 0.00 15.00 FORMAT "%5.2" /end CHARACTERISTIC
/begin CHARACTERISTIC DFES_DbLv.DFC_ClthEPBNpl_C "" VALUE 0x80041860 Val_Wu8 15.00 DFES_OneToOne 0.00 15.00 FORMAT "%5.2" /end CHARACTERISTIC
/begin CHARACTERISTIC DFES_DbLv.DFC_ClthEPBSensErr_C "" VALUE 0x80041861 Val_Wu8 15.00 DFES_OneToOne 0.00 15.00 FORMAT "%5.2" /end CHARACTERISTIC
/begin CHARACTERISTIC DFES_DbLv.DFC_ClthErr_C "" VALUE 0x80041862 Val_Wu8 15.00 DFES_OneToOne 0.00 15.00 FORMAT "%5.2" /end CHARACTERISTIC
/begin CHARACTERISTIC DFES_DbLv.DFC_ClthSig_C "" VALUE 0x80041863 Val_Wu8 15.00 DFES_OneToOne 0.00 15.00 FORMAT "%5.2" /end CHARACTERISTIC
/begin CHARACTERISTIC DFES_DbLv.DFC_MILLmpOL_C "" VALUE 0x80041864 Val_Wu8 15.00 DFES_OneToOne 0.00 15.00 FORMAT "%5.2" /end CHARACTERISTIC
/begin CHARACTERISTIC DFES_DbLv.DFC_MILLmpSCB_C "" VALUE 0x80041865 Val_Wu8 15.00 DFES_OneToOne 0.00 15.00 FORMAT "%5.2" /end CHARACTERISTIC
/begin CHARACTERISTIC DFES_DbLv.DFC_MILLmpSCG_C "" VALUE 0x80041866 Val_Wu8 15.00 DFES_OneToOne 0.00 15.00 FORMAT "%5.2" /end CHARACTERISTIC
/begin CHARACTERISTIC DFES_DbLv.DFC_SRCHighAPP1_C "" VALUE 0x80041867 Val_Wu8 15.00 DFES_OneToOne 0.00 15.00 FORMAT "%5.2" /end CHARACTERISTIC
/begin CHARACTERISTIC DFES_DbLv.DFC_SRCHighAPP2_C "" VALUE 0x80041868 Val_Wu8 15.00 DFES_OneToOne 0.00 15.00 FORMAT "%5.2" /end CHARACTERISTIC
/begin CHARACTERISTIC DFES_DbLv.DFC_SRCLowAPP1_C "" VALUE 0x80041869 Val_Wu8 15.00 DFES_OneToOne 0.00 15.00 FORMAT "%5.2" /end CHARACTERISTIC
/begin CHARACTERISTIC DFES_DbLv.DFC_SRCLowAPP2_C "" VALUE 0x8004186A Val_Wu8 15.00 DFES_OneToOne 0.00 15.00 FORMAT "%5.2" /end CHARACTERISTIC
/begin CHARACTERISTIC DFES_DbLv.DFC_SyncAPP_C "" VALUE 0x8004186B Val_Wu8 15.00 DFES_OneToOne 0.00 15.00 FORMAT "%5.2" /end CHARACTERISTIC
/begin CHARACTERISTIC DFES_DbLv.DFC_VehVMax_C "" VALUE 0x8004186C Val_Wu8 15.00 DFES_OneToOne 0.00 15.00 FORMAT "%5.2" /end CHARACTERISTIC
/begin CHARACTERISTIC DFES_DbLv.DFC_VehVPlaus_C "" VALUE 0x8004186D Val_Wu8 15.00 DFES_OneToOne 0.00 15.00 FORMAT "%5.2" /end CHARACTERISTIC
/begin CHARACTERISTIC DFES_DbLv.DFC_VehVSig_C "" VALUE 0x8004186E Val_Wu8 15.00 DFES_OneToOne 0.00 15.00 FORMAT "%5.2" /end CHARACTERISTIC
/begin CHARACTERISTIC DFES_DbLv.DFC_BusDiagBusOffNodeA_C "" VALUE 0x8004186F Val_Wu8 15.00 DFES_OneToOne 0.00 15.00 FORMAT "%5.2" /end CHARACTERISTIC
/begin CHARACTERISTIC DFES_DbLv.DFC_ComACSensTO_C "" VALUE 0x80041870 Val_Wu8 15.00 DFES_OneToOne 0.00 15.00 FORMAT "%5.2" /end CHARACTERISTIC
/begin CHARACTERISTIC DFES_DbLv.DFC_ComAWD1TO_C "" VALUE 0x80041871 Val_Wu8 15.00 DFES_OneToOne 0.00 15.00 FORMAT "%5.2" /end CHARACTERISTIC
/begin CHARACTERISTIC DFES_DbLv.DFC_ComBRK10TO_C "" VALUE 0x80041872 Val_Wu8 15.00 DFES_OneToOne 0.00 15.00 FORMAT "%5.2" /end CHARACTERISTIC
/begin CHARACTERISTIC DFES_DbLv.DFC_ComGW11TO_C "" VALUE 0x80041873 Val_Wu8 15.00 DFES_OneToOne 0.00 15.00 FORMAT "%5.2" /end CHARACTERISTIC
/begin CHARACTERISTIC DFES_DbLv.DFC_ComLVL1TO_C "" VALUE 0x80041874 Val_Wu8 15.00 DFES_OneToOne 0.00 15.00 FORMAT "%5.2" /end CHARACTERISTIC
/begin CHARACTERISTIC DFES_DbLv.DFC_ComPRKA01TO_C "" VALUE 0x80041875 Val_Wu8 15.00 DFES_OneToOne 0.00 15.00 FORMAT "%5.2" /end CHARACTERISTIC
/begin CHARACTERISTIC DFES_DbLv.DFC_ComPRKH01TO_C "" VALUE 0x80041876 Val_Wu8 15.00 DFES_OneToOne 0.00 15.00 FORMAT "%5.2" /end CHARACTERISTIC
/begin CHARACTERISTIC DFES_DbLv.DFC_ComPRKH1TO_C "" VALUE 0x80041877 Val_Wu8 15.00 DFES_OneToOne 0.00 15.00 FORMAT "%5.2" /end CHARACTERISTIC
/begin CHARACTERISTIC DFES_DbLv.DFC_ComTRBCH1TO_C "" VALUE 0x80041878 Val_Wu8 15.00 DFES_OneToOne 0.00 15.00 FORMAT "%5.2" /end CHARACTERISTIC
/begin CHARACTERISTIC DFES_DbLv.DFC_ComTRBCH2TO_C "" VALUE 0x80041879 Val_Wu8 15.00 DFES_OneToOne 0.00 15.00 FORMAT "%5.2" /end CHARACTERISTIC
/begin CHARACTERISTIC DFES_DbLv.DFC_DK_C "" VALUE 0x8004187A Val_Wu8 15.00 DFES_OneToOne 0.00 15.00 FORMAT "%5.2" /end CHARACTERISTIC
/begin CHARACTERISTIC DFES_DbLv.DFC_DKRSA_C "" VALUE 0x8004187B Val_Wu8 15.00 DFES_OneToOne 0.00 15.00 FORMAT "%5.2" /end CHARACTERISTIC
/begin CHARACTERISTIC DFES_DbLv.DFC_DKVSmax_C "" VALUE 0x8004187C Val_Wu8 15.00 DFES_OneToOne 0.00 15.00 FORMAT "%5.2" /end CHARACTERISTIC
/begin CHARACTERISTIC DFES_DbLv.DFC_DKmax_C "" VALUE 0x8004187D Val_Wu8 15.00 DFES_OneToOne 0.00 15.00 FORMAT "%5.2" /end CHARACTERISTIC
/begin CHARACTERISTIC DFES_DbLv.DFC_DKmin_C "" VALUE 0x8004187E Val_Wu8 15.00 DFES_OneToOne 0.00 15.00 FORMAT "%5.2" /end CHARACTERISTIC
/begin CHARACTERISTIC DFES_DbLv.DFC_DSSmax_C "" VALUE 0x8004187F Val_Wu8 15.00 DFES_OneToOne 0.00 15.00 FORMAT "%5.2" /end CHARACTERISTIC
/begin CHARACTERISTIC DFES_DbLv.DFC_EEPEraseErr_C "" VALUE 0x80041880 Val_Wu8 15.00 DFES_OneToOne 0.00 15.00 FORMAT "%5.2" /end CHARACTERISTIC
/begin CHARACTERISTIC DFES_DbLv.DFC_EEPRdErr_C "" VALUE 0x80041881 Val_Wu8 15.00 DFES_OneToOne 0.00 15.00 FORMAT "%5.2" /end CHARACTERISTIC
/begin CHARACTERISTIC DFES_DbLv.DFC_EEPWrErr_C "" VALUE 0x80041882 Val_Wu8 15.00 DFES_OneToOne 0.00 15.00 FORMAT "%5.2" /end CHARACTERISTIC
/begin CHARACTERISTIC DFES_DbLv.DFC_EV1max_C "" VALUE 0x80041883 Val_Wu8 15.00 DFES_OneToOne 0.00 15.00 FORMAT "%5.2" /end CHARACTERISTIC
/begin CHARACTERISTIC DFES_DbLv.DFC_EV1min_C "" VALUE 0x80041884 Val_Wu8 15.00 DFES_OneToOne 0.00 15.00 FORMAT "%5.2" /end CHARACTERISTIC
/begin CHARACTERISTIC DFES_DbLv.DFC_EV1sig_C "" VALUE 0x80041885 Val_Wu8 15.00 DFES_OneToOne 0.00 15.00 FORMAT "%5.2" /end CHARACTERISTIC
/begin CHARACTERISTIC DFES_DbLv.DFC_EV2max_C "" VALUE 0x80041886 Val_Wu8 15.00 DFES_OneToOne 0.00 15.00 FORMAT "%5.2" /end CHARACTERISTIC
/begin CHARACTERISTIC DFES_DbLv.DFC_EV2min_C "" VALUE 0x80041887 Val_Wu8 15.00 DFES_OneToOne 0.00 15.00 FORMAT "%5.2" /end CHARACTERISTIC
/begin CHARACTERISTIC DFES_DbLv.DFC_EV2sig_C "" VALUE 0x80041888 Val_Wu8 15.00 DFES_OneToOne 0.00 15.00 FORMAT "%5.2" /end CHARACTERISTIC
/begin CHARACTERISTIC DFES_DbLv.DFC_EV3max_C "" VALUE 0x80041889 Val_Wu8 15.00 DFES_OneToOne 0.00 15.00 FORMAT "%5.2" /end CHARACTERISTIC
/begin CHARACTERISTIC DFES_DbLv.DFC_EV3min_C "" VALUE 0x8004188A Val_Wu8 15.00 DFES_OneToOne 0.00 15.00 FORMAT "%5.2" /end CHARACTERISTIC
/begin CHARACTERISTIC DFES_DbLv.DFC_EV3sig_C "" VALUE 0x8004188B Val_Wu8 15.00 DFES_OneToOne 0.00 15.00 FORMAT "%5.2" /end CHARACTERISTIC
/begin CHARACTERISTIC DFES_DbLv.DFC_EpmCaSI1ErrSig_C "" VALUE 0x8004188C Val_Wu8 15.00 DFES_OneToOne 0.00 15.00 FORMAT "%5.2" /end CHARACTERISTIC
/begin CHARACTERISTIC DFES_DbLv.DFC_EpmCaSI1NoSig_C "" VALUE 0x8004188D Val_Wu8 15.00 DFES_OneToOne 0.00 15.00 FORMAT "%5.2" /end CHARACTERISTIC
/begin CHARACTERISTIC DFES_DbLv.DFC_EpmCaSI1NoSigMax_C "" VALUE 0x8004188E Val_Wu8 15.00 DFES_OneToOne 0.00 15.00 FORMAT "%5.2" /end CHARACTERISTIC
/begin CHARACTERISTIC DFES_DbLv.DFC_EpmCaSI1NoSigMin_C "" VALUE 0x8004188F Val_Wu8 15.00 DFES_OneToOne 0.00 15.00 FORMAT "%5.2" /end CHARACTERISTIC
/begin CHARACTERISTIC DFES_DbLv.DFC_EpmCaSI1OfsErr_C "" VALUE 0x80041890 Val_Wu8 15.00 DFES_OneToOne 0.00 15.00 FORMAT "%5.2" /end CHARACTERISTIC
/begin CHARACTERISTIC DFES_DbLv.DFC_EpmCrSErrSig_C "" VALUE 0x80041891 Val_Wu8 15.00 DFES_OneToOne 0.00 15.00 FORMAT "%5.2" /end CHARACTERISTIC
/begin CHARACTERISTIC DFES_DbLv.DFC_EpmCrSNoSig_C "" VALUE 0x80041892 Val_Wu8 15.00 DFES_OneToOne 0.00 15.00 FORMAT "%5.2" /end CHARACTERISTIC
/begin CHARACTERISTIC DFES_DbLv.DFC_FRAmax_C "" VALUE 0x80041893 Val_Wu8 15.00 DFES_OneToOne 0.00 15.00 FORMAT "%5.2" /end CHARACTERISTIC
/begin CHARACTERISTIC DFES_DbLv.DFC_FRAmin_C "" VALUE 0x80041894 Val_Wu8 15.00 DFES_OneToOne 0.00 15.00 FORMAT "%5.2" /end CHARACTERISTIC
/begin CHARACTERISTIC DFES_DbLv.DFC_HEGOS1B1ElecMax_C "" VALUE 0x80041895 Val_Wu8 15.00 DFES_OneToOne 0.00 15.00 FORMAT "%5.2" /end CHARACTERISTIC
/begin CHARACTERISTIC DFES_DbLv.DFC_HEGOS1B1ElecMin_C "" VALUE 0x80041896 Val_Wu8 15.00 DFES_OneToOne 0.00 15.00 FORMAT "%5.2" /end CHARACTERISTIC
/begin CHARACTERISTIC DFES_DbLv.DFC_HEGOS1B1ElecNpl_C "" VALUE 0x80041897 Val_Wu8 15.00 DFES_OneToOne 0.00 15.00 FORMAT "%5.2" /end CHARACTERISTIC
/begin CHARACTERISTIC DFES_DbLv.DFC_HEGOS1B1ElecSig_C "" VALUE 0x80041898 Val_Wu8 15.00 DFES_OneToOne 0.00 15.00 FORMAT "%5.2" /end CHARACTERISTIC
/begin CHARACTERISTIC DFES_DbLv.DFC_HEGOS1B1HtgNpl_C "" VALUE 0x80041899 Val_Wu8 15.00 DFES_OneToOne 0.00 15.00 FORMAT "%5.2" /end CHARACTERISTIC
/begin CHARACTERISTIC DFES_DbLv.DFC_HEGOS1B1HtrPsMax_C "" VALUE 0x8004189A Val_Wu8 15.00 DFES_OneToOne 0.00 15.00 FORMAT "%5.2" /end CHARACTERISTIC
/begin CHARACTERISTIC DFES_DbLv.DFC_HEGOS1B1HtrPsMin_C "" VALUE 0x8004189B Val_Wu8 15.00 DFES_OneToOne 0.00 15.00 FORMAT "%5.2" /end CHARACTERISTIC
/begin CHARACTERISTIC DFES_DbLv.DFC_HEGOS1B1HtrPsSig_C "" VALUE 0x8004189C Val_Wu8 15.00 DFES_OneToOne 0.00 15.00 FORMAT "%5.2" /end CHARACTERISTIC
/begin CHARACTERISTIC DFES_DbLv.DFC_HEGOS1B1StkMax_C "" VALUE 0x8004189D Val_Wu8 15.00 DFES_OneToOne 0.00 15.00 FORMAT "%5.2" /end CHARACTERISTIC
/begin CHARACTERISTIC DFES_DbLv.DFC_HEGOS1B1StkMin_C "" VALUE 0x8004189E Val_Wu8 15.00 DFES_OneToOne 0.00 15.00 FORMAT "%5.2" /end CHARACTERISTIC
/begin CHARACTERISTIC DFES_DbLv.DFC_HEGOS2B1RstrcnLean_C "" VALUE 0x8004189F Val_Wu8 15.00 DFES_OneToOne 0.00 15.00 FORMAT "%5.2" /end CHARACTERISTIC
/begin CHARACTERISTIC DFES_DbLv.DFC_HEGOS2B1RstrcnRich_C "" VALUE 0x800418A0 Val_Wu8 15.00 DFES_OneToOne 0.00 15.00 FORMAT "%5.2" /end CHARACTERISTIC
/begin CHARACTERISTIC DFES_DbLv.DFC_IdleChrgActrJamVlvClsd_C "" VALUE 0x800418A1 Val_Wu8 15.00 DFES_OneToOne 0.00 15.00 FORMAT "%5.2" /end CHARACTERISTIC
/begin CHARACTERISTIC DFES_DbLv.DFC_IdleChrgActrJamVlvOpn_C "" VALUE 0x800418A2 Val_Wu8 15.00 DFES_OneToOne 0.00 15.00 FORMAT "%5.2" /end CHARACTERISTIC
/begin CHARACTERISTIC DFES_DbLv.DFC_IgnClPsDevOscErr1_C "" VALUE 0x800418A3 Val_Wu8 15.00 DFES_OneToOne 0.00 15.00 FORMAT "%5.2" /end CHARACTERISTIC
/begin CHARACTERISTIC DFES_DbLv.DFC_KPEmax_C "" VALUE 0x800418A4 Val_Wu8 15.00 DFES_OneToOne 0.00 15.00 FORMAT "%5.2" /end CHARACTERISTIC
/begin CHARACTERISTIC DFES_DbLv.DFC_KPEmin_C "" VALUE 0x800418A5 Val_Wu8 15.00 DFES_OneToOne 0.00 15.00 FORMAT "%5.2" /end CHARACTERISTIC
/begin CHARACTERISTIC DFES_DbLv.DFC_KPEsig_C "" VALUE 0x800418A6 Val_Wu8 15.00 DFES_OneToOne 0.00 15.00 FORMAT "%5.2" /end CHARACTERISTIC
/begin CHARACTERISTIC DFES_DbLv.DFC_KS1max_C "" VALUE 0x800418A7 Val_Wu8 15.00 DFES_OneToOne 0.00 15.00 FORMAT "%5.2" /end CHARACTERISTIC
/begin CHARACTERISTIC DFES_DbLv.DFC_KS1min_C "" VALUE 0x800418A8 Val_Wu8 15.00 DFES_OneToOne 0.00 15.00 FORMAT "%5.2" /end CHARACTERISTIC
/begin CHARACTERISTIC DFES_DbLv.DFC_LLRKHmax_C "" VALUE 0x800418A9 Val_Wu8 15.00 DFES_OneToOne 0.00 15.00 FORMAT "%5.2" /end CHARACTERISTIC
/begin CHARACTERISTIC DFES_DbLv.DFC_LLRKHmin_C "" VALUE 0x800418AA Val_Wu8 15.00 DFES_OneToOne 0.00 15.00 FORMAT "%5.2" /end CHARACTERISTIC
/begin CHARACTERISTIC DFES_DbLv.DFC_LLRKHnpl_C "" VALUE 0x800418AB Val_Wu8 15.00 DFES_OneToOne 0.00 15.00 FORMAT "%5.2" /end CHARACTERISTIC
/begin CHARACTERISTIC DFES_DbLv.DFC_LLRmax_C "" VALUE 0x800418AC Val_Wu8 15.00 DFES_OneToOne 0.00 15.00 FORMAT "%5.2" /end CHARACTERISTIC
/begin CHARACTERISTIC DFES_DbLv.DFC_LLRmin_C "" VALUE 0x800418AD Val_Wu8 15.00 DFES_OneToOne 0.00 15.00 FORMAT "%5.2" /end CHARACTERISTIC
/begin CHARACTERISTIC DFES_DbLv.DFC_LLRnpl_C "" VALUE 0x800418AE Val_Wu8 15.00 DFES_OneToOne 0.00 15.00 FORMAT "%5.2" /end CHARACTERISTIC
/begin CHARACTERISTIC DFES_DbLv.DFC_LMmax_C "" VALUE 0x800418AF Val_Wu8 15.00 DFES_OneToOne 0.00 15.00 FORMAT "%5.2" /end CHARACTERISTIC
/begin CHARACTERISTIC DFES_DbLv.DFC_LZSRnpl_C "" VALUE 0x800418B0 Val_Wu8 15.00 DFES_OneToOne 0.00 15.00 FORMAT "%5.2" /end CHARACTERISTIC
/begin CHARACTERISTIC DFES_DbLv.DFC_MD_C "" VALUE 0x800418B1 Val_Wu8 15.00 DFES_OneToOne 0.00 15.00 FORMAT "%5.2" /end CHARACTERISTIC
/begin CHARACTERISTIC DFES_DbLv.DFC_MD00min_C "" VALUE 0x800418B2 Val_Wu8 15.00 DFES_OneToOne 0.00 15.00 FORMAT "%5.2" /end CHARACTERISTIC
/begin CHARACTERISTIC DFES_DbLv.DFC_MD00npl_C "" VALUE 0x800418B3 Val_Wu8 15.00 DFES_OneToOne 0.00 15.00 FORMAT "%5.2" /end CHARACTERISTIC
/begin CHARACTERISTIC DFES_DbLv.DFC_MD01min_C "" VALUE 0x800418B4 Val_Wu8 15.00 DFES_OneToOne 0.00 15.00 FORMAT "%5.2" /end CHARACTERISTIC
/begin CHARACTERISTIC DFES_DbLv.DFC_MD01npl_C "" VALUE 0x800418B5 Val_Wu8 15.00 DFES_OneToOne 0.00 15.00 FORMAT "%5.2" /end CHARACTERISTIC
/begin CHARACTERISTIC DFES_DbLv.DFC_MD02min_C "" VALUE 0x800418B6 Val_Wu8 15.00 DFES_OneToOne 0.00 15.00 FORMAT "%5.2" /end CHARACTERISTIC
/begin CHARACTERISTIC DFES_DbLv.DFC_MD02npl_C "" VALUE 0x800418B7 Val_Wu8 15.00 DFES_OneToOne 0.00 15.00 FORMAT "%5.2" /end CHARACTERISTIC
/begin CHARACTERISTIC DFES_DbLv.DFC_MD03min_C "" VALUE 0x800418B8 Val_Wu8 15.00 DFES_OneToOne 0.00 15.00 FORMAT "%5.2" /end CHARACTERISTIC
/begin CHARACTERISTIC DFES_DbLv.DFC_MD03npl_C "" VALUE 0x800418B9 Val_Wu8 15.00 DFES_OneToOne 0.00 15.00 FORMAT "%5.2" /end CHARACTERISTIC
/begin CHARACTERISTIC DFES_DbLv.DFC_MD04min_C "" VALUE 0x800418BA Val_Wu8 15.00 DFES_OneToOne 0.00 15.00 FORMAT "%5.2" /end CHARACTERISTIC
/begin CHARACTERISTIC DFES_DbLv.DFC_MD04npl_C "" VALUE 0x800418BB Val_Wu8 15.00 DFES_OneToOne 0.00 15.00 FORMAT "%5.2" /end CHARACTERISTIC
/begin CHARACTERISTIC DFES_DbLv.DFC_MDCyl_0_C "" VALUE 0x800418BC Val_Wu8 15.00 DFES_OneToOne 0.00 15.00 FORMAT "%5.2" /end CHARACTERISTIC
/begin CHARACTERISTIC DFES_DbLv.DFC_MDCyl_1_C "" VALUE 0x800418BD Val_Wu8 15.00 DFES_OneToOne 0.00 15.00 FORMAT "%5.2" /end CHARACTERISTIC
/begin CHARACTERISTIC DFES_DbLv.DFC_MDCyl_2_C "" VALUE 0x800418BE Val_Wu8 15.00 DFES_OneToOne 0.00 15.00 FORMAT "%5.2" /end CHARACTERISTIC
/begin CHARACTERISTIC DFES_DbLv.DFC_MDFC_C "" VALUE 0x800418BF Val_Wu8 15.00 DFES_OneToOne 0.00 15.00 FORMAT "%5.2" /end CHARACTERISTIC
/begin CHARACTERISTIC DFES_DbLv.DFC_MDmin_C "" VALUE 0x800418C0 Val_Wu8 15.00 DFES_OneToOne 0.00 15.00 FORMAT "%5.2" /end CHARACTERISTIC
/begin CHARACTERISTIC DFES_DbLv.DFC_MDnpl_C "" VALUE 0x800418C1 Val_Wu8 15.00 DFES_OneToOne 0.00 15.00 FORMAT "%5.2" /end CHARACTERISTIC
/begin CHARACTERISTIC DFES_DbLv.DFC_MoCADCNTP_C "" VALUE 0x800418C2 Val_Wu8 15.00 DFES_OneToOne 0.00 15.00 FORMAT "%5.2" /end CHARACTERISTIC
/begin CHARACTERISTIC DFES_DbLv.DFC_MoCADCTst_C "" VALUE 0x800418C3 Val_Wu8 15.00 DFES_OneToOne 0.00 15.00 FORMAT "%5.2" /end CHARACTERISTIC
/begin CHARACTERISTIC DFES_DbLv.DFC_MoCComctErrMM_C "" VALUE 0x800418C4 Val_Wu8 15.00 DFES_OneToOne 0.00 15.00 FORMAT "%5.2" /end CHARACTERISTIC
/begin CHARACTERISTIC DFES_DbLv.DFC_OCWDAActv_C "" VALUE 0x800418C5 Val_Wu8 15.00 DFES_OneToOne 0.00 15.00 FORMAT "%5.2" /end CHARACTERISTIC
/begin CHARACTERISTIC DFES_DbLv.DFC_OCWDACom_C "" VALUE 0x800418C6 Val_Wu8 15.00 DFES_OneToOne 0.00 15.00 FORMAT "%5.2" /end CHARACTERISTIC
/begin CHARACTERISTIC DFES_DbLv.DFC_ORAmax_C "" VALUE 0x800418C7 Val_Wu8 15.00 DFES_OneToOne 0.00 15.00 FORMAT "%5.2" /end CHARACTERISTIC
/begin CHARACTERISTIC DFES_DbLv.DFC_ORAmin_C "" VALUE 0x800418C8 Val_Wu8 15.00 DFES_OneToOne 0.00 15.00 FORMAT "%5.2" /end CHARACTERISTIC
/begin CHARACTERISTIC DFES_DbLv.DFC_PSR1max_C "" VALUE 0x800418C9 Val_Wu8 15.00 DFES_OneToOne 0.00 15.00 FORMAT "%5.2" /end CHARACTERISTIC
/begin CHARACTERISTIC DFES_DbLv.DFC_PSRBmax_C "" VALUE 0x800418CA Val_Wu8 15.00 DFES_OneToOne 0.00 15.00 FORMAT "%5.2" /end CHARACTERISTIC
/begin CHARACTERISTIC DFES_DbLv.DFC_PSRBmin_C "" VALUE 0x800418CB Val_Wu8 15.00 DFES_OneToOne 0.00 15.00 FORMAT "%5.2" /end CHARACTERISTIC
/begin CHARACTERISTIC DFES_DbLv.DFC_PSREmax_C "" VALUE 0x800418CC Val_Wu8 15.00 DFES_OneToOne 0.00 15.00 FORMAT "%5.2" /end CHARACTERISTIC
/begin CHARACTERISTIC DFES_DbLv.DFC_PSREmin_C "" VALUE 0x800418CD Val_Wu8 15.00 DFES_OneToOne 0.00 15.00 FORMAT "%5.2" /end CHARACTERISTIC
/begin CHARACTERISTIC DFES_DbLv.DFC_PSRPmax_C "" VALUE 0x800418CE Val_Wu8 15.00 DFES_OneToOne 0.00 15.00 FORMAT "%5.2" /end CHARACTERISTIC
/begin CHARACTERISTIC DFES_DbLv.DFC_PSRPmin_C "" VALUE 0x800418CF Val_Wu8 15.00 DFES_OneToOne 0.00 15.00 FORMAT "%5.2" /end CHARACTERISTIC
/begin CHARACTERISTIC DFES_DbLv.DFC_PSRPsig_C "" VALUE 0x800418D0 Val_Wu8 15.00 DFES_OneToOne 0.00 15.00 FORMAT "%5.2" /end CHARACTERISTIC
/begin CHARACTERISTIC DFES_DbLv.DFC_PSRmax_C "" VALUE 0x800418D1 Val_Wu8 15.00 DFES_OneToOne 0.00 15.00 FORMAT "%5.2" /end CHARACTERISTIC
/begin CHARACTERISTIC DFES_DbLv.DFC_SSpMon1_C "" VALUE 0x800418D2 Val_Wu8 15.00 DFES_OneToOne 0.00 15.00 FORMAT "%5.2" /end CHARACTERISTIC
/begin CHARACTERISTIC DFES_DbLv.DFC_SSpMon2_C "" VALUE 0x800418D3 Val_Wu8 15.00 DFES_OneToOne 0.00 15.00 FORMAT "%5.2" /end CHARACTERISTIC
/begin CHARACTERISTIC DFES_DbLv.DFC_SSpMon3_C "" VALUE 0x800418D4 Val_Wu8 15.00 DFES_OneToOne 0.00 15.00 FORMAT "%5.2" /end CHARACTERISTIC
/begin CHARACTERISTIC DFES_DbLv.DFC_SWReset_0_C "" VALUE 0x800418D5 Val_Wu8 15.00 DFES_OneToOne 0.00 15.00 FORMAT "%5.2" /end CHARACTERISTIC
/begin CHARACTERISTIC DFES_DbLv.DFC_SWReset_1_C "" VALUE 0x800418D6 Val_Wu8 15.00 DFES_OneToOne 0.00 15.00 FORMAT "%5.2" /end CHARACTERISTIC
/begin CHARACTERISTIC DFES_DbLv.DFC_SWReset_2_C "" VALUE 0x800418D7 Val_Wu8 15.00 DFES_OneToOne 0.00 15.00 FORMAT "%5.2" /end CHARACTERISTIC
/begin CHARACTERISTIC DFES_DbLv.DFC_TASREmax_C "" VALUE 0x800418D8 Val_Wu8 15.00 DFES_OneToOne 0.00 15.00 FORMAT "%5.2" /end CHARACTERISTIC
/begin CHARACTERISTIC DFES_DbLv.DFC_TASREmin_C "" VALUE 0x800418D9 Val_Wu8 15.00 DFES_OneToOne 0.00 15.00 FORMAT "%5.2" /end CHARACTERISTIC
/begin CHARACTERISTIC DFES_DbLv.DFC_TASREnpl_C "" VALUE 0x800418DA Val_Wu8 15.00 DFES_OneToOne 0.00 15.00 FORMAT "%5.2" /end CHARACTERISTIC
/begin CHARACTERISTIC DFES_DbLv.DFC_TASRmax_C "" VALUE 0x800418DB Val_Wu8 15.00 DFES_OneToOne 0.00 15.00 FORMAT "%5.2" /end CHARACTERISTIC
/begin CHARACTERISTIC DFES_DbLv.DFC_TAmax_C "" VALUE 0x800418DC Val_Wu8 15.00 DFES_OneToOne 0.00 15.00 FORMAT "%5.2" /end CHARACTERISTIC
/begin CHARACTERISTIC DFES_DbLv.DFC_TEVEmax_C "" VALUE 0x800418DD Val_Wu8 15.00 DFES_OneToOne 0.00 15.00 FORMAT "%5.2" /end CHARACTERISTIC
/begin CHARACTERISTIC DFES_DbLv.DFC_TEVEmin_C "" VALUE 0x800418DE Val_Wu8 15.00 DFES_OneToOne 0.00 15.00 FORMAT "%5.2" /end CHARACTERISTIC
/begin CHARACTERISTIC DFES_DbLv.DFC_TEVEsig_C "" VALUE 0x800418DF Val_Wu8 15.00 DFES_OneToOne 0.00 15.00 FORMAT "%5.2" /end CHARACTERISTIC
/begin CHARACTERISTIC DFES_DbLv.DFC_TMCSmax_C "" VALUE 0x800418E0 Val_Wu8 15.00 DFES_OneToOne 0.00 15.00 FORMAT "%5.2" /end CHARACTERISTIC
/begin CHARACTERISTIC DFES_DbLv.DFC_TMCSmin_C "" VALUE 0x800418E1 Val_Wu8 15.00 DFES_OneToOne 0.00 15.00 FORMAT "%5.2" /end CHARACTERISTIC
/begin CHARACTERISTIC DFES_DbLv.DFC_TMEmax_C "" VALUE 0x800418E2 Val_Wu8 15.00 DFES_OneToOne 0.00 15.00 FORMAT "%5.2" /end CHARACTERISTIC
/begin CHARACTERISTIC DFES_DbLv.DFC_TMEmin_C "" VALUE 0x800418E3 Val_Wu8 15.00 DFES_OneToOne 0.00 15.00 FORMAT "%5.2" /end CHARACTERISTIC
/begin CHARACTERISTIC DFES_DbLv.DFC_TMEnpl_C "" VALUE 0x800418E4 Val_Wu8 15.00 DFES_OneToOne 0.00 15.00 FORMAT "%5.2" /end CHARACTERISTIC
/begin CHARACTERISTIC DFES_DbLv.DFC_TMEsig_C "" VALUE 0x800418E5 Val_Wu8 15.00 DFES_OneToOne 0.00 15.00 FORMAT "%5.2" /end CHARACTERISTIC
/begin CHARACTERISTIC DFES_DbLv.DFC_TMPmax_C "" VALUE 0x800418E6 Val_Wu8 15.00 DFES_OneToOne 0.00 15.00 FORMAT "%5.2" /end CHARACTERISTIC
/begin CHARACTERISTIC DFES_DbLv.DFC_TMPmin_C "" VALUE 0x800418E7 Val_Wu8 15.00 DFES_OneToOne 0.00 15.00 FORMAT "%5.2" /end CHARACTERISTIC
/begin CHARACTERISTIC DFES_DbLv.DFC_TMPnpl_C "" VALUE 0x800418E8 Val_Wu8 15.00 DFES_OneToOne 0.00 15.00 FORMAT "%5.2" /end CHARACTERISTIC
/begin CHARACTERISTIC DFES_DbLv.DFC_TMmax_C "" VALUE 0x800418E9 Val_Wu8 15.00 DFES_OneToOne 0.00 15.00 FORMAT "%5.2" /end CHARACTERISTIC
/begin CHARACTERISTIC DFES_DbLv.DFC_TUMmax_C "" VALUE 0x800418EA Val_Wu8 15.00 DFES_OneToOne 0.00 15.00 FORMAT "%5.2" /end CHARACTERISTIC
/begin CHARACTERISTIC DFES_DbLv.DFC_TWCCTrimMaxB1_C "" VALUE 0x800418EB Val_Wu8 15.00 DFES_OneToOne 0.00 15.00 FORMAT "%5.2" /end CHARACTERISTIC
/begin CHARACTERISTIC DFES_DbLv.DFC_TWCCTrimMinB1_C "" VALUE 0x800418EC Val_Wu8 15.00 DFES_OneToOne 0.00 15.00 FORMAT "%5.2" /end CHARACTERISTIC
/begin CHARACTERISTIC DFES_DbLv.DFC_TWCDPriCatB1_C "" VALUE 0x800418ED Val_Wu8 15.00 DFES_OneToOne 0.00 15.00 FORMAT "%5.2" /end CHARACTERISTIC
/begin CHARACTERISTIC DFES_DbLv.DFC_UBRmax_C "" VALUE 0x800418EE Val_Wu8 15.00 DFES_OneToOne 0.00 15.00 FORMAT "%5.2" /end CHARACTERISTIC
/begin CHARACTERISTIC DFES_DbLv.DFC_UBmax_C "" VALUE 0x800418EF Val_Wu8 15.00 DFES_OneToOne 0.00 15.00 FORMAT "%5.2" /end CHARACTERISTIC
/begin CHARACTERISTIC DFES_DbLv.DFC_UBmin_C "" VALUE 0x800418F0 Val_Wu8 15.00 DFES_OneToOne 0.00 15.00 FORMAT "%5.2" /end CHARACTERISTIC
/begin CHARACTERISTIC DFES_DbLv.DFC_UBnpl_C "" VALUE 0x800418F1 Val_Wu8 15.00 DFES_OneToOne 0.00 15.00 FORMAT "%5.2" /end CHARACTERISTIC
/begin CHARACTERISTIC DFES_DTCM.DFC_Unused_C "" VALUE 0x80040E8A Val_Wu16 65535.00 DFES_OneToOne 0.00 65535.00 FORMAT "%8.2" READ_ONLY /end CHARACTERISTIC
/begin CHARACTERISTIC DFES_DTCM.DFC_AltMaxPwr_C "" VALUE 0x80040E8C Val_Wu16 65535.00 DFES_OneToOne 0.00 65535.00 FORMAT "%8.2" /end CHARACTERISTIC
/begin CHARACTERISTIC DFES_DTCM.DFC_BrkNpl_C "" VALUE 0x80040E8E Val_Wu16 65535.00 DFES_OneToOne 0.00 65535.00 FORMAT "%8.2" /end CHARACTERISTIC
/begin CHARACTERISTIC DFES_DTCM.DFC_Cj930SSp1Mon_C "" VALUE 0x80040E90 Val_Wu16 65535.00 DFES_OneToOne 0.00 65535.00 FORMAT "%8.2" /end CHARACTERISTIC
/begin CHARACTERISTIC DFES_DTCM.DFC_Cj930SSp2Mon_C "" VALUE 0x80040E92 Val_Wu16 65535.00 DFES_OneToOne 0.00 65535.00 FORMAT "%8.2" /end CHARACTERISTIC
/begin CHARACTERISTIC DFES_DTCM.DFC_Cj930SSp3Mon_C "" VALUE 0x80040E94 Val_Wu16 65535.00 DFES_OneToOne 0.00 65535.00 FORMAT "%8.2" /end CHARACTERISTIC
/begin CHARACTERISTIC DFES_DTCM.DFC_IdleChrgActrAMax_C "" VALUE 0x80040E96 Val_Wu16 65535.00 DFES_OneToOne 0.00 65535.00 FORMAT "%8.2" /end CHARACTERISTIC
/begin CHARACTERISTIC DFES_DTCM.DFC_IdleChrgActrAMin_C "" VALUE 0x80040E98 Val_Wu16 65535.00 DFES_OneToOne 0.00 65535.00 FORMAT "%8.2" /end CHARACTERISTIC
/begin CHARACTERISTIC DFES_DTCM.DFC_IdleChrgActrASig_C "" VALUE 0x80040E9A Val_Wu16 65535.00 DFES_OneToOne 0.00 65535.00 FORMAT "%8.2" /end CHARACTERISTIC
/begin CHARACTERISTIC DFES_DTCM.DFC_IdleChrgActrBMax_C "" VALUE 0x80040E9C Val_Wu16 65535.00 DFES_OneToOne 0.00 65535.00 FORMAT "%8.2" /end CHARACTERISTIC
/begin CHARACTERISTIC DFES_DTCM.DFC_IdleChrgActrBMin_C "" VALUE 0x80040E9E Val_Wu16 65535.00 DFES_OneToOne 0.00 65535.00 FORMAT "%8.2" /end CHARACTERISTIC
/begin CHARACTERISTIC DFES_DTCM.DFC_IdleChrgActrBSig_C "" VALUE 0x80040EA0 Val_Wu16 65535.00 DFES_OneToOne 0.00 65535.00 FORMAT "%8.2" /end CHARACTERISTIC
/begin CHARACTERISTIC DFES_DTCM.DFC_IdleChrgActrGovDeCold_C "" VALUE 0x80040EA2 Val_Wu16 65535.00 DFES_OneToOne 0.00 65535.00 FORMAT "%8.2" /end CHARACTERISTIC
/begin CHARACTERISTIC DFES_DTCM.DFC_IdleChrgActrGovDeMax_C "" VALUE 0x80040EA4 Val_Wu16 65535.00 DFES_OneToOne 0.00 65535.00 FORMAT "%8.2" /end CHARACTERISTIC
/begin CHARACTERISTIC DFES_DTCM.DFC_IdleChrgActrGovDeMin_C "" VALUE 0x80040EA6 Val_Wu16 65535.00 DFES_OneToOne 0.00 65535.00 FORMAT "%8.2" /end CHARACTERISTIC
/begin CHARACTERISTIC DFES_DTCM.DFC_IdleChrgActrNAMax_C "" VALUE 0x80040EA8 Val_Wu16 65535.00 DFES_OneToOne 0.00 65535.00 FORMAT "%8.2" /end CHARACTERISTIC
/begin CHARACTERISTIC DFES_DTCM.DFC_IdleChrgActrNAMin_C "" VALUE 0x80040EAA Val_Wu16 65535.00 DFES_OneToOne 0.00 65535.00 FORMAT "%8.2" /end CHARACTERISTIC
/begin CHARACTERISTIC DFES_DTCM.DFC_IdleChrgActrNASig_C "" VALUE 0x80040EAC Val_Wu16 65535.00 DFES_OneToOne 0.00 65535.00 FORMAT "%8.2" /end CHARACTERISTIC
/begin CHARACTERISTIC DFES_DTCM.DFC_IdleChrgActrNBMax_C "" VALUE 0x80040EAE Val_Wu16 65535.00 DFES_OneToOne 0.00 65535.00 FORMAT "%8.2" /end CHARACTERISTIC
/begin CHARACTERISTIC DFES_DTCM.DFC_IdleChrgActrNBMin_C "" VALUE 0x80040EB0 Val_Wu16 65535.00 DFES_OneToOne 0.00 65535.00 FORMAT "%8.2" /end CHARACTERISTIC
/begin CHARACTERISTIC DFES_DTCM.DFC_IdleChrgActrNBSig_C "" VALUE 0x80040EB2 Val_Wu16 65535.00 DFES_OneToOne 0.00 65535.00 FORMAT "%8.2" /end CHARACTERISTIC
/begin CHARACTERISTIC DFES_DTCM.DFC_IdleChrgActrOverTmp_C "" VALUE 0x80040EB4 Val_Wu16 65535.00 DFES_OneToOne 0.00 65535.00 FORMAT "%8.2" /end CHARACTERISTIC
/begin CHARACTERISTIC DFES_DTCM.DFC_MonUMaxSupply1_C "" VALUE 0x80040EB6 Val_Wu16 65535.00 DFES_OneToOne 0.00 65535.00 FORMAT "%8.2" /end CHARACTERISTIC
/begin CHARACTERISTIC DFES_DTCM.DFC_MonUMinSupply1_C "" VALUE 0x80040EB8 Val_Wu16 65535.00 DFES_OneToOne 0.00 65535.00 FORMAT "%8.2" /end CHARACTERISTIC
/begin CHARACTERISTIC DFES_DTCM.DFC_ClthNplClsd_C "" VALUE 0x80040EBA Val_Wu16 65535.00 DFES_OneToOne 0.00 65535.00 FORMAT "%8.2" /end CHARACTERISTIC
/begin CHARACTERISTIC DFES_DTCM.DFC_ClthNplOpn_C "" VALUE 0x80040EBC Val_Wu16 65535.00 DFES_OneToOne 0.00 65535.00 FORMAT "%8.2" /end CHARACTERISTIC
/begin CHARACTERISTIC DFES_DTCM.DFC_IgnClPsDevComErr1_C "" VALUE 0x80040EBE Val_Wu16 65535.00 DFES_OneToOne 0.00 65535.00 FORMAT "%8.2" /end CHARACTERISTIC
/begin CHARACTERISTIC DFES_DTCM.DFC_IgnClPsOpenLoad0_C "" VALUE 0x80040EC0 Val_Wu16 65535.00 DFES_OneToOne 0.00 65535.00 FORMAT "%8.2" /end CHARACTERISTIC
/begin CHARACTERISTIC DFES_DTCM.DFC_IgnClPsOpenLoad1_C "" VALUE 0x80040EC2 Val_Wu16 65535.00 DFES_OneToOne 0.00 65535.00 FORMAT "%8.2" /end CHARACTERISTIC
/begin CHARACTERISTIC DFES_DTCM.DFC_IgnClPsOpenLoad2_C "" VALUE 0x80040EC4 Val_Wu16 65535.00 DFES_OneToOne 0.00 65535.00 FORMAT "%8.2" /end CHARACTERISTIC
/begin CHARACTERISTIC DFES_DTCM.DFC_IgnClPsShCirBatt0_C "" VALUE 0x80040EC6 Val_Wu16 65535.00 DFES_OneToOne 0.00 65535.00 FORMAT "%8.2" /end CHARACTERISTIC
/begin CHARACTERISTIC DFES_DTCM.DFC_IgnClPsShCirBatt1_C "" VALUE 0x80040EC8 Val_Wu16 65535.00 DFES_OneToOne 0.00 65535.00 FORMAT "%8.2" /end CHARACTERISTIC
/begin CHARACTERISTIC DFES_DTCM.DFC_IgnClPsShCirBatt2_C "" VALUE 0x80040ECA Val_Wu16 65535.00 DFES_OneToOne 0.00 65535.00 FORMAT "%8.2" /end CHARACTERISTIC
/begin CHARACTERISTIC DFES_DTCM.DFC_IgnClPsShCirGnd0_C "" VALUE 0x80040ECC Val_Wu16 65535.00 DFES_OneToOne 0.00 65535.00 FORMAT "%8.2" /end CHARACTERISTIC
/begin CHARACTERISTIC DFES_DTCM.DFC_IgnClPsShCirGnd1_C "" VALUE 0x80040ECE Val_Wu16 65535.00 DFES_OneToOne 0.00 65535.00 FORMAT "%8.2" /end CHARACTERISTIC
/begin CHARACTERISTIC DFES_DTCM.DFC_IgnClPsShCirGnd2_C "" VALUE 0x80040ED0 Val_Wu16 65535.00 DFES_OneToOne 0.00 65535.00 FORMAT "%8.2" /end CHARACTERISTIC
/begin CHARACTERISTIC DFES_DTCM.DFC_KnDetSens1PortAMax_C "" VALUE 0x80040ED2 Val_Wu16 65535.00 DFES_OneToOne 0.00 65535.00 FORMAT "%8.2" /end CHARACTERISTIC
/begin CHARACTERISTIC DFES_DTCM.DFC_KnDetSens1PortAMin_C "" VALUE 0x80040ED4 Val_Wu16 65535.00 DFES_OneToOne 0.00 65535.00 FORMAT "%8.2" /end CHARACTERISTIC
/begin CHARACTERISTIC DFES_DTCM.DFC_KnDetSens1PortBMax_C "" VALUE 0x80040ED6 Val_Wu16 65535.00 DFES_OneToOne 0.00 65535.00 FORMAT "%8.2" /end CHARACTERISTIC
/begin CHARACTERISTIC DFES_DTCM.DFC_KnDetSens1PortBMin_C "" VALUE 0x80040ED8 Val_Wu16 65535.00 DFES_OneToOne 0.00 65535.00 FORMAT "%8.2" /end CHARACTERISTIC
/begin CHARACTERISTIC DFES_DTCM.DFC_VehVWhlErr_C "" VALUE 0x80040EDA Val_Wu16 65535.00 DFES_OneToOne 0.00 65535.00 FORMAT "%8.2" /end CHARACTERISTIC
/begin CHARACTERISTIC DFES_DTCM.DFC_AirCCmprOL_C "" VALUE 0x80040EDC Val_Wu16 65535.00 DFES_OneToOne 0.00 65535.00 FORMAT "%8.2" /end CHARACTERISTIC
/begin CHARACTERISTIC DFES_DTCM.DFC_AirCCmprOvrTemp_C "" VALUE 0x80040EDE Val_Wu16 65535.00 DFES_OneToOne 0.00 65535.00 FORMAT "%8.2" /end CHARACTERISTIC
/begin CHARACTERISTIC DFES_DTCM.DFC_AirCCmprSCB_C "" VALUE 0x80040EE0 Val_Wu16 65535.00 DFES_OneToOne 0.00 65535.00 FORMAT "%8.2" /end CHARACTERISTIC
/begin CHARACTERISTIC DFES_DTCM.DFC_AirCCmprSCG_C "" VALUE 0x80040EE2 Val_Wu16 65535.00 DFES_OneToOne 0.00 65535.00 FORMAT "%8.2" /end CHARACTERISTIC
/begin CHARACTERISTIC DFES_DTCM.DFC_AltIOLdSRCMin_C "" VALUE 0x80040EE4 Val_Wu16 65535.00 DFES_OneToOne 0.00 65535.00 FORMAT "%8.2" /end CHARACTERISTIC
/begin CHARACTERISTIC DFES_DTCM.DFC_AltIOOL_C "" VALUE 0x80040EE6 Val_Wu16 65535.00 DFES_OneToOne 0.00 65535.00 FORMAT "%8.2" /end CHARACTERISTIC
/begin CHARACTERISTIC DFES_DTCM.DFC_AltIOOvrTemp_C "" VALUE 0x80040EE8 Val_Wu16 65535.00 DFES_OneToOne 0.00 65535.00 FORMAT "%8.2" /end CHARACTERISTIC
/begin CHARACTERISTIC DFES_DTCM.DFC_AltIOSCB_C "" VALUE 0x80040EEA Val_Wu16 65535.00 DFES_OneToOne 0.00 65535.00 FORMAT "%8.2" /end CHARACTERISTIC
/begin CHARACTERISTIC DFES_DTCM.DFC_AltIOSCG_C "" VALUE 0x80040EEC Val_Wu16 65535.00 DFES_OneToOne 0.00 65535.00 FORMAT "%8.2" /end CHARACTERISTIC
/begin CHARACTERISTIC DFES_DTCM.DFC_DevLibBattUHi_C "" VALUE 0x80040EEE Val_Wu16 65535.00 DFES_OneToOne 0.00 65535.00 FORMAT "%8.2" /end CHARACTERISTIC
/begin CHARACTERISTIC DFES_DTCM.DFC_DevLibBattULo_C "" VALUE 0x80040EF0 Val_Wu16 65535.00 DFES_OneToOne 0.00 65535.00 FORMAT "%8.2" /end CHARACTERISTIC
/begin CHARACTERISTIC DFES_DTCM.DFC_FanDIOOL_C "" VALUE 0x80040EF2 Val_Wu16 65535.00 DFES_OneToOne 0.00 65535.00 FORMAT "%8.2" /end CHARACTERISTIC
/begin CHARACTERISTIC DFES_DTCM.DFC_FanDIOOvrTemp_C "" VALUE 0x80040EF4 Val_Wu16 65535.00 DFES_OneToOne 0.00 65535.00 FORMAT "%8.2" /end CHARACTERISTIC
/begin CHARACTERISTIC DFES_DTCM.DFC_FanDIOSCB_C "" VALUE 0x80040EF6 Val_Wu16 65535.00 DFES_OneToOne 0.00 65535.00 FORMAT "%8.2" /end CHARACTERISTIC
/begin CHARACTERISTIC DFES_DTCM.DFC_FanDIOSCG_C "" VALUE 0x80040EF8 Val_Wu16 65535.00 DFES_OneToOne 0.00 65535.00 FORMAT "%8.2" /end CHARACTERISTIC
/begin CHARACTERISTIC DFES_DTCM.DFC_FanPWMOL_C "" VALUE 0x80040EFA Val_Wu16 65535.00 DFES_OneToOne 0.00 65535.00 FORMAT "%8.2" /end CHARACTERISTIC
/begin CHARACTERISTIC DFES_DTCM.DFC_FanPWMOvrTemp_C "" VALUE 0x80040EFC Val_Wu16 65535.00 DFES_OneToOne 0.00 65535.00 FORMAT "%8.2" /end CHARACTERISTIC
/begin CHARACTERISTIC DFES_DTCM.DFC_FanPWMSCB_C "" VALUE 0x80040EFE Val_Wu16 65535.00 DFES_OneToOne 0.00 65535.00 FORMAT "%8.2" /end CHARACTERISTIC
/begin CHARACTERISTIC DFES_DTCM.DFC_FanPWMSCG_C "" VALUE 0x80040F00 Val_Wu16 65535.00 DFES_OneToOne 0.00 65535.00 FORMAT "%8.2" /end CHARACTERISTIC
/begin CHARACTERISTIC DFES_DTCM.DFC_AirCClntPAnaSRCMax_C "" VALUE 0x80040F02 Val_Wu16 65535.00 DFES_OneToOne 0.00 65535.00 FORMAT "%8.2" /end CHARACTERISTIC
/begin CHARACTERISTIC DFES_DTCM.DFC_AirCClntPAnaSRCMin_C "" VALUE 0x80040F04 Val_Wu16 65535.00 DFES_OneToOne 0.00 65535.00 FORMAT "%8.2" /end CHARACTERISTIC
/begin CHARACTERISTIC DFES_DTCM.DFC_AirCSwtNpl_C "" VALUE 0x80040F06 Val_Wu16 65535.00 DFES_OneToOne 0.00 65535.00 FORMAT "%8.2" /end CHARACTERISTIC
/begin CHARACTERISTIC DFES_DTCM.DFC_AirCSwtSig_C "" VALUE 0x80040F08 Val_Wu16 65535.00 DFES_OneToOne 0.00 65535.00 FORMAT "%8.2" /end CHARACTERISTIC
/begin CHARACTERISTIC DFES_DTCM.DFC_AltIOLdSRCMax_C "" VALUE 0x80040F0A Val_Wu16 65535.00 DFES_OneToOne 0.00 65535.00 FORMAT "%8.2" /end CHARACTERISTIC
/begin CHARACTERISTIC DFES_DTCM.DFC_BrkSig_C "" VALUE 0x80040F0C Val_Wu16 65535.00 DFES_OneToOne 0.00 65535.00 FORMAT "%8.2" /end CHARACTERISTIC
/begin CHARACTERISTIC DFES_DTCM.DFC_ClthEPBNpl_C "" VALUE 0x80040F0E Val_Wu16 65535.00 DFES_OneToOne 0.00 65535.00 FORMAT "%8.2" /end CHARACTERISTIC
/begin CHARACTERISTIC DFES_DTCM.DFC_ClthEPBSensErr_C "" VALUE 0x80040F10 Val_Wu16 65535.00 DFES_OneToOne 0.00 65535.00 FORMAT "%8.2" /end CHARACTERISTIC
/begin CHARACTERISTIC DFES_DTCM.DFC_ClthErr_C "" VALUE 0x80040F12 Val_Wu16 65535.00 DFES_OneToOne 0.00 65535.00 FORMAT "%8.2" /end CHARACTERISTIC
/begin CHARACTERISTIC DFES_DTCM.DFC_ClthSig_C "" VALUE 0x80040F14 Val_Wu16 65535.00 DFES_OneToOne 0.00 65535.00 FORMAT "%8.2" /end CHARACTERISTIC
/begin CHARACTERISTIC DFES_DTCM.DFC_MILLmpOL_C "" VALUE 0x80040F16 Val_Wu16 65535.00 DFES_OneToOne 0.00 65535.00 FORMAT "%8.2" /end CHARACTERISTIC
/begin CHARACTERISTIC DFES_DTCM.DFC_MILLmpSCB_C "" VALUE 0x80040F18 Val_Wu16 65535.00 DFES_OneToOne 0.00 65535.00 FORMAT "%8.2" /end CHARACTERISTIC
/begin CHARACTERISTIC DFES_DTCM.DFC_MILLmpSCG_C "" VALUE 0x80040F1A Val_Wu16 65535.00 DFES_OneToOne 0.00 65535.00 FORMAT "%8.2" /end CHARACTERISTIC
/begin CHARACTERISTIC DFES_DTCM.DFC_SRCHighAPP1_C "" VALUE 0x80040F1C Val_Wu16 65535.00 DFES_OneToOne 0.00 65535.00 FORMAT "%8.2" /end CHARACTERISTIC
/begin CHARACTERISTIC DFES_DTCM.DFC_SRCHighAPP2_C "" VALUE 0x80040F1E Val_Wu16 65535.00 DFES_OneToOne 0.00 65535.00 FORMAT "%8.2" /end CHARACTERISTIC
/begin CHARACTERISTIC DFES_DTCM.DFC_SRCLowAPP1_C "" VALUE 0x80040F20 Val_Wu16 65535.00 DFES_OneToOne 0.00 65535.00 FORMAT "%8.2" /end CHARACTERISTIC
/begin CHARACTERISTIC DFES_DTCM.DFC_SRCLowAPP2_C "" VALUE 0x80040F22 Val_Wu16 65535.00 DFES_OneToOne 0.00 65535.00 FORMAT "%8.2" /end CHARACTERISTIC
/begin CHARACTERISTIC DFES_DTCM.DFC_SyncAPP_C "" VALUE 0x80040F24 Val_Wu16 65535.00 DFES_OneToOne 0.00 65535.00 FORMAT "%8.2" /end CHARACTERISTIC
/begin CHARACTERISTIC DFES_DTCM.DFC_VehVMax_C "" VALUE 0x80040F26 Val_Wu16 65535.00 DFES_OneToOne 0.00 65535.00 FORMAT "%8.2" /end CHARACTERISTIC
/begin CHARACTERISTIC DFES_DTCM.DFC_VehVPlaus_C "" VALUE 0x80040F28 Val_Wu16 65535.00 DFES_OneToOne 0.00 65535.00 FORMAT "%8.2" /end CHARACTERISTIC
/begin CHARACTERISTIC DFES_DTCM.DFC_VehVSig_C "" VALUE 0x80040F2A Val_Wu16 65535.00 DFES_OneToOne 0.00 65535.00 FORMAT "%8.2" /end CHARACTERISTIC
/begin CHARACTERISTIC DFES_DTCM.DFC_BusDiagBusOffNodeA_C "" VALUE 0x80040F2C Val_Wu16 65535.00 DFES_OneToOne 0.00 65535.00 FORMAT "%8.2" /end CHARACTERISTIC
/begin CHARACTERISTIC DFES_DTCM.DFC_ComACSensTO_C "" VALUE 0x80040F2E Val_Wu16 65535.00 DFES_OneToOne 0.00 65535.00 FORMAT "%8.2" /end CHARACTERISTIC
/begin CHARACTERISTIC DFES_DTCM.DFC_ComAWD1TO_C "" VALUE 0x80040F30 Val_Wu16 65535.00 DFES_OneToOne 0.00 65535.00 FORMAT "%8.2" /end CHARACTERISTIC
/begin CHARACTERISTIC DFES_DTCM.DFC_ComBRK10TO_C "" VALUE 0x80040F32 Val_Wu16 65535.00 DFES_OneToOne 0.00 65535.00 FORMAT "%8.2" /end CHARACTERISTIC
/begin CHARACTERISTIC DFES_DTCM.DFC_ComGW11TO_C "" VALUE 0x80040F34 Val_Wu16 65535.00 DFES_OneToOne 0.00 65535.00 FORMAT "%8.2" /end CHARACTERISTIC
/begin CHARACTERISTIC DFES_DTCM.DFC_ComLVL1TO_C "" VALUE 0x80040F36 Val_Wu16 65535.00 DFES_OneToOne 0.00 65535.00 FORMAT "%8.2" /end CHARACTERISTIC
/begin CHARACTERISTIC DFES_DTCM.DFC_ComPRKA01TO_C "" VALUE 0x80040F38 Val_Wu16 65535.00 DFES_OneToOne 0.00 65535.00 FORMAT "%8.2" /end CHARACTERISTIC
/begin CHARACTERISTIC DFES_DTCM.DFC_ComPRKH01TO_C "" VALUE 0x80040F3A Val_Wu16 65535.00 DFES_OneToOne 0.00 65535.00 FORMAT "%8.2" /end CHARACTERISTIC
/begin CHARACTERISTIC DFES_DTCM.DFC_ComPRKH1TO_C "" VALUE 0x80040F3C Val_Wu16 65535.00 DFES_OneToOne 0.00 65535.00 FORMAT "%8.2" /end CHARACTERISTIC
/begin CHARACTERISTIC DFES_DTCM.DFC_ComTRBCH1TO_C "" VALUE 0x80040F3E Val_Wu16 65535.00 DFES_OneToOne 0.00 65535.00 FORMAT "%8.2" /end CHARACTERISTIC
/begin CHARACTERISTIC DFES_DTCM.DFC_ComTRBCH2TO_C "" VALUE 0x80040F40 Val_Wu16 65535.00 DFES_OneToOne 0.00 65535.00 FORMAT "%8.2" /end CHARACTERISTIC
/begin CHARACTERISTIC DFES_DTCM.DFC_DK_C "" VALUE 0x80040F42 Val_Wu16 65535.00 DFES_OneToOne 0.00 65535.00 FORMAT "%8.2" /end CHARACTERISTIC
/begin CHARACTERISTIC DFES_DTCM.DFC_DKRSA_C "" VALUE 0x80040F44 Val_Wu16 65535.00 DFES_OneToOne 0.00 65535.00 FORMAT "%8.2" /end CHARACTERISTIC
/begin CHARACTERISTIC DFES_DTCM.DFC_DKVSmax_C "" VALUE 0x80040F46 Val_Wu16 65535.00 DFES_OneToOne 0.00 65535.00 FORMAT "%8.2" /end CHARACTERISTIC
/begin CHARACTERISTIC DFES_DTCM.DFC_DKmax_C "" VALUE 0x80040F48 Val_Wu16 65535.00 DFES_OneToOne 0.00 65535.00 FORMAT "%8.2" /end CHARACTERISTIC
/begin CHARACTERISTIC DFES_DTCM.DFC_DKmin_C "" VALUE 0x80040F4A Val_Wu16 65535.00 DFES_OneToOne 0.00 65535.00 FORMAT "%8.2" /end CHARACTERISTIC
/begin CHARACTERISTIC DFES_DTCM.DFC_DSSmax_C "" VALUE 0x80040F4C Val_Wu16 65535.00 DFES_OneToOne 0.00 65535.00 FORMAT "%8.2" /end CHARACTERISTIC
/begin CHARACTERISTIC DFES_DTCM.DFC_EEPEraseErr_C "" VALUE 0x80040F4E Val_Wu16 65535.00 DFES_OneToOne 0.00 65535.00 FORMAT "%8.2" /end CHARACTERISTIC
/begin CHARACTERISTIC DFES_DTCM.DFC_EEPRdErr_C "" VALUE 0x80040F50 Val_Wu16 65535.00 DFES_OneToOne 0.00 65535.00 FORMAT "%8.2" /end CHARACTERISTIC
/begin CHARACTERISTIC DFES_DTCM.DFC_EEPWrErr_C "" VALUE 0x80040F52 Val_Wu16 65535.00 DFES_OneToOne 0.00 65535.00 FORMAT "%8.2" /end CHARACTERISTIC
/begin CHARACTERISTIC DFES_DTCM.DFC_EV1max_C "" VALUE 0x80040F54 Val_Wu16 65535.00 DFES_OneToOne 0.00 65535.00 FORMAT "%8.2" /end CHARACTERISTIC
/begin CHARACTERISTIC DFES_DTCM.DFC_EV1min_C "" VALUE 0x80040F56 Val_Wu16 65535.00 DFES_OneToOne 0.00 65535.00 FORMAT "%8.2" /end CHARACTERISTIC
/begin CHARACTERISTIC DFES_DTCM.DFC_EV1sig_C "" VALUE 0x80040F58 Val_Wu16 65535.00 DFES_OneToOne 0.00 65535.00 FORMAT "%8.2" /end CHARACTERISTIC
/begin CHARACTERISTIC DFES_DTCM.DFC_EV2max_C "" VALUE 0x80040F5A Val_Wu16 65535.00 DFES_OneToOne 0.00 65535.00 FORMAT "%8.2" /end CHARACTERISTIC
/begin CHARACTERISTIC DFES_DTCM.DFC_EV2min_C "" VALUE 0x80040F5C Val_Wu16 65535.00 DFES_OneToOne 0.00 65535.00 FORMAT "%8.2" /end CHARACTERISTIC
/begin CHARACTERISTIC DFES_DTCM.DFC_EV2sig_C "" VALUE 0x80040F5E Val_Wu16 65535.00 DFES_OneToOne 0.00 65535.00 FORMAT "%8.2" /end CHARACTERISTIC
/begin CHARACTERISTIC DFES_DTCM.DFC_EV3max_C "" VALUE 0x80040F60 Val_Wu16 65535.00 DFES_OneToOne 0.00 65535.00 FORMAT "%8.2" /end CHARACTERISTIC
/begin CHARACTERISTIC DFES_DTCM.DFC_EV3min_C "" VALUE 0x80040F62 Val_Wu16 65535.00 DFES_OneToOne 0.00 65535.00 FORMAT "%8.2" /end CHARACTERISTIC
/begin CHARACTERISTIC DFES_DTCM.DFC_EV3sig_C "" VALUE 0x80040F64 Val_Wu16 65535.00 DFES_OneToOne 0.00 65535.00 FORMAT "%8.2" /end CHARACTERISTIC
/begin CHARACTERISTIC DFES_DTCM.DFC_EpmCaSI1ErrSig_C "" VALUE 0x80040F66 Val_Wu16 65535.00 DFES_OneToOne 0.00 65535.00 FORMAT "%8.2" /end CHARACTERISTIC
/begin CHARACTERISTIC DFES_DTCM.DFC_EpmCaSI1NoSig_C "" VALUE 0x80040F68 Val_Wu16 65535.00 DFES_OneToOne 0.00 65535.00 FORMAT "%8.2" /end CHARACTERISTIC
/begin CHARACTERISTIC DFES_DTCM.DFC_EpmCaSI1NoSigMax_C "" VALUE 0x80040F6A Val_Wu16 65535.00 DFES_OneToOne 0.00 65535.00 FORMAT "%8.2" /end CHARACTERISTIC
/begin CHARACTERISTIC DFES_DTCM.DFC_EpmCaSI1NoSigMin_C "" VALUE 0x80040F6C Val_Wu16 65535.00 DFES_OneToOne 0.00 65535.00 FORMAT "%8.2" /end CHARACTERISTIC
/begin CHARACTERISTIC DFES_DTCM.DFC_EpmCaSI1OfsErr_C "" VALUE 0x80040F6E Val_Wu16 65535.00 DFES_OneToOne 0.00 65535.00 FORMAT "%8.2" /end CHARACTERISTIC
/begin CHARACTERISTIC DFES_DTCM.DFC_EpmCrSErrSig_C "" VALUE 0x80040F70 Val_Wu16 65535.00 DFES_OneToOne 0.00 65535.00 FORMAT "%8.2" /end CHARACTERISTIC
/begin CHARACTERISTIC DFES_DTCM.DFC_EpmCrSNoSig_C "" VALUE 0x80040F72 Val_Wu16 65535.00 DFES_OneToOne 0.00 65535.00 FORMAT "%8.2" /end CHARACTERISTIC
/begin CHARACTERISTIC DFES_DTCM.DFC_FRAmax_C "" VALUE 0x80040F74 Val_Wu16 65535.00 DFES_OneToOne 0.00 65535.00 FORMAT "%8.2" /end CHARACTERISTIC
/begin CHARACTERISTIC DFES_DTCM.DFC_FRAmin_C "" VALUE 0x80040F76 Val_Wu16 65535.00 DFES_OneToOne 0.00 65535.00 FORMAT "%8.2" /end CHARACTERISTIC
/begin CHARACTERISTIC DFES_DTCM.DFC_HEGOS1B1ElecMax_C "" VALUE 0x80040F78 Val_Wu16 65535.00 DFES_OneToOne 0.00 65535.00 FORMAT "%8.2" /end CHARACTERISTIC
/begin CHARACTERISTIC DFES_DTCM.DFC_HEGOS1B1ElecMin_C "" VALUE 0x80040F7A Val_Wu16 65535.00 DFES_OneToOne 0.00 65535.00 FORMAT "%8.2" /end CHARACTERISTIC
/begin CHARACTERISTIC DFES_DTCM.DFC_HEGOS1B1ElecNpl_C "" VALUE 0x80040F7C Val_Wu16 65535.00 DFES_OneToOne 0.00 65535.00 FORMAT "%8.2" /end CHARACTERISTIC
/begin CHARACTERISTIC DFES_DTCM.DFC_HEGOS1B1ElecSig_C "" VALUE 0x80040F7E Val_Wu16 65535.00 DFES_OneToOne 0.00 65535.00 FORMAT "%8.2" /end CHARACTERISTIC
/begin CHARACTERISTIC DFES_DTCM.DFC_HEGOS1B1HtgNpl_C "" VALUE 0x80040F80 Val_Wu16 65535.00 DFES_OneToOne 0.00 65535.00 FORMAT "%8.2" /end CHARACTERISTIC
/begin CHARACTERISTIC DFES_DTCM.DFC_HEGOS1B1HtrPsMax_C "" VALUE 0x80040F82 Val_Wu16 65535.00 DFES_OneToOne 0.00 65535.00 FORMAT "%8.2" /end CHARACTERISTIC
/begin CHARACTERISTIC DFES_DTCM.DFC_HEGOS1B1HtrPsMin_C "" VALUE 0x80040F84 Val_Wu16 65535.00 DFES_OneToOne 0.00 65535.00 FORMAT "%8.2" /end CHARACTERISTIC
/begin CHARACTERISTIC DFES_DTCM.DFC_HEGOS1B1HtrPsSig_C "" VALUE 0x80040F86 Val_Wu16 65535.00 DFES_OneToOne 0.00 65535.00 FORMAT "%8.2" /end CHARACTERISTIC
/begin CHARACTERISTIC DFES_DTCM.DFC_HEGOS1B1StkMax_C "" VALUE 0x80040F88 Val_Wu16 65535.00 DFES_OneToOne 0.00 65535.00 FORMAT "%8.2" /end CHARACTERISTIC
/begin CHARACTERISTIC DFES_DTCM.DFC_HEGOS1B1StkMin_C "" VALUE 0x80040F8A Val_Wu16 65535.00 DFES_OneToOne 0.00 65535.00 FORMAT "%8.2" /end CHARACTERISTIC
/begin CHARACTERISTIC DFES_DTCM.DFC_HEGOS2B1RstrcnLean_C "" VALUE 0x80040F8C Val_Wu16 65535.00 DFES_OneToOne 0.00 65535.00 FORMAT "%8.2" /end CHARACTERISTIC
/begin CHARACTERISTIC DFES_DTCM.DFC_HEGOS2B1RstrcnRich_C "" VALUE 0x80040F8E Val_Wu16 65535.00 DFES_OneToOne 0.00 65535.00 FORMAT "%8.2" /end CHARACTERISTIC
/begin CHARACTERISTIC DFES_DTCM.DFC_IdleChrgActrJamVlvClsd_C "" VALUE 0x80040F90 Val_Wu16 65535.00 DFES_OneToOne 0.00 65535.00 FORMAT "%8.2" /end CHARACTERISTIC
/begin CHARACTERISTIC DFES_DTCM.DFC_IdleChrgActrJamVlvOpn_C "" VALUE 0x80040F92 Val_Wu16 65535.00 DFES_OneToOne 0.00 65535.00 FORMAT "%8.2" /end CHARACTERISTIC
/begin CHARACTERISTIC DFES_DTCM.DFC_IgnClPsDevOscErr1_C "" VALUE 0x80040F94 Val_Wu16 65535.00 DFES_OneToOne 0.00 65535.00 FORMAT "%8.2" /end CHARACTERISTIC
/begin CHARACTERISTIC DFES_DTCM.DFC_KPEmax_C "" VALUE 0x80040F96 Val_Wu16 65535.00 DFES_OneToOne 0.00 65535.00 FORMAT "%8.2" /end CHARACTERISTIC
/begin CHARACTERISTIC DFES_DTCM.DFC_KPEmin_C "" VALUE 0x80040F98 Val_Wu16 65535.00 DFES_OneToOne 0.00 65535.00 FORMAT "%8.2" /end CHARACTERISTIC
/begin CHARACTERISTIC DFES_DTCM.DFC_KPEsig_C "" VALUE 0x80040F9A Val_Wu16 65535.00 DFES_OneToOne 0.00 65535.00 FORMAT "%8.2" /end CHARACTERISTIC
/begin CHARACTERISTIC DFES_DTCM.DFC_KS1max_C "" VALUE 0x80040F9C Val_Wu16 65535.00 DFES_OneToOne 0.00 65535.00 FORMAT "%8.2" /end CHARACTERISTIC
/begin CHARACTERISTIC DFES_DTCM.DFC_KS1min_C "" VALUE 0x80040F9E Val_Wu16 65535.00 DFES_OneToOne 0.00 65535.00 FORMAT "%8.2" /end CHARACTERISTIC
/begin CHARACTERISTIC DFES_DTCM.DFC_LLRKHmax_C "" VALUE 0x80040FA0 Val_Wu16 65535.00 DFES_OneToOne 0.00 65535.00 FORMAT "%8.2" /end CHARACTERISTIC
/begin CHARACTERISTIC DFES_DTCM.DFC_LLRKHmin_C "" VALUE 0x80040FA2 Val_Wu16 65535.00 DFES_OneToOne 0.00 65535.00 FORMAT "%8.2" /end CHARACTERISTIC
/begin CHARACTERISTIC DFES_DTCM.DFC_LLRKHnpl_C "" VALUE 0x80040FA4 Val_Wu16 65535.00 DFES_OneToOne 0.00 65535.00 FORMAT "%8.2" /end CHARACTERISTIC
/begin CHARACTERISTIC DFES_DTCM.DFC_LLRmax_C "" VALUE 0x80040FA6 Val_Wu16 65535.00 DFES_OneToOne 0.00 65535.00 FORMAT "%8.2" /end CHARACTERISTIC
/begin CHARACTERISTIC DFES_DTCM.DFC_LLRmin_C "" VALUE 0x80040FA8 Val_Wu16 65535.00 DFES_OneToOne 0.00 65535.00 FORMAT "%8.2" /end CHARACTERISTIC
/begin CHARACTERISTIC DFES_DTCM.DFC_LLRnpl_C "" VALUE 0x80040FAA Val_Wu16 65535.00 DFES_OneToOne 0.00 65535.00 FORMAT "%8.2" /end CHARACTERISTIC
/begin CHARACTERISTIC DFES_DTCM.DFC_LMmax_C "" VALUE 0x80040FAC Val_Wu16 65535.00 DFES_OneToOne 0.00 65535.00 FORMAT "%8.2" /end CHARACTERISTIC
/begin CHARACTERISTIC DFES_DTCM.DFC_LZSRnpl_C "" VALUE 0x80040FAE Val_Wu16 65535.00 DFES_OneToOne 0.00 65535.00 FORMAT "%8.2" /end CHARACTERISTIC
/begin CHARACTERISTIC DFES_DTCM.DFC_MD_C "" VALUE 0x80040FB0 Val_Wu16 65535.00 DFES_OneToOne 0.00 65535.00 FORMAT "%8.2" /end CHARACTERISTIC
/begin CHARACTERISTIC DFES_DTCM.DFC_MD00min_C "" VALUE 0x80040FB2 Val_Wu16 65535.00 DFES_OneToOne 0.00 65535.00 FORMAT "%8.2" /end CHARACTERISTIC
/begin CHARACTERISTIC DFES_DTCM.DFC_MD00npl_C "" VALUE 0x80040FB4 Val_Wu16 65535.00 DFES_OneToOne 0.00 65535.00 FORMAT "%8.2" /end CHARACTERISTIC
/begin CHARACTERISTIC DFES_DTCM.DFC_MD01min_C "" VALUE 0x80040FB6 Val_Wu16 65535.00 DFES_OneToOne 0.00 65535.00 FORMAT "%8.2" /end CHARACTERISTIC
/begin CHARACTERISTIC DFES_DTCM.DFC_MD01npl_C "" VALUE 0x80040FB8 Val_Wu16 65535.00 DFES_OneToOne 0.00 65535.00 FORMAT "%8.2" /end CHARACTERISTIC
/begin CHARACTERISTIC DFES_DTCM.DFC_MD02min_C "" VALUE 0x80040FBA Val_Wu16 65535.00 DFES_OneToOne 0.00 65535.00 FORMAT "%8.2" /end CHARACTERISTIC
/begin CHARACTERISTIC DFES_DTCM.DFC_MD02npl_C "" VALUE 0x80040FBC Val_Wu16 65535.00 DFES_OneToOne 0.00 65535.00 FORMAT "%8.2" /end CHARACTERISTIC
/begin CHARACTERISTIC DFES_DTCM.DFC_MD03min_C "" VALUE 0x80040FBE Val_Wu16 65535.00 DFES_OneToOne 0.00 65535.00 FORMAT "%8.2" /end CHARACTERISTIC
/begin CHARACTERISTIC DFES_DTCM.DFC_MD03npl_C "" VALUE 0x80040FC0 Val_Wu16 65535.00 DFES_OneToOne 0.00 65535.00 FORMAT "%8.2" /end CHARACTERISTIC
/begin CHARACTERISTIC DFES_DTCM.DFC_MD04min_C "" VALUE 0x80040FC2 Val_Wu16 65535.00 DFES_OneToOne 0.00 65535.00 FORMAT "%8.2" /end CHARACTERISTIC
/begin CHARACTERISTIC DFES_DTCM.DFC_MD04npl_C "" VALUE 0x80040FC4 Val_Wu16 65535.00 DFES_OneToOne 0.00 65535.00 FORMAT "%8.2" /end CHARACTERISTIC
/begin CHARACTERISTIC DFES_DTCM.DFC_MDCyl_0_C "" VALUE 0x80040FC6 Val_Wu16 65535.00 DFES_OneToOne 0.00 65535.00 FORMAT "%8.2" /end CHARACTERISTIC
/begin CHARACTERISTIC DFES_DTCM.DFC_MDCyl_1_C "" VALUE 0x80040FC8 Val_Wu16 65535.00 DFES_OneToOne 0.00 65535.00 FORMAT "%8.2" /end CHARACTERISTIC
/begin CHARACTERISTIC DFES_DTCM.DFC_MDCyl_2_C "" VALUE 0x80040FCA Val_Wu16 65535.00 DFES_OneToOne 0.00 65535.00 FORMAT "%8.2" /end CHARACTERISTIC
/begin CHARACTERISTIC DFES_DTCM.DFC_MDFC_C "" VALUE 0x80040FCC Val_Wu16 65535.00 DFES_OneToOne 0.00 65535.00 FORMAT "%8.2" /end CHARACTERISTIC
/begin CHARACTERISTIC DFES_DTCM.DFC_MDmin_C "" VALUE 0x80040FCE Val_Wu16 65535.00 DFES_OneToOne 0.00 65535.00 FORMAT "%8.2" /end CHARACTERISTIC
/begin CHARACTERISTIC DFES_DTCM.DFC_MDnpl_C "" VALUE 0x80040FD0 Val_Wu16 65535.00 DFES_OneToOne 0.00 65535.00 FORMAT "%8.2" /end CHARACTERISTIC
/begin CHARACTERISTIC DFES_DTCM.DFC_MoCADCNTP_C "" VALUE 0x80040FD2 Val_Wu16 65535.00 DFES_OneToOne 0.00 65535.00 FORMAT "%8.2" /end CHARACTERISTIC
/begin CHARACTERISTIC DFES_DTCM.DFC_MoCADCTst_C "" VALUE 0x80040FD4 Val_Wu16 65535.00 DFES_OneToOne 0.00 65535.00 FORMAT "%8.2" /end CHARACTERISTIC
/begin CHARACTERISTIC DFES_DTCM.DFC_MoCComctErrMM_C "" VALUE 0x80040FD6 Val_Wu16 65535.00 DFES_OneToOne 0.00 65535.00 FORMAT "%8.2" /end CHARACTERISTIC
/begin CHARACTERISTIC DFES_DTCM.DFC_OCWDAActv_C "" VALUE 0x80040FD8 Val_Wu16 65535.00 DFES_OneToOne 0.00 65535.00 FORMAT "%8.2" /end CHARACTERISTIC
/begin CHARACTERISTIC DFES_DTCM.DFC_OCWDACom_C "" VALUE 0x80040FDA Val_Wu16 65535.00 DFES_OneToOne 0.00 65535.00 FORMAT "%8.2" /end CHARACTERISTIC
/begin CHARACTERISTIC DFES_DTCM.DFC_ORAmax_C "" VALUE 0x80040FDC Val_Wu16 65535.00 DFES_OneToOne 0.00 65535.00 FORMAT "%8.2" /end CHARACTERISTIC
/begin CHARACTERISTIC DFES_DTCM.DFC_ORAmin_C "" VALUE 0x80040FDE Val_Wu16 65535.00 DFES_OneToOne 0.00 65535.00 FORMAT "%8.2" /end CHARACTERISTIC
/begin CHARACTERISTIC DFES_DTCM.DFC_PSR1max_C "" VALUE 0x80040FE0 Val_Wu16 65535.00 DFES_OneToOne 0.00 65535.00 FORMAT "%8.2" /end CHARACTERISTIC
/begin CHARACTERISTIC DFES_DTCM.DFC_PSRBmax_C "" VALUE 0x80040FE2 Val_Wu16 65535.00 DFES_OneToOne 0.00 65535.00 FORMAT "%8.2" /end CHARACTERISTIC
/begin CHARACTERISTIC DFES_DTCM.DFC_PSRBmin_C "" VALUE 0x80040FE4 Val_Wu16 65535.00 DFES_OneToOne 0.00 65535.00 FORMAT "%8.2" /end CHARACTERISTIC
/begin CHARACTERISTIC DFES_DTCM.DFC_PSREmax_C "" VALUE 0x80040FE6 Val_Wu16 65535.00 DFES_OneToOne 0.00 65535.00 FORMAT "%8.2" /end CHARACTERISTIC
/begin CHARACTERISTIC DFES_DTCM.DFC_PSREmin_C "" VALUE 0x80040FE8 Val_Wu16 65535.00 DFES_OneToOne 0.00 65535.00 FORMAT "%8.2" /end CHARACTERISTIC
/begin CHARACTERISTIC DFES_DTCM.DFC_PSRPmax_C "" VALUE 0x80040FEA Val_Wu16 65535.00 DFES_OneToOne 0.00 65535.00 FORMAT "%8.2" /end CHARACTERISTIC
/begin CHARACTERISTIC DFES_DTCM.DFC_PSRPmin_C "" VALUE 0x80040FEC Val_Wu16 65535.00 DFES_OneToOne 0.00 65535.00 FORMAT "%8.2" /end CHARACTERISTIC
/begin CHARACTERISTIC DFES_DTCM.DFC_PSRPsig_C "" VALUE 0x80040FEE Val_Wu16 65535.00 DFES_OneToOne 0.00 65535.00 FORMAT "%8.2" /end CHARACTERISTIC
/begin CHARACTERISTIC DFES_DTCM.DFC_PSRmax_C "" VALUE 0x80040FF0 Val_Wu16 65535.00 DFES_OneToOne 0.00 65535.00 FORMAT "%8.2" /end CHARACTERISTIC
/begin CHARACTERISTIC DFES_DTCM.DFC_SSpMon1_C "" VALUE 0x80040FF2 Val_Wu16 65535.00 DFES_OneToOne 0.00 65535.00 FORMAT "%8.2" /end CHARACTERISTIC
/begin CHARACTERISTIC DFES_DTCM.DFC_SSpMon2_C "" VALUE 0x80040FF4 Val_Wu16 65535.00 DFES_OneToOne 0.00 65535.00 FORMAT "%8.2" /end CHARACTERISTIC
/begin CHARACTERISTIC DFES_DTCM.DFC_SSpMon3_C "" VALUE 0x80040FF6 Val_Wu16 65535.00 DFES_OneToOne 0.00 65535.00 FORMAT "%8.2" /end CHARACTERISTIC
/begin CHARACTERISTIC DFES_DTCM.DFC_SWReset_0_C "" VALUE 0x80040FF8 Val_Wu16 65535.00 DFES_OneToOne 0.00 65535.00 FORMAT "%8.2" /end CHARACTERISTIC
/begin CHARACTERISTIC DFES_DTCM.DFC_SWReset_1_C "" VALUE 0x80040FFA Val_Wu16 65535.00 DFES_OneToOne 0.00 65535.00 FORMAT "%8.2" /end CHARACTERISTIC
/begin CHARACTERISTIC DFES_DTCM.DFC_SWReset_2_C "" VALUE 0x80040FFC Val_Wu16 65535.00 DFES_OneToOne 0.00 65535.00 FORMAT "%8.2" /end CHARACTERISTIC
/begin CHARACTERISTIC DFES_DTCM.DFC_TASREmax_C "" VALUE 0x80040FFE Val_Wu16 65535.00 DFES_OneToOne 0.00 65535.00 FORMAT "%8.2" /end CHARACTERISTIC
/begin CHARACTERISTIC DFES_DTCM.DFC_TASREmin_C "" VALUE 0x80041000 Val_Wu16 65535.00 DFES_OneToOne 0.00 65535.00 FORMAT "%8.2" /end CHARACTERISTIC
/begin CHARACTERISTIC DFES_DTCM.DFC_TASREnpl_C "" VALUE 0x80041002 Val_Wu16 65535.00 DFES_OneToOne 0.00 65535.00 FORMAT "%8.2" /end CHARACTERISTIC
/begin CHARACTERISTIC DFES_DTCM.DFC_TASRmax_C "" VALUE 0x80041004 Val_Wu16 65535.00 DFES_OneToOne 0.00 65535.00 FORMAT "%8.2" /end CHARACTERISTIC
/begin CHARACTERISTIC DFES_DTCM.DFC_TAmax_C "" VALUE 0x80041006 Val_Wu16 65535.00 DFES_OneToOne 0.00 65535.00 FORMAT "%8.2" /end CHARACTERISTIC
/begin CHARACTERISTIC DFES_DTCM.DFC_TEVEmax_C "" VALUE 0x80041008 Val_Wu16 65535.00 DFES_OneToOne 0.00 65535.00 FORMAT "%8.2" /end CHARACTERISTIC
/begin CHARACTERISTIC DFES_DTCM.DFC_TEVEmin_C "" VALUE 0x8004100A Val_Wu16 65535.00 DFES_OneToOne 0.00 65535.00 FORMAT "%8.2" /end CHARACTERISTIC
/begin CHARACTERISTIC DFES_DTCM.DFC_TEVEsig_C "" VALUE 0x8004100C Val_Wu16 65535.00 DFES_OneToOne 0.00 65535.00 FORMAT "%8.2" /end CHARACTERISTIC
/begin CHARACTERISTIC DFES_DTCM.DFC_TMCSmax_C "" VALUE 0x8004100E Val_Wu16 65535.00 DFES_OneToOne 0.00 65535.00 FORMAT "%8.2" /end CHARACTERISTIC
/begin CHARACTERISTIC DFES_DTCM.DFC_TMCSmin_C "" VALUE 0x80041010 Val_Wu16 65535.00 DFES_OneToOne 0.00 65535.00 FORMAT "%8.2" /end CHARACTERISTIC
/begin CHARACTERISTIC DFES_DTCM.DFC_TMEmax_C "" VALUE 0x80041012 Val_Wu16 65535.00 DFES_OneToOne 0.00 65535.00 FORMAT "%8.2" /end CHARACTERISTIC
/begin CHARACTERISTIC DFES_DTCM.DFC_TMEmin_C "" VALUE 0x80041014 Val_Wu16 65535.00 DFES_OneToOne 0.00 65535.00 FORMAT "%8.2" /end CHARACTERISTIC
/begin CHARACTERISTIC DFES_DTCM.DFC_TMEnpl_C "" VALUE 0x80041016 Val_Wu16 65535.00 DFES_OneToOne 0.00 65535.00 FORMAT "%8.2" /end CHARACTERISTIC
/begin CHARACTERISTIC DFES_DTCM.DFC_TMEsig_C "" VALUE 0x80041018 Val_Wu16 65535.00 DFES_OneToOne 0.00 65535.00 FORMAT "%8.2" /end CHARACTERISTIC
/begin CHARACTERISTIC DFES_DTCM.DFC_TMPmax_C "" VALUE 0x8004101A Val_Wu16 65535.00 DFES_OneToOne 0.00 65535.00 FORMAT "%8.2" /end CHARACTERISTIC
/begin CHARACTERISTIC DFES_DTCM.DFC_TMPmin_C "" VALUE 0x8004101C Val_Wu16 65535.00 DFES_OneToOne 0.00 65535.00 FORMAT "%8.2" /end CHARACTERISTIC
/begin CHARACTERISTIC DFES_DTCM.DFC_TMPnpl_C "" VALUE 0x8004101E Val_Wu16 65535.00 DFES_OneToOne 0.00 65535.00 FORMAT "%8.2" /end CHARACTERISTIC
/begin CHARACTERISTIC DFES_DTCM.DFC_TMmax_C "" VALUE 0x80041020 Val_Wu16 65535.00 DFES_OneToOne 0.00 65535.00 FORMAT "%8.2" /end CHARACTERISTIC
/begin CHARACTERISTIC DFES_DTCM.DFC_TUMmax_C "" VALUE 0x80041022 Val_Wu16 65535.00 DFES_OneToOne 0.00 65535.00 FORMAT "%8.2" /end CHARACTERISTIC
/begin CHARACTERISTIC DFES_DTCM.DFC_TWCCTrimMaxB1_C "" VALUE 0x80041024 Val_Wu16 65535.00 DFES_OneToOne 0.00 65535.00 FORMAT "%8.2" /end CHARACTERISTIC
/begin CHARACTERISTIC DFES_DTCM.DFC_TWCCTrimMinB1_C "" VALUE 0x80041026 Val_Wu16 65535.00 DFES_OneToOne 0.00 65535.00 FORMAT "%8.2" /end CHARACTERISTIC
/begin CHARACTERISTIC DFES_DTCM.DFC_TWCDPriCatB1_C "" VALUE 0x80041028 Val_Wu16 65535.00 DFES_OneToOne 0.00 65535.00 FORMAT "%8.2" /end CHARACTERISTIC
/begin CHARACTERISTIC DFES_DTCM.DFC_UBRmax_C "" VALUE 0x8004102A Val_Wu16 65535.00 DFES_OneToOne 0.00 65535.00 FORMAT "%8.2" /end CHARACTERISTIC
/begin CHARACTERISTIC DFES_DTCM.DFC_UBmax_C "" VALUE 0x8004102C Val_Wu16 65535.00 DFES_OneToOne 0.00 65535.00 FORMAT "%8.2" /end CHARACTERISTIC
/begin CHARACTERISTIC DFES_DTCM.DFC_UBmin_C "" VALUE 0x8004102E Val_Wu16 65535.00 DFES_OneToOne 0.00 65535.00 FORMAT "%8.2" /end CHARACTERISTIC
/begin CHARACTERISTIC DFES_DTCM.DFC_UBnpl_C "" VALUE 0x80041030 Val_Wu16 65535.00 DFES_OneToOne 0.00 65535.00 FORMAT "%8.2" /end CHARACTERISTIC
/begin CHARACTERISTIC DFES_DTCO.DFC_Unused_C "" VALUE 0x80041672 Val_Wu16 65535.00 DFES_OneToOne 0.00 65535.00 FORMAT "%8.2" READ_ONLY /end CHARACTERISTIC
/begin CHARACTERISTIC DFES_DTCO.DFC_AltMaxPwr_C "" VALUE 0x80041674 Val_Wu16 65535.00 DFES_OneToOne 0.00 65535.00 FORMAT "%8.2" /end CHARACTERISTIC
/begin CHARACTERISTIC DFES_DTCO.DFC_BrkNpl_C "" VALUE 0x80041676 Val_Wu16 65535.00 DFES_OneToOne 0.00 65535.00 FORMAT "%8.2" /end CHARACTERISTIC
/begin CHARACTERISTIC DFES_DTCO.DFC_Cj930SSp1Mon_C "" VALUE 0x80041678 Val_Wu16 65535.00 DFES_OneToOne 0.00 65535.00 FORMAT "%8.2" /end CHARACTERISTIC
/begin CHARACTERISTIC DFES_DTCO.DFC_Cj930SSp2Mon_C "" VALUE 0x8004167A Val_Wu16 65535.00 DFES_OneToOne 0.00 65535.00 FORMAT "%8.2" /end CHARACTERISTIC
/begin CHARACTERISTIC DFES_DTCO.DFC_Cj930SSp3Mon_C "" VALUE 0x8004167C Val_Wu16 65535.00 DFES_OneToOne 0.00 65535.00 FORMAT "%8.2" /end CHARACTERISTIC
/begin CHARACTERISTIC DFES_DTCO.DFC_IdleChrgActrAMax_C "" VALUE 0x8004167E Val_Wu16 65535.00 DFES_OneToOne 0.00 65535.00 FORMAT "%8.2" /end CHARACTERISTIC
/begin CHARACTERISTIC DFES_DTCO.DFC_IdleChrgActrAMin_C "" VALUE 0x80041680 Val_Wu16 65535.00 DFES_OneToOne 0.00 65535.00 FORMAT "%8.2" /end CHARACTERISTIC
/begin CHARACTERISTIC DFES_DTCO.DFC_IdleChrgActrASig_C "" VALUE 0x80041682 Val_Wu16 65535.00 DFES_OneToOne 0.00 65535.00 FORMAT "%8.2" /end CHARACTERISTIC
/begin CHARACTERISTIC DFES_DTCO.DFC_IdleChrgActrBMax_C "" VALUE 0x80041684 Val_Wu16 65535.00 DFES_OneToOne 0.00 65535.00 FORMAT "%8.2" /end CHARACTERISTIC
/begin CHARACTERISTIC DFES_DTCO.DFC_IdleChrgActrBMin_C "" VALUE 0x80041686 Val_Wu16 65535.00 DFES_OneToOne 0.00 65535.00 FORMAT "%8.2" /end CHARACTERISTIC
/begin CHARACTERISTIC DFES_DTCO.DFC_IdleChrgActrBSig_C "" VALUE 0x80041688 Val_Wu16 65535.00 DFES_OneToOne 0.00 65535.00 FORMAT "%8.2" /end CHARACTERISTIC
/begin CHARACTERISTIC DFES_DTCO.DFC_IdleChrgActrGovDeCold_C "" VALUE 0x8004168A Val_Wu16 65535.00 DFES_OneToOne 0.00 65535.00 FORMAT "%8.2" /end CHARACTERISTIC
/begin CHARACTERISTIC DFES_DTCO.DFC_IdleChrgActrGovDeMax_C "" VALUE 0x8004168C Val_Wu16 65535.00 DFES_OneToOne 0.00 65535.00 FORMAT "%8.2" /end CHARACTERISTIC
/begin CHARACTERISTIC DFES_DTCO.DFC_IdleChrgActrGovDeMin_C "" VALUE 0x8004168E Val_Wu16 65535.00 DFES_OneToOne 0.00 65535.00 FORMAT "%8.2" /end CHARACTERISTIC
/begin CHARACTERISTIC DFES_DTCO.DFC_IdleChrgActrNAMax_C "" VALUE 0x80041690 Val_Wu16 65535.00 DFES_OneToOne 0.00 65535.00 FORMAT "%8.2" /end CHARACTERISTIC
/begin CHARACTERISTIC DFES_DTCO.DFC_IdleChrgActrNAMin_C "" VALUE 0x80041692 Val_Wu16 65535.00 DFES_OneToOne 0.00 65535.00 FORMAT "%8.2" /end CHARACTERISTIC
/begin CHARACTERISTIC DFES_DTCO.DFC_IdleChrgActrNASig_C "" VALUE 0x80041694 Val_Wu16 65535.00 DFES_OneToOne 0.00 65535.00 FORMAT "%8.2" /end CHARACTERISTIC
/begin CHARACTERISTIC DFES_DTCO.DFC_IdleChrgActrNBMax_C "" VALUE 0x80041696 Val_Wu16 65535.00 DFES_OneToOne 0.00 65535.00 FORMAT "%8.2" /end CHARACTERISTIC
/begin CHARACTERISTIC DFES_DTCO.DFC_IdleChrgActrNBMin_C "" VALUE 0x80041698 Val_Wu16 65535.00 DFES_OneToOne 0.00 65535.00 FORMAT "%8.2" /end CHARACTERISTIC
/begin CHARACTERISTIC DFES_DTCO.DFC_IdleChrgActrNBSig_C "" VALUE 0x8004169A Val_Wu16 65535.00 DFES_OneToOne 0.00 65535.00 FORMAT "%8.2" /end CHARACTERISTIC
/begin CHARACTERISTIC DFES_DTCO.DFC_IdleChrgActrOverTmp_C "" VALUE 0x8004169C Val_Wu16 65535.00 DFES_OneToOne 0.00 65535.00 FORMAT "%8.2" /end CHARACTERISTIC
/begin CHARACTERISTIC DFES_DTCO.DFC_MonUMaxSupply1_C "" VALUE 0x8004169E Val_Wu16 65535.00 DFES_OneToOne 0.00 65535.00 FORMAT "%8.2" /end CHARACTERISTIC
/begin CHARACTERISTIC DFES_DTCO.DFC_MonUMinSupply1_C "" VALUE 0x800416A0 Val_Wu16 65535.00 DFES_OneToOne 0.00 65535.00 FORMAT "%8.2" /end CHARACTERISTIC
/begin CHARACTERISTIC DFES_DTCO.DFC_ClthNplClsd_C "" VALUE 0x800416A2 Val_Wu16 65535.00 DFES_OneToOne 0.00 65535.00 FORMAT "%8.2" /end CHARACTERISTIC
/begin CHARACTERISTIC DFES_DTCO.DFC_ClthNplOpn_C "" VALUE 0x800416A4 Val_Wu16 65535.00 DFES_OneToOne 0.00 65535.00 FORMAT "%8.2" /end CHARACTERISTIC
/begin CHARACTERISTIC DFES_DTCO.DFC_IgnClPsDevComErr1_C "" VALUE 0x800416A6 Val_Wu16 65535.00 DFES_OneToOne 0.00 65535.00 FORMAT "%8.2" /end CHARACTERISTIC
/begin CHARACTERISTIC DFES_DTCO.DFC_IgnClPsOpenLoad0_C "" VALUE 0x800416A8 Val_Wu16 65535.00 DFES_OneToOne 0.00 65535.00 FORMAT "%8.2" /end CHARACTERISTIC
/begin CHARACTERISTIC DFES_DTCO.DFC_IgnClPsOpenLoad1_C "" VALUE 0x800416AA Val_Wu16 65535.00 DFES_OneToOne 0.00 65535.00 FORMAT "%8.2" /end CHARACTERISTIC
/begin CHARACTERISTIC DFES_DTCO.DFC_IgnClPsOpenLoad2_C "" VALUE 0x800416AC Val_Wu16 65535.00 DFES_OneToOne 0.00 65535.00 FORMAT "%8.2" /end CHARACTERISTIC
/begin CHARACTERISTIC DFES_DTCO.DFC_IgnClPsShCirBatt0_C "" VALUE 0x800416AE Val_Wu16 65535.00 DFES_OneToOne 0.00 65535.00 FORMAT "%8.2" /end CHARACTERISTIC
/begin CHARACTERISTIC DFES_DTCO.DFC_IgnClPsShCirBatt1_C "" VALUE 0x800416B0 Val_Wu16 65535.00 DFES_OneToOne 0.00 65535.00 FORMAT "%8.2" /end CHARACTERISTIC
/begin CHARACTERISTIC DFES_DTCO.DFC_IgnClPsShCirBatt2_C "" VALUE 0x800416B2 Val_Wu16 65535.00 DFES_OneToOne 0.00 65535.00 FORMAT "%8.2" /end CHARACTERISTIC
/begin CHARACTERISTIC DFES_DTCO.DFC_IgnClPsShCirGnd0_C "" VALUE 0x800416B4 Val_Wu16 65535.00 DFES_OneToOne 0.00 65535.00 FORMAT "%8.2" /end CHARACTERISTIC
/begin CHARACTERISTIC DFES_DTCO.DFC_IgnClPsShCirGnd1_C "" VALUE 0x800416B6 Val_Wu16 65535.00 DFES_OneToOne 0.00 65535.00 FORMAT "%8.2" /end CHARACTERISTIC
/begin CHARACTERISTIC DFES_DTCO.DFC_IgnClPsShCirGnd2_C "" VALUE 0x800416B8 Val_Wu16 65535.00 DFES_OneToOne 0.00 65535.00 FORMAT "%8.2" /end CHARACTERISTIC
/begin CHARACTERISTIC DFES_DTCO.DFC_KnDetSens1PortAMax_C "" VALUE 0x800416BA Val_Wu16 65535.00 DFES_OneToOne 0.00 65535.00 FORMAT "%8.2" /end CHARACTERISTIC
/begin CHARACTERISTIC DFES_DTCO.DFC_KnDetSens1PortAMin_C "" VALUE 0x800416BC Val_Wu16 65535.00 DFES_OneToOne 0.00 65535.00 FORMAT "%8.2" /end CHARACTERISTIC
/begin CHARACTERISTIC DFES_DTCO.DFC_KnDetSens1PortBMax_C "" VALUE 0x800416BE Val_Wu16 65535.00 DFES_OneToOne 0.00 65535.00 FORMAT "%8.2" /end CHARACTERISTIC
/begin CHARACTERISTIC DFES_DTCO.DFC_KnDetSens1PortBMin_C "" VALUE 0x800416C0 Val_Wu16 65535.00 DFES_OneToOne 0.00 65535.00 FORMAT "%8.2" /end CHARACTERISTIC
/begin CHARACTERISTIC DFES_DTCO.DFC_VehVWhlErr_C "" VALUE 0x800416C2 Val_Wu16 65535.00 DFES_OneToOne 0.00 65535.00 FORMAT "%8.2" /end CHARACTERISTIC
/begin CHARACTERISTIC DFES_DTCO.DFC_AirCCmprOL_C "" VALUE 0x800416C4 Val_Wu16 65535.00 DFES_OneToOne 0.00 65535.00 FORMAT "%8.2" /end CHARACTERISTIC
/begin CHARACTERISTIC DFES_DTCO.DFC_AirCCmprOvrTemp_C "" VALUE 0x800416C6 Val_Wu16 65535.00 DFES_OneToOne 0.00 65535.00 FORMAT "%8.2" /end CHARACTERISTIC
/begin CHARACTERISTIC DFES_DTCO.DFC_AirCCmprSCB_C "" VALUE 0x800416C8 Val_Wu16 65535.00 DFES_OneToOne 0.00 65535.00 FORMAT "%8.2" /end CHARACTERISTIC
/begin CHARACTERISTIC DFES_DTCO.DFC_AirCCmprSCG_C "" VALUE 0x800416CA Val_Wu16 65535.00 DFES_OneToOne 0.00 65535.00 FORMAT "%8.2" /end CHARACTERISTIC
/begin CHARACTERISTIC DFES_DTCO.DFC_AltIOLdSRCMin_C "" VALUE 0x800416CC Val_Wu16 65535.00 DFES_OneToOne 0.00 65535.00 FORMAT "%8.2" /end CHARACTERISTIC
/begin CHARACTERISTIC DFES_DTCO.DFC_AltIOOL_C "" VALUE 0x800416CE Val_Wu16 65535.00 DFES_OneToOne 0.00 65535.00 FORMAT "%8.2" /end CHARACTERISTIC
/begin CHARACTERISTIC DFES_DTCO.DFC_AltIOOvrTemp_C "" VALUE 0x800416D0 Val_Wu16 65535.00 DFES_OneToOne 0.00 65535.00 FORMAT "%8.2" /end CHARACTERISTIC
/begin CHARACTERISTIC DFES_DTCO.DFC_AltIOSCB_C "" VALUE 0x800416D2 Val_Wu16 65535.00 DFES_OneToOne 0.00 65535.00 FORMAT "%8.2" /end CHARACTERISTIC
/begin CHARACTERISTIC DFES_DTCO.DFC_AltIOSCG_C "" VALUE 0x800416D4 Val_Wu16 65535.00 DFES_OneToOne 0.00 65535.00 FORMAT "%8.2" /end CHARACTERISTIC
/begin CHARACTERISTIC DFES_DTCO.DFC_DevLibBattUHi_C "" VALUE 0x800416D6 Val_Wu16 65535.00 DFES_OneToOne 0.00 65535.00 FORMAT "%8.2" /end CHARACTERISTIC
/begin CHARACTERISTIC DFES_DTCO.DFC_DevLibBattULo_C "" VALUE 0x800416D8 Val_Wu16 65535.00 DFES_OneToOne 0.00 65535.00 FORMAT "%8.2" /end CHARACTERISTIC
/begin CHARACTERISTIC DFES_DTCO.DFC_FanDIOOL_C "" VALUE 0x800416DA Val_Wu16 65535.00 DFES_OneToOne 0.00 65535.00 FORMAT "%8.2" /end CHARACTERISTIC
/begin CHARACTERISTIC DFES_DTCO.DFC_FanDIOOvrTemp_C "" VALUE 0x800416DC Val_Wu16 65535.00 DFES_OneToOne 0.00 65535.00 FORMAT "%8.2" /end CHARACTERISTIC
/begin CHARACTERISTIC DFES_DTCO.DFC_FanDIOSCB_C "" VALUE 0x800416DE Val_Wu16 65535.00 DFES_OneToOne 0.00 65535.00 FORMAT "%8.2" /end CHARACTERISTIC
/begin CHARACTERISTIC DFES_DTCO.DFC_FanDIOSCG_C "" VALUE 0x800416E0 Val_Wu16 65535.00 DFES_OneToOne 0.00 65535.00 FORMAT "%8.2" /end CHARACTERISTIC
/begin CHARACTERISTIC DFES_DTCO.DFC_FanPWMOL_C "" VALUE 0x800416E2 Val_Wu16 65535.00 DFES_OneToOne 0.00 65535.00 FORMAT "%8.2" /end CHARACTERISTIC
/begin CHARACTERISTIC DFES_DTCO.DFC_FanPWMOvrTemp_C "" VALUE 0x800416E4 Val_Wu16 65535.00 DFES_OneToOne 0.00 65535.00 FORMAT "%8.2" /end CHARACTERISTIC
/begin CHARACTERISTIC DFES_DTCO.DFC_FanPWMSCB_C "" VALUE 0x800416E6 Val_Wu16 65535.00 DFES_OneToOne 0.00 65535.00 FORMAT "%8.2" /end CHARACTERISTIC
/begin CHARACTERISTIC DFES_DTCO.DFC_FanPWMSCG_C "" VALUE 0x800416E8 Val_Wu16 65535.00 DFES_OneToOne 0.00 65535.00 FORMAT "%8.2" /end CHARACTERISTIC
/begin CHARACTERISTIC DFES_DTCO.DFC_AirCClntPAnaSRCMax_C "" VALUE 0x800416EA Val_Wu16 65535.00 DFES_OneToOne 0.00 65535.00 FORMAT "%8.2" /end CHARACTERISTIC
/begin CHARACTERISTIC DFES_DTCO.DFC_AirCClntPAnaSRCMin_C "" VALUE 0x800416EC Val_Wu16 65535.00 DFES_OneToOne 0.00 65535.00 FORMAT "%8.2" /end CHARACTERISTIC
/begin CHARACTERISTIC DFES_DTCO.DFC_AirCSwtNpl_C "" VALUE 0x800416EE Val_Wu16 65535.00 DFES_OneToOne 0.00 65535.00 FORMAT "%8.2" /end CHARACTERISTIC
/begin CHARACTERISTIC DFES_DTCO.DFC_AirCSwtSig_C "" VALUE 0x800416F0 Val_Wu16 65535.00 DFES_OneToOne 0.00 65535.00 FORMAT "%8.2" /end CHARACTERISTIC
/begin CHARACTERISTIC DFES_DTCO.DFC_AltIOLdSRCMax_C "" VALUE 0x800416F2 Val_Wu16 65535.00 DFES_OneToOne 0.00 65535.00 FORMAT "%8.2" /end CHARACTERISTIC
/begin CHARACTERISTIC DFES_DTCO.DFC_BrkSig_C "" VALUE 0x800416F4 Val_Wu16 65535.00 DFES_OneToOne 0.00 65535.00 FORMAT "%8.2" /end CHARACTERISTIC
/begin CHARACTERISTIC DFES_DTCO.DFC_ClthEPBNpl_C "" VALUE 0x800416F6 Val_Wu16 65535.00 DFES_OneToOne 0.00 65535.00 FORMAT "%8.2" /end CHARACTERISTIC
/begin CHARACTERISTIC DFES_DTCO.DFC_ClthEPBSensErr_C "" VALUE 0x800416F8 Val_Wu16 65535.00 DFES_OneToOne 0.00 65535.00 FORMAT "%8.2" /end CHARACTERISTIC
/begin CHARACTERISTIC DFES_DTCO.DFC_ClthErr_C "" VALUE 0x800416FA Val_Wu16 65535.00 DFES_OneToOne 0.00 65535.00 FORMAT "%8.2" /end CHARACTERISTIC
/begin CHARACTERISTIC DFES_DTCO.DFC_ClthSig_C "" VALUE 0x800416FC Val_Wu16 65535.00 DFES_OneToOne 0.00 65535.00 FORMAT "%8.2" /end CHARACTERISTIC
/begin CHARACTERISTIC DFES_DTCO.DFC_MILLmpOL_C "" VALUE 0x800416FE Val_Wu16 65535.00 DFES_OneToOne 0.00 65535.00 FORMAT "%8.2" /end CHARACTERISTIC
/begin CHARACTERISTIC DFES_DTCO.DFC_MILLmpSCB_C "" VALUE 0x80041700 Val_Wu16 65535.00 DFES_OneToOne 0.00 65535.00 FORMAT "%8.2" /end CHARACTERISTIC
/begin CHARACTERISTIC DFES_DTCO.DFC_MILLmpSCG_C "" VALUE 0x80041702 Val_Wu16 65535.00 DFES_OneToOne 0.00 65535.00 FORMAT "%8.2" /end CHARACTERISTIC
/begin CHARACTERISTIC DFES_DTCO.DFC_SRCHighAPP1_C "" VALUE 0x80041704 Val_Wu16 65535.00 DFES_OneToOne 0.00 65535.00 FORMAT "%8.2" /end CHARACTERISTIC
/begin CHARACTERISTIC DFES_DTCO.DFC_SRCHighAPP2_C "" VALUE 0x80041706 Val_Wu16 65535.00 DFES_OneToOne 0.00 65535.00 FORMAT "%8.2" /end CHARACTERISTIC
/begin CHARACTERISTIC DFES_DTCO.DFC_SRCLowAPP1_C "" VALUE 0x80041708 Val_Wu16 65535.00 DFES_OneToOne 0.00 65535.00 FORMAT "%8.2" /end CHARACTERISTIC
/begin CHARACTERISTIC DFES_DTCO.DFC_SRCLowAPP2_C "" VALUE 0x8004170A Val_Wu16 65535.00 DFES_OneToOne 0.00 65535.00 FORMAT "%8.2" /end CHARACTERISTIC
/begin CHARACTERISTIC DFES_DTCO.DFC_SyncAPP_C "" VALUE 0x8004170C Val_Wu16 65535.00 DFES_OneToOne 0.00 65535.00 FORMAT "%8.2" /end CHARACTERISTIC
/begin CHARACTERISTIC DFES_DTCO.DFC_VehVMax_C "" VALUE 0x8004170E Val_Wu16 65535.00 DFES_OneToOne 0.00 65535.00 FORMAT "%8.2" /end CHARACTERISTIC
/begin CHARACTERISTIC DFES_DTCO.DFC_VehVPlaus_C "" VALUE 0x80041710 Val_Wu16 65535.00 DFES_OneToOne 0.00 65535.00 FORMAT "%8.2" /end CHARACTERISTIC
/begin CHARACTERISTIC DFES_DTCO.DFC_VehVSig_C "" VALUE 0x80041712 Val_Wu16 65535.00 DFES_OneToOne 0.00 65535.00 FORMAT "%8.2" /end CHARACTERISTIC
/begin CHARACTERISTIC DFES_DTCO.DFC_BusDiagBusOffNodeA_C "" VALUE 0x80041714 Val_Wu16 65535.00 DFES_OneToOne 0.00 65535.00 FORMAT "%8.2" /end CHARACTERISTIC
/begin CHARACTERISTIC DFES_DTCO.DFC_ComACSensTO_C "" VALUE 0x80041716 Val_Wu16 65535.00 DFES_OneToOne 0.00 65535.00 FORMAT "%8.2" /end CHARACTERISTIC
/begin CHARACTERISTIC DFES_DTCO.DFC_ComAWD1TO_C "" VALUE 0x80041718 Val_Wu16 65535.00 DFES_OneToOne 0.00 65535.00 FORMAT "%8.2" /end CHARACTERISTIC
/begin CHARACTERISTIC DFES_DTCO.DFC_ComBRK10TO_C "" VALUE 0x8004171A Val_Wu16 65535.00 DFES_OneToOne 0.00 65535.00 FORMAT "%8.2" /end CHARACTERISTIC
/begin CHARACTERISTIC DFES_DTCO.DFC_ComGW11TO_C "" VALUE 0x8004171C Val_Wu16 65535.00 DFES_OneToOne 0.00 65535.00 FORMAT "%8.2" /end CHARACTERISTIC
/begin CHARACTERISTIC DFES_DTCO.DFC_ComLVL1TO_C "" VALUE 0x8004171E Val_Wu16 65535.00 DFES_OneToOne 0.00 65535.00 FORMAT "%8.2" /end CHARACTERISTIC
/begin CHARACTERISTIC DFES_DTCO.DFC_ComPRKA01TO_C "" VALUE 0x80041720 Val_Wu16 65535.00 DFES_OneToOne 0.00 65535.00 FORMAT "%8.2" /end CHARACTERISTIC
/begin CHARACTERISTIC DFES_DTCO.DFC_ComPRKH01TO_C "" VALUE 0x80041722 Val_Wu16 65535.00 DFES_OneToOne 0.00 65535.00 FORMAT "%8.2" /end CHARACTERISTIC
/begin CHARACTERISTIC DFES_DTCO.DFC_ComPRKH1TO_C "" VALUE 0x80041724 Val_Wu16 65535.00 DFES_OneToOne 0.00 65535.00 FORMAT "%8.2" /end CHARACTERISTIC
/begin CHARACTERISTIC DFES_DTCO.DFC_ComTRBCH1TO_C "" VALUE 0x80041726 Val_Wu16 65535.00 DFES_OneToOne 0.00 65535.00 FORMAT "%8.2" /end CHARACTERISTIC
/begin CHARACTERISTIC DFES_DTCO.DFC_ComTRBCH2TO_C "" VALUE 0x80041728 Val_Wu16 65535.00 DFES_OneToOne 0.00 65535.00 FORMAT "%8.2" /end CHARACTERISTIC
/begin CHARACTERISTIC DFES_DTCO.DFC_DK_C "" VALUE 0x8004172A Val_Wu16 65535.00 DFES_OneToOne 0.00 65535.00 FORMAT "%8.2" /end CHARACTERISTIC
/begin CHARACTERISTIC DFES_DTCO.DFC_DKRSA_C "" VALUE 0x8004172C Val_Wu16 65535.00 DFES_OneToOne 0.00 65535.00 FORMAT "%8.2" /end CHARACTERISTIC
/begin CHARACTERISTIC DFES_DTCO.DFC_DKVSmax_C "" VALUE 0x8004172E Val_Wu16 65535.00 DFES_OneToOne 0.00 65535.00 FORMAT "%8.2" /end CHARACTERISTIC
/begin CHARACTERISTIC DFES_DTCO.DFC_DKmax_C "" VALUE 0x80041730 Val_Wu16 65535.00 DFES_OneToOne 0.00 65535.00 FORMAT "%8.2" /end CHARACTERISTIC
/begin CHARACTERISTIC DFES_DTCO.DFC_DKmin_C "" VALUE 0x80041732 Val_Wu16 65535.00 DFES_OneToOne 0.00 65535.00 FORMAT "%8.2" /end CHARACTERISTIC
/begin CHARACTERISTIC DFES_DTCO.DFC_DSSmax_C "" VALUE 0x80041734 Val_Wu16 65535.00 DFES_OneToOne 0.00 65535.00 FORMAT "%8.2" /end CHARACTERISTIC
/begin CHARACTERISTIC DFES_DTCO.DFC_EEPEraseErr_C "" VALUE 0x80041736 Val_Wu16 65535.00 DFES_OneToOne 0.00 65535.00 FORMAT "%8.2" /end CHARACTERISTIC
/begin CHARACTERISTIC DFES_DTCO.DFC_EEPRdErr_C "" VALUE 0x80041738 Val_Wu16 65535.00 DFES_OneToOne 0.00 65535.00 FORMAT "%8.2" /end CHARACTERISTIC
/begin CHARACTERISTIC DFES_DTCO.DFC_EEPWrErr_C "" VALUE 0x8004173A Val_Wu16 65535.00 DFES_OneToOne 0.00 65535.00 FORMAT "%8.2" /end CHARACTERISTIC
/begin CHARACTERISTIC DFES_DTCO.DFC_EV1max_C "" VALUE 0x8004173C Val_Wu16 65535.00 DFES_OneToOne 0.00 65535.00 FORMAT "%8.2" /end CHARACTERISTIC
/begin CHARACTERISTIC DFES_DTCO.DFC_EV1min_C "" VALUE 0x8004173E Val_Wu16 65535.00 DFES_OneToOne 0.00 65535.00 FORMAT "%8.2" /end CHARACTERISTIC
/begin CHARACTERISTIC DFES_DTCO.DFC_EV1sig_C "" VALUE 0x80041740 Val_Wu16 65535.00 DFES_OneToOne 0.00 65535.00 FORMAT "%8.2" /end CHARACTERISTIC
/begin CHARACTERISTIC DFES_DTCO.DFC_EV2max_C "" VALUE 0x80041742 Val_Wu16 65535.00 DFES_OneToOne 0.00 65535.00 FORMAT "%8.2" /end CHARACTERISTIC
/begin CHARACTERISTIC DFES_DTCO.DFC_EV2min_C "" VALUE 0x80041744 Val_Wu16 65535.00 DFES_OneToOne 0.00 65535.00 FORMAT "%8.2" /end CHARACTERISTIC
/begin CHARACTERISTIC DFES_DTCO.DFC_EV2sig_C "" VALUE 0x80041746 Val_Wu16 65535.00 DFES_OneToOne 0.00 65535.00 FORMAT "%8.2" /end CHARACTERISTIC
/begin CHARACTERISTIC DFES_DTCO.DFC_EV3max_C "" VALUE 0x80041748 Val_Wu16 65535.00 DFES_OneToOne 0.00 65535.00 FORMAT "%8.2" /end CHARACTERISTIC
/begin CHARACTERISTIC DFES_DTCO.DFC_EV3min_C "" VALUE 0x8004174A Val_Wu16 65535.00 DFES_OneToOne 0.00 65535.00 FORMAT "%8.2" /end CHARACTERISTIC
/begin CHARACTERISTIC DFES_DTCO.DFC_EV3sig_C "" VALUE 0x8004174C Val_Wu16 65535.00 DFES_OneToOne 0.00 65535.00 FORMAT "%8.2" /end CHARACTERISTIC
/begin CHARACTERISTIC DFES_DTCO.DFC_EpmCaSI1ErrSig_C "" VALUE 0x8004174E Val_Wu16 65535.00 DFES_OneToOne 0.00 65535.00 FORMAT "%8.2" /end CHARACTERISTIC
/begin CHARACTERISTIC DFES_DTCO.DFC_EpmCaSI1NoSig_C "" VALUE 0x80041750 Val_Wu16 65535.00 DFES_OneToOne 0.00 65535.00 FORMAT "%8.2" /end CHARACTERISTIC
/begin CHARACTERISTIC DFES_DTCO.DFC_EpmCaSI1NoSigMax_C "" VALUE 0x80041752 Val_Wu16 65535.00 DFES_OneToOne 0.00 65535.00 FORMAT "%8.2" /end CHARACTERISTIC
/begin CHARACTERISTIC DFES_DTCO.DFC_EpmCaSI1NoSigMin_C "" VALUE 0x80041754 Val_Wu16 65535.00 DFES_OneToOne 0.00 65535.00 FORMAT "%8.2" /end CHARACTERISTIC
/begin CHARACTERISTIC DFES_DTCO.DFC_EpmCaSI1OfsErr_C "" VALUE 0x80041756 Val_Wu16 65535.00 DFES_OneToOne 0.00 65535.00 FORMAT "%8.2" /end CHARACTERISTIC
/begin CHARACTERISTIC DFES_DTCO.DFC_EpmCrSErrSig_C "" VALUE 0x80041758 Val_Wu16 65535.00 DFES_OneToOne 0.00 65535.00 FORMAT "%8.2" /end CHARACTERISTIC
/begin CHARACTERISTIC DFES_DTCO.DFC_EpmCrSNoSig_C "" VALUE 0x8004175A Val_Wu16 65535.00 DFES_OneToOne 0.00 65535.00 FORMAT "%8.2" /end CHARACTERISTIC
/begin CHARACTERISTIC DFES_DTCO.DFC_FRAmax_C "" VALUE 0x8004175C Val_Wu16 65535.00 DFES_OneToOne 0.00 65535.00 FORMAT "%8.2" /end CHARACTERISTIC
/begin CHARACTERISTIC DFES_DTCO.DFC_FRAmin_C "" VALUE 0x8004175E Val_Wu16 65535.00 DFES_OneToOne 0.00 65535.00 FORMAT "%8.2" /end CHARACTERISTIC
/begin CHARACTERISTIC DFES_DTCO.DFC_HEGOS1B1ElecMax_C "" VALUE 0x80041760 Val_Wu16 65535.00 DFES_OneToOne 0.00 65535.00 FORMAT "%8.2" /end CHARACTERISTIC
/begin CHARACTERISTIC DFES_DTCO.DFC_HEGOS1B1ElecMin_C "" VALUE 0x80041762 Val_Wu16 65535.00 DFES_OneToOne 0.00 65535.00 FORMAT "%8.2" /end CHARACTERISTIC
/begin CHARACTERISTIC DFES_DTCO.DFC_HEGOS1B1ElecNpl_C "" VALUE 0x80041764 Val_Wu16 65535.00 DFES_OneToOne 0.00 65535.00 FORMAT "%8.2" /end CHARACTERISTIC
/begin CHARACTERISTIC DFES_DTCO.DFC_HEGOS1B1ElecSig_C "" VALUE 0x80041766 Val_Wu16 65535.00 DFES_OneToOne 0.00 65535.00 FORMAT "%8.2" /end CHARACTERISTIC
/begin CHARACTERISTIC DFES_DTCO.DFC_HEGOS1B1HtgNpl_C "" VALUE 0x80041768 Val_Wu16 65535.00 DFES_OneToOne 0.00 65535.00 FORMAT "%8.2" /end CHARACTERISTIC
/begin CHARACTERISTIC DFES_DTCO.DFC_HEGOS1B1HtrPsMax_C "" VALUE 0x8004176A Val_Wu16 65535.00 DFES_OneToOne 0.00 65535.00 FORMAT "%8.2" /end CHARACTERISTIC
/begin CHARACTERISTIC DFES_DTCO.DFC_HEGOS1B1HtrPsMin_C "" VALUE 0x8004176C Val_Wu16 65535.00 DFES_OneToOne 0.00 65535.00 FORMAT "%8.2" /end CHARACTERISTIC
/begin CHARACTERISTIC DFES_DTCO.DFC_HEGOS1B1HtrPsSig_C "" VALUE 0x8004176E Val_Wu16 65535.00 DFES_OneToOne 0.00 65535.00 FORMAT "%8.2" /end CHARACTERISTIC
/begin CHARACTERISTIC DFES_DTCO.DFC_HEGOS1B1StkMax_C "" VALUE 0x80041770 Val_Wu16 65535.00 DFES_OneToOne 0.00 65535.00 FORMAT "%8.2" /end CHARACTERISTIC
/begin CHARACTERISTIC DFES_DTCO.DFC_HEGOS1B1StkMin_C "" VALUE 0x80041772 Val_Wu16 65535.00 DFES_OneToOne 0.00 65535.00 FORMAT "%8.2" /end CHARACTERISTIC
/begin CHARACTERISTIC DFES_DTCO.DFC_HEGOS2B1RstrcnLean_C "" VALUE 0x80041774 Val_Wu16 65535.00 DFES_OneToOne 0.00 65535.00 FORMAT "%8.2" /end CHARACTERISTIC
/begin CHARACTERISTIC DFES_DTCO.DFC_HEGOS2B1RstrcnRich_C "" VALUE 0x80041776 Val_Wu16 65535.00 DFES_OneToOne 0.00 65535.00 FORMAT "%8.2" /end CHARACTERISTIC
/begin CHARACTERISTIC DFES_DTCO.DFC_IdleChrgActrJamVlvClsd_C "" VALUE 0x80041778 Val_Wu16 65535.00 DFES_OneToOne 0.00 65535.00 FORMAT "%8.2" /end CHARACTERISTIC
/begin CHARACTERISTIC DFES_DTCO.DFC_IdleChrgActrJamVlvOpn_C "" VALUE 0x8004177A Val_Wu16 65535.00 DFES_OneToOne 0.00 65535.00 FORMAT "%8.2" /end CHARACTERISTIC
/begin CHARACTERISTIC DFES_DTCO.DFC_IgnClPsDevOscErr1_C "" VALUE 0x8004177C Val_Wu16 65535.00 DFES_OneToOne 0.00 65535.00 FORMAT "%8.2" /end CHARACTERISTIC
/begin CHARACTERISTIC DFES_DTCO.DFC_KPEmax_C "" VALUE 0x8004177E Val_Wu16 65535.00 DFES_OneToOne 0.00 65535.00 FORMAT "%8.2" /end CHARACTERISTIC
/begin CHARACTERISTIC DFES_DTCO.DFC_KPEmin_C "" VALUE 0x80041780 Val_Wu16 65535.00 DFES_OneToOne 0.00 65535.00 FORMAT "%8.2" /end CHARACTERISTIC
/begin CHARACTERISTIC DFES_DTCO.DFC_KPEsig_C "" VALUE 0x80041782 Val_Wu16 65535.00 DFES_OneToOne 0.00 65535.00 FORMAT "%8.2" /end CHARACTERISTIC
/begin CHARACTERISTIC DFES_DTCO.DFC_KS1max_C "" VALUE 0x80041784 Val_Wu16 65535.00 DFES_OneToOne 0.00 65535.00 FORMAT "%8.2" /end CHARACTERISTIC
/begin CHARACTERISTIC DFES_DTCO.DFC_KS1min_C "" VALUE 0x80041786 Val_Wu16 65535.00 DFES_OneToOne 0.00 65535.00 FORMAT "%8.2" /end CHARACTERISTIC
/begin CHARACTERISTIC DFES_DTCO.DFC_LLRKHmax_C "" VALUE 0x80041788 Val_Wu16 65535.00 DFES_OneToOne 0.00 65535.00 FORMAT "%8.2" /end CHARACTERISTIC
/begin CHARACTERISTIC DFES_DTCO.DFC_LLRKHmin_C "" VALUE 0x8004178A Val_Wu16 65535.00 DFES_OneToOne 0.00 65535.00 FORMAT "%8.2" /end CHARACTERISTIC
/begin CHARACTERISTIC DFES_DTCO.DFC_LLRKHnpl_C "" VALUE 0x8004178C Val_Wu16 65535.00 DFES_OneToOne 0.00 65535.00 FORMAT "%8.2" /end CHARACTERISTIC
/begin CHARACTERISTIC DFES_DTCO.DFC_LLRmax_C "" VALUE 0x8004178E Val_Wu16 65535.00 DFES_OneToOne 0.00 65535.00 FORMAT "%8.2" /end CHARACTERISTIC
/begin CHARACTERISTIC DFES_DTCO.DFC_LLRmin_C "" VALUE 0x80041790 Val_Wu16 65535.00 DFES_OneToOne 0.00 65535.00 FORMAT "%8.2" /end CHARACTERISTIC
/begin CHARACTERISTIC DFES_DTCO.DFC_LLRnpl_C "" VALUE 0x80041792 Val_Wu16 65535.00 DFES_OneToOne 0.00 65535.00 FORMAT "%8.2" /end CHARACTERISTIC
/begin CHARACTERISTIC DFES_DTCO.DFC_LMmax_C "" VALUE 0x80041794 Val_Wu16 65535.00 DFES_OneToOne 0.00 65535.00 FORMAT "%8.2" /end CHARACTERISTIC
/begin CHARACTERISTIC DFES_DTCO.DFC_LZSRnpl_C "" VALUE 0x80041796 Val_Wu16 65535.00 DFES_OneToOne 0.00 65535.00 FORMAT "%8.2" /end CHARACTERISTIC
/begin CHARACTERISTIC DFES_DTCO.DFC_MD_C "" VALUE 0x80041798 Val_Wu16 65535.00 DFES_OneToOne 0.00 65535.00 FORMAT "%8.2" /end CHARACTERISTIC
/begin CHARACTERISTIC DFES_DTCO.DFC_MD00min_C "" VALUE 0x8004179A Val_Wu16 65535.00 DFES_OneToOne 0.00 65535.00 FORMAT "%8.2" /end CHARACTERISTIC
/begin CHARACTERISTIC DFES_DTCO.DFC_MD00npl_C "" VALUE 0x8004179C Val_Wu16 65535.00 DFES_OneToOne 0.00 65535.00 FORMAT "%8.2" /end CHARACTERISTIC
/begin CHARACTERISTIC DFES_DTCO.DFC_MD01min_C "" VALUE 0x8004179E Val_Wu16 65535.00 DFES_OneToOne 0.00 65535.00 FORMAT "%8.2" /end CHARACTERISTIC
/begin CHARACTERISTIC DFES_DTCO.DFC_MD01npl_C "" VALUE 0x800417A0 Val_Wu16 65535.00 DFES_OneToOne 0.00 65535.00 FORMAT "%8.2" /end CHARACTERISTIC
/begin CHARACTERISTIC DFES_DTCO.DFC_MD02min_C "" VALUE 0x800417A2 Val_Wu16 65535.00 DFES_OneToOne 0.00 65535.00 FORMAT "%8.2" /end CHARACTERISTIC
/begin CHARACTERISTIC DFES_DTCO.DFC_MD02npl_C "" VALUE 0x800417A4 Val_Wu16 65535.00 DFES_OneToOne 0.00 65535.00 FORMAT "%8.2" /end CHARACTERISTIC
/begin CHARACTERISTIC DFES_DTCO.DFC_MD03min_C "" VALUE 0x800417A6 Val_Wu16 65535.00 DFES_OneToOne 0.00 65535.00 FORMAT "%8.2" /end CHARACTERISTIC
/begin CHARACTERISTIC DFES_DTCO.DFC_MD03npl_C "" VALUE 0x800417A8 Val_Wu16 65535.00 DFES_OneToOne 0.00 65535.00 FORMAT "%8.2" /end CHARACTERISTIC
/begin CHARACTERISTIC DFES_DTCO.DFC_MD04min_C "" VALUE 0x800417AA Val_Wu16 65535.00 DFES_OneToOne 0.00 65535.00 FORMAT "%8.2" /end CHARACTERISTIC
/begin CHARACTERISTIC DFES_DTCO.DFC_MD04npl_C "" VALUE 0x800417AC Val_Wu16 65535.00 DFES_OneToOne 0.00 65535.00 FORMAT "%8.2" /end CHARACTERISTIC
/begin CHARACTERISTIC DFES_DTCO.DFC_MDCyl_0_C "" VALUE 0x800417AE Val_Wu16 65535.00 DFES_OneToOne 0.00 65535.00 FORMAT "%8.2" /end CHARACTERISTIC
/begin CHARACTERISTIC DFES_DTCO.DFC_MDCyl_1_C "" VALUE 0x800417B0 Val_Wu16 65535.00 DFES_OneToOne 0.00 65535.00 FORMAT "%8.2" /end CHARACTERISTIC
/begin CHARACTERISTIC DFES_DTCO.DFC_MDCyl_2_C "" VALUE 0x800417B2 Val_Wu16 65535.00 DFES_OneToOne 0.00 65535.00 FORMAT "%8.2" /end CHARACTERISTIC
/begin CHARACTERISTIC DFES_DTCO.DFC_MDFC_C "" VALUE 0x800417B4 Val_Wu16 65535.00 DFES_OneToOne 0.00 65535.00 FORMAT "%8.2" /end CHARACTERISTIC
/begin CHARACTERISTIC DFES_DTCO.DFC_MDmin_C "" VALUE 0x800417B6 Val_Wu16 65535.00 DFES_OneToOne 0.00 65535.00 FORMAT "%8.2" /end CHARACTERISTIC
/begin CHARACTERISTIC DFES_DTCO.DFC_MDnpl_C "" VALUE 0x800417B8 Val_Wu16 65535.00 DFES_OneToOne 0.00 65535.00 FORMAT "%8.2" /end CHARACTERISTIC
/begin CHARACTERISTIC DFES_DTCO.DFC_MoCADCNTP_C "" VALUE 0x800417BA Val_Wu16 65535.00 DFES_OneToOne 0.00 65535.00 FORMAT "%8.2" /end CHARACTERISTIC
/begin CHARACTERISTIC DFES_DTCO.DFC_MoCADCTst_C "" VALUE 0x800417BC Val_Wu16 65535.00 DFES_OneToOne 0.00 65535.00 FORMAT "%8.2" /end CHARACTERISTIC
/begin CHARACTERISTIC DFES_DTCO.DFC_MoCComctErrMM_C "" VALUE 0x800417BE Val_Wu16 65535.00 DFES_OneToOne 0.00 65535.00 FORMAT "%8.2" /end CHARACTERISTIC
/begin CHARACTERISTIC DFES_DTCO.DFC_OCWDAActv_C "" VALUE 0x800417C0 Val_Wu16 65535.00 DFES_OneToOne 0.00 65535.00 FORMAT "%8.2" /end CHARACTERISTIC
/begin CHARACTERISTIC DFES_DTCO.DFC_OCWDACom_C "" VALUE 0x800417C2 Val_Wu16 65535.00 DFES_OneToOne 0.00 65535.00 FORMAT "%8.2" /end CHARACTERISTIC
/begin CHARACTERISTIC DFES_DTCO.DFC_ORAmax_C "" VALUE 0x800417C4 Val_Wu16 65535.00 DFES_OneToOne 0.00 65535.00 FORMAT "%8.2" /end CHARACTERISTIC
/begin CHARACTERISTIC DFES_DTCO.DFC_ORAmin_C "" VALUE 0x800417C6 Val_Wu16 65535.00 DFES_OneToOne 0.00 65535.00 FORMAT "%8.2" /end CHARACTERISTIC
/begin CHARACTERISTIC DFES_DTCO.DFC_PSR1max_C "" VALUE 0x800417C8 Val_Wu16 65535.00 DFES_OneToOne 0.00 65535.00 FORMAT "%8.2" /end CHARACTERISTIC
/begin CHARACTERISTIC DFES_DTCO.DFC_PSRBmax_C "" VALUE 0x800417CA Val_Wu16 65535.00 DFES_OneToOne 0.00 65535.00 FORMAT "%8.2" /end CHARACTERISTIC
/begin CHARACTERISTIC DFES_DTCO.DFC_PSRBmin_C "" VALUE 0x800417CC Val_Wu16 65535.00 DFES_OneToOne 0.00 65535.00 FORMAT "%8.2" /end CHARACTERISTIC
/begin CHARACTERISTIC DFES_DTCO.DFC_PSREmax_C "" VALUE 0x800417CE Val_Wu16 65535.00 DFES_OneToOne 0.00 65535.00 FORMAT "%8.2" /end CHARACTERISTIC
/begin CHARACTERISTIC DFES_DTCO.DFC_PSREmin_C "" VALUE 0x800417D0 Val_Wu16 65535.00 DFES_OneToOne 0.00 65535.00 FORMAT "%8.2" /end CHARACTERISTIC
/begin CHARACTERISTIC DFES_DTCO.DFC_PSRPmax_C "" VALUE 0x800417D2 Val_Wu16 65535.00 DFES_OneToOne 0.00 65535.00 FORMAT "%8.2" /end CHARACTERISTIC
/begin CHARACTERISTIC DFES_DTCO.DFC_PSRPmin_C "" VALUE 0x800417D4 Val_Wu16 65535.00 DFES_OneToOne 0.00 65535.00 FORMAT "%8.2" /end CHARACTERISTIC
/begin CHARACTERISTIC DFES_DTCO.DFC_PSRPsig_C "" VALUE 0x800417D6 Val_Wu16 65535.00 DFES_OneToOne 0.00 65535.00 FORMAT "%8.2" /end CHARACTERISTIC
/begin CHARACTERISTIC DFES_DTCO.DFC_PSRmax_C "" VALUE 0x800417D8 Val_Wu16 65535.00 DFES_OneToOne 0.00 65535.00 FORMAT "%8.2" /end CHARACTERISTIC
/begin CHARACTERISTIC DFES_DTCO.DFC_SSpMon1_C "" VALUE 0x800417DA Val_Wu16 65535.00 DFES_OneToOne 0.00 65535.00 FORMAT "%8.2" /end CHARACTERISTIC
/begin CHARACTERISTIC DFES_DTCO.DFC_SSpMon2_C "" VALUE 0x800417DC Val_Wu16 65535.00 DFES_OneToOne 0.00 65535.00 FORMAT "%8.2" /end CHARACTERISTIC
/begin CHARACTERISTIC DFES_DTCO.DFC_SSpMon3_C "" VALUE 0x800417DE Val_Wu16 65535.00 DFES_OneToOne 0.00 65535.00 FORMAT "%8.2" /end CHARACTERISTIC
/begin CHARACTERISTIC DFES_DTCO.DFC_SWReset_0_C "" VALUE 0x800417E0 Val_Wu16 65535.00 DFES_OneToOne 0.00 65535.00 FORMAT "%8.2" /end CHARACTERISTIC
/begin CHARACTERISTIC DFES_DTCO.DFC_SWReset_1_C "" VALUE 0x800417E2 Val_Wu16 65535.00 DFES_OneToOne 0.00 65535.00 FORMAT "%8.2" /end CHARACTERISTIC
/begin CHARACTERISTIC DFES_DTCO.DFC_SWReset_2_C "" VALUE 0x800417E4 Val_Wu16 65535.00 DFES_OneToOne 0.00 65535.00 FORMAT "%8.2" /end CHARACTERISTIC
/begin CHARACTERISTIC DFES_DTCO.DFC_TASREmax_C "" VALUE 0x800417E6 Val_Wu16 65535.00 DFES_OneToOne 0.00 65535.00 FORMAT "%8.2" /end CHARACTERISTIC
/begin CHARACTERISTIC DFES_DTCO.DFC_TASREmin_C "" VALUE 0x800417E8 Val_Wu16 65535.00 DFES_OneToOne 0.00 65535.00 FORMAT "%8.2" /end CHARACTERISTIC
/begin CHARACTERISTIC DFES_DTCO.DFC_TASREnpl_C "" VALUE 0x800417EA Val_Wu16 65535.00 DFES_OneToOne 0.00 65535.00 FORMAT "%8.2" /end CHARACTERISTIC
/begin CHARACTERISTIC DFES_DTCO.DFC_TASRmax_C "" VALUE 0x800417EC Val_Wu16 65535.00 DFES_OneToOne 0.00 65535.00 FORMAT "%8.2" /end CHARACTERISTIC
/begin CHARACTERISTIC DFES_DTCO.DFC_TAmax_C "" VALUE 0x800417EE Val_Wu16 65535.00 DFES_OneToOne 0.00 65535.00 FORMAT "%8.2" /end CHARACTERISTIC
/begin CHARACTERISTIC DFES_DTCO.DFC_TEVEmax_C "" VALUE 0x800417F0 Val_Wu16 65535.00 DFES_OneToOne 0.00 65535.00 FORMAT "%8.2" /end CHARACTERISTIC
/begin CHARACTERISTIC DFES_DTCO.DFC_TEVEmin_C "" VALUE 0x800417F2 Val_Wu16 65535.00 DFES_OneToOne 0.00 65535.00 FORMAT "%8.2" /end CHARACTERISTIC
/begin CHARACTERISTIC DFES_DTCO.DFC_TEVEsig_C "" VALUE 0x800417F4 Val_Wu16 65535.00 DFES_OneToOne 0.00 65535.00 FORMAT "%8.2" /end CHARACTERISTIC
/begin CHARACTERISTIC DFES_DTCO.DFC_TMCSmax_C "" VALUE 0x800417F6 Val_Wu16 65535.00 DFES_OneToOne 0.00 65535.00 FORMAT "%8.2" /end CHARACTERISTIC
/begin CHARACTERISTIC DFES_DTCO.DFC_TMCSmin_C "" VALUE 0x800417F8 Val_Wu16 65535.00 DFES_OneToOne 0.00 65535.00 FORMAT "%8.2" /end CHARACTERISTIC
/begin CHARACTERISTIC DFES_DTCO.DFC_TMEmax_C "" VALUE 0x800417FA Val_Wu16 65535.00 DFES_OneToOne 0.00 65535.00 FORMAT "%8.2" /end CHARACTERISTIC
/begin CHARACTERISTIC DFES_DTCO.DFC_TMEmin_C "" VALUE 0x800417FC Val_Wu16 65535.00 DFES_OneToOne 0.00 65535.00 FORMAT "%8.2" /end CHARACTERISTIC
/begin CHARACTERISTIC DFES_DTCO.DFC_TMEnpl_C "" VALUE 0x800417FE Val_Wu16 65535.00 DFES_OneToOne 0.00 65535.00 FORMAT "%8.2" /end CHARACTERISTIC
/begin CHARACTERISTIC DFES_DTCO.DFC_TMEsig_C "" VALUE 0x80041800 Val_Wu16 65535.00 DFES_OneToOne 0.00 65535.00 FORMAT "%8.2" /end CHARACTERISTIC
/begin CHARACTERISTIC DFES_DTCO.DFC_TMPmax_C "" VALUE 0x80041802 Val_Wu16 65535.00 DFES_OneToOne 0.00 65535.00 FORMAT "%8.2" /end CHARACTERISTIC
/begin CHARACTERISTIC DFES_DTCO.DFC_TMPmin_C "" VALUE 0x80041804 Val_Wu16 65535.00 DFES_OneToOne 0.00 65535.00 FORMAT "%8.2" /end CHARACTERISTIC
/begin CHARACTERISTIC DFES_DTCO.DFC_TMPnpl_C "" VALUE 0x80041806 Val_Wu16 65535.00 DFES_OneToOne 0.00 65535.00 FORMAT "%8.2" /end CHARACTERISTIC
/begin CHARACTERISTIC DFES_DTCO.DFC_TMmax_C "" VALUE 0x80041808 Val_Wu16 65535.00 DFES_OneToOne 0.00 65535.00 FORMAT "%8.2" /end CHARACTERISTIC
/begin CHARACTERISTIC DFES_DTCO.DFC_TUMmax_C "" VALUE 0x8004180A Val_Wu16 65535.00 DFES_OneToOne 0.00 65535.00 FORMAT "%8.2" /end CHARACTERISTIC
/begin CHARACTERISTIC DFES_DTCO.DFC_TWCCTrimMaxB1_C "" VALUE 0x8004180C Val_Wu16 65535.00 DFES_OneToOne 0.00 65535.00 FORMAT "%8.2" /end CHARACTERISTIC
/begin CHARACTERISTIC DFES_DTCO.DFC_TWCCTrimMinB1_C "" VALUE 0x8004180E Val_Wu16 65535.00 DFES_OneToOne 0.00 65535.00 FORMAT "%8.2" /end CHARACTERISTIC
/begin CHARACTERISTIC DFES_DTCO.DFC_TWCDPriCatB1_C "" VALUE 0x80041810 Val_Wu16 65535.00 DFES_OneToOne 0.00 65535.00 FORMAT "%8.2" /end CHARACTERISTIC
/begin CHARACTERISTIC DFES_DTCO.DFC_UBRmax_C "" VALUE 0x80041812 Val_Wu16 65535.00 DFES_OneToOne 0.00 65535.00 FORMAT "%8.2" /end CHARACTERISTIC
/begin CHARACTERISTIC DFES_DTCO.DFC_UBmax_C "" VALUE 0x80041814 Val_Wu16 65535.00 DFES_OneToOne 0.00 65535.00 FORMAT "%8.2" /end CHARACTERISTIC
/begin CHARACTERISTIC DFES_DTCO.DFC_UBmin_C "" VALUE 0x80041816 Val_Wu16 65535.00 DFES_OneToOne 0.00 65535.00 FORMAT "%8.2" /end CHARACTERISTIC
/begin CHARACTERISTIC DFES_DTCO.DFC_UBnpl_C "" VALUE 0x80041818 Val_Wu16 65535.00 DFES_OneToOne 0.00 65535.00 FORMAT "%8.2" /end CHARACTERISTIC
/begin CHARACTERISTIC DFES_Env.xSet1_CA "" VAL_BLK 0x80041A9A ValA_Wu16 59.0000000000 Signals_IntSigNumVerb 0.00 59.0000000000 FORMAT "%13.10" NUMBER 2 /end CHARACTERISTIC
/begin CHARACTERISTIC DFES_Env.xSet2_CA "" VAL_BLK 0x80041A9E ValA_Wu16 59.0000000000 Signals_IntSigNumVerb 0.00 59.0000000000 FORMAT "%13.10" NUMBER 2 /end CHARACTERISTIC
/begin CHARACTERISTIC DFES_Env.xSet3_CA "" VAL_BLK 0x80041AA2 ValA_Wu16 59.0000000000 Signals_IntSigNumVerb 0.00 59.0000000000 FORMAT "%13.10" NUMBER 2 /end CHARACTERISTIC
/begin CHARACTERISTIC DFES_Env.xSet4_CA "" VAL_BLK 0x80041AA6 ValA_Wu16 59.0000000000 Signals_IntSigNumVerb 0.00 59.0000000000 FORMAT "%13.10" NUMBER 2 /end CHARACTERISTIC
/begin CHARACTERISTIC DFES_Env.xSet5_CA "" VAL_BLK 0x80041AAA ValA_Wu16 59.0000000000 Signals_IntSigNumVerb 0.00 59.0000000000 FORMAT "%13.10" NUMBER 2 /end CHARACTERISTIC
/begin CHARACTERISTIC DFES_Env.xSet6_CA "" VAL_BLK 0x80041AAE ValA_Wu16 59.0000000000 Signals_IntSigNumVerb 0.00 59.0000000000 FORMAT "%13.10" NUMBER 2 /end CHARACTERISTIC
/begin CHARACTERISTIC DFES_Env.xSet7_CA "" VAL_BLK 0x80041AB2 ValA_Wu16 59.0000000000 Signals_IntSigNumVerb 0.00 59.0000000000 FORMAT "%13.10" NUMBER 2 /end CHARACTERISTIC
/begin CHARACTERISTIC DFES_Env.xSet8_CA "" VAL_BLK 0x80041AB6 ValA_Wu16 59.0000000000 Signals_IntSigNumVerb 0.00 59.0000000000 FORMAT "%13.10" NUMBER 2 /end CHARACTERISTIC
/begin CHARACTERISTIC DFES_Env.xSet9_CA "" VAL_BLK 0x80041ABA ValA_Wu16 59.0000000000 Signals_IntSigNumVerb 0.00 59.0000000000 FORMAT "%13.10" NUMBER 2 /end CHARACTERISTIC
/begin CHARACTERISTIC DFES_Env.xSet10_CA "" VAL_BLK 0x80041ABE ValA_Wu16 59.0000000000 Signals_IntSigNumVerb 0.00 59.0000000000 FORMAT "%13.10" NUMBER 2 /end CHARACTERISTIC
/begin CHARACTERISTIC DFES_Env.xSet11_CA "" VAL_BLK 0x80041AC2 ValA_Wu16 59.0000000000 Signals_IntSigNumVerb 0.00 59.0000000000 FORMAT "%13.10" NUMBER 2 /end CHARACTERISTIC
/begin CHARACTERISTIC DFES_Env.xSet12_CA "" VAL_BLK 0x80041AC6 ValA_Wu16 59.0000000000 Signals_IntSigNumVerb 0.00 59.0000000000 FORMAT "%13.10" NUMBER 2 /end CHARACTERISTIC
/begin CHARACTERISTIC DFES_Env.xSet13_CA "" VAL_BLK 0x80041ACA ValA_Wu16 59.0000000000 Signals_IntSigNumVerb 0.00 59.0000000000 FORMAT "%13.10" NUMBER 2 /end CHARACTERISTIC
/begin CHARACTERISTIC DFES_Env.xSet14_CA "" VAL_BLK 0x80041ACE ValA_Wu16 59.0000000000 Signals_IntSigNumVerb 0.00 59.0000000000 FORMAT "%13.10" NUMBER 2 /end CHARACTERISTIC
/begin CHARACTERISTIC DFES_Env.xSet15_CA "" VAL_BLK 0x80041AD2 ValA_Wu16 59.0000000000 Signals_IntSigNumVerb 0.00 59.0000000000 FORMAT "%13.10" NUMBER 2 /end CHARACTERISTIC
/begin CHARACTERISTIC DFES_Env.xSet16_CA "" VAL_BLK 0x80041AD6 ValA_Wu16 59.0000000000 Signals_IntSigNumVerb 0.00 59.0000000000 FORMAT "%13.10" NUMBER 2 /end CHARACTERISTIC
/begin CHARACTERISTIC DFES_Env.xSet17_CA "" VAL_BLK 0x80041ADA ValA_Wu16 59.0000000000 Signals_IntSigNumVerb 0.00 59.0000000000 FORMAT "%13.10" NUMBER 2 /end CHARACTERISTIC
/begin CHARACTERISTIC DFES_Env.xSet18_CA "" VAL_BLK 0x80041ADE ValA_Wu16 59.0000000000 Signals_IntSigNumVerb 0.00 59.0000000000 FORMAT "%13.10" NUMBER 2 /end CHARACTERISTIC
/begin CHARACTERISTIC DFES_Env.xSet19_CA "" VAL_BLK 0x80041AE2 ValA_Wu16 59.0000000000 Signals_IntSigNumVerb 0.00 59.0000000000 FORMAT "%13.10" NUMBER 2 /end CHARACTERISTIC
/begin CHARACTERISTIC DFES_Env.xSet20_CA "" VAL_BLK 0x80041AE6 ValA_Wu16 59.0000000000 Signals_IntSigNumVerb 0.00 59.0000000000 FORMAT "%13.10" NUMBER 2 /end CHARACTERISTIC
/begin CHARACTERISTIC DFES_Env.xSet21_CA "" VAL_BLK 0x80041AEA ValA_Wu16 59.0000000000 Signals_IntSigNumVerb 0.00 59.0000000000 FORMAT "%13.10" NUMBER 2 /end CHARACTERISTIC
/begin CHARACTERISTIC DFES_Env.xSet22_CA "" VAL_BLK 0x80041AEE ValA_Wu16 59.0000000000 Signals_IntSigNumVerb 0.00 59.0000000000 FORMAT "%13.10" NUMBER 2 /end CHARACTERISTIC
/begin CHARACTERISTIC DFES_Env.xSet23_CA "" VAL_BLK 0x80041AF2 ValA_Wu16 59.0000000000 Signals_IntSigNumVerb 0.00 59.0000000000 FORMAT "%13.10" NUMBER 2 /end CHARACTERISTIC
/begin CHARACTERISTIC DFES_Env.xSet24_CA "" VAL_BLK 0x80041AF6 ValA_Wu16 59.0000000000 Signals_IntSigNumVerb 0.00 59.0000000000 FORMAT "%13.10" NUMBER 2 /end CHARACTERISTIC
/begin CHARACTERISTIC DFES_Env.xSet25_CA "" VAL_BLK 0x80041AFA ValA_Wu16 59.0000000000 Signals_IntSigNumVerb 0.00 59.0000000000 FORMAT "%13.10" NUMBER 2 /end CHARACTERISTIC
/begin CHARACTERISTIC DFES_Env.xSet26_CA "" VAL_BLK 0x80041AFE ValA_Wu16 59.0000000000 Signals_IntSigNumVerb 0.00 59.0000000000 FORMAT "%13.10" NUMBER 2 /end CHARACTERISTIC
/begin CHARACTERISTIC DFES_Env.xSet27_CA "" VAL_BLK 0x80041B02 ValA_Wu16 59.0000000000 Signals_IntSigNumVerb 0.00 59.0000000000 FORMAT "%13.10" NUMBER 2 /end CHARACTERISTIC
/begin CHARACTERISTIC DFES_Env.xSet28_CA "" VAL_BLK 0x80041B06 ValA_Wu16 59.0000000000 Signals_IntSigNumVerb 0.00 59.0000000000 FORMAT "%13.10" NUMBER 2 /end CHARACTERISTIC
/begin CHARACTERISTIC DFES_Env.xSet29_CA "" VAL_BLK 0x80041B0A ValA_Wu16 59.0000000000 Signals_IntSigNumVerb 0.00 59.0000000000 FORMAT "%13.10" NUMBER 2 /end CHARACTERISTIC
/begin CHARACTERISTIC DFES_Env.xSet30_CA "" VAL_BLK 0x80041B0E ValA_Wu16 59.0000000000 Signals_IntSigNumVerb 0.00 59.0000000000 FORMAT "%13.10" NUMBER 2 /end CHARACTERISTIC
/begin CHARACTERISTIC DFES_Env.xSet31_CA "" VAL_BLK 0x80041B12 ValA_Wu16 59.0000000000 Signals_IntSigNumVerb 0.00 59.0000000000 FORMAT "%13.10" NUMBER 2 /end CHARACTERISTIC
/begin CHARACTERISTIC DFES_Env.xSet32_CA "" VAL_BLK 0x80041B16 ValA_Wu16 59.0000000000 Signals_IntSigNumVerb 0.00 59.0000000000 FORMAT "%13.10" NUMBER 2 /end CHARACTERISTIC
/begin CHARACTERISTIC DFES_Env.xSet33_CA "" VAL_BLK 0x80041B1A ValA_Wu16 59.0000000000 Signals_IntSigNumVerb 0.00 59.0000000000 FORMAT "%13.10" NUMBER 2 /end CHARACTERISTIC
/begin CHARACTERISTIC DFES_Env.xSet34_CA "" VAL_BLK 0x80041B1E ValA_Wu16 59.0000000000 Signals_IntSigNumVerb 0.00 59.0000000000 FORMAT "%13.10" NUMBER 2 /end CHARACTERISTIC
/begin CHARACTERISTIC DFES_Env.xSet35_CA "" VAL_BLK 0x80041B22 ValA_Wu16 59.0000000000 Signals_IntSigNumVerb 0.00 59.0000000000 FORMAT "%13.10" NUMBER 2 /end CHARACTERISTIC
/begin CHARACTERISTIC DFES_Env.xSet36_CA "" VAL_BLK 0x80041B26 ValA_Wu16 59.0000000000 Signals_IntSigNumVerb 0.00 59.0000000000 FORMAT "%13.10" NUMBER 2 /end CHARACTERISTIC
/begin CHARACTERISTIC DFES_Env.xSet37_CA "" VAL_BLK 0x80041B2A ValA_Wu16 59.0000000000 Signals_IntSigNumVerb 0.00 59.0000000000 FORMAT "%13.10" NUMBER 2 /end CHARACTERISTIC
/begin CHARACTERISTIC DFES_Env.xSet38_CA "" VAL_BLK 0x80041B2E ValA_Wu16 59.0000000000 Signals_IntSigNumVerb 0.00 59.0000000000 FORMAT "%13.10" NUMBER 2 /end CHARACTERISTIC
/begin CHARACTERISTIC DFES_Env.xSet39_CA "" VAL_BLK 0x80041B32 ValA_Wu16 59.0000000000 Signals_IntSigNumVerb 0.00 59.0000000000 FORMAT "%13.10" NUMBER 2 /end CHARACTERISTIC
/begin CHARACTERISTIC DFES_Env.xSet40_CA "" VAL_BLK 0x80041B36 ValA_Wu16 59.0000000000 Signals_IntSigNumVerb 0.00 59.0000000000 FORMAT "%13.10" NUMBER 2 /end CHARACTERISTIC
/begin CHARACTERISTIC DFES_Env.xSet41_CA "" VAL_BLK 0x80041B3A ValA_Wu16 59.0000000000 Signals_IntSigNumVerb 0.00 59.0000000000 FORMAT "%13.10" NUMBER 2 /end CHARACTERISTIC
/begin CHARACTERISTIC DFES_Env.xSet42_CA "" VAL_BLK 0x80041B3E ValA_Wu16 59.0000000000 Signals_IntSigNumVerb 0.00 59.0000000000 FORMAT "%13.10" NUMBER 2 /end CHARACTERISTIC
/begin CHARACTERISTIC DFES_Env.xSet43_CA "" VAL_BLK 0x80041B42 ValA_Wu16 59.0000000000 Signals_IntSigNumVerb 0.00 59.0000000000 FORMAT "%13.10" NUMBER 2 /end CHARACTERISTIC
/begin CHARACTERISTIC DFES_Env.xSet44_CA "" VAL_BLK 0x80041B46 ValA_Wu16 59.0000000000 Signals_IntSigNumVerb 0.00 59.0000000000 FORMAT "%13.10" NUMBER 2 /end CHARACTERISTIC
/begin CHARACTERISTIC DFES_Env.xSet45_CA "" VAL_BLK 0x80041B4A ValA_Wu16 59.0000000000 Signals_IntSigNumVerb 0.00 59.0000000000 FORMAT "%13.10" NUMBER 2 /end CHARACTERISTIC
/begin CHARACTERISTIC DFES_Env.xSet46_CA "" VAL_BLK 0x80041B4E ValA_Wu16 59.0000000000 Signals_IntSigNumVerb 0.00 59.0000000000 FORMAT "%13.10" NUMBER 2 /end CHARACTERISTIC
/begin CHARACTERISTIC DFES_Env.xSet47_CA "" VAL_BLK 0x80041B52 ValA_Wu16 59.0000000000 Signals_IntSigNumVerb 0.00 59.0000000000 FORMAT "%13.10" NUMBER 2 /end CHARACTERISTIC
/begin CHARACTERISTIC DFES_Env.xSet48_CA "" VAL_BLK 0x80041B56 ValA_Wu16 59.0000000000 Signals_IntSigNumVerb 0.00 59.0000000000 FORMAT "%13.10" NUMBER 2 /end CHARACTERISTIC
/begin CHARACTERISTIC DFES_Env.xSet49_CA "" VAL_BLK 0x80041B5A ValA_Wu16 59.0000000000 Signals_IntSigNumVerb 0.00 59.0000000000 FORMAT "%13.10" NUMBER 2 /end CHARACTERISTIC
/begin CHARACTERISTIC DFES_Env.xSet50_CA "" VAL_BLK 0x80041B5E ValA_Wu16 59.0000000000 Signals_IntSigNumVerb 0.00 59.0000000000 FORMAT "%13.10" NUMBER 2 /end CHARACTERISTIC
/begin CHARACTERISTIC DFES_EnvRef.DFC_Unused_C "" VALUE 0x800418F2 Val_Wu8 49. DFES_EnvTabVerb 0.00 49. FORMAT "%2.0" READ_ONLY /end CHARACTERISTIC
/begin CHARACTERISTIC DFES_EnvRef.DFC_AltMaxPwr_C "" VALUE 0x800418F3 Val_Wu8 49. DFES_EnvTabVerb 0.00 49. FORMAT "%2.0" /end CHARACTERISTIC
/begin CHARACTERISTIC DFES_EnvRef.DFC_BrkNpl_C "" VALUE 0x800418F4 Val_Wu8 49. DFES_EnvTabVerb 0.00 49. FORMAT "%2.0" /end CHARACTERISTIC
/begin CHARACTERISTIC DFES_EnvRef.DFC_Cj930SSp1Mon_C "" VALUE 0x800418F5 Val_Wu8 49. DFES_EnvTabVerb 0.00 49. FORMAT "%2.0" /end CHARACTERISTIC
/begin CHARACTERISTIC DFES_EnvRef.DFC_Cj930SSp2Mon_C "" VALUE 0x800418F6 Val_Wu8 49. DFES_EnvTabVerb 0.00 49. FORMAT "%2.0" /end CHARACTERISTIC
/begin CHARACTERISTIC DFES_EnvRef.DFC_Cj930SSp3Mon_C "" VALUE 0x800418F7 Val_Wu8 49. DFES_EnvTabVerb 0.00 49. FORMAT "%2.0" /end CHARACTERISTIC
/begin CHARACTERISTIC DFES_EnvRef.DFC_IdleChrgActrAMax_C "" VALUE 0x800418F8 Val_Wu8 49. DFES_EnvTabVerb 0.00 49. FORMAT "%2.0" /end CHARACTERISTIC
/begin CHARACTERISTIC DFES_EnvRef.DFC_IdleChrgActrAMin_C "" VALUE 0x800418F9 Val_Wu8 49. DFES_EnvTabVerb 0.00 49. FORMAT "%2.0" /end CHARACTERISTIC
/begin CHARACTERISTIC DFES_EnvRef.DFC_IdleChrgActrASig_C "" VALUE 0x800418FA Val_Wu8 49. DFES_EnvTabVerb 0.00 49. FORMAT "%2.0" /end CHARACTERISTIC
/begin CHARACTERISTIC DFES_EnvRef.DFC_IdleChrgActrBMax_C "" VALUE 0x800418FB Val_Wu8 49. DFES_EnvTabVerb 0.00 49. FORMAT "%2.0" /end CHARACTERISTIC
/begin CHARACTERISTIC DFES_EnvRef.DFC_IdleChrgActrBMin_C "" VALUE 0x800418FC Val_Wu8 49. DFES_EnvTabVerb 0.00 49. FORMAT "%2.0" /end CHARACTERISTIC
/begin CHARACTERISTIC DFES_EnvRef.DFC_IdleChrgActrBSig_C "" VALUE 0x800418FD Val_Wu8 49. DFES_EnvTabVerb 0.00 49. FORMAT "%2.0" /end CHARACTERISTIC
/begin CHARACTERISTIC DFES_EnvRef.DFC_IdleChrgActrGovDeCold_C "" VALUE 0x800418FE Val_Wu8 49. DFES_EnvTabVerb 0.00 49. FORMAT "%2.0" /end CHARACTERISTIC
/begin CHARACTERISTIC DFES_EnvRef.DFC_IdleChrgActrGovDeMax_C "" VALUE 0x800418FF Val_Wu8 49. DFES_EnvTabVerb 0.00 49. FORMAT "%2.0" /end CHARACTERISTIC
/begin CHARACTERISTIC DFES_EnvRef.DFC_IdleChrgActrGovDeMin_C "" VALUE 0x80041900 Val_Wu8 49. DFES_EnvTabVerb 0.00 49. FORMAT "%2.0" /end CHARACTERISTIC
/begin CHARACTERISTIC DFES_EnvRef.DFC_IdleChrgActrNAMax_C "" VALUE 0x80041901 Val_Wu8 49. DFES_EnvTabVerb 0.00 49. FORMAT "%2.0" /end CHARACTERISTIC
/begin CHARACTERISTIC DFES_EnvRef.DFC_IdleChrgActrNAMin_C "" VALUE 0x80041902 Val_Wu8 49. DFES_EnvTabVerb 0.00 49. FORMAT "%2.0" /end CHARACTERISTIC
/begin CHARACTERISTIC DFES_EnvRef.DFC_IdleChrgActrNASig_C "" VALUE 0x80041903 Val_Wu8 49. DFES_EnvTabVerb 0.00 49. FORMAT "%2.0" /end CHARACTERISTIC
/begin CHARACTERISTIC DFES_EnvRef.DFC_IdleChrgActrNBMax_C "" VALUE 0x80041904 Val_Wu8 49. DFES_EnvTabVerb 0.00 49. FORMAT "%2.0" /end CHARACTERISTIC
/begin CHARACTERISTIC DFES_EnvRef.DFC_IdleChrgActrNBMin_C "" VALUE 0x80041905 Val_Wu8 49. DFES_EnvTabVerb 0.00 49. FORMAT "%2.0" /end CHARACTERISTIC
/begin CHARACTERISTIC DFES_EnvRef.DFC_IdleChrgActrNBSig_C "" VALUE 0x80041906 Val_Wu8 49. DFES_EnvTabVerb 0.00 49. FORMAT "%2.0" /end CHARACTERISTIC
/begin CHARACTERISTIC DFES_EnvRef.DFC_IdleChrgActrOverTmp_C "" VALUE 0x80041907 Val_Wu8 49. DFES_EnvTabVerb 0.00 49. FORMAT "%2.0" /end CHARACTERISTIC
/begin CHARACTERISTIC DFES_EnvRef.DFC_MonUMaxSupply1_C "" VALUE 0x80041908 Val_Wu8 49. DFES_EnvTabVerb 0.00 49. FORMAT "%2.0" /end CHARACTERISTIC
/begin CHARACTERISTIC DFES_EnvRef.DFC_MonUMinSupply1_C "" VALUE 0x80041909 Val_Wu8 49. DFES_EnvTabVerb 0.00 49. FORMAT "%2.0" /end CHARACTERISTIC
/begin CHARACTERISTIC DFES_EnvRef.DFC_ClthNplClsd_C "" VALUE 0x8004190A Val_Wu8 49. DFES_EnvTabVerb 0.00 49. FORMAT "%2.0" /end CHARACTERISTIC
/begin CHARACTERISTIC DFES_EnvRef.DFC_ClthNplOpn_C "" VALUE 0x8004190B Val_Wu8 49. DFES_EnvTabVerb 0.00 49. FORMAT "%2.0" /end CHARACTERISTIC
/begin CHARACTERISTIC DFES_EnvRef.DFC_IgnClPsDevComErr1_C "" VALUE 0x8004190C Val_Wu8 49. DFES_EnvTabVerb 0.00 49. FORMAT "%2.0" /end CHARACTERISTIC
/begin CHARACTERISTIC DFES_EnvRef.DFC_IgnClPsOpenLoad0_C "" VALUE 0x8004190D Val_Wu8 49. DFES_EnvTabVerb 0.00 49. FORMAT "%2.0" /end CHARACTERISTIC
/begin CHARACTERISTIC DFES_EnvRef.DFC_IgnClPsOpenLoad1_C "" VALUE 0x8004190E Val_Wu8 49. DFES_EnvTabVerb 0.00 49. FORMAT "%2.0" /end CHARACTERISTIC
/begin CHARACTERISTIC DFES_EnvRef.DFC_IgnClPsOpenLoad2_C "" VALUE 0x8004190F Val_Wu8 49. DFES_EnvTabVerb 0.00 49. FORMAT "%2.0" /end CHARACTERISTIC
/begin CHARACTERISTIC DFES_EnvRef.DFC_IgnClPsShCirBatt0_C "" VALUE 0x80041910 Val_Wu8 49. DFES_EnvTabVerb 0.00 49. FORMAT "%2.0" /end CHARACTERISTIC
/begin CHARACTERISTIC DFES_EnvRef.DFC_IgnClPsShCirBatt1_C "" VALUE 0x80041911 Val_Wu8 49. DFES_EnvTabVerb 0.00 49. FORMAT "%2.0" /end CHARACTERISTIC
/begin CHARACTERISTIC DFES_EnvRef.DFC_IgnClPsShCirBatt2_C "" VALUE 0x80041912 Val_Wu8 49. DFES_EnvTabVerb 0.00 49. FORMAT "%2.0" /end CHARACTERISTIC
/begin CHARACTERISTIC DFES_EnvRef.DFC_IgnClPsShCirGnd0_C "" VALUE 0x80041913 Val_Wu8 49. DFES_EnvTabVerb 0.00 49. FORMAT "%2.0" /end CHARACTERISTIC
/begin CHARACTERISTIC DFES_EnvRef.DFC_IgnClPsShCirGnd1_C "" VALUE 0x80041914 Val_Wu8 49. DFES_EnvTabVerb 0.00 49. FORMAT "%2.0" /end CHARACTERISTIC
/begin CHARACTERISTIC DFES_EnvRef.DFC_IgnClPsShCirGnd2_C "" VALUE 0x80041915 Val_Wu8 49. DFES_EnvTabVerb 0.00 49. FORMAT "%2.0" /end CHARACTERISTIC
/begin CHARACTERISTIC DFES_EnvRef.DFC_KnDetSens1PortAMax_C "" VALUE 0x80041916 Val_Wu8 49. DFES_EnvTabVerb 0.00 49. FORMAT "%2.0" /end CHARACTERISTIC
/begin CHARACTERISTIC DFES_EnvRef.DFC_KnDetSens1PortAMin_C "" VALUE 0x80041917 Val_Wu8 49. DFES_EnvTabVerb 0.00 49. FORMAT "%2.0" /end CHARACTERISTIC
/begin CHARACTERISTIC DFES_EnvRef.DFC_KnDetSens1PortBMax_C "" VALUE 0x80041918 Val_Wu8 49. DFES_EnvTabVerb 0.00 49. FORMAT "%2.0" /end CHARACTERISTIC
/begin CHARACTERISTIC DFES_EnvRef.DFC_KnDetSens1PortBMin_C "" VALUE 0x80041919 Val_Wu8 49. DFES_EnvTabVerb 0.00 49. FORMAT "%2.0" /end CHARACTERISTIC
/begin CHARACTERISTIC DFES_EnvRef.DFC_VehVWhlErr_C "" VALUE 0x8004191A Val_Wu8 49. DFES_EnvTabVerb 0.00 49. FORMAT "%2.0" /end CHARACTERISTIC
/begin CHARACTERISTIC DFES_EnvRef.DFC_AirCCmprOL_C "" VALUE 0x8004191B Val_Wu8 49. DFES_EnvTabVerb 0.00 49. FORMAT "%2.0" /end CHARACTERISTIC
/begin CHARACTERISTIC DFES_EnvRef.DFC_AirCCmprOvrTemp_C "" VALUE 0x8004191C Val_Wu8 49. DFES_EnvTabVerb 0.00 49. FORMAT "%2.0" /end CHARACTERISTIC
/begin CHARACTERISTIC DFES_EnvRef.DFC_AirCCmprSCB_C "" VALUE 0x8004191D Val_Wu8 49. DFES_EnvTabVerb 0.00 49. FORMAT "%2.0" /end CHARACTERISTIC
/begin CHARACTERISTIC DFES_EnvRef.DFC_AirCCmprSCG_C "" VALUE 0x8004191E Val_Wu8 49. DFES_EnvTabVerb 0.00 49. FORMAT "%2.0" /end CHARACTERISTIC
/begin CHARACTERISTIC DFES_EnvRef.DFC_AltIOLdSRCMin_C "" VALUE 0x8004191F Val_Wu8 49. DFES_EnvTabVerb 0.00 49. FORMAT "%2.0" /end CHARACTERISTIC
/begin CHARACTERISTIC DFES_EnvRef.DFC_AltIOOL_C "" VALUE 0x80041920 Val_Wu8 49. DFES_EnvTabVerb 0.00 49. FORMAT "%2.0" /end CHARACTERISTIC
/begin CHARACTERISTIC DFES_EnvRef.DFC_AltIOOvrTemp_C "" VALUE 0x80041921 Val_Wu8 49. DFES_EnvTabVerb 0.00 49. FORMAT "%2.0" /end CHARACTERISTIC
/begin CHARACTERISTIC DFES_EnvRef.DFC_AltIOSCB_C "" VALUE 0x80041922 Val_Wu8 49. DFES_EnvTabVerb 0.00 49. FORMAT "%2.0" /end CHARACTERISTIC
/begin CHARACTERISTIC DFES_EnvRef.DFC_AltIOSCG_C "" VALUE 0x80041923 Val_Wu8 49. DFES_EnvTabVerb 0.00 49. FORMAT "%2.0" /end CHARACTERISTIC
/begin CHARACTERISTIC DFES_EnvRef.DFC_DevLibBattUHi_C "" VALUE 0x80041924 Val_Wu8 49. DFES_EnvTabVerb 0.00 49. FORMAT "%2.0" /end CHARACTERISTIC
/begin CHARACTERISTIC DFES_EnvRef.DFC_DevLibBattULo_C "" VALUE 0x80041925 Val_Wu8 49. DFES_EnvTabVerb 0.00 49. FORMAT "%2.0" /end CHARACTERISTIC
/begin CHARACTERISTIC DFES_EnvRef.DFC_FanDIOOL_C "" VALUE 0x80041926 Val_Wu8 49. DFES_EnvTabVerb 0.00 49. FORMAT "%2.0" /end CHARACTERISTIC
/begin CHARACTERISTIC DFES_EnvRef.DFC_FanDIOOvrTemp_C "" VALUE 0x80041927 Val_Wu8 49. DFES_EnvTabVerb 0.00 49. FORMAT "%2.0" /end CHARACTERISTIC
/begin CHARACTERISTIC DFES_EnvRef.DFC_FanDIOSCB_C "" VALUE 0x80041928 Val_Wu8 49. DFES_EnvTabVerb 0.00 49. FORMAT "%2.0" /end CHARACTERISTIC
/begin CHARACTERISTIC DFES_EnvRef.DFC_FanDIOSCG_C "" VALUE 0x80041929 Val_Wu8 49. DFES_EnvTabVerb 0.00 49. FORMAT "%2.0" /end CHARACTERISTIC
/begin CHARACTERISTIC DFES_EnvRef.DFC_FanPWMOL_C "" VALUE 0x8004192A Val_Wu8 49. DFES_EnvTabVerb 0.00 49. FORMAT "%2.0" /end CHARACTERISTIC
/begin CHARACTERISTIC DFES_EnvRef.DFC_FanPWMOvrTemp_C "" VALUE 0x8004192B Val_Wu8 49. DFES_EnvTabVerb 0.00 49. FORMAT "%2.0" /end CHARACTERISTIC
/begin CHARACTERISTIC DFES_EnvRef.DFC_FanPWMSCB_C "" VALUE 0x8004192C Val_Wu8 49. DFES_EnvTabVerb 0.00 49. FORMAT "%2.0" /end CHARACTERISTIC
/begin CHARACTERISTIC DFES_EnvRef.DFC_FanPWMSCG_C "" VALUE 0x8004192D Val_Wu8 49. DFES_EnvTabVerb 0.00 49. FORMAT "%2.0" /end CHARACTERISTIC
/begin CHARACTERISTIC DFES_EnvRef.DFC_AirCClntPAnaSRCMax_C "" VALUE 0x8004192E Val_Wu8 49. DFES_EnvTabVerb 0.00 49. FORMAT "%2.0" /end CHARACTERISTIC
/begin CHARACTERISTIC DFES_EnvRef.DFC_AirCClntPAnaSRCMin_C "" VALUE 0x8004192F Val_Wu8 49. DFES_EnvTabVerb 0.00 49. FORMAT "%2.0" /end CHARACTERISTIC
/begin CHARACTERISTIC DFES_EnvRef.DFC_AirCSwtNpl_C "" VALUE 0x80041930 Val_Wu8 49. DFES_EnvTabVerb 0.00 49. FORMAT "%2.0" /end CHARACTERISTIC
/begin CHARACTERISTIC DFES_EnvRef.DFC_AirCSwtSig_C "" VALUE 0x80041931 Val_Wu8 49. DFES_EnvTabVerb 0.00 49. FORMAT "%2.0" /end CHARACTERISTIC
/begin CHARACTERISTIC DFES_EnvRef.DFC_AltIOLdSRCMax_C "" VALUE 0x80041932 Val_Wu8 49. DFES_EnvTabVerb 0.00 49. FORMAT "%2.0" /end CHARACTERISTIC
/begin CHARACTERISTIC DFES_EnvRef.DFC_BrkSig_C "" VALUE 0x80041933 Val_Wu8 49. DFES_EnvTabVerb 0.00 49. FORMAT "%2.0" /end CHARACTERISTIC
/begin CHARACTERISTIC DFES_EnvRef.DFC_ClthEPBNpl_C "" VALUE 0x80041934 Val_Wu8 49. DFES_EnvTabVerb 0.00 49. FORMAT "%2.0" /end CHARACTERISTIC
/begin CHARACTERISTIC DFES_EnvRef.DFC_ClthEPBSensErr_C "" VALUE 0x80041935 Val_Wu8 49. DFES_EnvTabVerb 0.00 49. FORMAT "%2.0" /end CHARACTERISTIC
/begin CHARACTERISTIC DFES_EnvRef.DFC_ClthErr_C "" VALUE 0x80041936 Val_Wu8 49. DFES_EnvTabVerb 0.00 49. FORMAT "%2.0" /end CHARACTERISTIC
/begin CHARACTERISTIC DFES_EnvRef.DFC_ClthSig_C "" VALUE 0x80041937 Val_Wu8 49. DFES_EnvTabVerb 0.00 49. FORMAT "%2.0" /end CHARACTERISTIC
/begin CHARACTERISTIC DFES_EnvRef.DFC_MILLmpOL_C "" VALUE 0x80041938 Val_Wu8 49. DFES_EnvTabVerb 0.00 49. FORMAT "%2.0" /end CHARACTERISTIC
/begin CHARACTERISTIC DFES_EnvRef.DFC_MILLmpSCB_C "" VALUE 0x80041939 Val_Wu8 49. DFES_EnvTabVerb 0.00 49. FORMAT "%2.0" /end CHARACTERISTIC
/begin CHARACTERISTIC DFES_EnvRef.DFC_MILLmpSCG_C "" VALUE 0x8004193A Val_Wu8 49. DFES_EnvTabVerb 0.00 49. FORMAT "%2.0" /end CHARACTERISTIC
/begin CHARACTERISTIC DFES_EnvRef.DFC_SRCHighAPP1_C "" VALUE 0x8004193B Val_Wu8 49. DFES_EnvTabVerb 0.00 49. FORMAT "%2.0" /end CHARACTERISTIC
/begin CHARACTERISTIC DFES_EnvRef.DFC_SRCHighAPP2_C "" VALUE 0x8004193C Val_Wu8 49. DFES_EnvTabVerb 0.00 49. FORMAT "%2.0" /end CHARACTERISTIC
/begin CHARACTERISTIC DFES_EnvRef.DFC_SRCLowAPP1_C "" VALUE 0x8004193D Val_Wu8 49. DFES_EnvTabVerb 0.00 49. FORMAT "%2.0" /end CHARACTERISTIC
/begin CHARACTERISTIC DFES_EnvRef.DFC_SRCLowAPP2_C "" VALUE 0x8004193E Val_Wu8 49. DFES_EnvTabVerb 0.00 49. FORMAT "%2.0" /end CHARACTERISTIC
/begin CHARACTERISTIC DFES_EnvRef.DFC_SyncAPP_C "" VALUE 0x8004193F Val_Wu8 49. DFES_EnvTabVerb 0.00 49. FORMAT "%2.0" /end CHARACTERISTIC
/begin CHARACTERISTIC DFES_EnvRef.DFC_VehVMax_C "" VALUE 0x80041940 Val_Wu8 49. DFES_EnvTabVerb 0.00 49. FORMAT "%2.0" /end CHARACTERISTIC
/begin CHARACTERISTIC DFES_EnvRef.DFC_VehVPlaus_C "" VALUE 0x80041941 Val_Wu8 49. DFES_EnvTabVerb 0.00 49. FORMAT "%2.0" /end CHARACTERISTIC
/begin CHARACTERISTIC DFES_EnvRef.DFC_VehVSig_C "" VALUE 0x80041942 Val_Wu8 49. DFES_EnvTabVerb 0.00 49. FORMAT "%2.0" /end CHARACTERISTIC
/begin CHARACTERISTIC DFES_EnvRef.DFC_BusDiagBusOffNodeA_C "" VALUE 0x80041943 Val_Wu8 49. DFES_EnvTabVerb 0.00 49. FORMAT "%2.0" /end CHARACTERISTIC
/begin CHARACTERISTIC DFES_EnvRef.DFC_ComACSensTO_C "" VALUE 0x80041944 Val_Wu8 49. DFES_EnvTabVerb 0.00 49. FORMAT "%2.0" /end CHARACTERISTIC
/begin CHARACTERISTIC DFES_EnvRef.DFC_ComAWD1TO_C "" VALUE 0x80041945 Val_Wu8 49. DFES_EnvTabVerb 0.00 49. FORMAT "%2.0" /end CHARACTERISTIC
/begin CHARACTERISTIC DFES_EnvRef.DFC_ComBRK10TO_C "" VALUE 0x80041946 Val_Wu8 49. DFES_EnvTabVerb 0.00 49. FORMAT "%2.0" /end CHARACTERISTIC
/begin CHARACTERISTIC DFES_EnvRef.DFC_ComGW11TO_C "" VALUE 0x80041947 Val_Wu8 49. DFES_EnvTabVerb 0.00 49. FORMAT "%2.0" /end CHARACTERISTIC
/begin CHARACTERISTIC DFES_EnvRef.DFC_ComLVL1TO_C "" VALUE 0x80041948 Val_Wu8 49. DFES_EnvTabVerb 0.00 49. FORMAT "%2.0" /end CHARACTERISTIC
/begin CHARACTERISTIC DFES_EnvRef.DFC_ComPRKA01TO_C "" VALUE 0x80041949 Val_Wu8 49. DFES_EnvTabVerb 0.00 49. FORMAT "%2.0" /end CHARACTERISTIC
/begin CHARACTERISTIC DFES_EnvRef.DFC_ComPRKH01TO_C "" VALUE 0x8004194A Val_Wu8 49. DFES_EnvTabVerb 0.00 49. FORMAT "%2.0" /end CHARACTERISTIC
/begin CHARACTERISTIC DFES_EnvRef.DFC_ComPRKH1TO_C "" VALUE 0x8004194B Val_Wu8 49. DFES_EnvTabVerb 0.00 49. FORMAT "%2.0" /end CHARACTERISTIC
/begin CHARACTERISTIC DFES_EnvRef.DFC_ComTRBCH1TO_C "" VALUE 0x8004194C Val_Wu8 49. DFES_EnvTabVerb 0.00 49. FORMAT "%2.0" /end CHARACTERISTIC
/begin CHARACTERISTIC DFES_EnvRef.DFC_ComTRBCH2TO_C "" VALUE 0x8004194D Val_Wu8 49. DFES_EnvTabVerb 0.00 49. FORMAT "%2.0" /end CHARACTERISTIC
/begin CHARACTERISTIC DFES_EnvRef.DFC_DK_C "" VALUE 0x8004194E Val_Wu8 49. DFES_EnvTabVerb 0.00 49. FORMAT "%2.0" /end CHARACTERISTIC
/begin CHARACTERISTIC DFES_EnvRef.DFC_DKRSA_C "" VALUE 0x8004194F Val_Wu8 49. DFES_EnvTabVerb 0.00 49. FORMAT "%2.0" /end CHARACTERISTIC
/begin CHARACTERISTIC DFES_EnvRef.DFC_DKVSmax_C "" VALUE 0x80041950 Val_Wu8 49. DFES_EnvTabVerb 0.00 49. FORMAT "%2.0" /end CHARACTERISTIC
/begin CHARACTERISTIC DFES_EnvRef.DFC_DKmax_C "" VALUE 0x80041951 Val_Wu8 49. DFES_EnvTabVerb 0.00 49. FORMAT "%2.0" /end CHARACTERISTIC
/begin CHARACTERISTIC DFES_EnvRef.DFC_DKmin_C "" VALUE 0x80041952 Val_Wu8 49. DFES_EnvTabVerb 0.00 49. FORMAT "%2.0" /end CHARACTERISTIC
/begin CHARACTERISTIC DFES_EnvRef.DFC_DSSmax_C "" VALUE 0x80041953 Val_Wu8 49. DFES_EnvTabVerb 0.00 49. FORMAT "%2.0" /end CHARACTERISTIC
/begin CHARACTERISTIC DFES_EnvRef.DFC_EEPEraseErr_C "" VALUE 0x80041954 Val_Wu8 49. DFES_EnvTabVerb 0.00 49. FORMAT "%2.0" /end CHARACTERISTIC
/begin CHARACTERISTIC DFES_EnvRef.DFC_EEPRdErr_C "" VALUE 0x80041955 Val_Wu8 49. DFES_EnvTabVerb 0.00 49. FORMAT "%2.0" /end CHARACTERISTIC
/begin CHARACTERISTIC DFES_EnvRef.DFC_EEPWrErr_C "" VALUE 0x80041956 Val_Wu8 49. DFES_EnvTabVerb 0.00 49. FORMAT "%2.0" /end CHARACTERISTIC
/begin CHARACTERISTIC DFES_EnvRef.DFC_EV1max_C "" VALUE 0x80041957 Val_Wu8 49. DFES_EnvTabVerb 0.00 49. FORMAT "%2.0" /end CHARACTERISTIC
/begin CHARACTERISTIC DFES_EnvRef.DFC_EV1min_C "" VALUE 0x80041958 Val_Wu8 49. DFES_EnvTabVerb 0.00 49. FORMAT "%2.0" /end CHARACTERISTIC
/begin CHARACTERISTIC DFES_EnvRef.DFC_EV1sig_C "" VALUE 0x80041959 Val_Wu8 49. DFES_EnvTabVerb 0.00 49. FORMAT "%2.0" /end CHARACTERISTIC
/begin CHARACTERISTIC DFES_EnvRef.DFC_EV2max_C "" VALUE 0x8004195A Val_Wu8 49. DFES_EnvTabVerb 0.00 49. FORMAT "%2.0" /end CHARACTERISTIC
/begin CHARACTERISTIC DFES_EnvRef.DFC_EV2min_C "" VALUE 0x8004195B Val_Wu8 49. DFES_EnvTabVerb 0.00 49. FORMAT "%2.0" /end CHARACTERISTIC
/begin CHARACTERISTIC DFES_EnvRef.DFC_EV2sig_C "" VALUE 0x8004195C Val_Wu8 49. DFES_EnvTabVerb 0.00 49. FORMAT "%2.0" /end CHARACTERISTIC
/begin CHARACTERISTIC DFES_EnvRef.DFC_EV3max_C "" VALUE 0x8004195D Val_Wu8 49. DFES_EnvTabVerb 0.00 49. FORMAT "%2.0" /end CHARACTERISTIC
/begin CHARACTERISTIC DFES_EnvRef.DFC_EV3min_C "" VALUE 0x8004195E Val_Wu8 49. DFES_EnvTabVerb 0.00 49. FORMAT "%2.0" /end CHARACTERISTIC
/begin CHARACTERISTIC DFES_EnvRef.DFC_EV3sig_C "" VALUE 0x8004195F Val_Wu8 49. DFES_EnvTabVerb 0.00 49. FORMAT "%2.0" /end CHARACTERISTIC
/begin CHARACTERISTIC DFES_EnvRef.DFC_EpmCaSI1ErrSig_C "" VALUE 0x80041960 Val_Wu8 49. DFES_EnvTabVerb 0.00 49. FORMAT "%2.0" /end CHARACTERISTIC
/begin CHARACTERISTIC DFES_EnvRef.DFC_EpmCaSI1NoSig_C "" VALUE 0x80041961 Val_Wu8 49. DFES_EnvTabVerb 0.00 49. FORMAT "%2.0" /end CHARACTERISTIC
/begin CHARACTERISTIC DFES_EnvRef.DFC_EpmCaSI1NoSigMax_C "" VALUE 0x80041962 Val_Wu8 49. DFES_EnvTabVerb 0.00 49. FORMAT "%2.0" /end CHARACTERISTIC
/begin CHARACTERISTIC DFES_EnvRef.DFC_EpmCaSI1NoSigMin_C "" VALUE 0x80041963 Val_Wu8 49. DFES_EnvTabVerb 0.00 49. FORMAT "%2.0" /end CHARACTERISTIC
/begin CHARACTERISTIC DFES_EnvRef.DFC_EpmCaSI1OfsErr_C "" VALUE 0x80041964 Val_Wu8 49. DFES_EnvTabVerb 0.00 49. FORMAT "%2.0" /end CHARACTERISTIC
/begin CHARACTERISTIC DFES_EnvRef.DFC_EpmCrSErrSig_C "" VALUE 0x80041965 Val_Wu8 49. DFES_EnvTabVerb 0.00 49. FORMAT "%2.0" /end CHARACTERISTIC
/begin CHARACTERISTIC DFES_EnvRef.DFC_EpmCrSNoSig_C "" VALUE 0x80041966 Val_Wu8 49. DFES_EnvTabVerb 0.00 49. FORMAT "%2.0" /end CHARACTERISTIC
/begin CHARACTERISTIC DFES_EnvRef.DFC_FRAmax_C "" VALUE 0x80041967 Val_Wu8 49. DFES_EnvTabVerb 0.00 49. FORMAT "%2.0" /end CHARACTERISTIC
/begin CHARACTERISTIC DFES_EnvRef.DFC_FRAmin_C "" VALUE 0x80041968 Val_Wu8 49. DFES_EnvTabVerb 0.00 49. FORMAT "%2.0" /end CHARACTERISTIC
/begin CHARACTERISTIC DFES_EnvRef.DFC_HEGOS1B1ElecMax_C "" VALUE 0x80041969 Val_Wu8 49. DFES_EnvTabVerb 0.00 49. FORMAT "%2.0" /end CHARACTERISTIC
/begin CHARACTERISTIC DFES_EnvRef.DFC_HEGOS1B1ElecMin_C "" VALUE 0x8004196A Val_Wu8 49. DFES_EnvTabVerb 0.00 49. FORMAT "%2.0" /end CHARACTERISTIC
/begin CHARACTERISTIC DFES_EnvRef.DFC_HEGOS1B1ElecNpl_C "" VALUE 0x8004196B Val_Wu8 49. DFES_EnvTabVerb 0.00 49. FORMAT "%2.0" /end CHARACTERISTIC
/begin CHARACTERISTIC DFES_EnvRef.DFC_HEGOS1B1ElecSig_C "" VALUE 0x8004196C Val_Wu8 49. DFES_EnvTabVerb 0.00 49. FORMAT "%2.0" /end CHARACTERISTIC
/begin CHARACTERISTIC DFES_EnvRef.DFC_HEGOS1B1HtgNpl_C "" VALUE 0x8004196D Val_Wu8 49. DFES_EnvTabVerb 0.00 49. FORMAT "%2.0" /end CHARACTERISTIC
/begin CHARACTERISTIC DFES_EnvRef.DFC_HEGOS1B1HtrPsMax_C "" VALUE 0x8004196E Val_Wu8 49. DFES_EnvTabVerb 0.00 49. FORMAT "%2.0" /end CHARACTERISTIC
/begin CHARACTERISTIC DFES_EnvRef.DFC_HEGOS1B1HtrPsMin_C "" VALUE 0x8004196F Val_Wu8 49. DFES_EnvTabVerb 0.00 49. FORMAT "%2.0" /end CHARACTERISTIC
/begin CHARACTERISTIC DFES_EnvRef.DFC_HEGOS1B1HtrPsSig_C "" VALUE 0x80041970 Val_Wu8 49. DFES_EnvTabVerb 0.00 49. FORMAT "%2.0" /end CHARACTERISTIC
/begin CHARACTERISTIC DFES_EnvRef.DFC_HEGOS1B1StkMax_C "" VALUE 0x80041971 Val_Wu8 49. DFES_EnvTabVerb 0.00 49. FORMAT "%2.0" /end CHARACTERISTIC
/begin CHARACTERISTIC DFES_EnvRef.DFC_HEGOS1B1StkMin_C "" VALUE 0x80041972 Val_Wu8 49. DFES_EnvTabVerb 0.00 49. FORMAT "%2.0" /end CHARACTERISTIC
/begin CHARACTERISTIC DFES_EnvRef.DFC_HEGOS2B1RstrcnLean_C "" VALUE 0x80041973 Val_Wu8 49. DFES_EnvTabVerb 0.00 49. FORMAT "%2.0" /end CHARACTERISTIC
/begin CHARACTERISTIC DFES_EnvRef.DFC_HEGOS2B1RstrcnRich_C "" VALUE 0x80041974 Val_Wu8 49. DFES_EnvTabVerb 0.00 49. FORMAT "%2.0" /end CHARACTERISTIC
/begin CHARACTERISTIC DFES_EnvRef.DFC_IdleChrgActrJamVlvClsd_C "" VALUE 0x80041975 Val_Wu8 49. DFES_EnvTabVerb 0.00 49. FORMAT "%2.0" /end CHARACTERISTIC
/begin CHARACTERISTIC DFES_EnvRef.DFC_IdleChrgActrJamVlvOpn_C "" VALUE 0x80041976 Val_Wu8 49. DFES_EnvTabVerb 0.00 49. FORMAT "%2.0" /end CHARACTERISTIC
/begin CHARACTERISTIC DFES_EnvRef.DFC_IgnClPsDevOscErr1_C "" VALUE 0x80041977 Val_Wu8 49. DFES_EnvTabVerb 0.00 49. FORMAT "%2.0" /end CHARACTERISTIC
/begin CHARACTERISTIC DFES_EnvRef.DFC_KPEmax_C "" VALUE 0x80041978 Val_Wu8 49. DFES_EnvTabVerb 0.00 49. FORMAT "%2.0" /end CHARACTERISTIC
/begin CHARACTERISTIC DFES_EnvRef.DFC_KPEmin_C "" VALUE 0x80041979 Val_Wu8 49. DFES_EnvTabVerb 0.00 49. FORMAT "%2.0" /end CHARACTERISTIC
/begin CHARACTERISTIC DFES_EnvRef.DFC_KPEsig_C "" VALUE 0x8004197A Val_Wu8 49. DFES_EnvTabVerb 0.00 49. FORMAT "%2.0" /end CHARACTERISTIC
/begin CHARACTERISTIC DFES_EnvRef.DFC_KS1max_C "" VALUE 0x8004197B Val_Wu8 49. DFES_EnvTabVerb 0.00 49. FORMAT "%2.0" /end CHARACTERISTIC
/begin CHARACTERISTIC DFES_EnvRef.DFC_KS1min_C "" VALUE 0x8004197C Val_Wu8 49. DFES_EnvTabVerb 0.00 49. FORMAT "%2.0" /end CHARACTERISTIC
/begin CHARACTERISTIC DFES_EnvRef.DFC_LLRKHmax_C "" VALUE 0x8004197D Val_Wu8 49. DFES_EnvTabVerb 0.00 49. FORMAT "%2.0" /end CHARACTERISTIC
/begin CHARACTERISTIC DFES_EnvRef.DFC_LLRKHmin_C "" VALUE 0x8004197E Val_Wu8 49. DFES_EnvTabVerb 0.00 49. FORMAT "%2.0" /end CHARACTERISTIC
/begin CHARACTERISTIC DFES_EnvRef.DFC_LLRKHnpl_C "" VALUE 0x8004197F Val_Wu8 49. DFES_EnvTabVerb 0.00 49. FORMAT "%2.0" /end CHARACTERISTIC
/begin CHARACTERISTIC DFES_EnvRef.DFC_LLRmax_C "" VALUE 0x80041980 Val_Wu8 49. DFES_EnvTabVerb 0.00 49. FORMAT "%2.0" /end CHARACTERISTIC
/begin CHARACTERISTIC DFES_EnvRef.DFC_LLRmin_C "" VALUE 0x80041981 Val_Wu8 49. DFES_EnvTabVerb 0.00 49. FORMAT "%2.0" /end CHARACTERISTIC
/begin CHARACTERISTIC DFES_EnvRef.DFC_LLRnpl_C "" VALUE 0x80041982 Val_Wu8 49. DFES_EnvTabVerb 0.00 49. FORMAT "%2.0" /end CHARACTERISTIC
/begin CHARACTERISTIC DFES_EnvRef.DFC_LMmax_C "" VALUE 0x80041983 Val_Wu8 49. DFES_EnvTabVerb 0.00 49. FORMAT "%2.0" /end CHARACTERISTIC
/begin CHARACTERISTIC DFES_EnvRef.DFC_LZSRnpl_C "" VALUE 0x80041984 Val_Wu8 49. DFES_EnvTabVerb 0.00 49. FORMAT "%2.0" /end CHARACTERISTIC
/begin CHARACTERISTIC DFES_EnvRef.DFC_MD_C "" VALUE 0x80041985 Val_Wu8 49. DFES_EnvTabVerb 0.00 49. FORMAT "%2.0" /end CHARACTERISTIC
/begin CHARACTERISTIC DFES_EnvRef.DFC_MD00min_C "" VALUE 0x80041986 Val_Wu8 49. DFES_EnvTabVerb 0.00 49. FORMAT "%2.0" /end CHARACTERISTIC
/begin CHARACTERISTIC DFES_EnvRef.DFC_MD00npl_C "" VALUE 0x80041987 Val_Wu8 49. DFES_EnvTabVerb 0.00 49. FORMAT "%2.0" /end CHARACTERISTIC
/begin CHARACTERISTIC DFES_EnvRef.DFC_MD01min_C "" VALUE 0x80041988 Val_Wu8 49. DFES_EnvTabVerb 0.00 49. FORMAT "%2.0" /end CHARACTERISTIC
/begin CHARACTERISTIC DFES_EnvRef.DFC_MD01npl_C "" VALUE 0x80041989 Val_Wu8 49. DFES_EnvTabVerb 0.00 49. FORMAT "%2.0" /end CHARACTERISTIC
/begin CHARACTERISTIC DFES_EnvRef.DFC_MD02min_C "" VALUE 0x8004198A Val_Wu8 49. DFES_EnvTabVerb 0.00 49. FORMAT "%2.0" /end CHARACTERISTIC
/begin CHARACTERISTIC DFES_EnvRef.DFC_MD02npl_C "" VALUE 0x8004198B Val_Wu8 49. DFES_EnvTabVerb 0.00 49. FORMAT "%2.0" /end CHARACTERISTIC
/begin CHARACTERISTIC DFES_EnvRef.DFC_MD03min_C "" VALUE 0x8004198C Val_Wu8 49. DFES_EnvTabVerb 0.00 49. FORMAT "%2.0" /end CHARACTERISTIC
/begin CHARACTERISTIC DFES_EnvRef.DFC_MD03npl_C "" VALUE 0x8004198D Val_Wu8 49. DFES_EnvTabVerb 0.00 49. FORMAT "%2.0" /end CHARACTERISTIC
/begin CHARACTERISTIC DFES_EnvRef.DFC_MD04min_C "" VALUE 0x8004198E Val_Wu8 49. DFES_EnvTabVerb 0.00 49. FORMAT "%2.0" /end CHARACTERISTIC
/begin CHARACTERISTIC DFES_EnvRef.DFC_MD04npl_C "" VALUE 0x8004198F Val_Wu8 49. DFES_EnvTabVerb 0.00 49. FORMAT "%2.0" /end CHARACTERISTIC
/begin CHARACTERISTIC DFES_EnvRef.DFC_MDCyl_0_C "" VALUE 0x80041990 Val_Wu8 49. DFES_EnvTabVerb 0.00 49. FORMAT "%2.0" /end CHARACTERISTIC
/begin CHARACTERISTIC DFES_EnvRef.DFC_MDCyl_1_C "" VALUE 0x80041991 Val_Wu8 49. DFES_EnvTabVerb 0.00 49. FORMAT "%2.0" /end CHARACTERISTIC
/begin CHARACTERISTIC DFES_EnvRef.DFC_MDCyl_2_C "" VALUE 0x80041992 Val_Wu8 49. DFES_EnvTabVerb 0.00 49. FORMAT "%2.0" /end CHARACTERISTIC
/begin CHARACTERISTIC DFES_EnvRef.DFC_MDFC_C "" VALUE 0x80041993 Val_Wu8 49. DFES_EnvTabVerb 0.00 49. FORMAT "%2.0" /end CHARACTERISTIC
/begin CHARACTERISTIC DFES_EnvRef.DFC_MDmin_C "" VALUE 0x80041994 Val_Wu8 49. DFES_EnvTabVerb 0.00 49. FORMAT "%2.0" /end CHARACTERISTIC
/begin CHARACTERISTIC DFES_EnvRef.DFC_MDnpl_C "" VALUE 0x80041995 Val_Wu8 49. DFES_EnvTabVerb 0.00 49. FORMAT "%2.0" /end CHARACTERISTIC
/begin CHARACTERISTIC DFES_EnvRef.DFC_MoCADCNTP_C "" VALUE 0x80041996 Val_Wu8 49. DFES_EnvTabVerb 0.00 49. FORMAT "%2.0" /end CHARACTERISTIC
/begin CHARACTERISTIC DFES_EnvRef.DFC_MoCADCTst_C "" VALUE 0x80041997 Val_Wu8 49. DFES_EnvTabVerb 0.00 49. FORMAT "%2.0" /end CHARACTERISTIC
/begin CHARACTERISTIC DFES_EnvRef.DFC_MoCComctErrMM_C "" VALUE 0x80041998 Val_Wu8 49. DFES_EnvTabVerb 0.00 49. FORMAT "%2.0" /end CHARACTERISTIC
/begin CHARACTERISTIC DFES_EnvRef.DFC_OCWDAActv_C "" VALUE 0x80041999 Val_Wu8 49. DFES_EnvTabVerb 0.00 49. FORMAT "%2.0" /end CHARACTERISTIC
/begin CHARACTERISTIC DFES_EnvRef.DFC_OCWDACom_C "" VALUE 0x8004199A Val_Wu8 49. DFES_EnvTabVerb 0.00 49. FORMAT "%2.0" /end CHARACTERISTIC
/begin CHARACTERISTIC DFES_EnvRef.DFC_ORAmax_C "" VALUE 0x8004199B Val_Wu8 49. DFES_EnvTabVerb 0.00 49. FORMAT "%2.0" /end CHARACTERISTIC
/begin CHARACTERISTIC DFES_EnvRef.DFC_ORAmin_C "" VALUE 0x8004199C Val_Wu8 49. DFES_EnvTabVerb 0.00 49. FORMAT "%2.0" /end CHARACTERISTIC
/begin CHARACTERISTIC DFES_EnvRef.DFC_PSR1max_C "" VALUE 0x8004199D Val_Wu8 49. DFES_EnvTabVerb 0.00 49. FORMAT "%2.0" /end CHARACTERISTIC
/begin CHARACTERISTIC DFES_EnvRef.DFC_PSRBmax_C "" VALUE 0x8004199E Val_Wu8 49. DFES_EnvTabVerb 0.00 49. FORMAT "%2.0" /end CHARACTERISTIC
/begin CHARACTERISTIC DFES_EnvRef.DFC_PSRBmin_C "" VALUE 0x8004199F Val_Wu8 49. DFES_EnvTabVerb 0.00 49. FORMAT "%2.0" /end CHARACTERISTIC
/begin CHARACTERISTIC DFES_EnvRef.DFC_PSREmax_C "" VALUE 0x800419A0 Val_Wu8 49. DFES_EnvTabVerb 0.00 49. FORMAT "%2.0" /end CHARACTERISTIC
/begin CHARACTERISTIC DFES_EnvRef.DFC_PSREmin_C "" VALUE 0x800419A1 Val_Wu8 49. DFES_EnvTabVerb 0.00 49. FORMAT "%2.0" /end CHARACTERISTIC
/begin CHARACTERISTIC DFES_EnvRef.DFC_PSRPmax_C "" VALUE 0x800419A2 Val_Wu8 49. DFES_EnvTabVerb 0.00 49. FORMAT "%2.0" /end CHARACTERISTIC
/begin CHARACTERISTIC DFES_EnvRef.DFC_PSRPmin_C "" VALUE 0x800419A3 Val_Wu8 49. DFES_EnvTabVerb 0.00 49. FORMAT "%2.0" /end CHARACTERISTIC
/begin CHARACTERISTIC DFES_EnvRef.DFC_PSRPsig_C "" VALUE 0x800419A4 Val_Wu8 49. DFES_EnvTabVerb 0.00 49. FORMAT "%2.0" /end CHARACTERISTIC
/begin CHARACTERISTIC DFES_EnvRef.DFC_PSRmax_C "" VALUE 0x800419A5 Val_Wu8 49. DFES_EnvTabVerb 0.00 49. FORMAT "%2.0" /end CHARACTERISTIC
/begin CHARACTERISTIC DFES_EnvRef.DFC_SSpMon1_C "" VALUE 0x800419A6 Val_Wu8 49. DFES_EnvTabVerb 0.00 49. FORMAT "%2.0" /end CHARACTERISTIC
/begin CHARACTERISTIC DFES_EnvRef.DFC_SSpMon2_C "" VALUE 0x800419A7 Val_Wu8 49. DFES_EnvTabVerb 0.00 49. FORMAT "%2.0" /end CHARACTERISTIC
/begin CHARACTERISTIC DFES_EnvRef.DFC_SSpMon3_C "" VALUE 0x800419A8 Val_Wu8 49. DFES_EnvTabVerb 0.00 49. FORMAT "%2.0" /end CHARACTERISTIC
/begin CHARACTERISTIC DFES_EnvRef.DFC_SWReset_0_C "" VALUE 0x800419A9 Val_Wu8 49. DFES_EnvTabVerb 0.00 49. FORMAT "%2.0" /end CHARACTERISTIC
/begin CHARACTERISTIC DFES_EnvRef.DFC_SWReset_1_C "" VALUE 0x800419AA Val_Wu8 49. DFES_EnvTabVerb 0.00 49. FORMAT "%2.0" /end CHARACTERISTIC
/begin CHARACTERISTIC DFES_EnvRef.DFC_SWReset_2_C "" VALUE 0x800419AB Val_Wu8 49. DFES_EnvTabVerb 0.00 49. FORMAT "%2.0" /end CHARACTERISTIC
/begin CHARACTERISTIC DFES_EnvRef.DFC_TASREmax_C "" VALUE 0x800419AC Val_Wu8 49. DFES_EnvTabVerb 0.00 49. FORMAT "%2.0" /end CHARACTERISTIC
/begin CHARACTERISTIC DFES_EnvRef.DFC_TASREmin_C "" VALUE 0x800419AD Val_Wu8 49. DFES_EnvTabVerb 0.00 49. FORMAT "%2.0" /end CHARACTERISTIC
/begin CHARACTERISTIC DFES_EnvRef.DFC_TASREnpl_C "" VALUE 0x800419AE Val_Wu8 49. DFES_EnvTabVerb 0.00 49. FORMAT "%2.0" /end CHARACTERISTIC
/begin CHARACTERISTIC DFES_EnvRef.DFC_TASRmax_C "" VALUE 0x800419AF Val_Wu8 49. DFES_EnvTabVerb 0.00 49. FORMAT "%2.0" /end CHARACTERISTIC
/begin CHARACTERISTIC DFES_EnvRef.DFC_TAmax_C "" VALUE 0x800419B0 Val_Wu8 49. DFES_EnvTabVerb 0.00 49. FORMAT "%2.0" /end CHARACTERISTIC
/begin CHARACTERISTIC DFES_EnvRef.DFC_TEVEmax_C "" VALUE 0x800419B1 Val_Wu8 49. DFES_EnvTabVerb 0.00 49. FORMAT "%2.0" /end CHARACTERISTIC
/begin CHARACTERISTIC DFES_EnvRef.DFC_TEVEmin_C "" VALUE 0x800419B2 Val_Wu8 49. DFES_EnvTabVerb 0.00 49. FORMAT "%2.0" /end CHARACTERISTIC
/begin CHARACTERISTIC DFES_EnvRef.DFC_TEVEsig_C "" VALUE 0x800419B3 Val_Wu8 49. DFES_EnvTabVerb 0.00 49. FORMAT "%2.0" /end CHARACTERISTIC
/begin CHARACTERISTIC DFES_EnvRef.DFC_TMCSmax_C "" VALUE 0x800419B4 Val_Wu8 49. DFES_EnvTabVerb 0.00 49. FORMAT "%2.0" /end CHARACTERISTIC
/begin CHARACTERISTIC DFES_EnvRef.DFC_TMCSmin_C "" VALUE 0x800419B5 Val_Wu8 49. DFES_EnvTabVerb 0.00 49. FORMAT "%2.0" /end CHARACTERISTIC
/begin CHARACTERISTIC DFES_EnvRef.DFC_TMEmax_C "" VALUE 0x800419B6 Val_Wu8 49. DFES_EnvTabVerb 0.00 49. FORMAT "%2.0" /end CHARACTERISTIC
/begin CHARACTERISTIC DFES_EnvRef.DFC_TMEmin_C "" VALUE 0x800419B7 Val_Wu8 49. DFES_EnvTabVerb 0.00 49. FORMAT "%2.0" /end CHARACTERISTIC
/begin CHARACTERISTIC DFES_EnvRef.DFC_TMEnpl_C "" VALUE 0x800419B8 Val_Wu8 49. DFES_EnvTabVerb 0.00 49. FORMAT "%2.0" /end CHARACTERISTIC
/begin CHARACTERISTIC DFES_EnvRef.DFC_TMEsig_C "" VALUE 0x800419B9 Val_Wu8 49. DFES_EnvTabVerb 0.00 49. FORMAT "%2.0" /end CHARACTERISTIC
/begin CHARACTERISTIC DFES_EnvRef.DFC_TMPmax_C "" VALUE 0x800419BA Val_Wu8 49. DFES_EnvTabVerb 0.00 49. FORMAT "%2.0" /end CHARACTERISTIC
/begin CHARACTERISTIC DFES_EnvRef.DFC_TMPmin_C "" VALUE 0x800419BB Val_Wu8 49. DFES_EnvTabVerb 0.00 49. FORMAT "%2.0" /end CHARACTERISTIC
/begin CHARACTERISTIC DFES_EnvRef.DFC_TMPnpl_C "" VALUE 0x800419BC Val_Wu8 49. DFES_EnvTabVerb 0.00 49. FORMAT "%2.0" /end CHARACTERISTIC
/begin CHARACTERISTIC DFES_EnvRef.DFC_TMmax_C "" VALUE 0x800419BD Val_Wu8 49. DFES_EnvTabVerb 0.00 49. FORMAT "%2.0" /end CHARACTERISTIC
/begin CHARACTERISTIC DFES_EnvRef.DFC_TUMmax_C "" VALUE 0x800419BE Val_Wu8 49. DFES_EnvTabVerb 0.00 49. FORMAT "%2.0" /end CHARACTERISTIC
/begin CHARACTERISTIC DFES_EnvRef.DFC_TWCCTrimMaxB1_C "" VALUE 0x800419BF Val_Wu8 49. DFES_EnvTabVerb 0.00 49. FORMAT "%2.0" /end CHARACTERISTIC
/begin CHARACTERISTIC DFES_EnvRef.DFC_TWCCTrimMinB1_C "" VALUE 0x800419C0 Val_Wu8 49. DFES_EnvTabVerb 0.00 49. FORMAT "%2.0" /end CHARACTERISTIC
/begin CHARACTERISTIC DFES_EnvRef.DFC_TWCDPriCatB1_C "" VALUE 0x800419C1 Val_Wu8 49. DFES_EnvTabVerb 0.00 49. FORMAT "%2.0" /end CHARACTERISTIC
/begin CHARACTERISTIC DFES_EnvRef.DFC_UBRmax_C "" VALUE 0x800419C2 Val_Wu8 49. DFES_EnvTabVerb 0.00 49. FORMAT "%2.0" /end CHARACTERISTIC
/begin CHARACTERISTIC DFES_EnvRef.DFC_UBmax_C "" VALUE 0x800419C3 Val_Wu8 49. DFES_EnvTabVerb 0.00 49. FORMAT "%2.0" /end CHARACTERISTIC
/begin CHARACTERISTIC DFES_EnvRef.DFC_UBmin_C "" VALUE 0x800419C4 Val_Wu8 49. DFES_EnvTabVerb 0.00 49. FORMAT "%2.0" /end CHARACTERISTIC
/begin CHARACTERISTIC DFES_EnvRef.DFC_UBnpl_C "" VALUE 0x800419C5 Val_Wu8 49. DFES_EnvTabVerb 0.00 49. FORMAT "%2.0" /end CHARACTERISTIC
/begin CHARACTERISTIC DFES_FaultTyp.DFC_Unused_C "" VALUE 0x800419C6 Val_Wu8 255.0 DFES_OneToOne 0.00 255.0 FORMAT "%5.1" READ_ONLY /end CHARACTERISTIC
/begin CHARACTERISTIC DFES_FaultTyp.DFC_AltMaxPwr_C "" VALUE 0x800419C7 Val_Wu8 255.0 DFES_OneToOne 0.00 255.0 FORMAT "%5.1" /end CHARACTERISTIC
/begin CHARACTERISTIC DFES_FaultTyp.DFC_BrkNpl_C "" VALUE 0x800419C8 Val_Wu8 255.0 DFES_OneToOne 0.00 255.0 FORMAT "%5.1" /end CHARACTERISTIC
/begin CHARACTERISTIC DFES_FaultTyp.DFC_Cj930SSp1Mon_C "" VALUE 0x800419C9 Val_Wu8 255.0 DFES_OneToOne 0.00 255.0 FORMAT "%5.1" /end CHARACTERISTIC
/begin CHARACTERISTIC DFES_FaultTyp.DFC_Cj930SSp2Mon_C "" VALUE 0x800419CA Val_Wu8 255.0 DFES_OneToOne 0.00 255.0 FORMAT "%5.1" /end CHARACTERISTIC
/begin CHARACTERISTIC DFES_FaultTyp.DFC_Cj930SSp3Mon_C "" VALUE 0x800419CB Val_Wu8 255.0 DFES_OneToOne 0.00 255.0 FORMAT "%5.1" /end CHARACTERISTIC
/begin CHARACTERISTIC DFES_FaultTyp.DFC_IdleChrgActrAMax_C "" VALUE 0x800419CC Val_Wu8 255.0 DFES_OneToOne 0.00 255.0 FORMAT "%5.1" /end CHARACTERISTIC
/begin CHARACTERISTIC DFES_FaultTyp.DFC_IdleChrgActrAMin_C "" VALUE 0x800419CD Val_Wu8 255.0 DFES_OneToOne 0.00 255.0 FORMAT "%5.1" /end CHARACTERISTIC
/begin CHARACTERISTIC DFES_FaultTyp.DFC_IdleChrgActrASig_C "" VALUE 0x800419CE Val_Wu8 255.0 DFES_OneToOne 0.00 255.0 FORMAT "%5.1" /end CHARACTERISTIC
/begin CHARACTERISTIC DFES_FaultTyp.DFC_IdleChrgActrBMax_C "" VALUE 0x800419CF Val_Wu8 255.0 DFES_OneToOne 0.00 255.0 FORMAT "%5.1" /end CHARACTERISTIC
/begin CHARACTERISTIC DFES_FaultTyp.DFC_IdleChrgActrBMin_C "" VALUE 0x800419D0 Val_Wu8 255.0 DFES_OneToOne 0.00 255.0 FORMAT "%5.1" /end CHARACTERISTIC
/begin CHARACTERISTIC DFES_FaultTyp.DFC_IdleChrgActrBSig_C "" VALUE 0x800419D1 Val_Wu8 255.0 DFES_OneToOne 0.00 255.0 FORMAT "%5.1" /end CHARACTERISTIC
/begin CHARACTERISTIC DFES_FaultTyp.DFC_IdleChrgActrGovDeCold_C "" VALUE 0x800419D2 Val_Wu8 255.0 DFES_OneToOne 0.00 255.0 FORMAT "%5.1" /end CHARACTERISTIC
/begin CHARACTERISTIC DFES_FaultTyp.DFC_IdleChrgActrGovDeMax_C "" VALUE 0x800419D3 Val_Wu8 255.0 DFES_OneToOne 0.00 255.0 FORMAT "%5.1" /end CHARACTERISTIC
/begin CHARACTERISTIC DFES_FaultTyp.DFC_IdleChrgActrGovDeMin_C "" VALUE 0x800419D4 Val_Wu8 255.0 DFES_OneToOne 0.00 255.0 FORMAT "%5.1" /end CHARACTERISTIC
/begin CHARACTERISTIC DFES_FaultTyp.DFC_IdleChrgActrNAMax_C "" VALUE 0x800419D5 Val_Wu8 255.0 DFES_OneToOne 0.00 255.0 FORMAT "%5.1" /end CHARACTERISTIC
/begin CHARACTERISTIC DFES_FaultTyp.DFC_IdleChrgActrNAMin_C "" VALUE 0x800419D6 Val_Wu8 255.0 DFES_OneToOne 0.00 255.0 FORMAT "%5.1" /end CHARACTERISTIC
/begin CHARACTERISTIC DFES_FaultTyp.DFC_IdleChrgActrNASig_C "" VALUE 0x800419D7 Val_Wu8 255.0 DFES_OneToOne 0.00 255.0 FORMAT "%5.1" /end CHARACTERISTIC
/begin CHARACTERISTIC DFES_FaultTyp.DFC_IdleChrgActrNBMax_C "" VALUE 0x800419D8 Val_Wu8 255.0 DFES_OneToOne 0.00 255.0 FORMAT "%5.1" /end CHARACTERISTIC
/begin CHARACTERISTIC DFES_FaultTyp.DFC_IdleChrgActrNBMin_C "" VALUE 0x800419D9 Val_Wu8 255.0 DFES_OneToOne 0.00 255.0 FORMAT "%5.1" /end CHARACTERISTIC
/begin CHARACTERISTIC DFES_FaultTyp.DFC_IdleChrgActrNBSig_C "" VALUE 0x800419DA Val_Wu8 255.0 DFES_OneToOne 0.00 255.0 FORMAT "%5.1" /end CHARACTERISTIC
/begin CHARACTERISTIC DFES_FaultTyp.DFC_IdleChrgActrOverTmp_C "" VALUE 0x800419DB Val_Wu8 255.0 DFES_OneToOne 0.00 255.0 FORMAT "%5.1" /end CHARACTERISTIC
/begin CHARACTERISTIC DFES_FaultTyp.DFC_MonUMaxSupply1_C "" VALUE 0x800419DC Val_Wu8 255.0 DFES_OneToOne 0.00 255.0 FORMAT "%5.1" /end CHARACTERISTIC
/begin CHARACTERISTIC DFES_FaultTyp.DFC_MonUMinSupply1_C "" VALUE 0x800419DD Val_Wu8 255.0 DFES_OneToOne 0.00 255.0 FORMAT "%5.1" /end CHARACTERISTIC
/begin CHARACTERISTIC DFES_FaultTyp.DFC_ClthNplClsd_C "" VALUE 0x800419DE Val_Wu8 255.0 DFES_OneToOne 0.00 255.0 FORMAT "%5.1" /end CHARACTERISTIC
/begin CHARACTERISTIC DFES_FaultTyp.DFC_ClthNplOpn_C "" VALUE 0x800419DF Val_Wu8 255.0 DFES_OneToOne 0.00 255.0 FORMAT "%5.1" /end CHARACTERISTIC
/begin CHARACTERISTIC DFES_FaultTyp.DFC_IgnClPsDevComErr1_C "" VALUE 0x800419E0 Val_Wu8 255.0 DFES_OneToOne 0.00 255.0 FORMAT "%5.1" /end CHARACTERISTIC
/begin CHARACTERISTIC DFES_FaultTyp.DFC_IgnClPsOpenLoad0_C "" VALUE 0x800419E1 Val_Wu8 255.0 DFES_OneToOne 0.00 255.0 FORMAT "%5.1" /end CHARACTERISTIC
/begin CHARACTERISTIC DFES_FaultTyp.DFC_IgnClPsOpenLoad1_C "" VALUE 0x800419E2 Val_Wu8 255.0 DFES_OneToOne 0.00 255.0 FORMAT "%5.1" /end CHARACTERISTIC
/begin CHARACTERISTIC DFES_FaultTyp.DFC_IgnClPsOpenLoad2_C "" VALUE 0x800419E3 Val_Wu8 255.0 DFES_OneToOne 0.00 255.0 FORMAT "%5.1" /end CHARACTERISTIC
/begin CHARACTERISTIC DFES_FaultTyp.DFC_IgnClPsShCirBatt0_C "" VALUE 0x800419E4 Val_Wu8 255.0 DFES_OneToOne 0.00 255.0 FORMAT "%5.1" /end CHARACTERISTIC
/begin CHARACTERISTIC DFES_FaultTyp.DFC_IgnClPsShCirBatt1_C "" VALUE 0x800419E5 Val_Wu8 255.0 DFES_OneToOne 0.00 255.0 FORMAT "%5.1" /end CHARACTERISTIC
/begin CHARACTERISTIC DFES_FaultTyp.DFC_IgnClPsShCirBatt2_C "" VALUE 0x800419E6 Val_Wu8 255.0 DFES_OneToOne 0.00 255.0 FORMAT "%5.1" /end CHARACTERISTIC
/begin CHARACTERISTIC DFES_FaultTyp.DFC_IgnClPsShCirGnd0_C "" VALUE 0x800419E7 Val_Wu8 255.0 DFES_OneToOne 0.00 255.0 FORMAT "%5.1" /end CHARACTERISTIC
/begin CHARACTERISTIC DFES_FaultTyp.DFC_IgnClPsShCirGnd1_C "" VALUE 0x800419E8 Val_Wu8 255.0 DFES_OneToOne 0.00 255.0 FORMAT "%5.1" /end CHARACTERISTIC
/begin CHARACTERISTIC DFES_FaultTyp.DFC_IgnClPsShCirGnd2_C "" VALUE 0x800419E9 Val_Wu8 255.0 DFES_OneToOne 0.00 255.0 FORMAT "%5.1" /end CHARACTERISTIC
/begin CHARACTERISTIC DFES_FaultTyp.DFC_KnDetSens1PortAMax_C "" VALUE 0x800419EA Val_Wu8 255.0 DFES_OneToOne 0.00 255.0 FORMAT "%5.1" /end CHARACTERISTIC
/begin CHARACTERISTIC DFES_FaultTyp.DFC_KnDetSens1PortAMin_C "" VALUE 0x800419EB Val_Wu8 255.0 DFES_OneToOne 0.00 255.0 FORMAT "%5.1" /end CHARACTERISTIC
/begin CHARACTERISTIC DFES_FaultTyp.DFC_KnDetSens1PortBMax_C "" VALUE 0x800419EC Val_Wu8 255.0 DFES_OneToOne 0.00 255.0 FORMAT "%5.1" /end CHARACTERISTIC
/begin CHARACTERISTIC DFES_FaultTyp.DFC_KnDetSens1PortBMin_C "" VALUE 0x800419ED Val_Wu8 255.0 DFES_OneToOne 0.00 255.0 FORMAT "%5.1" /end CHARACTERISTIC
/begin CHARACTERISTIC DFES_FaultTyp.DFC_VehVWhlErr_C "" VALUE 0x800419EE Val_Wu8 255.0 DFES_OneToOne 0.00 255.0 FORMAT "%5.1" /end CHARACTERISTIC
/begin CHARACTERISTIC DFES_FaultTyp.DFC_AirCCmprOL_C "" VALUE 0x800419EF Val_Wu8 255.0 DFES_OneToOne 0.00 255.0 FORMAT "%5.1" /end CHARACTERISTIC
/begin CHARACTERISTIC DFES_FaultTyp.DFC_AirCCmprOvrTemp_C "" VALUE 0x800419F0 Val_Wu8 255.0 DFES_OneToOne 0.00 255.0 FORMAT "%5.1" /end CHARACTERISTIC
/begin CHARACTERISTIC DFES_FaultTyp.DFC_AirCCmprSCB_C "" VALUE 0x800419F1 Val_Wu8 255.0 DFES_OneToOne 0.00 255.0 FORMAT "%5.1" /end CHARACTERISTIC
/begin CHARACTERISTIC DFES_FaultTyp.DFC_AirCCmprSCG_C "" VALUE 0x800419F2 Val_Wu8 255.0 DFES_OneToOne 0.00 255.0 FORMAT "%5.1" /end CHARACTERISTIC
/begin CHARACTERISTIC DFES_FaultTyp.DFC_AltIOLdSRCMin_C "" VALUE 0x800419F3 Val_Wu8 255.0 DFES_OneToOne 0.00 255.0 FORMAT "%5.1" /end CHARACTERISTIC
/begin CHARACTERISTIC DFES_FaultTyp.DFC_AltIOOL_C "" VALUE 0x800419F4 Val_Wu8 255.0 DFES_OneToOne 0.00 255.0 FORMAT "%5.1" /end CHARACTERISTIC
/begin CHARACTERISTIC DFES_FaultTyp.DFC_AltIOOvrTemp_C "" VALUE 0x800419F5 Val_Wu8 255.0 DFES_OneToOne 0.00 255.0 FORMAT "%5.1" /end CHARACTERISTIC
/begin CHARACTERISTIC DFES_FaultTyp.DFC_AltIOSCB_C "" VALUE 0x800419F6 Val_Wu8 255.0 DFES_OneToOne 0.00 255.0 FORMAT "%5.1" /end CHARACTERISTIC
/begin CHARACTERISTIC DFES_FaultTyp.DFC_AltIOSCG_C "" VALUE 0x800419F7 Val_Wu8 255.0 DFES_OneToOne 0.00 255.0 FORMAT "%5.1" /end CHARACTERISTIC
/begin CHARACTERISTIC DFES_FaultTyp.DFC_DevLibBattUHi_C "" VALUE 0x800419F8 Val_Wu8 255.0 DFES_OneToOne 0.00 255.0 FORMAT "%5.1" /end CHARACTERISTIC
/begin CHARACTERISTIC DFES_FaultTyp.DFC_DevLibBattULo_C "" VALUE 0x800419F9 Val_Wu8 255.0 DFES_OneToOne 0.00 255.0 FORMAT "%5.1" /end CHARACTERISTIC
/begin CHARACTERISTIC DFES_FaultTyp.DFC_FanDIOOL_C "" VALUE 0x800419FA Val_Wu8 255.0 DFES_OneToOne 0.00 255.0 FORMAT "%5.1" /end CHARACTERISTIC
/begin CHARACTERISTIC DFES_FaultTyp.DFC_FanDIOOvrTemp_C "" VALUE 0x800419FB Val_Wu8 255.0 DFES_OneToOne 0.00 255.0 FORMAT "%5.1" /end CHARACTERISTIC
/begin CHARACTERISTIC DFES_FaultTyp.DFC_FanDIOSCB_C "" VALUE 0x800419FC Val_Wu8 255.0 DFES_OneToOne 0.00 255.0 FORMAT "%5.1" /end CHARACTERISTIC
/begin CHARACTERISTIC DFES_FaultTyp.DFC_FanDIOSCG_C "" VALUE 0x800419FD Val_Wu8 255.0 DFES_OneToOne 0.00 255.0 FORMAT "%5.1" /end CHARACTERISTIC
/begin CHARACTERISTIC DFES_FaultTyp.DFC_FanPWMOL_C "" VALUE 0x800419FE Val_Wu8 255.0 DFES_OneToOne 0.00 255.0 FORMAT "%5.1" /end CHARACTERISTIC
/begin CHARACTERISTIC DFES_FaultTyp.DFC_FanPWMOvrTemp_C "" VALUE 0x800419FF Val_Wu8 255.0 DFES_OneToOne 0.00 255.0 FORMAT "%5.1" /end CHARACTERISTIC
/begin CHARACTERISTIC DFES_FaultTyp.DFC_FanPWMSCB_C "" VALUE 0x80041A00 Val_Wu8 255.0 DFES_OneToOne 0.00 255.0 FORMAT "%5.1" /end CHARACTERISTIC
/begin CHARACTERISTIC DFES_FaultTyp.DFC_FanPWMSCG_C "" VALUE 0x80041A01 Val_Wu8 255.0 DFES_OneToOne 0.00 255.0 FORMAT "%5.1" /end CHARACTERISTIC
/begin CHARACTERISTIC DFES_FaultTyp.DFC_AirCClntPAnaSRCMax_C "" VALUE 0x80041A02 Val_Wu8 255.0 DFES_OneToOne 0.00 255.0 FORMAT "%5.1" /end CHARACTERISTIC
/begin CHARACTERISTIC DFES_FaultTyp.DFC_AirCClntPAnaSRCMin_C "" VALUE 0x80041A03 Val_Wu8 255.0 DFES_OneToOne 0.00 255.0 FORMAT "%5.1" /end CHARACTERISTIC
/begin CHARACTERISTIC DFES_FaultTyp.DFC_AirCSwtNpl_C "" VALUE 0x80041A04 Val_Wu8 255.0 DFES_OneToOne 0.00 255.0 FORMAT "%5.1" /end CHARACTERISTIC
/begin CHARACTERISTIC DFES_FaultTyp.DFC_AirCSwtSig_C "" VALUE 0x80041A05 Val_Wu8 255.0 DFES_OneToOne 0.00 255.0 FORMAT "%5.1" /end CHARACTERISTIC
/begin CHARACTERISTIC DFES_FaultTyp.DFC_AltIOLdSRCMax_C "" VALUE 0x80041A06 Val_Wu8 255.0 DFES_OneToOne 0.00 255.0 FORMAT "%5.1" /end CHARACTERISTIC
/begin CHARACTERISTIC DFES_FaultTyp.DFC_BrkSig_C "" VALUE 0x80041A07 Val_Wu8 255.0 DFES_OneToOne 0.00 255.0 FORMAT "%5.1" /end CHARACTERISTIC
/begin CHARACTERISTIC DFES_FaultTyp.DFC_ClthEPBNpl_C "" VALUE 0x80041A08 Val_Wu8 255.0 DFES_OneToOne 0.00 255.0 FORMAT "%5.1" /end CHARACTERISTIC
/begin CHARACTERISTIC DFES_FaultTyp.DFC_ClthEPBSensErr_C "" VALUE 0x80041A09 Val_Wu8 255.0 DFES_OneToOne 0.00 255.0 FORMAT "%5.1" /end CHARACTERISTIC
/begin CHARACTERISTIC DFES_FaultTyp.DFC_ClthErr_C "" VALUE 0x80041A0A Val_Wu8 255.0 DFES_OneToOne 0.00 255.0 FORMAT "%5.1" /end CHARACTERISTIC
/begin CHARACTERISTIC DFES_FaultTyp.DFC_ClthSig_C "" VALUE 0x80041A0B Val_Wu8 255.0 DFES_OneToOne 0.00 255.0 FORMAT "%5.1" /end CHARACTERISTIC
/begin CHARACTERISTIC DFES_FaultTyp.DFC_MILLmpOL_C "" VALUE 0x80041A0C Val_Wu8 255.0 DFES_OneToOne 0.00 255.0 FORMAT "%5.1" /end CHARACTERISTIC
/begin CHARACTERISTIC DFES_FaultTyp.DFC_MILLmpSCB_C "" VALUE 0x80041A0D Val_Wu8 255.0 DFES_OneToOne 0.00 255.0 FORMAT "%5.1" /end CHARACTERISTIC
/begin CHARACTERISTIC DFES_FaultTyp.DFC_MILLmpSCG_C "" VALUE 0x80041A0E Val_Wu8 255.0 DFES_OneToOne 0.00 255.0 FORMAT "%5.1" /end CHARACTERISTIC
/begin CHARACTERISTIC DFES_FaultTyp.DFC_SRCHighAPP1_C "" VALUE 0x80041A0F Val_Wu8 255.0 DFES_OneToOne 0.00 255.0 FORMAT "%5.1" /end CHARACTERISTIC
/begin CHARACTERISTIC DFES_FaultTyp.DFC_SRCHighAPP2_C "" VALUE 0x80041A10 Val_Wu8 255.0 DFES_OneToOne 0.00 255.0 FORMAT "%5.1" /end CHARACTERISTIC
/begin CHARACTERISTIC DFES_FaultTyp.DFC_SRCLowAPP1_C "" VALUE 0x80041A11 Val_Wu8 255.0 DFES_OneToOne 0.00 255.0 FORMAT "%5.1" /end CHARACTERISTIC
/begin CHARACTERISTIC DFES_FaultTyp.DFC_SRCLowAPP2_C "" VALUE 0x80041A12 Val_Wu8 255.0 DFES_OneToOne 0.00 255.0 FORMAT "%5.1" /end CHARACTERISTIC
/begin CHARACTERISTIC DFES_FaultTyp.DFC_SyncAPP_C "" VALUE 0x80041A13 Val_Wu8 255.0 DFES_OneToOne 0.00 255.0 FORMAT "%5.1" /end CHARACTERISTIC
/begin CHARACTERISTIC DFES_FaultTyp.DFC_VehVMax_C "" VALUE 0x80041A14 Val_Wu8 255.0 DFES_OneToOne 0.00 255.0 FORMAT "%5.1" /end CHARACTERISTIC
/begin CHARACTERISTIC DFES_FaultTyp.DFC_VehVPlaus_C "" VALUE 0x80041A15 Val_Wu8 255.0 DFES_OneToOne 0.00 255.0 FORMAT "%5.1" /end CHARACTERISTIC
/begin CHARACTERISTIC DFES_FaultTyp.DFC_VehVSig_C "" VALUE 0x80041A16 Val_Wu8 255.0 DFES_OneToOne 0.00 255.0 FORMAT "%5.1" /end CHARACTERISTIC
/begin CHARACTERISTIC DFES_FaultTyp.DFC_BusDiagBusOffNodeA_C "" VALUE 0x80041A17 Val_Wu8 255.0 DFES_OneToOne 0.00 255.0 FORMAT "%5.1" /end CHARACTERISTIC
/begin CHARACTERISTIC DFES_FaultTyp.DFC_ComACSensTO_C "" VALUE 0x80041A18 Val_Wu8 255.0 DFES_OneToOne 0.00 255.0 FORMAT "%5.1" /end CHARACTERISTIC
/begin CHARACTERISTIC DFES_FaultTyp.DFC_ComAWD1TO_C "" VALUE 0x80041A19 Val_Wu8 255.0 DFES_OneToOne 0.00 255.0 FORMAT "%5.1" /end CHARACTERISTIC
/begin CHARACTERISTIC DFES_FaultTyp.DFC_ComBRK10TO_C "" VALUE 0x80041A1A Val_Wu8 255.0 DFES_OneToOne 0.00 255.0 FORMAT "%5.1" /end CHARACTERISTIC
/begin CHARACTERISTIC DFES_FaultTyp.DFC_ComGW11TO_C "" VALUE 0x80041A1B Val_Wu8 255.0 DFES_OneToOne 0.00 255.0 FORMAT "%5.1" /end CHARACTERISTIC
/begin CHARACTERISTIC DFES_FaultTyp.DFC_ComLVL1TO_C "" VALUE 0x80041A1C Val_Wu8 255.0 DFES_OneToOne 0.00 255.0 FORMAT "%5.1" /end CHARACTERISTIC
/begin CHARACTERISTIC DFES_FaultTyp.DFC_ComPRKA01TO_C "" VALUE 0x80041A1D Val_Wu8 255.0 DFES_OneToOne 0.00 255.0 FORMAT "%5.1" /end CHARACTERISTIC
/begin CHARACTERISTIC DFES_FaultTyp.DFC_ComPRKH01TO_C "" VALUE 0x80041A1E Val_Wu8 255.0 DFES_OneToOne 0.00 255.0 FORMAT "%5.1" /end CHARACTERISTIC
/begin CHARACTERISTIC DFES_FaultTyp.DFC_ComPRKH1TO_C "" VALUE 0x80041A1F Val_Wu8 255.0 DFES_OneToOne 0.00 255.0 FORMAT "%5.1" /end CHARACTERISTIC
/begin CHARACTERISTIC DFES_FaultTyp.DFC_ComTRBCH1TO_C "" VALUE 0x80041A20 Val_Wu8 255.0 DFES_OneToOne 0.00 255.0 FORMAT "%5.1" /end CHARACTERISTIC
/begin CHARACTERISTIC DFES_FaultTyp.DFC_ComTRBCH2TO_C "" VALUE 0x80041A21 Val_Wu8 255.0 DFES_OneToOne 0.00 255.0 FORMAT "%5.1" /end CHARACTERISTIC
/begin CHARACTERISTIC DFES_FaultTyp.DFC_DK_C "" VALUE 0x80041A22 Val_Wu8 255.0 DFES_OneToOne 0.00 255.0 FORMAT "%5.1" /end CHARACTERISTIC
/begin CHARACTERISTIC DFES_FaultTyp.DFC_DKRSA_C "" VALUE 0x80041A23 Val_Wu8 255.0 DFES_OneToOne 0.00 255.0 FORMAT "%5.1" /end CHARACTERISTIC
/begin CHARACTERISTIC DFES_FaultTyp.DFC_DKVSmax_C "" VALUE 0x80041A24 Val_Wu8 255.0 DFES_OneToOne 0.00 255.0 FORMAT "%5.1" /end CHARACTERISTIC
/begin CHARACTERISTIC DFES_FaultTyp.DFC_DKmax_C "" VALUE 0x80041A25 Val_Wu8 255.0 DFES_OneToOne 0.00 255.0 FORMAT "%5.1" /end CHARACTERISTIC
/begin CHARACTERISTIC DFES_FaultTyp.DFC_DKmin_C "" VALUE 0x80041A26 Val_Wu8 255.0 DFES_OneToOne 0.00 255.0 FORMAT "%5.1" /end CHARACTERISTIC
/begin CHARACTERISTIC DFES_FaultTyp.DFC_DSSmax_C "" VALUE 0x80041A27 Val_Wu8 255.0 DFES_OneToOne 0.00 255.0 FORMAT "%5.1" /end CHARACTERISTIC
/begin CHARACTERISTIC DFES_FaultTyp.DFC_EEPEraseErr_C "" VALUE 0x80041A28 Val_Wu8 255.0 DFES_OneToOne 0.00 255.0 FORMAT "%5.1" /end CHARACTERISTIC
/begin CHARACTERISTIC DFES_FaultTyp.DFC_EEPRdErr_C "" VALUE 0x80041A29 Val_Wu8 255.0 DFES_OneToOne 0.00 255.0 FORMAT "%5.1" /end CHARACTERISTIC
/begin CHARACTERISTIC DFES_FaultTyp.DFC_EEPWrErr_C "" VALUE 0x80041A2A Val_Wu8 255.0 DFES_OneToOne 0.00 255.0 FORMAT "%5.1" /end CHARACTERISTIC
/begin CHARACTERISTIC DFES_FaultTyp.DFC_EV1max_C "" VALUE 0x80041A2B Val_Wu8 255.0 DFES_OneToOne 0.00 255.0 FORMAT "%5.1" /end CHARACTERISTIC
/begin CHARACTERISTIC DFES_FaultTyp.DFC_EV1min_C "" VALUE 0x80041A2C Val_Wu8 255.0 DFES_OneToOne 0.00 255.0 FORMAT "%5.1" /end CHARACTERISTIC
/begin CHARACTERISTIC DFES_FaultTyp.DFC_EV1sig_C "" VALUE 0x80041A2D Val_Wu8 255.0 DFES_OneToOne 0.00 255.0 FORMAT "%5.1" /end CHARACTERISTIC
/begin CHARACTERISTIC DFES_FaultTyp.DFC_EV2max_C "" VALUE 0x80041A2E Val_Wu8 255.0 DFES_OneToOne 0.00 255.0 FORMAT "%5.1" /end CHARACTERISTIC
/begin CHARACTERISTIC DFES_FaultTyp.DFC_EV2min_C "" VALUE 0x80041A2F Val_Wu8 255.0 DFES_OneToOne 0.00 255.0 FORMAT "%5.1" /end CHARACTERISTIC
/begin CHARACTERISTIC DFES_FaultTyp.DFC_EV2sig_C "" VALUE 0x80041A30 Val_Wu8 255.0 DFES_OneToOne 0.00 255.0 FORMAT "%5.1" /end CHARACTERISTIC
/begin CHARACTERISTIC DFES_FaultTyp.DFC_EV3max_C "" VALUE 0x80041A31 Val_Wu8 255.0 DFES_OneToOne 0.00 255.0 FORMAT "%5.1" /end CHARACTERISTIC
/begin CHARACTERISTIC DFES_FaultTyp.DFC_EV3min_C "" VALUE 0x80041A32 Val_Wu8 255.0 DFES_OneToOne 0.00 255.0 FORMAT "%5.1" /end CHARACTERISTIC
/begin CHARACTERISTIC DFES_FaultTyp.DFC_EV3sig_C "" VALUE 0x80041A33 Val_Wu8 255.0 DFES_OneToOne 0.00 255.0 FORMAT "%5.1" /end CHARACTERISTIC
/begin CHARACTERISTIC DFES_FaultTyp.DFC_EpmCaSI1ErrSig_C "" VALUE 0x80041A34 Val_Wu8 255.0 DFES_OneToOne 0.00 255.0 FORMAT "%5.1" /end CHARACTERISTIC
/begin CHARACTERISTIC DFES_FaultTyp.DFC_EpmCaSI1NoSig_C "" VALUE 0x80041A35 Val_Wu8 255.0 DFES_OneToOne 0.00 255.0 FORMAT "%5.1" /end CHARACTERISTIC
/begin CHARACTERISTIC DFES_FaultTyp.DFC_EpmCaSI1NoSigMax_C "" VALUE 0x80041A36 Val_Wu8 255.0 DFES_OneToOne 0.00 255.0 FORMAT "%5.1" /end CHARACTERISTIC
/begin CHARACTERISTIC DFES_FaultTyp.DFC_EpmCaSI1NoSigMin_C "" VALUE 0x80041A37 Val_Wu8 255.0 DFES_OneToOne 0.00 255.0 FORMAT "%5.1" /end CHARACTERISTIC
/begin CHARACTERISTIC DFES_FaultTyp.DFC_EpmCaSI1OfsErr_C "" VALUE 0x80041A38 Val_Wu8 255.0 DFES_OneToOne 0.00 255.0 FORMAT "%5.1" /end CHARACTERISTIC
/begin CHARACTERISTIC DFES_FaultTyp.DFC_EpmCrSErrSig_C "" VALUE 0x80041A39 Val_Wu8 255.0 DFES_OneToOne 0.00 255.0 FORMAT "%5.1" /end CHARACTERISTIC
/begin CHARACTERISTIC DFES_FaultTyp.DFC_EpmCrSNoSig_C "" VALUE 0x80041A3A Val_Wu8 255.0 DFES_OneToOne 0.00 255.0 FORMAT "%5.1" /end CHARACTERISTIC
/begin CHARACTERISTIC DFES_FaultTyp.DFC_FRAmax_C "" VALUE 0x80041A3B Val_Wu8 255.0 DFES_OneToOne 0.00 255.0 FORMAT "%5.1" /end CHARACTERISTIC
/begin CHARACTERISTIC DFES_FaultTyp.DFC_FRAmin_C "" VALUE 0x80041A3C Val_Wu8 255.0 DFES_OneToOne 0.00 255.0 FORMAT "%5.1" /end CHARACTERISTIC
/begin CHARACTERISTIC DFES_FaultTyp.DFC_HEGOS1B1ElecMax_C "" VALUE 0x80041A3D Val_Wu8 255.0 DFES_OneToOne 0.00 255.0 FORMAT "%5.1" /end CHARACTERISTIC
/begin CHARACTERISTIC DFES_FaultTyp.DFC_HEGOS1B1ElecMin_C "" VALUE 0x80041A3E Val_Wu8 255.0 DFES_OneToOne 0.00 255.0 FORMAT "%5.1" /end CHARACTERISTIC
/begin CHARACTERISTIC DFES_FaultTyp.DFC_HEGOS1B1ElecNpl_C "" VALUE 0x80041A3F Val_Wu8 255.0 DFES_OneToOne 0.00 255.0 FORMAT "%5.1" /end CHARACTERISTIC
/begin CHARACTERISTIC DFES_FaultTyp.DFC_HEGOS1B1ElecSig_C "" VALUE 0x80041A40 Val_Wu8 255.0 DFES_OneToOne 0.00 255.0 FORMAT "%5.1" /end CHARACTERISTIC
/begin CHARACTERISTIC DFES_FaultTyp.DFC_HEGOS1B1HtgNpl_C "" VALUE 0x80041A41 Val_Wu8 255.0 DFES_OneToOne 0.00 255.0 FORMAT "%5.1" /end CHARACTERISTIC
/begin CHARACTERISTIC DFES_FaultTyp.DFC_HEGOS1B1HtrPsMax_C "" VALUE 0x80041A42 Val_Wu8 255.0 DFES_OneToOne 0.00 255.0 FORMAT "%5.1" /end CHARACTERISTIC
/begin CHARACTERISTIC DFES_FaultTyp.DFC_HEGOS1B1HtrPsMin_C "" VALUE 0x80041A43 Val_Wu8 255.0 DFES_OneToOne 0.00 255.0 FORMAT "%5.1" /end CHARACTERISTIC
/begin CHARACTERISTIC DFES_FaultTyp.DFC_HEGOS1B1HtrPsSig_C "" VALUE 0x80041A44 Val_Wu8 255.0 DFES_OneToOne 0.00 255.0 FORMAT "%5.1" /end CHARACTERISTIC
/begin CHARACTERISTIC DFES_FaultTyp.DFC_HEGOS1B1StkMax_C "" VALUE 0x80041A45 Val_Wu8 255.0 DFES_OneToOne 0.00 255.0 FORMAT "%5.1" /end CHARACTERISTIC
/begin CHARACTERISTIC DFES_FaultTyp.DFC_HEGOS1B1StkMin_C "" VALUE 0x80041A46 Val_Wu8 255.0 DFES_OneToOne 0.00 255.0 FORMAT "%5.1" /end CHARACTERISTIC
/begin CHARACTERISTIC DFES_FaultTyp.DFC_HEGOS2B1RstrcnLean_C "" VALUE 0x80041A47 Val_Wu8 255.0 DFES_OneToOne 0.00 255.0 FORMAT "%5.1" /end CHARACTERISTIC
/begin CHARACTERISTIC DFES_FaultTyp.DFC_HEGOS2B1RstrcnRich_C "" VALUE 0x80041A48 Val_Wu8 255.0 DFES_OneToOne 0.00 255.0 FORMAT "%5.1" /end CHARACTERISTIC
/begin CHARACTERISTIC DFES_FaultTyp.DFC_IdleChrgActrJamVlvClsd_C "" VALUE 0x80041A49 Val_Wu8 255.0 DFES_OneToOne 0.00 255.0 FORMAT "%5.1" /end CHARACTERISTIC
/begin CHARACTERISTIC DFES_FaultTyp.DFC_IdleChrgActrJamVlvOpn_C "" VALUE 0x80041A4A Val_Wu8 255.0 DFES_OneToOne 0.00 255.0 FORMAT "%5.1" /end CHARACTERISTIC
/begin CHARACTERISTIC DFES_FaultTyp.DFC_IgnClPsDevOscErr1_C "" VALUE 0x80041A4B Val_Wu8 255.0 DFES_OneToOne 0.00 255.0 FORMAT "%5.1" /end CHARACTERISTIC
/begin CHARACTERISTIC DFES_FaultTyp.DFC_KPEmax_C "" VALUE 0x80041A4C Val_Wu8 255.0 DFES_OneToOne 0.00 255.0 FORMAT "%5.1" /end CHARACTERISTIC
/begin CHARACTERISTIC DFES_FaultTyp.DFC_KPEmin_C "" VALUE 0x80041A4D Val_Wu8 255.0 DFES_OneToOne 0.00 255.0 FORMAT "%5.1" /end CHARACTERISTIC
/begin CHARACTERISTIC DFES_FaultTyp.DFC_KPEsig_C "" VALUE 0x80041A4E Val_Wu8 255.0 DFES_OneToOne 0.00 255.0 FORMAT "%5.1" /end CHARACTERISTIC
/begin CHARACTERISTIC DFES_FaultTyp.DFC_KS1max_C "" VALUE 0x80041A4F Val_Wu8 255.0 DFES_OneToOne 0.00 255.0 FORMAT "%5.1" /end CHARACTERISTIC
/begin CHARACTERISTIC DFES_FaultTyp.DFC_KS1min_C "" VALUE 0x80041A50 Val_Wu8 255.0 DFES_OneToOne 0.00 255.0 FORMAT "%5.1" /end CHARACTERISTIC
/begin CHARACTERISTIC DFES_FaultTyp.DFC_LLRKHmax_C "" VALUE 0x80041A51 Val_Wu8 255.0 DFES_OneToOne 0.00 255.0 FORMAT "%5.1" /end CHARACTERISTIC
/begin CHARACTERISTIC DFES_FaultTyp.DFC_LLRKHmin_C "" VALUE 0x80041A52 Val_Wu8 255.0 DFES_OneToOne 0.00 255.0 FORMAT "%5.1" /end CHARACTERISTIC
/begin CHARACTERISTIC DFES_FaultTyp.DFC_LLRKHnpl_C "" VALUE 0x80041A53 Val_Wu8 255.0 DFES_OneToOne 0.00 255.0 FORMAT "%5.1" /end CHARACTERISTIC
/begin CHARACTERISTIC DFES_FaultTyp.DFC_LLRmax_C "" VALUE 0x80041A54 Val_Wu8 255.0 DFES_OneToOne 0.00 255.0 FORMAT "%5.1" /end CHARACTERISTIC
/begin CHARACTERISTIC DFES_FaultTyp.DFC_LLRmin_C "" VALUE 0x80041A55 Val_Wu8 255.0 DFES_OneToOne 0.00 255.0 FORMAT "%5.1" /end CHARACTERISTIC
/begin CHARACTERISTIC DFES_FaultTyp.DFC_LLRnpl_C "" VALUE 0x80041A56 Val_Wu8 255.0 DFES_OneToOne 0.00 255.0 FORMAT "%5.1" /end CHARACTERISTIC
/begin CHARACTERISTIC DFES_FaultTyp.DFC_LMmax_C "" VALUE 0x80041A57 Val_Wu8 255.0 DFES_OneToOne 0.00 255.0 FORMAT "%5.1" /end CHARACTERISTIC
/begin CHARACTERISTIC DFES_FaultTyp.DFC_LZSRnpl_C "" VALUE 0x80041A58 Val_Wu8 255.0 DFES_OneToOne 0.00 255.0 FORMAT "%5.1" /end CHARACTERISTIC
/begin CHARACTERISTIC DFES_FaultTyp.DFC_MD_C "" VALUE 0x80041A59 Val_Wu8 255.0 DFES_OneToOne 0.00 255.0 FORMAT "%5.1" /end CHARACTERISTIC
/begin CHARACTERISTIC DFES_FaultTyp.DFC_MD00min_C "" VALUE 0x80041A5A Val_Wu8 255.0 DFES_OneToOne 0.00 255.0 FORMAT "%5.1" /end CHARACTERISTIC
/begin CHARACTERISTIC DFES_FaultTyp.DFC_MD00npl_C "" VALUE 0x80041A5B Val_Wu8 255.0 DFES_OneToOne 0.00 255.0 FORMAT "%5.1" /end CHARACTERISTIC
/begin CHARACTERISTIC DFES_FaultTyp.DFC_MD01min_C "" VALUE 0x80041A5C Val_Wu8 255.0 DFES_OneToOne 0.00 255.0 FORMAT "%5.1" /end CHARACTERISTIC
/begin CHARACTERISTIC DFES_FaultTyp.DFC_MD01npl_C "" VALUE 0x80041A5D Val_Wu8 255.0 DFES_OneToOne 0.00 255.0 FORMAT "%5.1" /end CHARACTERISTIC
/begin CHARACTERISTIC DFES_FaultTyp.DFC_MD02min_C "" VALUE 0x80041A5E Val_Wu8 255.0 DFES_OneToOne 0.00 255.0 FORMAT "%5.1" /end CHARACTERISTIC
/begin CHARACTERISTIC DFES_FaultTyp.DFC_MD02npl_C "" VALUE 0x80041A5F Val_Wu8 255.0 DFES_OneToOne 0.00 255.0 FORMAT "%5.1" /end CHARACTERISTIC
/begin CHARACTERISTIC DFES_FaultTyp.DFC_MD03min_C "" VALUE 0x80041A60 Val_Wu8 255.0 DFES_OneToOne 0.00 255.0 FORMAT "%5.1" /end CHARACTERISTIC
/begin CHARACTERISTIC DFES_FaultTyp.DFC_MD03npl_C "" VALUE 0x80041A61 Val_Wu8 255.0 DFES_OneToOne 0.00 255.0 FORMAT "%5.1" /end CHARACTERISTIC
/begin CHARACTERISTIC DFES_FaultTyp.DFC_MD04min_C "" VALUE 0x80041A62 Val_Wu8 255.0 DFES_OneToOne 0.00 255.0 FORMAT "%5.1" /end CHARACTERISTIC
/begin CHARACTERISTIC DFES_FaultTyp.DFC_MD04npl_C "" VALUE 0x80041A63 Val_Wu8 255.0 DFES_OneToOne 0.00 255.0 FORMAT "%5.1" /end CHARACTERISTIC
/begin CHARACTERISTIC DFES_FaultTyp.DFC_MDCyl_0_C "" VALUE 0x80041A64 Val_Wu8 255.0 DFES_OneToOne 0.00 255.0 FORMAT "%5.1" /end CHARACTERISTIC
/begin CHARACTERISTIC DFES_FaultTyp.DFC_MDCyl_1_C "" VALUE 0x80041A65 Val_Wu8 255.0 DFES_OneToOne 0.00 255.0 FORMAT "%5.1" /end CHARACTERISTIC
/begin CHARACTERISTIC DFES_FaultTyp.DFC_MDCyl_2_C "" VALUE 0x80041A66 Val_Wu8 255.0 DFES_OneToOne 0.00 255.0 FORMAT "%5.1" /end CHARACTERISTIC
/begin CHARACTERISTIC DFES_FaultTyp.DFC_MDFC_C "" VALUE 0x80041A67 Val_Wu8 255.0 DFES_OneToOne 0.00 255.0 FORMAT "%5.1" /end CHARACTERISTIC
/begin CHARACTERISTIC DFES_FaultTyp.DFC_MDmin_C "" VALUE 0x80041A68 Val_Wu8 255.0 DFES_OneToOne 0.00 255.0 FORMAT "%5.1" /end CHARACTERISTIC
/begin CHARACTERISTIC DFES_FaultTyp.DFC_MDnpl_C "" VALUE 0x80041A69 Val_Wu8 255.0 DFES_OneToOne 0.00 255.0 FORMAT "%5.1" /end CHARACTERISTIC
/begin CHARACTERISTIC DFES_FaultTyp.DFC_MoCADCNTP_C "" VALUE 0x80041A6A Val_Wu8 255.0 DFES_OneToOne 0.00 255.0 FORMAT "%5.1" /end CHARACTERISTIC
/begin CHARACTERISTIC DFES_FaultTyp.DFC_MoCADCTst_C "" VALUE 0x80041A6B Val_Wu8 255.0 DFES_OneToOne 0.00 255.0 FORMAT "%5.1" /end CHARACTERISTIC
/begin CHARACTERISTIC DFES_FaultTyp.DFC_MoCComctErrMM_C "" VALUE 0x80041A6C Val_Wu8 255.0 DFES_OneToOne 0.00 255.0 FORMAT "%5.1" /end CHARACTERISTIC
/begin CHARACTERISTIC DFES_FaultTyp.DFC_OCWDAActv_C "" VALUE 0x80041A6D Val_Wu8 255.0 DFES_OneToOne 0.00 255.0 FORMAT "%5.1" /end CHARACTERISTIC
/begin CHARACTERISTIC DFES_FaultTyp.DFC_OCWDACom_C "" VALUE 0x80041A6E Val_Wu8 255.0 DFES_OneToOne 0.00 255.0 FORMAT "%5.1" /end CHARACTERISTIC
/begin CHARACTERISTIC DFES_FaultTyp.DFC_ORAmax_C "" VALUE 0x80041A6F Val_Wu8 255.0 DFES_OneToOne 0.00 255.0 FORMAT "%5.1" /end CHARACTERISTIC
/begin CHARACTERISTIC DFES_FaultTyp.DFC_ORAmin_C "" VALUE 0x80041A70 Val_Wu8 255.0 DFES_OneToOne 0.00 255.0 FORMAT "%5.1" /end CHARACTERISTIC
/begin CHARACTERISTIC DFES_FaultTyp.DFC_PSR1max_C "" VALUE 0x80041A71 Val_Wu8 255.0 DFES_OneToOne 0.00 255.0 FORMAT "%5.1" /end CHARACTERISTIC
/begin CHARACTERISTIC DFES_FaultTyp.DFC_PSRBmax_C "" VALUE 0x80041A72 Val_Wu8 255.0 DFES_OneToOne 0.00 255.0 FORMAT "%5.1" /end CHARACTERISTIC
/begin CHARACTERISTIC DFES_FaultTyp.DFC_PSRBmin_C "" VALUE 0x80041A73 Val_Wu8 255.0 DFES_OneToOne 0.00 255.0 FORMAT "%5.1" /end CHARACTERISTIC
/begin CHARACTERISTIC DFES_FaultTyp.DFC_PSREmax_C "" VALUE 0x80041A74 Val_Wu8 255.0 DFES_OneToOne 0.00 255.0 FORMAT "%5.1" /end CHARACTERISTIC
/begin CHARACTERISTIC DFES_FaultTyp.DFC_PSREmin_C "" VALUE 0x80041A75 Val_Wu8 255.0 DFES_OneToOne 0.00 255.0 FORMAT "%5.1" /end CHARACTERISTIC
/begin CHARACTERISTIC DFES_FaultTyp.DFC_PSRPmax_C "" VALUE 0x80041A76 Val_Wu8 255.0 DFES_OneToOne 0.00 255.0 FORMAT "%5.1" /end CHARACTERISTIC
/begin CHARACTERISTIC DFES_FaultTyp.DFC_PSRPmin_C "" VALUE 0x80041A77 Val_Wu8 255.0 DFES_OneToOne 0.00 255.0 FORMAT "%5.1" /end CHARACTERISTIC
/begin CHARACTERISTIC DFES_FaultTyp.DFC_PSRPsig_C "" VALUE 0x80041A78 Val_Wu8 255.0 DFES_OneToOne 0.00 255.0 FORMAT "%5.1" /end CHARACTERISTIC
/begin CHARACTERISTIC DFES_FaultTyp.DFC_PSRmax_C "" VALUE 0x80041A79 Val_Wu8 255.0 DFES_OneToOne 0.00 255.0 FORMAT "%5.1" /end CHARACTERISTIC
/begin CHARACTERISTIC DFES_FaultTyp.DFC_SSpMon1_C "" VALUE 0x80041A7A Val_Wu8 255.0 DFES_OneToOne 0.00 255.0 FORMAT "%5.1" /end CHARACTERISTIC
/begin CHARACTERISTIC DFES_FaultTyp.DFC_SSpMon2_C "" VALUE 0x80041A7B Val_Wu8 255.0 DFES_OneToOne 0.00 255.0 FORMAT "%5.1" /end CHARACTERISTIC
/begin CHARACTERISTIC DFES_FaultTyp.DFC_SSpMon3_C "" VALUE 0x80041A7C Val_Wu8 255.0 DFES_OneToOne 0.00 255.0 FORMAT "%5.1" /end CHARACTERISTIC
/begin CHARACTERISTIC DFES_FaultTyp.DFC_SWReset_0_C "" VALUE 0x80041A7D Val_Wu8 255.0 DFES_OneToOne 0.00 255.0 FORMAT "%5.1" /end CHARACTERISTIC
/begin CHARACTERISTIC DFES_FaultTyp.DFC_SWReset_1_C "" VALUE 0x80041A7E Val_Wu8 255.0 DFES_OneToOne 0.00 255.0 FORMAT "%5.1" /end CHARACTERISTIC
/begin CHARACTERISTIC DFES_FaultTyp.DFC_SWReset_2_C "" VALUE 0x80041A7F Val_Wu8 255.0 DFES_OneToOne 0.00 255.0 FORMAT "%5.1" /end CHARACTERISTIC
/begin CHARACTERISTIC DFES_FaultTyp.DFC_TASREmax_C "" VALUE 0x80041A80 Val_Wu8 255.0 DFES_OneToOne 0.00 255.0 FORMAT "%5.1" /end CHARACTERISTIC
/begin CHARACTERISTIC DFES_FaultTyp.DFC_TASREmin_C "" VALUE 0x80041A81 Val_Wu8 255.0 DFES_OneToOne 0.00 255.0 FORMAT "%5.1" /end CHARACTERISTIC
/begin CHARACTERISTIC DFES_FaultTyp.DFC_TASREnpl_C "" VALUE 0x80041A82 Val_Wu8 255.0 DFES_OneToOne 0.00 255.0 FORMAT "%5.1" /end CHARACTERISTIC
/begin CHARACTERISTIC DFES_FaultTyp.DFC_TASRmax_C "" VALUE 0x80041A83 Val_Wu8 255.0 DFES_OneToOne 0.00 255.0 FORMAT "%5.1" /end CHARACTERISTIC
/begin CHARACTERISTIC DFES_FaultTyp.DFC_TAmax_C "" VALUE 0x80041A84 Val_Wu8 255.0 DFES_OneToOne 0.00 255.0 FORMAT "%5.1" /end CHARACTERISTIC
/begin CHARACTERISTIC DFES_FaultTyp.DFC_TEVEmax_C "" VALUE 0x80041A85 Val_Wu8 255.0 DFES_OneToOne 0.00 255.0 FORMAT "%5.1" /end CHARACTERISTIC
/begin CHARACTERISTIC DFES_FaultTyp.DFC_TEVEmin_C "" VALUE 0x80041A86 Val_Wu8 255.0 DFES_OneToOne 0.00 255.0 FORMAT "%5.1" /end CHARACTERISTIC
/begin CHARACTERISTIC DFES_FaultTyp.DFC_TEVEsig_C "" VALUE 0x80041A87 Val_Wu8 255.0 DFES_OneToOne 0.00 255.0 FORMAT "%5.1" /end CHARACTERISTIC
/begin CHARACTERISTIC DFES_FaultTyp.DFC_TMCSmax_C "" VALUE 0x80041A88 Val_Wu8 255.0 DFES_OneToOne 0.00 255.0 FORMAT "%5.1" /end CHARACTERISTIC
/begin CHARACTERISTIC DFES_FaultTyp.DFC_TMCSmin_C "" VALUE 0x80041A89 Val_Wu8 255.0 DFES_OneToOne 0.00 255.0 FORMAT "%5.1" /end CHARACTERISTIC
/begin CHARACTERISTIC DFES_FaultTyp.DFC_TMEmax_C "" VALUE 0x80041A8A Val_Wu8 255.0 DFES_OneToOne 0.00 255.0 FORMAT "%5.1" /end CHARACTERISTIC
/begin CHARACTERISTIC DFES_FaultTyp.DFC_TMEmin_C "" VALUE 0x80041A8B Val_Wu8 255.0 DFES_OneToOne 0.00 255.0 FORMAT "%5.1" /end CHARACTERISTIC
/begin CHARACTERISTIC DFES_FaultTyp.DFC_TMEnpl_C "" VALUE 0x80041A8C Val_Wu8 255.0 DFES_OneToOne 0.00 255.0 FORMAT "%5.1" /end CHARACTERISTIC
/begin CHARACTERISTIC DFES_FaultTyp.DFC_TMEsig_C "" VALUE 0x80041A8D Val_Wu8 255.0 DFES_OneToOne 0.00 255.0 FORMAT "%5.1" /end CHARACTERISTIC
/begin CHARACTERISTIC DFES_FaultTyp.DFC_TMPmax_C "" VALUE 0x80041A8E Val_Wu8 255.0 DFES_OneToOne 0.00 255.0 FORMAT "%5.1" /end CHARACTERISTIC
/begin FUNCTION DFES "2.9.0"
 /begin DEF_CHARACTERISTIC DFES_DbLv.DFC_AirCSwtNpl_C DFES_DbLv.DFC_AirCSwtSig_C DFES_DbLv.DFC_AltIOLdSRCMax_C DFES_DbLv.DFC_BrkSig_C DFES_DbLv.DFC_ClthEPBNpl_C DFES_DbLv.DFC_ClthEPBSensErr_C DFES_DbLv.DFC_ClthErr_C DFES_DbLv.DFC_ClthSig_C DFES_DbLv.DFC_MILLmpOL_C DFES_DbLv.DFC_MILLmpSCB_C DFES_DbLv.DFC_MILLmpSCG_C DFES_DbLv.DFC_SRCHighAPP1_C DFES_DbLv.DFC_SRCHighAPP2_C DFES_DbLv.DFC_SRCLowAPP1_C DFES_DbLv.DFC_SRCLowAPP2_C DFES_DbLv.DFC_SyncAPP_C DFES_DbLv.DFC_VehVMax_C DFES_DbLv.DFC_VehVPlaus_C DFES_DbLv.DFC_VehVSig_C DFES_DbLv.DFC_BusDiagBusOffNodeA_C DFES_DbLv.DFC_ComACSensTO_C DFES_DbLv.DFC_ComAWD1TO_C DFES_DbLv.DFC_ComBRK10TO_C DFES_DbLv.DFC_ComGW11TO_C DFES_DbLv.DFC_ComLVL1TO_C DFES_DbLv.DFC_ComPRKA01TO_C DFES_DbLv.DFC_ComPRKH01TO_C DFES_DbLv.DFC_ComPRKH1TO_C DFES_DbLv.DFC_ComTRBCH1TO_C DFES_DbLv.DFC_ComTRBCH2TO_C DFES_DbLv.DFC_DK_C DFES_DbLv.DFC_DKRSA_C DFES_DbLv.DFC_DKVSmax_C DFES_DbLv.DFC_DKmax_C DFES_DbLv.DFC_DKmin_C DFES_DbLv.DFC_DSSmax_C DFES_DbLv.DFC_EEPEraseErr_C DFES_DbLv.DFC_EEPRdErr_C DFES_DbLv.DFC_EEPWrErr_C DFES_DbLv.DFC_EV1max_C DFES_DbLv.DFC_EV1min_C DFES_DbLv.DFC_EV1sig_C DFES_DbLv.DFC_EV2max_C DFES_DbLv.DFC_EV2min_C DFES_DbLv.DFC_EV2sig_C DFES_DbLv.DFC_EV3max_C DFES_DbLv.DFC_EV3min_C DFES_DbLv.DFC_EV3sig_C DFES_DbLv.DFC_EpmCaSI1ErrSig_C DFES_DbLv.DFC_EpmCaSI1NoSig_C DFES_DbLv.DFC_EpmCaSI1NoSigMax_C DFES_DbLv.DFC_EpmCaSI1NoSigMin_C DFES_DbLv.DFC_EpmCaSI1OfsErr_C DFES_DbLv.DFC_EpmCrSErrSig_C DFES_DbLv.DFC_EpmCrSNoSig_C DFES_DbLv.DFC_FRAmax_C DFES_DbLv.DFC_FRAmin_C DFES_DbLv.DFC_HEGOS1B1ElecMax_C DFES_DbLv.DFC_HEGOS1B1ElecMin_C DFES_DbLv.DFC_HEGOS1B1ElecNpl_C DFES_DbLv.DFC_HEGOS1B1ElecSig_C DFES_DbLv.DFC_HEGOS1B1HtgNpl_C DFES_DbLv.DFC_HEGOS1B1HtrPsMax_C DFES_DbLv.DFC_HEGOS1B1HtrPsMin_C DFES_DbLv.DFC_HEGOS1B1HtrPsSig_C DFES_DbLv.DFC_HEGOS1B1StkMax_C DFES_DbLv.DFC_HEGOS1B1StkMin_C DFES_DbLv.DFC_HEGOS2B1RstrcnLean_C DFES_DbLv.DFC_HEGOS2B1RstrcnRich_C DFES_DbLv.DFC_IdleChrgActrJamVlvClsd_C DFES_DbLv.DFC_IdleChrgActrJamVlvOpn_C DFES_DbLv.DFC_IgnClPsDevOscErr1_C DFES_DbLv.DFC_KPEmax_C DFES_DbLv.DFC_KPEmin_C DFES_DbLv.DFC_KPEsig_C DFES_DbLv.DFC_KS1max_C DFES_DbLv.DFC_KS1min_C DFES_DbLv.DFC_LLRKHmax_C DFES_DbLv.DFC_LLRKHmin_C DFES_DbLv.DFC_LLRKHnpl_C DFES_DbLv.DFC_LLRmax_C DFES_DbLv.DFC_LLRmin_C DFES_DbLv.DFC_LLRnpl_C DFES_DbLv.DFC_LMmax_C DFES_DbLv.DFC_LZSRnpl_C DFES_DbLv.DFC_MD_C DFES_DbLv.DFC_MD00min_C DFES_DbLv.DFC_MD00npl_C DFES_DbLv.DFC_MD01min_C DFES_DbLv.DFC_MD01npl_C DFES_DbLv.DFC_MD02min_C DFES_DbLv.DFC_MD02npl_C DFES_DbLv.DFC_MD03min_C DFES_DbLv.DFC_MD03npl_C DFES_DbLv.DFC_MD04min_C DFES_DbLv.DFC_MD04npl_C DFES_DbLv.DFC_MDCyl_0_C DFES_DbLv.DFC_MDCyl_1_C DFES_DbLv.DFC_MDCyl_2_C DFES_DbLv.DFC_MDFC_C DFES_DbLv.DFC_MDmin_C DFES_DbLv.DFC_MDnpl_C DFES_DbLv.DFC_MoCADCNTP_C DFES_DbLv.DFC_MoCADCTst_C DFES_DbLv.DFC_MoCComctErrMM_C DFES_DbLv.DFC_OCWDAActv_C DFES_DbLv.DFC_OCWDACom_C DFES_DbLv.DFC_ORAmax_C DFES_DbLv.DFC_ORAmin_C DFES_DbLv.DFC_PSR1max_C DFES_DbLv.DFC_PSRBmax_C DFES_DbLv.DFC_PSRBmin_C DFES_DbLv.DFC_PSREmax_C DFES_DbLv.DFC_PSREmin_C DFES_DbLv.DFC_PSRPmax_C DFES_DbLv.DFC_PSRPmin_C DFES_DbLv.DFC_PSRPsig_C DFES_DbLv.DFC_PSRmax_C DFES_DbLv.DFC_SSpMon1_C DFES_DbLv.DFC_SSpMon2_C DFES_DbLv.DFC_SSpMon3_C DFES_DbLv.DFC_SWReset_0_C DFES_DbLv.DFC_SWReset_1_C DFES_DbLv.DFC_SWReset_2_C DFES_DbLv.DFC_TASREmax_C DFES_DbLv.DFC_TASREmin_C DFES_DbLv.DFC_TASREnpl_C DFES_DbLv.DFC_TASRmax_C DFES_DbLv.DFC_TAmax_C DFES_DbLv.DFC_TEVEmax_C DFES_DbLv.DFC_TEVEmin_C DFES_DbLv.DFC_TEVEsig_C DFES_DbLv.DFC_TMCSmax_C DFES_DbLv.DFC_TMCSmin_C DFES_DbLv.DFC_TMEmax_C DFES_DbLv.DFC_TMEmin_C DFES_DbLv.DFC_TMEnpl_C DFES_DbLv.DFC_TMEsig_C DFES_DbLv.DFC_TMPmax_C DFES_DbLv.DFC_TMPmin_C DFES_DbLv.DFC_TMPnpl_C DFES_DbLv.DFC_TMmax_C DFES_DbLv.DFC_TUMmax_C DFES_DbLv.DFC_TWCCTrimMaxB1_C DFES_DbLv.DFC_TWCCTrimMinB1_C DFES_DbLv.DFC_TWCDPriCatB1_C DFES_DbLv.DFC_UBRmax_C DFES_DbLv.DFC_UBmax_C DFES_DbLv.DFC_UBmin_C DFES_DbLv.DFC_UBnpl_C DFES_DTCM.DFC_Unused_C DFES_DTCM.DFC_AltMaxPwr_C DFES_DTCM.DFC_BrkNpl_C DFES_DTCM.DFC_Cj930SSp1Mon_C DFES_DTCM.DFC_Cj930SSp2Mon_C DFES_DTCM.DFC_Cj930SSp3Mon_C DFES_DTCM.DFC_IdleChrgActrAMax_C DFES_DTCM.DFC_IdleChrgActrAMin_C DFES_DTCM.DFC_IdleChrgActrASig_C DFES_DTCM.DFC_IdleChrgActrBMax_C DFES_DTCM.DFC_IdleChrgActrBMin_C DFES_DTCM.DFC_IdleChrgActrBSig_C DFES_DTCM.DFC_IdleChrgActrGovDeCold_C DFES_DTCM.DFC_IdleChrgActrGovDeMax_C DFES_DTCM.DFC_IdleChrgActrGovDeMin_C DFES_DTCM.DFC_IdleChrgActrNAMax_C DFES_DTCM.DFC_IdleChrgActrNAMin_C DFES_DTCM.DFC_IdleChrgActrNASig_C DFES_DTCM.DFC_IdleChrgActrNBMax_C DFES_DTCM.DFC_IdleChrgActrNBMin_C DFES_DTCM.DFC_IdleChrgActrNBSig_C DFES_DTCM.DFC_IdleChrgActrOverTmp_C DFES_DTCM.DFC_MonUMaxSupply1_C DFES_DTCM.DFC_MonUMinSupply1_C DFES_DTCM.DFC_ClthNplClsd_C DFES_DTCM.DFC_ClthNplOpn_C DFES_DTCM.DFC_IgnClPsDevComErr1_C DFES_DTCM.DFC_IgnClPsOpenLoad0_C DFES_DTCM.DFC_IgnClPsOpenLoad1_C DFES_DTCM.DFC_IgnClPsOpenLoad2_C DFES_DTCM.DFC_IgnClPsShCirBatt0_C DFES_DTCM.DFC_IgnClPsShCirBatt1_C DFES_DTCM.DFC_IgnClPsShCirBatt2_C DFES_DTCM.DFC_IgnClPsShCirGnd0_C DFES_DTCM.DFC_IgnClPsShCirGnd1_C DFES_DTCM.DFC_IgnClPsShCirGnd2_C DFES_DTCM.DFC_KnDetSens1PortAMax_C DFES_DTCM.DFC_KnDetSens1PortAMin_C DFES_DTCM.DFC_KnDetSens1PortBMax_C DFES_DTCM.DFC_KnDetSens1PortBMin_C DFES_DTCM.DFC_VehVWhlErr_C DFES_DTCM.DFC_AirCCmprOL_C DFES_DTCM.DFC_AirCCmprOvrTemp_C DFES_DTCM.DFC_AirCCmprSCB_C DFES_DTCM.DFC_AirCCmprSCG_C DFES_DTCM.DFC_AltIOLdSRCMin_C DFES_DTCM.DFC_AltIOOL_C DFES_DTCM.DFC_AltIOOvrTemp_C DFES_DTCM.DFC_AltIOSCB_C DFES_DTCM.DFC_AltIOSCG_C DFES_DTCM.DFC_DevLibBattUHi_C DFES_DTCM.DFC_DevLibBattULo_C DFES_DTCM.DFC_FanDIOOL_C DFES_DTCM.DFC_FanDIOOvrTemp_C DFES_DTCM.DFC_FanDIOSCB_C DFES_DTCM.DFC_FanDIOSCG_C DFES_DTCM.DFC_FanPWMOL_C DFES_DTCM.DFC_FanPWMOvrTemp_C DFES_DTCM.DFC_FanPWMSCB_C DFES_DTCM.DFC_FanPWMSCG_C DFES_DTCM.DFC_AirCClntPAnaSRCMax_C DFES_DTCM.DFC_AirCClntPAnaSRCMin_C DFES_DTCM.DFC_AirCSwtNpl_C DFES_DTCM.DFC_AirCSwtSig_C DFES_DTCM.DFC_AltIOLdSRCMax_C DFES_DTCM.DFC_BrkSig_C DFES_DTCM.DFC_ClthEPBNpl_C DFES_DTCM.DFC_ClthEPBSensErr_C DFES_DTCM.DFC_ClthErr_C DFES_DTCM.DFC_ClthSig_C DFES_DTCM.DFC_MILLmpOL_C DFES_DTCM.DFC_MILLmpSCB_C DFES_DTCM.DFC_MILLmpSCG_C DFES_DTCM.DFC_SRCHighAPP1_C DFES_DTCM.DFC_SRCHighAPP2_C DFES_DTCM.DFC_SRCLowAPP1_C DFES_DTCM.DFC_SRCLowAPP2_C DFES_DTCM.DFC_SyncAPP_C DFES_DTCM.DFC_VehVMax_C DFES_DTCM.DFC_VehVPlaus_C DFES_DTCM.DFC_VehVSig_C DFES_DTCM.DFC_BusDiagBusOffNodeA_C DFES_DTCM.DFC_ComACSensTO_C DFES_DTCM.DFC_ComAWD1TO_C DFES_DTCM.DFC_ComBRK10TO_C DFES_DTCM.DFC_ComGW11TO_C DFES_DTCM.DFC_ComLVL1TO_C DFES_DTCM.DFC_ComPRKA01TO_C DFES_DTCM.DFC_ComPRKH01TO_C DFES_DTCM.DFC_ComPRKH1TO_C DFES_DTCM.DFC_ComTRBCH1TO_C DFES_DTCM.DFC_ComTRBCH2TO_C DFES_DTCM.DFC_DK_C DFES_DTCM.DFC_DKRSA_C DFES_DTCM.DFC_DKVSmax_C DFES_DTCM.DFC_DKmax_C DFES_DTCM.DFC_DKmin_C DFES_DTCM.DFC_DSSmax_C DFES_DTCM.DFC_EEPEraseErr_C DFES_DTCM.DFC_EEPRdErr_C DFES_DTCM.DFC_EEPWrErr_C DFES_DTCM.DFC_EV1max_C DFES_DTCM.DFC_EV1min_C DFES_DTCM.DFC_EV1sig_C DFES_DTCM.DFC_EV2max_C DFES_DTCM.DFC_EV2min_C DFES_DTCM.DFC_EV2sig_C DFES_DTCM.DFC_EV3max_C DFES_DTCM.DFC_EV3min_C DFES_DTCM.DFC_EV3sig_C DFES_DTCM.DFC_EpmCaSI1ErrSig_C DFES_DTCM.DFC_EpmCaSI1NoSig_C DFES_DTCM.DFC_EpmCaSI1NoSigMax_C DFES_DTCM.DFC_EpmCaSI1NoSigMin_C DFES_DTCM.DFC_EpmCaSI1OfsErr_C DFES_DTCM.DFC_EpmCrSErrSig_C DFES_DTCM.DFC_EpmCrSNoSig_C DFES_DTCM.DFC_FRAmax_C DFES_DTCM.DFC_FRAmin_C DFES_DTCM.DFC_HEGOS1B1ElecMax_C DFES_DTCM.DFC_HEGOS1B1ElecMin_C DFES_DTCM.DFC_HEGOS1B1ElecNpl_C DFES_DTCM.DFC_HEGOS1B1ElecSig_C DFES_DTCM.DFC_HEGOS1B1HtgNpl_C DFES_DTCM.DFC_HEGOS1B1HtrPsMax_C DFES_DTCM.DFC_HEGOS1B1HtrPsMin_C DFES_DTCM.DFC_HEGOS1B1HtrPsSig_C DFES_DTCM.DFC_HEGOS1B1StkMax_C DFES_DTCM.DFC_HEGOS1B1StkMin_C DFES_DTCM.DFC_HEGOS2B1RstrcnLean_C DFES_DTCM.DFC_HEGOS2B1RstrcnRich_C DFES_DTCM.DFC_IdleChrgActrJamVlvClsd_C DFES_DTCM.DFC_IdleChrgActrJamVlvOpn_C DFES_DTCM.DFC_IgnClPsDevOscErr1_C DFES_DTCM.DFC_KPEmax_C DFES_DTCM.DFC_KPEmin_C DFES_DTCM.DFC_KPEsig_C DFES_DTCM.DFC_KS1max_C DFES_DTCM.DFC_KS1min_C DFES_DTCM.DFC_LLRKHmax_C DFES_DTCM.DFC_LLRKHmin_C DFES_DTCM.DFC_LLRKHnpl_C DFES_DTCM.DFC_LLRmax_C DFES_DTCM.DFC_LLRmin_C DFES_DTCM.DFC_LLRnpl_C DFES_DTCM.DFC_LMmax_C DFES_DTCM.DFC_LZSRnpl_C DFES_DTCM.DFC_MD_C DFES_DTCM.DFC_MD00min_C DFES_DTCM.DFC_MD00npl_C DFES_DTCM.DFC_MD01min_C DFES_DTCM.DFC_MD01npl_C DFES_DTCM.DFC_MD02min_C DFES_DTCM.DFC_MD02npl_C DFES_DTCM.DFC_MD03min_C DFES_DTCM.DFC_MD03npl_C DFES_DTCM.DFC_MD04min_C DFES_DTCM.DFC_MD04npl_C DFES_DTCM.DFC_MDCyl_0_C DFES_DTCM.DFC_MDCyl_1_C DFES_DTCM.DFC_MDCyl_2_C DFES_DTCM.DFC_MDFC_C DFES_DTCM.DFC_MDmin_C DFES_DTCM.DFC_MDnpl_C DFES_DTCM.DFC_MoCADCNTP_C DFES_DTCM.DFC_MoCADCTst_C DFES_DTCM.DFC_MoCComctErrMM_C DFES_DTCM.DFC_OCWDAActv_C DFES_DTCM.DFC_OCWDACom_C DFES_DTCM.DFC_ORAmax_C DFES_DTCM.DFC_ORAmin_C DFES_DTCM.DFC_PSR1max_C DFES_DTCM.DFC_PSRBmax_C DFES_DTCM.DFC_PSRBmin_C DFES_DTCM.DFC_PSREmax_C DFES_DTCM.DFC_PSREmin_C DFES_DTCM.DFC_PSRPmax_C DFES_DTCM.DFC_PSRPmin_C DFES_DTCM.DFC_PSRPsig_C DFES_DTCM.DFC_PSRmax_C DFES_DTCM.DFC_SSpMon1_C DFES_DTCM.DFC_SSpMon2_C DFES_DTCM.DFC_SSpMon3_C DFES_DTCM.DFC_SWReset_0_C DFES_DTCM.DFC_SWReset_1_C DFES_DTCM.DFC_SWReset_2_C DFES_DTCM.DFC_TASREmax_C DFES_DTCM.DFC_TASREmin_C DFES_DTCM.DFC_TASREnpl_C DFES_DTCM.DFC_TASRmax_C DFES_DTCM.DFC_TAmax_C DFES_DTCM.DFC_TEVEmax_C DFES_DTCM.DFC_TEVEmin_C DFES_DTCM.DFC_TEVEsig_C DFES_DTCM.DFC_TMCSmax_C DFES_DTCM.DFC_TMCSmin_C DFES_DTCM.DFC_TMEmax_C DFES_DTCM.DFC_TMEmin_C DFES_DTCM.DFC_TMEnpl_C DFES_DTCM.DFC_TMEsig_C DFES_DTCM.DFC_TMPmax_C DFES_DTCM.DFC_TMPmin_C DFES_DTCM.DFC_TMPnpl_C DFES_DTCM.DFC_TMmax_C DFES_DTCM.DFC_TUMmax_C DFES_DTCM.DFC_TWCCTrimMaxB1_C DFES_DTCM.DFC_TWCCTrimMinB1_C DFES_DTCM.DFC_TWCDPriCatB1_C DFES_DTCM.DFC_UBRmax_C DFES_DTCM.DFC_UBmax_C DFES_DTCM.DFC_UBmin_C DFES_DTCM.DFC_UBnpl_C DFES_DTCO.DFC_Unused_C DFES_DTCO.DFC_AltMaxPwr_C DFES_DTCO.DFC_BrkNpl_C DFES_DTCO.DFC_Cj930SSp1Mon_C DFES_DTCO.DFC_Cj930SSp2Mon_C DFES_DTCO.DFC_Cj930SSp3Mon_C DFES_DTCO.DFC_IdleChrgActrAMax_C DFES_DTCO.DFC_IdleChrgActrAMin_C DFES_DTCO.DFC_IdleChrgActrASig_C DFES_DTCO.DFC_IdleChrgActrBMax_C DFES_DTCO.DFC_IdleChrgActrBMin_C DFES_DTCO.DFC_IdleChrgActrBSig_C DFES_DTCO.DFC_IdleChrgActrGovDeCold_C DFES_DTCO.DFC_IdleChrgActrGovDeMax_C DFES_DTCO.DFC_IdleChrgActrGovDeMin_C DFES_DTCO.DFC_IdleChrgActrNAMax_C DFES_DTCO.DFC_IdleChrgActrNAMin_C DFES_DTCO.DFC_IdleChrgActrNASig_C DFES_DTCO.DFC_IdleChrgActrNBMax_C DFES_DTCO.DFC_IdleChrgActrNBMin_C DFES_DTCO.DFC_IdleChrgActrNBSig_C DFES_DTCO.DFC_IdleChrgActrOverTmp_C DFES_DTCO.DFC_MonUMaxSupply1_C DFES_DTCO.DFC_MonUMinSupply1_C DFES_DTCO.DFC_ClthNplClsd_C DFES_DTCO.DFC_ClthNplOpn_C DFES_DTCO.DFC_IgnClPsDevComErr1_C DFES_DTCO.DFC_IgnClPsOpenLoad0_C DFES_DTCO.DFC_IgnClPsOpenLoad1_C DFES_DTCO.DFC_IgnClPsOpenLoad2_C DFES_DTCO.DFC_IgnClPsShCirBatt0_C DFES_DTCO.DFC_IgnClPsShCirBatt1_C DFES_DTCO.DFC_IgnClPsShCirBatt2_C DFES_DTCO.DFC_IgnClPsShCirGnd0_C DFES_DTCO.DFC_IgnClPsShCirGnd1_C DFES_DTCO.DFC_IgnClPsShCirGnd2_C DFES_DTCO.DFC_KnDetSens1PortAMax_C DFES_DTCO.DFC_KnDetSens1PortAMin_C DFES_DTCO.DFC_KnDetSens1PortBMax_C DFES_DTCO.DFC_KnDetSens1PortBMin_C DFES_DTCO.DFC_VehVWhlErr_C DFES_DTCO.DFC_AirCCmprOL_C DFES_DTCO.DFC_AirCCmprOvrTemp_C DFES_DTCO.DFC_AirCCmprSCB_C DFES_DTCO.DFC_AirCCmprSCG_C DFES_DTCO.DFC_AltIOLdSRCMin_C DFES_DTCO.DFC_AltIOOL_C DFES_DTCO.DFC_AltIOOvrTemp_C DFES_DTCO.DFC_AltIOSCB_C DFES_DTCO.DFC_AltIOSCG_C DFES_DTCO.DFC_DevLibBattUHi_C DFES_DTCO.DFC_DevLibBattULo_C DFES_DTCO.DFC_FanDIOOL_C DFES_DTCO.DFC_FanDIOOvrTemp_C DFES_DTCO.DFC_FanDIOSCB_C DFES_DTCO.DFC_FanDIOSCG_C DFES_DTCO.DFC_FanPWMOL_C DFES_DTCO.DFC_FanPWMOvrTemp_C DFES_DTCO.DFC_FanPWMSCB_C DFES_DTCO.DFC_FanPWMSCG_C DFES_DTCO.DFC_AirCClntPAnaSRCMax_C DFES_DTCO.DFC_AirCClntPAnaSRCMin_C DFES_DTCO.DFC_AirCSwtNpl_C DFES_DTCO.DFC_AirCSwtSig_C DFES_DTCO.DFC_AltIOLdSRCMax_C DFES_DTCO.DFC_BrkSig_C DFES_DTCO.DFC_ClthEPBNpl_C DFES_DTCO.DFC_ClthEPBSensErr_C DFES_DTCO.DFC_ClthErr_C DFES_DTCO.DFC_ClthSig_C DFES_DTCO.DFC_MILLmpOL_C DFES_DTCO.DFC_MILLmpSCB_C DFES_DTCO.DFC_MILLmpSCG_C DFES_DTCO.DFC_SRCHighAPP1_C DFES_DTCO.DFC_SRCHighAPP2_C DFES_DTCO.DFC_SRCLowAPP1_C DFES_DTCO.DFC_SRCLowAPP2_C DFES_DTCO.DFC_SyncAPP_C DFES_DTCO.DFC_VehVMax_C DFES_DTCO.DFC_VehVPlaus_C DFES_DTCO.DFC_VehVSig_C DFES_DTCO.DFC_BusDiagBusOffNodeA_C DFES_DTCO.DFC_ComACSensTO_C DFES_DTCO.DFC_ComAWD1TO_C DFES_DTCO.DFC_ComBRK10TO_C DFES_DTCO.DFC_ComGW11TO_C DFES_DTCO.DFC_ComLVL1TO_C DFES_DTCO.DFC_ComPRKA01TO_C DFES_DTCO.DFC_ComPRKH01TO_C DFES_DTCO.DFC_ComPRKH1TO_C DFES_DTCO.DFC_ComTRBCH1TO_C DFES_DTCO.DFC_ComTRBCH2TO_C DFES_DTCO.DFC_DK_C DFES_DTCO.DFC_DKRSA_C DFES_DTCO.DFC_DKVSmax_C DFES_DTCO.DFC_DKmax_C DFES_DTCO.DFC_DKmin_C DFES_DTCO.DFC_DSSmax_C DFES_DTCO.DFC_EEPEraseErr_C DFES_DTCO.DFC_EEPRdErr_C DFES_DTCO.DFC_EEPWrErr_C DFES_DTCO.DFC_EV1max_C DFES_DTCO.DFC_EV1min_C DFES_DTCO.DFC_EV1sig_C DFES_DTCO.DFC_EV2max_C DFES_DTCO.DFC_EV2min_C DFES_DTCO.DFC_EV2sig_C DFES_DTCO.DFC_EV3max_C DFES_DTCO.DFC_EV3min_C DFES_DTCO.DFC_EV3sig_C DFES_DTCO.DFC_EpmCaSI1ErrSig_C DFES_DTCO.DFC_EpmCaSI1NoSig_C DFES_DTCO.DFC_EpmCaSI1NoSigMax_C DFES_DTCO.DFC_EpmCaSI1NoSigMin_C DFES_DTCO.DFC_EpmCaSI1OfsErr_C DFES_DTCO.DFC_EpmCrSErrSig_C DFES_DTCO.DFC_EpmCrSNoSig_C DFES_DTCO.DFC_FRAmax_C DFES_DTCO.DFC_FRAmin_C DFES_DTCO.DFC_HEGOS1B1ElecMax_C DFES_DTCO.DFC_HEGOS1B1ElecMin_C DFES_DTCO.DFC_HEGOS1B1ElecNpl_C DFES_DTCO.DFC_HEGOS1B1ElecSig_C DFES_DTCO.DFC_HEGOS1B1HtgNpl_C DFES_DTCO.DFC_HEGOS1B1HtrPsMax_C DFES_DTCO.DFC_HEGOS1B1HtrPsMin_C DFES_DTCO.DFC_HEGOS1B1HtrPsSig_C DFES_DTCO.DFC_HEGOS1B1StkMax_C DFES_DTCO.DFC_HEGOS1B1StkMin_C DFES_DTCO.DFC_HEGOS2B1RstrcnLean_C DFES_DTCO.DFC_HEGOS2B1RstrcnRich_C DFES_DTCO.DFC_IdleChrgActrJamVlvClsd_C DFES_DTCO.DFC_IdleChrgActrJamVlvOpn_C DFES_DTCO.DFC_IgnClPsDevOscErr1_C DFES_DTCO.DFC_KPEmax_C DFES_DTCO.DFC_KPEmin_C DFES_DTCO.DFC_KPEsig_C DFES_DTCO.DFC_KS1max_C DFES_DTCO.DFC_KS1min_C DFES_DTCO.DFC_LLRKHmax_C DFES_DTCO.DFC_LLRKHmin_C DFES_DTCO.DFC_LLRKHnpl_C DFES_DTCO.DFC_LLRmax_C DFES_DTCO.DFC_LLRmin_C DFES_DTCO.DFC_LLRnpl_C DFES_DTCO.DFC_LMmax_C DFES_DTCO.DFC_LZSRnpl_C DFES_DTCO.DFC_MD_C DFES_DTCO.DFC_MD00min_C DFES_DTCO.DFC_MD00npl_C DFES_DTCO.DFC_MD01min_C DFES_DTCO.DFC_MD01npl_C DFES_DTCO.DFC_MD02min_C DFES_DTCO.DFC_MD02npl_C DFES_DTCO.DFC_MD03min_C DFES_DTCO.DFC_MD03npl_C DFES_DTCO.DFC_MD04min_C DFES_DTCO.DFC_MD04npl_C DFES_DTCO.DFC_MDCyl_0_C DFES_DTCO.DFC_MDCyl_1_C DFES_DTCO.DFC_MDCyl_2_C DFES_DTCO.DFC_MDFC_C DFES_DTCO.DFC_MDmin_C DFES_DTCO.DFC_MDnpl_C DFES_DTCO.DFC_MoCADCNTP_C DFES_DTCO.DFC_MoCADCTst_C DFES_DTCO.DFC_MoCComctErrMM_C DFES_DTCO.DFC_OCWDAActv_C DFES_DTCO.DFC_OCWDACom_C DFES_DTCO.DFC_ORAmax_C DFES_DTCO.DFC_ORAmin_C DFES_DTCO.DFC_PSR1max_C DFES_DTCO.DFC_PSRBmax_C DFES_DTCO.DFC_PSRBmin_C DFES_DTCO.DFC_PSREmax_C DFES_DTCO.DFC_PSREmin_C DFES_DTCO.DFC_PSRPmax_C DFES_DTCO.DFC_PSRPmin_C DFES_DTCO.DFC_PSRPsig_C DFES_DTCO.DFC_PSRmax_C DFES_DTCO.DFC_SSpMon1_C DFES_DTCO.DFC_SSpMon2_C DFES_DTCO.DFC_SSpMon3_C DFES_DTCO.DFC_SWReset_0_C DFES_DTCO.DFC_SWReset_1_C DFES_DTCO.DFC_SWReset_2_C DFES_DTCO.DFC_TASREmax_C DFES_DTCO.DFC_TASREmin_C DFES_DTCO.DFC_TASREnpl_C DFES_DTCO.DFC_TASRmax_C DFES_DTCO.DFC_TAmax_C DFES_DTCO.DFC_TEVEmax_C DFES_DTCO.DFC_TEVEmin_C DFES_DTCO.DFC_TEVEsig_C DFES_DTCO.DFC_TMCSmax_C DFES_DTCO.DFC_TMCSmin_C DFES_DTCO.DFC_TMEmax_C DFES_DTCO.DFC_TMEmin_C DFES_DTCO.DFC_TMEnpl_C DFES_DTCO.DFC_TMEsig_C DFES_DTCO.DFC_TMPmax_C DFES_DTCO.DFC_TMPmin_C DFES_DTCO.DFC_TMPnpl_C DFES_DTCO.DFC_TMmax_C DFES_DTCO.DFC_TUMmax_C DFES_DTCO.DFC_TWCCTrimMaxB1_C DFES_DTCO.DFC_TWCCTrimMinB1_C DFES_DTCO.DFC_TWCDPriCatB1_C DFES_DTCO.DFC_UBRmax_C DFES_DTCO.DFC_UBmax_C DFES_DTCO.DFC_UBmin_C DFES_DTCO.DFC_UBnpl_C DFES_Env.xSet1_CA DFES_Env.xSet2_CA DFES_Env.xSet3_CA DFES_Env.xSet4_CA DFES_Env.xSet5_CA DFES_Env.xSet6_CA DFES_Env.xSet7_CA DFES_Env.xSet8_CA DFES_Env.xSet9_CA DFES_Env.xSet10_CA DFES_Env.xSet11_CA DFES_Env.xSet12_CA DFES_Env.xSet13_CA DFES_Env.xSet14_CA DFES_Env.xSet15_CA DFES_Env.xSet16_CA DFES_Env.xSet17_CA DFES_Env.xSet18_CA DFES_Env.xSet19_CA DFES_Env.xSet20_CA DFES_Env.xSet21_CA DFES_Env.xSet22_CA DFES_Env.xSet23_CA DFES_Env.xSet24_CA DFES_Env.xSet25_CA DFES_Env.xSet26_CA DFES_Env.xSet27_CA DFES_Env.xSet28_CA DFES_Env.xSet29_CA DFES_Env.xSet30_CA DFES_Env.xSet31_CA DFES_Env.xSet32_CA DFES_Env.xSet33_CA DFES_Env.xSet34_CA DFES_Env.xSet35_CA DFES_Env.xSet36_CA DFES_Env.xSet37_CA DFES_Env.xSet38_CA DFES_Env.xSet39_CA DFES_Env.xSet40_CA DFES_Env.xSet41_CA DFES_Env.xSet42_CA DFES_Env.xSet43_CA DFES_Env.xSet44_CA DFES_Env.xSet45_CA DFES_Env.xSet46_CA DFES_Env.xSet47_CA DFES_Env.xSet48_CA DFES_Env.xSet49_CA DFES_Env.xSet50_CA DFES_EnvRef.DFC_Unused_C DFES_EnvRef.DFC_AltMaxPwr_C DFES_EnvRef.DFC_BrkNpl_C DFES_EnvRef.DFC_Cj930SSp1Mon_C DFES_EnvRef.DFC_Cj930SSp2Mon_C DFES_EnvRef.DFC_Cj930SSp3Mon_C DFES_EnvRef.DFC_IdleChrgActrAMax_C DFES_EnvRef.DFC_IdleChrgActrAMin_C DFES_EnvRef.DFC_IdleChrgActrASig_C DFES_EnvRef.DFC_IdleChrgActrBMax_C DFES_EnvRef.DFC_IdleChrgActrBMin_C DFES_EnvRef.DFC_IdleChrgActrBSig_C DFES_EnvRef.DFC_IdleChrgActrGovDeCold_C DFES_EnvRef.DFC_IdleChrgActrGovDeMax_C DFES_EnvRef.DFC_IdleChrgActrGovDeMin_C DFES_EnvRef.DFC_IdleChrgActrNAMax_C DFES_EnvRef.DFC_IdleChrgActrNAMin_C DFES_EnvRef.DFC_IdleChrgActrNASig_C DFES_EnvRef.DFC_IdleChrgActrNBMax_C DFES_EnvRef.DFC_IdleChrgActrNBMin_C DFES_EnvRef.DFC_IdleChrgActrNBSig_C DFES_EnvRef.DFC_IdleChrgActrOverTmp_C DFES_EnvRef.DFC_MonUMaxSupply1_C DFES_EnvRef.DFC_MonUMinSupply1_C DFES_EnvRef.DFC_ClthNplClsd_C DFES_EnvRef.DFC_ClthNplOpn_C DFES_EnvRef.DFC_IgnClPsDevComErr1_C DFES_EnvRef.DFC_IgnClPsOpenLoad0_C DFES_EnvRef.DFC_IgnClPsOpenLoad1_C DFES_EnvRef.DFC_IgnClPsOpenLoad2_C DFES_EnvRef.DFC_IgnClPsShCirBatt0_C DFES_EnvRef.DFC_IgnClPsShCirBatt1_C DFES_EnvRef.DFC_IgnClPsShCirBatt2_C DFES_EnvRef.DFC_IgnClPsShCirGnd0_C DFES_EnvRef.DFC_IgnClPsShCirGnd1_C DFES_EnvRef.DFC_IgnClPsShCirGnd2_C DFES_EnvRef.DFC_KnDetSens1PortAMax_C DFES_EnvRef.DFC_KnDetSens1PortAMin_C DFES_EnvRef.DFC_KnDetSens1PortBMax_C DFES_EnvRef.DFC_KnDetSens1PortBMin_C DFES_EnvRef.DFC_VehVWhlErr_C DFES_EnvRef.DFC_AirCCmprOL_C DFES_EnvRef.DFC_AirCCmprOvrTemp_C DFES_EnvRef.DFC_AirCCmprSCB_C DFES_EnvRef.DFC_AirCCmprSCG_C DFES_EnvRef.DFC_AltIOLdSRCMin_C DFES_EnvRef.DFC_AltIOOL_C DFES_EnvRef.DFC_AltIOOvrTemp_C DFES_EnvRef.DFC_AltIOSCB_C DFES_EnvRef.DFC_AltIOSCG_C DFES_EnvRef.DFC_DevLibBattUHi_C DFES_EnvRef.DFC_DevLibBattULo_C DFES_EnvRef.DFC_FanDIOOL_C DFES_EnvRef.DFC_FanDIOOvrTemp_C DFES_EnvRef.DFC_FanDIOSCB_C DFES_EnvRef.DFC_FanDIOSCG_C DFES_EnvRef.DFC_FanPWMOL_C DFES_EnvRef.DFC_FanPWMOvrTemp_C DFES_EnvRef.DFC_FanPWMSCB_C DFES_EnvRef.DFC_FanPWMSCG_C DFES_EnvRef.DFC_AirCClntPAnaSRCMax_C DFES_EnvRef.DFC_AirCClntPAnaSRCMin_C DFES_EnvRef.DFC_AirCSwtNpl_C DFES_EnvRef.DFC_AirCSwtSig_C DFES_EnvRef.DFC_AltIOLdSRCMax_C DFES_EnvRef.DFC_BrkSig_C DFES_EnvRef.DFC_ClthEPBNpl_C DFES_EnvRef.DFC_ClthEPBSensErr_C DFES_EnvRef.DFC_ClthErr_C DFES_EnvRef.DFC_ClthSig_C DFES_EnvRef.DFC_MILLmpOL_C DFES_EnvRef.DFC_MILLmpSCB_C DFES_EnvRef.DFC_MILLmpSCG_C DFES_EnvRef.DFC_SRCHighAPP1_C DFES_EnvRef.DFC_SRCHighAPP2_C DFES_EnvRef.DFC_SRCLowAPP1_C DFES_EnvRef.DFC_SRCLowAPP2_C DFES_EnvRef.DFC_SyncAPP_C DFES_EnvRef.DFC_VehVMax_C DFES_EnvRef.DFC_VehVPlaus_C DFES_EnvRef.DFC_VehVSig_C DFES_EnvRef.DFC_BusDiagBusOffNodeA_C DFES_EnvRef.DFC_ComACSensTO_C DFES_EnvRef.DFC_ComAWD1TO_C DFES_EnvRef.DFC_ComBRK10TO_C DFES_EnvRef.DFC_ComGW11TO_C DFES_EnvRef.DFC_ComLVL1TO_C DFES_EnvRef.DFC_ComPRKA01TO_C DFES_EnvRef.DFC_ComPRKH01TO_C DFES_EnvRef.DFC_ComPRKH1TO_C DFES_EnvRef.DFC_ComTRBCH1TO_C DFES_EnvRef.DFC_ComTRBCH2TO_C DFES_EnvRef.DFC_DK_C DFES_EnvRef.DFC_DKRSA_C DFES_EnvRef.DFC_DKVSmax_C DFES_EnvRef.DFC_DKmax_C DFES_EnvRef.DFC_DKmin_C DFES_EnvRef.DFC_DSSmax_C DFES_EnvRef.DFC_EEPEraseErr_C DFES_EnvRef.DFC_EEPRdErr_C DFES_EnvRef.DFC_EEPWrErr_C DFES_EnvRef.DFC_EV1max_C DFES_EnvRef.DFC_EV1min_C DFES_EnvRef.DFC_EV1sig_C DFES_EnvRef.DFC_EV2max_C DFES_EnvRef.DFC_EV2min_C DFES_EnvRef.DFC_EV2sig_C DFES_EnvRef.DFC_EV3max_C DFES_EnvRef.DFC_EV3min_C DFES_EnvRef.DFC_EV3sig_C DFES_EnvRef.DFC_EpmCaSI1ErrSig_C DFES_EnvRef.DFC_EpmCaSI1NoSig_C DFES_EnvRef.DFC_EpmCaSI1NoSigMax_C DFES_EnvRef.DFC_EpmCaSI1NoSigMin_C DFES_EnvRef.DFC_EpmCaSI1OfsErr_C DFES_EnvRef.DFC_EpmCrSErrSig_C DFES_EnvRef.DFC_EpmCrSNoSig_C DFES_EnvRef.DFC_FRAmax_C DFES_EnvRef.DFC_FRAmin_C DFES_EnvRef.DFC_HEGOS1B1ElecMax_C DFES_EnvRef.DFC_HEGOS1B1ElecMin_C DFES_EnvRef.DFC_HEGOS1B1ElecNpl_C DFES_EnvRef.DFC_HEGOS1B1ElecSig_C DFES_EnvRef.DFC_HEGOS1B1HtgNpl_C DFES_EnvRef.DFC_HEGOS1B1HtrPsMax_C DFES_EnvRef.DFC_HEGOS1B1HtrPsMin_C DFES_EnvRef.DFC_HEGOS1B1HtrPsSig_C DFES_EnvRef.DFC_HEGOS1B1StkMax_C DFES_EnvRef.DFC_HEGOS1B1StkMin_C DFES_EnvRef.DFC_HEGOS2B1RstrcnLean_C DFES_EnvRef.DFC_HEGOS2B1RstrcnRich_C DFES_EnvRef.DFC_IdleChrgActrJamVlvClsd_C DFES_EnvRef.DFC_IdleChrgActrJamVlvOpn_C DFES_EnvRef.DFC_IgnClPsDevOscErr1_C DFES_EnvRef.DFC_KPEmax_C DFES_EnvRef.DFC_KPEmin_C DFES_EnvRef.DFC_KPEsig_C DFES_EnvRef.DFC_KS1max_C DFES_EnvRef.DFC_KS1min_C DFES_EnvRef.DFC_LLRKHmax_C DFES_EnvRef.DFC_LLRKHmin_C DFES_EnvRef.DFC_LLRKHnpl_C DFES_EnvRef.DFC_LLRmax_C DFES_EnvRef.DFC_LLRmin_C DFES_EnvRef.DFC_LLRnpl_C DFES_EnvRef.DFC_LMmax_C DFES_EnvRef.DFC_LZSRnpl_C DFES_EnvRef.DFC_MD_C DFES_EnvRef.DFC_MD00min_C DFES_EnvRef.DFC_MD00npl_C DFES_EnvRef.DFC_MD01min_C DFES_EnvRef.DFC_MD01npl_C DFES_EnvRef.DFC_MD02min_C DFES_EnvRef.DFC_MD02npl_C DFES_EnvRef.DFC_MD03min_C DFES_EnvRef.DFC_MD03npl_C DFES_EnvRef.DFC_MD04min_C DFES_EnvRef.DFC_MD04npl_C DFES_EnvRef.DFC_MDCyl_0_C DFES_EnvRef.DFC_MDCyl_1_C DFES_EnvRef.DFC_MDCyl_2_C DFES_EnvRef.DFC_MDFC_C DFES_EnvRef.DFC_MDmin_C DFES_EnvRef.DFC_MDnpl_C DFES_EnvRef.DFC_MoCADCNTP_C DFES_EnvRef.DFC_MoCADCTst_C DFES_EnvRef.DFC_MoCComctErrMM_C DFES_EnvRef.DFC_OCWDAActv_C DFES_EnvRef.DFC_OCWDACom_C DFES_EnvRef.DFC_ORAmax_C DFES_EnvRef.DFC_ORAmin_C DFES_EnvRef.DFC_PSR1max_C DFES_EnvRef.DFC_PSRBmax_C DFES_EnvRef.DFC_PSRBmin_C DFES_EnvRef.DFC_PSREmax_C DFES_EnvRef.DFC_PSREmin_C DFES_EnvRef.DFC_PSRPmax_C DFES_EnvRef.DFC_PSRPmin_C DFES_EnvRef.DFC_PSRPsig_C DFES_EnvRef.DFC_PSRmax_C DFES_EnvRef.DFC_SSpMon1_C DFES_EnvRef.DFC_SSpMon2_C DFES_EnvRef.DFC_SSpMon3_C DFES_EnvRef.DFC_SWReset_0_C DFES_EnvRef.DFC_SWReset_1_C DFES_EnvRef.DFC_SWReset_2_C DFES_EnvRef.DFC_TASREmax_C DFES_EnvRef.DFC_TASREmin_C DFES_EnvRef.DFC_TASREnpl_C DFES_EnvRef.DFC_TASRmax_C DFES_EnvRef.DFC_TAmax_C DFES_EnvRef.DFC_TEVEmax_C DFES_EnvRef.DFC_TEVEmin_C DFES_EnvRef.DFC_TEVEsig_C DFES_EnvRef.DFC_TMCSmax_C DFES_EnvRef.DFC_TMCSmin_C DFES_EnvRef.DFC_TMEmax_C DFES_EnvRef.DFC_TMEmin_C DFES_EnvRef.DFC_TMEnpl_C DFES_EnvRef.DFC_TMEsig_C DFES_EnvRef.DFC_TMPmax_C DFES_EnvRef.DFC_TMPmin_C DFES_EnvRef.DFC_TMPnpl_C DFES_EnvRef.DFC_TMmax_C DFES_EnvRef.DFC_TUMmax_C DFES_EnvRef.DFC_TWCCTrimMaxB1_C DFES_EnvRef.DFC_TWCCTrimMinB1_C DFES_EnvRef.DFC_TWCDPriCatB1_C DFES_EnvRef.DFC_UBRmax_C DFES_EnvRef.DFC_UBmax_C DFES_EnvRef.DFC_UBmin_C DFES_EnvRef.DFC_UBnpl_C DFES_FaultTyp.DFC_Unused_C DFES_FaultTyp.DFC_AltMaxPwr_C DFES_FaultTyp.DFC_BrkNpl_C DFES_FaultTyp.DFC_Cj930SSp1Mon_C DFES_FaultTyp.DFC_Cj930SSp2Mon_C DFES_FaultTyp.DFC_Cj930SSp3Mon_C DFES_FaultTyp.DFC_IdleChrgActrAMax_C DFES_FaultTyp.DFC_IdleChrgActrAMin_C DFES_FaultTyp.DFC_IdleChrgActrASig_C DFES_FaultTyp.DFC_IdleChrgActrBMax_C DFES_FaultTyp.DFC_IdleChrgActrBMin_C DFES_FaultTyp.DFC_IdleChrgActrBSig_C DFES_FaultTyp.DFC_IdleChrgActrGovDeCold_C DFES_FaultTyp.DFC_IdleChrgActrGovDeMax_C DFES_FaultTyp.DFC_IdleChrgActrGovDeMin_C DFES_FaultTyp.DFC_IdleChrgActrNAMax_C DFES_FaultTyp.DFC_IdleChrgActrNAMin_C DFES_FaultTyp.DFC_IdleChrgActrNASig_C DFES_FaultTyp.DFC_IdleChrgActrNBMax_C DFES_FaultTyp.DFC_IdleChrgActrNBMin_C DFES_FaultTyp.DFC_IdleChrgActrNBSig_C DFES_FaultTyp.DFC_IdleChrgActrOverTmp_C DFES_FaultTyp.DFC_MonUMaxSupply1_C DFES_FaultTyp.DFC_MonUMinSupply1_C DFES_FaultTyp.DFC_ClthNplClsd_C DFES_FaultTyp.DFC_ClthNplOpn_C DFES_FaultTyp.DFC_IgnClPsDevComErr1_C DFES_FaultTyp.DFC_IgnClPsOpenLoad0_C DFES_FaultTyp.DFC_IgnClPsOpenLoad1_C DFES_FaultTyp.DFC_IgnClPsOpenLoad2_C DFES_FaultTyp.DFC_IgnClPsShCirBatt0_C DFES_FaultTyp.DFC_IgnClPsShCirBatt1_C DFES_FaultTyp.DFC_IgnClPsShCirBatt2_C DFES_FaultTyp.DFC_IgnClPsShCirGnd0_C DFES_FaultTyp.DFC_IgnClPsShCirGnd1_C DFES_FaultTyp.DFC_IgnClPsShCirGnd2_C DFES_FaultTyp.DFC_KnDetSens1PortAMax_C DFES_FaultTyp.DFC_KnDetSens1PortAMin_C DFES_FaultTyp.DFC_KnDetSens1PortBMax_C DFES_FaultTyp.DFC_KnDetSens1PortBMin_C DFES_FaultTyp.DFC_VehVWhlErr_C DFES_FaultTyp.DFC_AirCCmprOL_C DFES_FaultTyp.DFC_AirCCmprOvrTemp_C DFES_FaultTyp.DFC_AirCCmprSCB_C DFES_FaultTyp.DFC_AirCCmprSCG_C DFES_FaultTyp.DFC_AltIOLdSRCMin_C DFES_FaultTyp.DFC_AltIOOL_C DFES_FaultTyp.DFC_AltIOOvrTemp_C DFES_FaultTyp.DFC_AltIOSCB_C DFES_FaultTyp.DFC_AltIOSCG_C DFES_FaultTyp.DFC_DevLibBattUHi_C DFES_FaultTyp.DFC_DevLibBattULo_C DFES_FaultTyp.DFC_FanDIOOL_C DFES_FaultTyp.DFC_FanDIOOvrTemp_C DFES_FaultTyp.DFC_FanDIOSCB_C DFES_FaultTyp.DFC_FanDIOSCG_C DFES_FaultTyp.DFC_FanPWMOL_C DFES_FaultTyp.DFC_FanPWMOvrTemp_C DFES_FaultTyp.DFC_FanPWMSCB_C DFES_FaultTyp.DFC_FanPWMSCG_C DFES_FaultTyp.DFC_AirCClntPAnaSRCMax_C DFES_FaultTyp.DFC_AirCClntPAnaSRCMin_C DFES_FaultTyp.DFC_AirCSwtNpl_C DFES_FaultTyp.DFC_AirCSwtSig_C DFES_FaultTyp.DFC_AltIOLdSRCMax_C DFES_FaultTyp.DFC_BrkSig_C DFES_FaultTyp.DFC_ClthEPBNpl_C DFES_FaultTyp.DFC_ClthEPBSensErr_C DFES_FaultTyp.DFC_ClthErr_C DFES_FaultTyp.DFC_ClthSig_C DFES_FaultTyp.DFC_MILLmpOL_C DFES_FaultTyp.DFC_MILLmpSCB_C DFES_FaultTyp.DFC_MILLmpSCG_C DFES_FaultTyp.DFC_SRCHighAPP1_C DFES_FaultTyp.DFC_SRCHighAPP2_C DFES_FaultTyp.DFC_SRCLowAPP1_C DFES_FaultTyp.DFC_SRCLowAPP2_C DFES_FaultTyp.DFC_SyncAPP_C DFES_FaultTyp.DFC_VehVMax_C DFES_FaultTyp.DFC_VehVPlaus_C DFES_FaultTyp.DFC_VehVSig_C DFES_FaultTyp.DFC_BusDiagBusOffNodeA_C DFES_FaultTyp.DFC_ComACSensTO_C DFES_FaultTyp.DFC_ComAWD1TO_C DFES_FaultTyp.DFC_ComBRK10TO_C DFES_FaultTyp.DFC_ComGW11TO_C DFES_FaultTyp.DFC_ComLVL1TO_C DFES_FaultTyp.DFC_ComPRKA01TO_C DFES_FaultTyp.DFC_ComPRKH01TO_C DFES_FaultTyp.DFC_ComPRKH1TO_C DFES_FaultTyp.DFC_ComTRBCH1TO_C DFES_FaultTyp.DFC_ComTRBCH2TO_C DFES_FaultTyp.DFC_DK_C DFES_FaultTyp.DFC_DKRSA_C DFES_FaultTyp.DFC_DKVSmax_C DFES_FaultTyp.DFC_DKmax_C DFES_FaultTyp.DFC_DKmin_C DFES_FaultTyp.DFC_DSSmax_C DFES_FaultTyp.DFC_EEPEraseErr_C DFES_FaultTyp.DFC_EEPRdErr_C DFES_FaultTyp.DFC_EEPWrErr_C DFES_FaultTyp.DFC_EV1max_C DFES_FaultTyp.DFC_EV1min_C DFES_FaultTyp.DFC_EV1sig_C DFES_FaultTyp.DFC_EV2max_C DFES_FaultTyp.DFC_EV2min_C DFES_FaultTyp.DFC_EV2sig_C DFES_FaultTyp.DFC_EV3max_C DFES_FaultTyp.DFC_EV3min_C DFES_FaultTyp.DFC_EV3sig_C DFES_FaultTyp.DFC_EpmCaSI1ErrSig_C DFES_FaultTyp.DFC_EpmCaSI1NoSig_C DFES_FaultTyp.DFC_EpmCaSI1NoSigMax_C DFES_FaultTyp.DFC_EpmCaSI1NoSigMin_C DFES_FaultTyp.DFC_EpmCaSI1OfsErr_C DFES_FaultTyp.DFC_EpmCrSErrSig_C DFES_FaultTyp.DFC_EpmCrSNoSig_C DFES_FaultTyp.DFC_FRAmax_C DFES_FaultTyp.DFC_FRAmin_C DFES_FaultTyp.DFC_HEGOS1B1ElecMax_C DFES_FaultTyp.DFC_HEGOS1B1ElecMin_C DFES_FaultTyp.DFC_HEGOS1B1ElecNpl_C DFES_FaultTyp.DFC_HEGOS1B1ElecSig_C DFES_FaultTyp.DFC_HEGOS1B1HtgNpl_C DFES_FaultTyp.DFC_HEGOS1B1HtrPsMax_C DFES_FaultTyp.DFC_HEGOS1B1HtrPsMin_C DFES_FaultTyp.DFC_HEGOS1B1HtrPsSig_C DFES_FaultTyp.DFC_HEGOS1B1StkMax_C DFES_FaultTyp.DFC_HEGOS1B1StkMin_C DFES_FaultTyp.DFC_HEGOS2B1RstrcnLean_C DFES_FaultTyp.DFC_HEGOS2B1RstrcnRich_C DFES_FaultTyp.DFC_IdleChrgActrJamVlvClsd_C DFES_FaultTyp.DFC_IdleChrgActrJamVlvOpn_C DFES_FaultTyp.DFC_IgnClPsDevOscErr1_C DFES_FaultTyp.DFC_KPEmax_C DFES_FaultTyp.DFC_KPEmin_C DFES_FaultTyp.DFC_KPEsig_C DFES_FaultTyp.DFC_KS1max_C DFES_FaultTyp.DFC_KS1min_C DFES_FaultTyp.DFC_LLRKHmax_C DFES_FaultTyp.DFC_LLRKHmin_C DFES_FaultTyp.DFC_LLRKHnpl_C DFES_FaultTyp.DFC_LLRmax_C DFES_FaultTyp.DFC_LLRmin_C DFES_FaultTyp.DFC_LLRnpl_C DFES_FaultTyp.DFC_LMmax_C DFES_FaultTyp.DFC_LZSRnpl_C DFES_FaultTyp.DFC_MD_C DFES_FaultTyp.DFC_MD00min_C DFES_FaultTyp.DFC_MD00npl_C DFES_FaultTyp.DFC_MD01min_C DFES_FaultTyp.DFC_MD01npl_C DFES_FaultTyp.DFC_MD02min_C DFES_FaultTyp.DFC_MD02npl_C DFES_FaultTyp.DFC_MD03min_C DFES_FaultTyp.DFC_MD03npl_C DFES_FaultTyp.DFC_MD04min_C DFES_FaultTyp.DFC_MD04npl_C DFES_FaultTyp.DFC_MDCyl_0_C DFES_FaultTyp.DFC_MDCyl_1_C DFES_FaultTyp.DFC_MDCyl_2_C DFES_FaultTyp.DFC_MDFC_C DFES_FaultTyp.DFC_MDmin_C DFES_FaultTyp.DFC_MDnpl_C DFES_FaultTyp.DFC_MoCADCNTP_C DFES_FaultTyp.DFC_MoCADCTst_C DFES_FaultTyp.DFC_MoCComctErrMM_C DFES_FaultTyp.DFC_OCWDAActv_C DFES_FaultTyp.DFC_OCWDACom_C DFES_FaultTyp.DFC_ORAmax_C DFES_FaultTyp.DFC_ORAmin_C DFES_FaultTyp.DFC_PSR1max_C DFES_FaultTyp.DFC_PSRBmax_C DFES_FaultTyp.DFC_PSRBmin_C DFES_FaultTyp.DFC_PSREmax_C DFES_FaultTyp.DFC_PSREmin_C DFES_FaultTyp.DFC_PSRPmax_C DFES_FaultTyp.DFC_PSRPmin_C DFES_FaultTyp.DFC_PSRPsig_C DFES_FaultTyp.DFC_PSRmax_C DFES_FaultTyp.DFC_SSpMon1_C DFES_FaultTyp.DFC_SSpMon2_C DFES_FaultTyp.DFC_SSpMon3_C DFES_FaultTyp.DFC_SWReset_0_C DFES_FaultTyp.DFC_SWReset_1_C DFES_FaultTyp.DFC_SWReset_2_C DFES_FaultTyp.DFC_TASREmax_C DFES_FaultTyp.DFC_TASREmin_C DFES_FaultTyp.DFC_TASREnpl_C DFES_FaultTyp.DFC_TASRmax_C DFES_FaultTyp.DFC_TAmax_C DFES_FaultTyp.DFC_TEVEmax_C DFES_FaultTyp.DFC_TEVEmin_C DFES_FaultTyp.DFC_TEVEsig_C DFES_FaultTyp.DFC_TMCSmax_C DFES_FaultTyp.DFC_TMCSmin_C DFES_FaultTyp.DFC_TMEmax_C DFES_FaultTyp.DFC_TMEmin_C DFES_FaultTyp.DFC_TMEnpl_C DFES_FaultTyp.DFC_TMEsig_C DFES_FaultTyp.DFC_TMPmax_C /end DEF_CHARACTERISTIC
 FUNCTION_VERSION "2.9.0" /end FUNCTION
/begin COMPU_METHOD DFES_EnvTabVerb "" TAB_VERB "%2.1" "-" COMPU_TAB_REF DFES_EnvTabVerb /end COMPU_METHOD
/begin COMPU_VTAB DFES_EnvTabVerb "" TAB_VERB 50 0 "xSet1" 1 "xSet2" 2 "xSet3" 3 "xSet4" 4 "xSet5" 5 "xSet6" 6 "xSet7" 7 "xSet8" 8 "xSet9" 9 "xSet10" 10 "xSet11" 11 "xSet12" 12 "xSet13" 13 "xSet14" 14 "xSet15" 15 "xSet16" 16 "xSet17" 17 "xSet18" 18 "xSet19" 19 "xSet20" 20 "xSet21" 21 "xSet22" 22 "xSet23" 23 "xSet24" 24 "xSet25" 25 "xSet26" 26 "xSet27" 27 "xSet28" 28 "xSet29" 29 "xSet30" 30 "xSet31" 31 "xSet32" 32 "xSet33" 33 "xSet34" 34 "xSet35" 35 "xSet36" 36 "xSet37" 37 "xSet38" 38 "xSet39" 39 "xSet40" 40 "xSet41" 41 "xSet42" 42 "xSet43" 43 "xSet44" 44 "xSet45" 45 "xSet46" 46 "xSet47" 47 "xSet48" 48 "xSet49" 49 "xSet50" DEFAULT_VALUE "---" /end COMPU_VTAB
/begin COMPU_METHOD DFES_OneToOne "" RAT_FUNC "%6.2" "-" COEFFS 0 1 0 0 0 1 /end COMPU_METHOD
/begin COMPU_METHOD Signals_IntSigNumVerb "" TAB_VERB "%6.3" "" COMPU_TAB_REF Signals_IntSigNumVerb /end COMPU_METHOD
/begin COMPU_VTAB Signals_IntSigNumVerb "" TAB_VERB 60 0 "SIGNALS_Signals_Default" 1 "SIGNALS_APP_rUnFlt" 2 "SIGNALS_Brk_st" 3 "SIGNALS_Brk_stRed" 4 "SIGNALS_EpmCaS_phiOfsCorr" 5 "SIGNALS_Epm_nEng" 6 "SIGNALS_Epm_stOpMode" 7 "SIGNALS_Epm_stSync" 8 "SIGNALS_I15031_FILLSIG1h" 9 "SIGNALS_I15031_FILLSIG2h" 10 "SIGNALS_I15031_FILLSIG4h" 11 "SIGNALS_PID01h" 12 "SIGNALS_PID03h_0" 13 "SIGNALS_PID03h_1" 14 "SIGNALS_PID04h" 15 "SIGNALS_PID05h" 16 "SIGNALS_PID06h_0" 17 "SIGNALS_PID07h_0" 18 "SIGNALS_PID0D_VehV_vSens" 19 "SIGNALS_PID0Eh" 20 "SIGNALS_PID0bh" 21 "SIGNALS_PID14h_0" 22 "SIGNALS_PID14h_1" 23 "SIGNALS_PID15h_1" 24 "SIGNALS_PID1Ch" 25 "SIGNALS_PID1Fh" 26 "SIGNALS_PID21h" 27 "SIGNALS_PID2Eh" 28 "SIGNALS_PID30h" 29 "SIGNALS_PID31h" 30 "SIGNALS_PID3Ch" 31 "SIGNALS_PID42h" 32 "SIGNALS_PID43h" 33 "SIGNALS_PID44h" 34 "SIGNALS_PID49_APP_uRaw1unLim" 35 "SIGNALS_PID4A_APP_uRaw2unLimWoNTP" 36 "SIGNALS_PID4FAh" 37 "SIGNALS_PID4FBh" 38 "SIGNALS_PID4FCh" 39 "SIGNALS_PID4FDh" 40 "SIGNALS_PID50Ah" 41 "SIGNALS_PID50Bh" 42 "SIGNALS_PID50Ch" 43 "SIGNALS_PID50Dh" 44 "SIGNALS_PID56h_0" 45 "SIGNALS_PID5A_APP_rOBDPID5A" 46 "SIGNALS_PID5Fh" 47 "SIGNALS_Signals_FillSig_1Bit" 48 "SIGNALS_Signals_FillSig_1Byte" 49 "SIGNALS_Signals_FillSig_2Bit" 50 "SIGNALS_Signals_FillSig_2Byte" 51 "SIGNALS_Signals_FillSig_3Bit" 52 "SIGNALS_Signals_FillSig_4Bit" 53 "SIGNALS_Signals_FillSig_4Byte" 54 "SIGNALS_Signals_FillSig_5Bit" 55 "SIGNALS_Signals_FillSig_6Bit" 56 "SIGNALS_Signals_FillSig_7Bit" 57 "SIGNALS_T15_stRaw" 58 "SIGNALS_VehV_a" 59 "SIGNALS_VehV_v" /end COMPU_VTAB
/begin RECORD_LAYOUT ValA_Wu16 FNC_VALUES 1 UWORD COLUMN_DIR DIRECT /end RECORD_LAYOUT
/begin RECORD_LAYOUT Val_Wu16 FNC_VALUES 1 UWORD COLUMN_DIR DIRECT /end RECORD_LAYOUT
/begin RECORD_LAYOUT Val_Wu8 FNC_VALUES 1 UBYTE COLUMN_DIR DIRECT /end RECORD_LAYOUT
/end MODULE
/end PROJECT
