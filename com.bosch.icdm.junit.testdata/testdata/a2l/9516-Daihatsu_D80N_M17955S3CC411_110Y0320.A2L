ASAP2_VERSION 1 4
/begin PROJECT M17955S3CC411_110Y0320 "M17955S3CC411_110Y0320"
/begin HEADER "" VERSION "M17955S3CC411_110Y0320" PROJECT_NO M17955S3CC411_110Y0320 /end HEADER
/begin MODULE DIM ""
/begin MOD_COMMON "" BYTE_ORDER MSB_LAST ALIGNMENT_BYTE 1 ALIGNMENT_WORD 2 ALIGNMENT_LONG 4 ALIGNMENT_FLOAT32_IEEE 4 /end MOD_COMMON
/begin CHARACTERISTIC ACREWFSO "" VALUE 0x80043D72 KwWU16 233.0133 q0p003556_KJ_DIV_s_K 0.00 233.0133 FORMAT "%8.4" /end CHARACTERISTIC
/begin CHARACTERISTIC ACREWHSO "" VALUE 0x80043D74 KwWU16 233.0133 q0p003556_KJ_DIV_s_K 0.00 233.0133 FORMAT "%8.4" /end CHARACTERISTIC
/begin CHARACTERISTIC ACREWVSO "" VALUE 0x80043D76 KwWU16 233.0133 q0p003556_KJ_DIV_s_K 0.00 233.0133 FORMAT "%8.4" /end CHARACTERISTIC
/begin CHARACTERISTIC ATMABKA "" CURVE 0x80043D78 GklWU8 0.9961 fak_ub_b1 0.00 0.9961
 /begin AXIS_DESCR COM_AXIS tabstlc_w t1sxs_uw_q1 6 0.00 65535.00 FORMAT "%8.2" AXIS_PTS_REF STS06TMUW /end AXIS_DESCR
/end CHARACTERISTIC
/begin CHARACTERISTIC ATMABKF "" CURVE 0x80043D7E GklWU8 0.9961 fak_ub_b1 0.00 0.9961
 /begin AXIS_DESCR COM_AXIS tabstlc_w t1sxs_uw_q1 6 0.00 65535.00 FORMAT "%8.2" AXIS_PTS_REF STS06TMUW /end AXIS_DESCR
/end CHARACTERISTIC
/begin CHARACTERISTIC ATMABKK "" CURVE 0x80043D84 GklWU8 0.9961 fak_ub_b1 0.00 0.9961
 /begin AXIS_DESCR COM_AXIS tabstlc_w t1sxs_uw_q1 6 0.00 65535.00 FORMAT "%8.2" AXIS_PTS_REF STS06TMUW /end AXIS_DESCR
/end CHARACTERISTIC
/begin CHARACTERISTIC BFZGRLNBKV "" VALUE 0x80043796 KwWS16 3555.556 bfzg_q0p1085069 -3555.556 0.00 FORMAT "%8.3" /end CHARACTERISTIC
/begin CHARACTERISTIC CWBGLASO "" VALUE 0x80042D12 KwWU8 255.0 dez 0.00 255.0 FORMAT "%5.1" /end CHARACTERISTIC
/begin CHARACTERISTIC CWBGLWM "" VALUE 0x80042D1A KwWU8 255.0 dez 0.00 255.0 FORMAT "%5.1" /end CHARACTERISTIC
/begin CHARACTERISTIC CWBGMSDK "" VALUE 0x80043342 KwWU8 255.0 dez 0.00 255.0 FORMAT "%5.1" /end CHARACTERISTIC
/begin CHARACTERISTIC CWBGMSHMDK "" VALUE 0x8004354E KwWU8 255.0 dez 0.00 255.0 FORMAT "%5.1" /end CHARACTERISTIC
/begin CHARACTERISTIC CWBGOSC "" VALUE 0x80043550 KwWU16 65535.00 dez 0.00 65535.00 FORMAT "%8.2" /end CHARACTERISTIC
/begin CHARACTERISTIC CWBGPU "" VALUE 0x800436E8 KwWU8 255.0 dez 0.00 255.0 FORMAT "%5.1" /end CHARACTERISTIC
/begin CHARACTERISTIC CWBGRL "" VALUE 0x800438BE KwWU8 255.0 dez 0.00 255.0 FORMAT "%5.1" /end CHARACTERISTIC
/begin CHARACTERISTIC CWBGTASR "" VALUE 0x800438C4 KwWU8 255.0 dez 0.00 255.0 FORMAT "%5.1" /end CHARACTERISTIC
/begin CHARACTERISTIC CWBGTCW "" VALUE 0x800438CA KwWU8 255.0 dez 0.00 255.0 FORMAT "%5.1" /end CHARACTERISTIC
/begin CHARACTERISTIC CWBGTMPK "" VALUE 0x80043970 KwWU16 65535.00 dez 0.00 65535.00 FORMAT "%8.2" /end CHARACTERISTIC
/begin CHARACTERISTIC CWDSS "" VALUE 0x800436E9 KwWU8 255.0 dez 0.00 255.0 FORMAT "%5.1" /end CHARACTERISTIC
/begin CHARACTERISTIC CWKONGTU "" VALUE 0x80044142 KwWU8 255.0 dez 0.00 255.0 FORMAT "%5.1" /end CHARACTERISTIC
/begin CHARACTERISTIC CWKONGTU3 "" VALUE 0x80044143 KwWU8 255.0 dez 0.00 255.0 FORMAT "%5.1" /end CHARACTERISTIC
/begin CHARACTERISTIC CWOSCRSC "" VALUE 0x80043552 KwWU8 255.0 dez 0.00 255.0 FORMAT "%5.1" /end CHARACTERISTIC
/begin CHARACTERISTIC CWPABNAV "" VALUE 0x800436A0 KwWU8 255.0 dez 0.00 255.0 FORMAT "%5.1" /end CHARACTERISTIC
/begin CHARACTERISTIC CWRTPE "" VALUE 0x80043D8A KwWU16 65535.00 dez 0.00 65535.00 FORMAT "%8.2" /end CHARACTERISTIC
/begin CHARACTERISTIC CWTOSPM "" VALUE 0x80043CEE KwWU8 255.0 dez 0.00 255.0 FORMAT "%5.1" /end CHARACTERISTIC
/begin CHARACTERISTIC CWTPE "" VALUE 0x80043D8C KwWU16 65535.00 dez 0.00 65535.00 FORMAT "%8.2" /end CHARACTERISTIC
/begin CHARACTERISTIC CWTPEBAST "" VALUE 0x80043D8E KwWU8 255.0 dez 0.00 255.0 FORMAT "%5.1" /end CHARACTERISTIC
/begin CHARACTERISTIC CWTPETWAB "" VALUE 0x80043D8F KwWU8 255.0 dez 0.00 255.0 FORMAT "%5.1" /end CHARACTERISTIC
/begin CHARACTERISTIC DANZSYN "" VALUE 0x80043343 KwWU8 255.0 dez 0.00 255.0 FORMAT "%5.1" /end CHARACTERISTIC
/begin CHARACTERISTIC DPBRINTTN "" VALUE 0x80042D1C KwWU16 2559.961 p_uw_q0p039 0.00 2559.961 FORMAT "%8.3" /end CHARACTERISTIC
/begin CHARACTERISTIC DPBRINTTX "" VALUE 0x80042D1E KwWU16 2559.961 p_uw_q0p039 0.00 2559.961 FORMAT "%8.3" /end CHARACTERISTIC
/begin CHARACTERISTIC DPLMDK "" VALUE 0x800438B2 KwWS16 2559.922 p_uw_q0p078 0.00 2559.922 FORMAT "%8.3" /end CHARACTERISTIC
/begin CHARACTERISTIC DPTPVDMN "" VALUE 0x80043754 KwWU16 5119.922 p_uw_q0p078 0.00 5119.922 FORMAT "%8.3" /end CHARACTERISTIC
/begin CHARACTERISTIC DPTPVDMX "" VALUE 0x80043756 KwWU16 5119.922 p_uw_q0p078 0.00 5119.922 FORMAT "%8.3" /end CHARACTERISTIC
/begin CHARACTERISTIC DPVLFVFZG "" CURVE 0x80043758 KlAxU8SstxU8WU16 2559.961 p_uw_q0p039 0.00 2559.961 FORMAT "%8.3"
 /begin AXIS_DESCR STD_AXIS vfzg vfzg_ub_q1p25 4 0.00 318.8 FORMAT "%5.1" DEPOSIT ABSOLUTE /end AXIS_DESCR
/end CHARACTERISTIC
/begin CHARACTERISTIC DRLRLPMAX "" VALUE 0x800438B4 KwWU16 767.9766 rel_uw_q0p0234 0.00 767.9766 FORMAT "%8.4" /end CHARACTERISTIC
/begin CHARACTERISTIC DRLRLPU "" VALUE 0x800438B6 KwWU16 1535.977 rel_uw_q0p0234 0.00 1535.977 FORMAT "%8.3" /end CHARACTERISTIC
/begin CHARACTERISTIC DTAVDKMX "" VALUE 0x800438C8 KwWU16 1535.977 temp_q0p0234 0.00 1535.977 FORMAT "%8.3" /end CHARACTERISTIC
/begin CHARACTERISTIC DTEVS "" VALUE 0x80043972 KwWU8 191.3 temp_q0p75_om48 -48.00 143.3 FORMAT "%5.1" /end CHARACTERISTIC
/begin CHARACTERISTIC DTMTATUM "" VALUE 0x80044144 KwWU8 191.3 temp_ub_b191p25 0.00 191.3 FORMAT "%5.1" /end CHARACTERISTIC
/begin CHARACTERISTIC DTTUTMECUO "" VALUE 0x80043908 KwWU8 191.3 temp_ub_q0p75_o48 -48.00 143.3 FORMAT "%5.1" /end CHARACTERISTIC
/begin CHARACTERISTIC DTUMDRLPMN "" VALUE 0x80044146 KwWS16 1535.977 rel_sw_q0p0234 -768.0000 767.9766 FORMAT "%8.4" /end CHARACTERISTIC
/begin CHARACTERISTIC DTUMDRLPMX "" VALUE 0x80044148 KwWS16 1535.977 rel_sw_q0p0234 -768.0000 767.9766 FORMAT "%8.4" /end CHARACTERISTIC
/begin CHARACTERISTIC DWDKMXWDK "" CURVE 0x80043344 KlAxU8SstxU16WU16 99.99847 rel_uw_b100 0.00 99.99847 FORMAT "%8.5"
 /begin AXIS_DESCR STD_AXIS wdkpmm_w rel_uw_b100 3 0.00 99.99847 FORMAT "%8.5" DEPOSIT ABSOLUTE /end AXIS_DESCR
/end CHARACTERISTIC
/begin CHARACTERISTIC DWDKPU "" VALUE 0x800441EE KwWU16 100.0000 relDK_uw_b100 0.00 100.0000 FORMAT "%8.4" /end CHARACTERISTIC
/begin CHARACTERISTIC DWDKUDAS "" VALUE 0x800441F0 KwWU16 100.0000 relDK_uw_b100 0.00 100.0000 FORMAT "%8.4" /end CHARACTERISTIC
/begin CHARACTERISTIC DWOGVA "" VALUE 0x800441F4 KwWS16 1023.984 kw_q0p0156 -512.0000 511.9844 FORMAT "%8.4" /end CHARACTERISTIC
/begin CHARACTERISTIC DWOGVE "" VALUE 0x800441F6 KwWS16 1023.984 kw_q0p0156 -512.0000 511.9844 FORMAT "%8.4" /end CHARACTERISTIC
/begin CHARACTERISTIC FABSTT "" CURVE 0x800438CC KlAxU8SstxU16WU8 0.9961 fak_ub_b1 0.00 0.9961
 /begin AXIS_DESCR STD_AXIS tengs_w t_q4_s 5 0.00 262140.0 FORMAT "%8.1" DEPOSIT ABSOLUTE /end AXIS_DESCR
/end CHARACTERISTIC
/begin CHARACTERISTIC FAFRSPVP "" CURVE 0x80042D20 KlAxU8SstxU16WU16 1.999969 fak_uw_b2 0.00 1.999969 FORMAT "%8.6"
 /begin AXIS_DESCR STD_AXIS vpsrabg_w fak_uw_b2 10 0.00 1.999969 FORMAT "%8.6" DEPOSIT ABSOLUTE /end AXIS_DESCR
/end CHARACTERISTIC
/begin CHARACTERISTIC FCOSCHKM "" VALUE 0x80043553 KwWU8 1.992188 fak_ub_b2 0.00 1.992188 FORMAT "%8.6" /end CHARACTERISTIC
/begin CHARACTERISTIC FCOSCOP "" VALUE 0x80043554 KwWU8 1.992188 fak_ub_b2 0.00 1.992188 FORMAT "%8.6" /end CHARACTERISTIC
/begin CHARACTERISTIC FFUPSRLTN "" VALUE 0x80042D4A KwWU16 1.999969 fak_uw_b2 0.00 1.999969 FORMAT "%8.6" /end CHARACTERISTIC
/begin CHARACTERISTIC FFUPSRLTX "" VALUE 0x80042D4C KwWU16 1.999969 fak_uw_b2 0.00 1.999969 FORMAT "%8.6" /end CHARACTERISTIC
/begin CHARACTERISTIC FGDPSMPDVS "" VALUE 0x800438B8 KwWU16 0.6999817 fak_uw_b1 0.3000031 0.9999847 FORMAT "%9.7" /end CHARACTERISTIC
/begin CHARACTERISTIC FHOMN "" VALUE 0x800436EA KwWU16 3.999939 fak_uw_b4 0.00 3.999939 FORMAT "%8.6" /end CHARACTERISTIC
/begin CHARACTERISTIC FHOMX "" VALUE 0x800436EC KwWU16 3.999939 fak_uw_b4 0.00 3.999939 FORMAT "%8.6" /end CHARACTERISTIC
/begin CHARACTERISTIC FIUWMSDKXN "" CURVE 0x80043352 KlAxU8SstxU16WU16 1.999969 fak_uw_b2 0.00 1.999969 FORMAT "%8.6"
 /begin AXIS_DESCR STD_AXIS nmot_w nmot_q0p25 5 0.00 16383.75 FORMAT "%8.2" DEPOSIT ABSOLUTE /end AXIS_DESCR
/end CHARACTERISTIC
/begin CHARACTERISTIC FKVDVP "" CURVE 0x80043368 FklWU16 1.999969 fak_uw_b2 0.00 1.999969 FORMAT "%8.6" READ_ONLY
 /begin AXIS_DESCR FIX_AXIS vpsrvdb_w fak_uw_b2 30 0.5000000 0.9531250 FORMAT "%9.7" FIX_AXIS_PAR 16384 9 30 /end AXIS_DESCR
/end CHARACTERISTIC
/begin CHARACTERISTIC FMSNDKTN "" VALUE 0x800433A4 KwWU16 1.999969 fak_uw_b2 0.00 1.999969 FORMAT "%8.6" /end CHARACTERISTIC
/begin CHARACTERISTIC FMSNDKTX "" VALUE 0x800433A6 KwWU16 1.999969 fak_uw_b2 0.00 1.999969 FORMAT "%8.6" /end CHARACTERISTIC
/begin CHARACTERISTIC FPSPULSMN "" VALUE 0x80043780 KwWU16 1.999969 fak_q3p0518Em5 0.00 1.999969 FORMAT "%8.6" /end CHARACTERISTIC
/begin CHARACTERISTIC FPSPULSMX "" VALUE 0x80043782 KwWU16 1.999969 fak_q3p0518Em5 0.00 1.999969 FORMAT "%8.6" /end CHARACTERISTIC
/begin CHARACTERISTIC FPVMXP "" VALUE 0x800438BA KwWU16 1.999969 fak_uw_b2 0.00 1.999969 FORMAT "%8.6" /end CHARACTERISTIC
/begin CHARACTERISTIC FPVMXST "" VALUE 0x80043784 KwWU16 3.999939 fak_q6p1035Em5 0.00 3.999939 FORMAT "%8.6" /end CHARACTERISTIC
/begin CHARACTERISTIC FRIRLABBR "" VALUE 0x80042D14 KwWU16 1.999969 fak_q3p0518Em5 0.00 1.999969 FORMAT "%8.6" /end CHARACTERISTIC
/begin CHARACTERISTIC FRLMNPU "" CURVE 0x80043798 KlAxU8SstxU16WU16 1.999969 fak_q3p0518Em5 0.00 1.999969 FORMAT "%8.6"
 /begin AXIS_DESCR STD_AXIS pu_w p_uw_q0p039 5 0.00 2559.961 FORMAT "%8.3" DEPOSIT ABSOLUTE /end AXIS_DESCR
/end CHARACTERISTIC
/begin CHARACTERISTIC FRLMNTMOT "" CURVE 0x800437AE KlAxU8SstxU8WU16 1.999969 fak_q3p0518Em5 0.00 1.999969 FORMAT "%8.6"
 /begin AXIS_DESCR STD_AXIS tmot temp_ub_q0p75_o48 5 -48.00 143.3 FORMAT "%5.1" DEPOSIT ABSOLUTE /end AXIS_DESCR
/end CHARACTERISTIC
/begin CHARACTERISTIC FTMEW "" VALUE 0x800438DE KwWU8 0.9961 fak_ub_b1 0.00 0.9961 /end CHARACTERISTIC
/begin CHARACTERISTIC FTMSDV "" CURVE 0x80042D4E KlAxU8SstxU16WU16 1.999969 fak_uw_b2 0.00 1.999969 FORMAT "%8.6"
 /begin AXIS_DESCR STD_AXIS tasr_w temp_q0p0234_o273 16 -273.1500 1262.827 FORMAT "%8.3" DEPOSIT ABSOLUTE /end AXIS_DESCR
/end CHARACTERISTIC
/begin CHARACTERISTIC FTOCHLWIN "" VALUE 0x80043CDA KwWU8 1.000 fak_q0p00392 0.00 1.000 FORMAT "%5.3" /end CHARACTERISTIC
/begin CHARACTERISTIC FTVDKTAVDK "" CURVE 0x80043974 KlAxU8SstxU16WU16 1.999969 fak_uw_b2 0.00 1.999969 FORMAT "%8.6"
 /begin AXIS_DESCR STD_AXIS tadk_w temp_q0p0234_o273 16 -273.1500 1262.827 FORMAT "%8.3" DEPOSIT ABSOLUTE /end AXIS_DESCR
/end CHARACTERISTIC
/begin CHARACTERISTIC FUPSRLMN "" VALUE 0x80042D90 KwWU16 0.2999954 rel_uw_b0p3 0.00 0.2999954 FORMAT "%9.7" /end CHARACTERISTIC
/begin CHARACTERISTIC FUPSRLMX "" VALUE 0x80042D92 KwWU16 0.2999954 rel_uw_b0p3 0.00 0.2999954 FORMAT "%9.7" /end CHARACTERISTIC
/begin CHARACTERISTIC FVBR "" CURVE 0x80042D94 KlAxU8SstxS16WU16 1.999969 fak_uw_b2 0.00 1.999969 FORMAT "%8.6"
 /begin AXIS_DESCR STD_AXIS wgvsme_w kw_q0p0156 20 -512.0000 511.9844 FORMAT "%8.4" DEPOSIT ABSOLUTE /end AXIS_DESCR
/end CHARACTERISTIC
/begin CHARACTERISTIC FWMABGW "" VALUE 0x80043D90 KwWU8 0.9961 fak_ub_b1 0.00 0.9961 /end CHARACTERISTIC
/begin CHARACTERISTIC FWMFKW "" VALUE 0x80043D91 KwWU8 0.9961 fak_ub_b1 0.00 0.9961 /end CHARACTERISTIC
/begin CHARACTERISTIC FWMKATW "" VALUE 0x80043D92 KwWU8 0.9961 fak_ub_b1 0.00 0.9961 /end CHARACTERISTIC
/begin CHARACTERISTIC FWMZAPWF "" VALUE 0x80043D93 KwWU8 255.0 dez 0.00 255.0 FORMAT "%5.1" /end CHARACTERISTIC
/begin CHARACTERISTIC FWMZFPWF "" VALUE 0x80043D94 KwWU8 255.0 dez 0.00 255.0 FORMAT "%5.1" /end CHARACTERISTIC
/begin CHARACTERISTIC FWMZKPWF "" VALUE 0x80043D95 KwWU8 255.0 dez 0.00 255.0 FORMAT "%5.1" /end CHARACTERISTIC
/begin CHARACTERISTIC FZPUSA "" CURVE 0x800436EE KlAxU8SstxU8WU8 1.890625 fak_ub_b2 0.1015625 1.992188 FORMAT "%8.6"
 /begin AXIS_DESCR STD_AXIS vfzg vfzg_ub_q1p25 8 0.00 318.8 FORMAT "%5.1" DEPOSIT ABSOLUTE /end AXIS_DESCR
/end CHARACTERISTIC
/begin CHARACTERISTIC IMLTUMAMN "" VALUE 0x8004414A KwWU16 23.30133 m_uw_b23p3 0.00 23.30133 FORMAT "%8.5" /end CHARACTERISTIC
/begin CHARACTERISTIC IMLTUMAMX "" VALUE 0x8004414C KwWU16 23.30133 m_uw_b23p3 0.00 23.30133 FORMAT "%8.5" /end CHARACTERISTIC
/begin CHARACTERISTIC KFDTMTE1S "" MAP 0x800438E0 KfAxU8AyU8SstxU8SstyU8WS8 2.988 temp_q0p01172 -1.500 1.488 FORMAT "%5.3"
 /begin AXIS_DESCR STD_AXIS mll1 m_ub_b1020 5 0.00 1020. FORMAT "%5.0" DEPOSIT ABSOLUTE /end AXIS_DESCR
 /begin AXIS_DESCR STD_AXIS tmew temp_ub_q0p75_o48 4 -48.00 143.3 FORMAT "%5.1" DEPOSIT ABSOLUTE /end AXIS_DESCR
/end CHARACTERISTIC
/begin CHARACTERISTIC KFDTR "" MAP 0x800439B6 KfAxU8AyU8SstxU16SstyU16WU16 1535.977 temp_q0p0234_o273 -273.1500 1262.827 FORMAT "%8.3"
 /begin AXIS_DESCR STD_AXIS psr_w p_q0p078 10 0.00 5119.922 FORMAT "%8.3" DEPOSIT ABSOLUTE /end AXIS_DESCR
 /begin AXIS_DESCR STD_AXIS nmot_w nmot_q0p25 10 0.00 16383.75 FORMAT "%8.2" DEPOSIT ABSOLUTE /end AXIS_DESCR
/end CHARACTERISTIC
/begin CHARACTERISTIC KFDTUMTAV "" MAP 0x8004414E KfAxU8AyU8SstxU8SstyU8WU8 191.3 temp_ub_q0p75_o48 -48.00 143.3 FORMAT "%5.1"
 /begin AXIS_DESCR STD_AXIS ml m_q4_kg_DIV_h 8 0.00 1020. FORMAT "%5.0" DEPOSIT ABSOLUTE /end AXIS_DESCR
 /begin AXIS_DESCR STD_AXIS ttummoffst temp_ub_q0p75_o48 8 -48.00 143.3 FORMAT "%5.1" DEPOSIT ABSOLUTE /end AXIS_DESCR
/end CHARACTERISTIC
/begin CHARACTERISTIC KFDTZ "" MAP 0x80043AAA KfAxU8AyU8SstxU16SstyU16WU16 6553.500 t_q0p1 0.00 6553.500 FORMAT "%8.3"
 /begin AXIS_DESCR STD_AXIS psr_w p_q0p078 8 0.00 5119.922 FORMAT "%8.3" DEPOSIT ABSOLUTE /end AXIS_DESCR
 /begin AXIS_DESCR STD_AXIS nmot_w nmot_q0p25 8 0.00 16383.75 FORMAT "%8.2" DEPOSIT ABSOLUTE /end AXIS_DESCR
/end CHARACTERISTIC
/begin CHARACTERISTIC KFFKPBRRES "" MAP 0x80042DE6 KfAxU8AyU8SstxS16SstyU16WU16 3.999939 fak_uw_b4 0.00 3.999939 FORMAT "%8.6"
 /begin AXIS_DESCR STD_AXIS wgvspum_w kw_q0p0156 8 -512.0000 511.9844 FORMAT "%8.4" DEPOSIT ABSOLUTE /end AXIS_DESCR
 /begin AXIS_DESCR STD_AXIS nmot_w nmot_uw_q0p25 20 0.00 16383.75 FORMAT "%8.2" DEPOSIT ABSOLUTE /end AXIS_DESCR
/end CHARACTERISTIC
/begin CHARACTERISTIC KFFKUPRLMX "" MAP 0x80042F60 KfAxU8AyU8SstxS16SstyU16WU16 1.999969 fak_uw_b2 0.00 1.999969 FORMAT "%8.6"
 /begin AXIS_DESCR STD_AXIS wgvsme_w kw_q0p0156 10 -512.0000 511.9844 FORMAT "%8.4" DEPOSIT ABSOLUTE /end AXIS_DESCR
 /begin AXIS_DESCR STD_AXIS nmottkor_w nmot_uw_q0p25 20 0.00 16383.75 FORMAT "%8.2" DEPOSIT ABSOLUTE /end AXIS_DESCR
/end CHARACTERISTIC
/begin CHARACTERISTIC KFFPBR "" MAP 0x8004312E KfAxU8AyU8SstxS16SstyU16WU16 3.999939 fak_uw_b4 0.00 3.999939 FORMAT "%8.6"
 /begin AXIS_DESCR STD_AXIS wgvsme_w kw_q0p0156 10 -512.0000 511.9844 FORMAT "%8.4" DEPOSIT ABSOLUTE /end AXIS_DESCR
 /begin AXIS_DESCR STD_AXIS nmottkor_w nmot_uw_q0p25 20 0.00 16383.75 FORMAT "%8.2" DEPOSIT ABSOLUTE /end AXIS_DESCR
/end CHARACTERISTIC
/begin CHARACTERISTIC KFFWLKFTBR "" MAP 0x80043B4E KfAxU8AyU8SstxU8SstyU8WU8 1.992188 fak_ub_b2 0.00 1.992188 FORMAT "%8.6"
 /begin AXIS_DESCR STD_AXIS tmotdifk temp_q0p75 8 0.00 191.3 FORMAT "%5.1" DEPOSIT ABSOLUTE /end AXIS_DESCR
 /begin AXIS_DESCR STD_AXIS tmst temp_q0p75_om48 5 -48.00 143.3 FORMAT "%5.1" DEPOSIT ABSOLUTE /end AXIS_DESCR
/end CHARACTERISTIC
/begin CHARACTERISTIC KFMSNWDKVP "" MAP 0x800433A8 KfAxU8AyU8SstxU16SstyU16WU16 6553.500 m_q0p1 0.00 6553.500 FORMAT "%8.3"
 /begin AXIS_DESCR STD_AXIS wdk_w rel_uw_b100 18 0.00 99.99847 FORMAT "%8.5" DEPOSIT ABSOLUTE /end AXIS_DESCR
 /begin AXIS_DESCR STD_AXIS vpsrvdb_w fak_uw_b2 8 0.00 1.999969 FORMAT "%8.6" DEPOSIT ABSOLUTE /end AXIS_DESCR
/end CHARACTERISTIC
/begin CHARACTERISTIC KFOSCHN "" MAP 0x80043556 KfAxU8AyU8SstxU16SstyU16WU16 6553.500 m_q0p1_mg 0.00 6553.500 FORMAT "%8.3"
 /begin AXIS_DESCR STD_AXIS thki_w temp_q0p0234_o273 8 -273.1500 1262.827 FORMAT "%8.3" DEPOSIT ABSOLUTE /end AXIS_DESCR
 /begin AXIS_DESCR STD_AXIS msabvhk_w m_uw_b6553p5 8 0.00 6553.500 FORMAT "%8.3" DEPOSIT ABSOLUTE /end AXIS_DESCR
/end CHARACTERISTIC
/begin CHARACTERISTIC KFOSCHOP "" MAP 0x800435FA KfAxU8AyU8SstxU16SstyU16WU16 6553.500 m_q0p1_mg 0.00 6553.500 FORMAT "%8.3"
 /begin AXIS_DESCR STD_AXIS thki_w temp_q0p0234_o273 8 -273.1500 1262.827 FORMAT "%8.3" DEPOSIT ABSOLUTE /end AXIS_DESCR
 /begin AXIS_DESCR STD_AXIS msabvhk_w m_uw_b6553p5 8 0.00 6553.500 FORMAT "%8.3" DEPOSIT ABSOLUTE /end AXIS_DESCR
/end CHARACTERISTIC
/begin CHARACTERISTIC KFTOCHLW "" MAP 0x80043CDB KfAxU8AyU8SstxU8SstyU8WU8 1.000 fak_q0p00392 0.00 1.000 FORMAT "%5.3"
 /begin AXIS_DESCR STD_AXIS ml m_ub_b1020 3 0.00 1020. FORMAT "%5.0" DEPOSIT ABSOLUTE /end AXIS_DESCR
 /begin AXIS_DESCR STD_AXIS nmot nmot_ub_q40 3 0.00 10200. FORMAT "%5.0" DEPOSIT ABSOLUTE /end AXIS_DESCR
/end CHARACTERISTIC
/begin CHARACTERISTIC KFTOSPMVML "" MAP 0x80043CF0 KfAxU8AyU8SstxU16SstyU8WU8 1.992188 fak_ub_b2 0.00 1.992188 FORMAT "%8.6"
 /begin AXIS_DESCR STD_AXIS ml_w m_uw_b6553p5 5 0.00 6553.500 FORMAT "%8.3" DEPOSIT ABSOLUTE /end AXIS_DESCR
 /begin AXIS_DESCR STD_AXIS vfzg vfzg_ub_q1p25 5 0.00 318.8 FORMAT "%5.1" DEPOSIT ABSOLUTE /end AXIS_DESCR
/end CHARACTERISTIC
/begin CHARACTERISTIC KFTOSPMWC "" MAP 0x80043D1A KfAxU8AyU8SstxU8SstyU8WU8 1.000 fak_ub_q0p00392 0.00 1.000 FORMAT "%5.3"
 /begin AXIS_DESCR STD_AXIS tumg temp_uw_q0p75_o48 4 -48.00 143.3 FORMAT "%5.1" DEPOSIT ABSOLUTE /end AXIS_DESCR
 /begin AXIS_DESCR STD_AXIS tmot temp_uw_q0p75_o48 2 -48.00 143.3 FORMAT "%5.1" DEPOSIT ABSOLUTE /end AXIS_DESCR
/end CHARACTERISTIC
/begin CHARACTERISTIC KFWMABG "" MAP 0x80043D96 GkfWU16 29825.71 q_q0p4551 0.00 29825.71 FORMAT "%8.2"
 /begin AXIS_DESCR COM_AXIS tavsost_w temp_q0p0234_o273 10 -273.1500 1262.827 FORMAT "%8.3" AXIS_PTS_REF STV10TMUW /end AXIS_DESCR
 /begin AXIS_DESCR COM_AXIS tmsttpe temp_ub_q0p75_o48 10 -48.00 143.3 FORMAT "%5.1" AXIS_PTS_REF STMS10TMUB /end AXIS_DESCR
/end CHARACTERISTIC
/begin CHARACTERISTIC KFWMFK "" MAP 0x80043E5E GkfWU16 29825.71 q_q0p4551 0.00 29825.71 FORMAT "%8.2"
 /begin AXIS_DESCR COM_AXIS tafsost_w temp_q0p0234_o273 10 -273.1500 1262.827 FORMAT "%8.3" AXIS_PTS_REF STF10TMUW /end AXIS_DESCR
 /begin AXIS_DESCR COM_AXIS tmsttpe temp_ub_q0p75_o48 10 -48.00 143.3 FORMAT "%5.1" AXIS_PTS_REF STMS10TMUB /end AXIS_DESCR
/end CHARACTERISTIC
/begin CHARACTERISTIC KFWMKAT "" MAP 0x80043F26 GkfWU16 29825.71 q_q0p4551 0.00 29825.71 FORMAT "%8.2"
 /begin AXIS_DESCR COM_AXIS tahsost_w temp_q0p0234_o273 10 -273.1500 1262.827 FORMAT "%8.3" AXIS_PTS_REF STH10TMUW /end AXIS_DESCR
 /begin AXIS_DESCR COM_AXIS tmsttpe temp_ub_q0p75_o48 10 -48.00 143.3 FORMAT "%5.1" AXIS_PTS_REF STMS10TMUB /end AXIS_DESCR
/end CHARACTERISTIC
/begin CHARACTERISTIC KFWTBR "" MAP 0x80043B86 KfAxU8AyU8SstxU16SstyU16WU16 1.999969 fak_uw_b2 0.00 1.999969 FORMAT "%8.6"
 /begin AXIS_DESCR STD_AXIS psr_w p_q0p078 10 0.00 5119.922 FORMAT "%8.3" DEPOSIT ABSOLUTE /end AXIS_DESCR
 /begin AXIS_DESCR STD_AXIS nmot_w nmot_q0p25 12 0.00 16383.75 FORMAT "%8.2" DEPOSIT ABSOLUTE /end AXIS_DESCR
/end CHARACTERISTIC
/begin CHARACTERISTIC KLFEXPSL "" CURVE 0x80043CA6 KlAxU8SstxU16WU16 0.9999847 fak_uw_b1 0.00 0.9999847 FORMAT "%9.7"
 /begin AXIS_DESCR STD_AXIS quotntke_w fak_uw_b8 6 0.00 7.999878 FORMAT "%8.6" DEPOSIT ABSOLUTE /end AXIS_DESCR
/end CHARACTERISTIC
/begin CHARACTERISTIC KLIMLTUMA "" CURVE 0x800441A0 KlAxU8SstxU8WU16 23.30133 m_uw_b23p3 0.00 23.30133 FORMAT "%8.5"
 /begin AXIS_DESCR STD_AXIS ml m_q4_kg_DIV_h 8 0.00 1020. FORMAT "%5.0" DEPOSIT ABSOLUTE /end AXIS_DESCR
/end CHARACTERISTIC
/begin CHARACTERISTIC KLKIWMA "" CURVE 0x80043FEE KlAxU8SstxU16WU8 1.992 fak_q0p0078 0.00 1.992 FORMAT "%5.3"
 /begin AXIS_DESCR STD_AXIS msabikr_w m_uw_b6553p5 8 0.00 6553.500 FORMAT "%8.3" DEPOSIT ABSOLUTE /end AXIS_DESCR
/end CHARACTERISTIC
/begin CHARACTERISTIC KLKIWMFK "" CURVE 0x80044008 KlAxU8SstxU16WU8 1.992 fak_q0p0078 0.00 1.992 FORMAT "%5.3"
 /begin AXIS_DESCR STD_AXIS msabnvk_w m_uw_b6553p5 8 0.00 6553.500 FORMAT "%8.3" DEPOSIT ABSOLUTE /end AXIS_DESCR
/end CHARACTERISTIC
/begin CHARACTERISTIC KLKIWMK "" CURVE 0x80044022 KlAxU8SstxU16WU8 1.992 fak_q0p0078 0.00 1.992 FORMAT "%5.3"
 /begin AXIS_DESCR STD_AXIS msabnhk_w m_uw_b6553p5 8 0.00 6553.500 FORMAT "%8.3" DEPOSIT ABSOLUTE /end AXIS_DESCR
/end CHARACTERISTIC
/begin CHARACTERISTIC KLMLNMOTMX "" CURVE 0x800441BA KlAxU8SstxU8WU8 1020. m_ub_b1020 0.00 1020. FORMAT "%5.0"
 /begin AXIS_DESCR STD_AXIS nmot nmot_ub_q40 8 0.00 10200. FORMAT "%5.0" DEPOSIT ABSOLUTE /end AXIS_DESCR
/end CHARACTERISTIC
/begin CHARACTERISTIC KLTOSPM_N "" CURVE 0x80043D2A KlAxU8SstxU8WU8 1.992188 fak_ub_b2 0.00 1.992188 FORMAT "%8.6"
 /begin AXIS_DESCR STD_AXIS nmot nmot_ub_q40 7 0.00 10200. FORMAT "%5.0" DEPOSIT ABSOLUTE /end AXIS_DESCR
/end CHARACTERISTIC
/begin CHARACTERISTIC KLTOSPM_TU "" CURVE 0x80043D39 KlAxU8SstxU8WU8 1.992188 fak_ub_b2 0.00 1.992188 FORMAT "%8.6"
 /begin AXIS_DESCR STD_AXIS tumg temp_ub_q0p75_o48 5 -48.00 143.3 FORMAT "%5.1" DEPOSIT ABSOLUTE /end AXIS_DESCR
/end CHARACTERISTIC
/begin CHARACTERISTIC KLTPPSRIFD "" CURVE 0x800436CC KlAxU8SstxU16WU16 1.999969 fak_q3p0518Em5 0.00 1.999969 FORMAT "%8.6"
 /begin AXIS_DESCR STD_AXIS fdpslma_w fak_q3p0518Em5 5 0.00 1.999969 FORMAT "%8.6" DEPOSIT ABSOLUTE /end AXIS_DESCR
/end CHARACTERISTIC
/begin CHARACTERISTIC KLTSWITCH "" CURVE 0x80043D44 KlAxU8SstxU8WU8 254.0 dez 1.000 255.0 FORMAT "%5.1"
 /begin AXIS_DESCR STD_AXIS nmot nmot_ub_q40 3 0.00 10200. FORMAT "%5.0" DEPOSIT ABSOLUTE /end AXIS_DESCR
/end CHARACTERISTIC
/begin CHARACTERISTIC KLTTOSPM1 "" CURVE 0x80043D4C KlAxU8SstxU8WU16 65534.00 dez 1.000000 65535.00 FORMAT "%8.2"
 /begin AXIS_DESCR STD_AXIS nmot nmot_ub_q40 3 0.00 10200. FORMAT "%5.0" DEPOSIT ABSOLUTE /end AXIS_DESCR
/end CHARACTERISTIC
/begin CHARACTERISTIC KLTTOSPM2 "" CURVE 0x80043D56 KlAxU8SstxU8WU16 65534.00 dez 1.000000 65535.00 FORMAT "%8.2"
 /begin AXIS_DESCR STD_AXIS nmot nmot_ub_q40 3 0.00 10200. FORMAT "%5.0" DEPOSIT ABSOLUTE /end AXIS_DESCR
/end CHARACTERISTIC
/begin CHARACTERISTIC KLWMKHFOEX "" CURVE 0x8004403C GklWU8 31.88 fak_ub_b32 0.00 31.88 FORMAT "%5.2"
 /begin AXIS_DESCR COM_AXIS tmst temp_ub_q0p75_o48 10 -48.00 143.3 FORMAT "%5.1" AXIS_PTS_REF STN10TMUB /end AXIS_DESCR
/end CHARACTERISTIC
/begin CHARACTERISTIC KLWMKHHOEX "" CURVE 0x80044046 GklWU8 31.88 fak_ub_b32 0.00 31.88 FORMAT "%5.2"
 /begin AXIS_DESCR COM_AXIS tmst temp_ub_q0p75_o48 10 -48.00 143.3 FORMAT "%5.1" AXIS_PTS_REF STN10TMUB /end AXIS_DESCR
/end CHARACTERISTIC
/begin CHARACTERISTIC KLWMKHVOEX "" CURVE 0x80044050 GklWU8 31.88 fak_ub_b32 0.00 31.88 FORMAT "%5.2"
 /begin AXIS_DESCR COM_AXIS tmst temp_ub_q0p75_o48 10 -48.00 143.3 FORMAT "%5.1" AXIS_PTS_REF STN10TMUB /end AXIS_DESCR
/end CHARACTERISTIC
/begin CHARACTERISTIC KLWMKKHFSO "" CURVE 0x8004405A GklWU8 31.88 fak_ub_b32 0.00 31.88 FORMAT "%5.2"
 /begin AXIS_DESCR COM_AXIS tmst temp_ub_q0p75_o48 10 -48.00 143.3 FORMAT "%5.1" AXIS_PTS_REF STN10TMUB /end AXIS_DESCR
/end CHARACTERISTIC
/begin CHARACTERISTIC KLWMKKHHSO "" CURVE 0x80044064 GklWU8 31.88 fak_ub_b32 0.00 31.88 FORMAT "%5.2"
 /begin AXIS_DESCR COM_AXIS tmst temp_ub_q0p75_o48 10 -48.00 143.3 FORMAT "%5.1" AXIS_PTS_REF STN10TMUB /end AXIS_DESCR
/end CHARACTERISTIC
/begin CHARACTERISTIC KLWMKKHVSO "" CURVE 0x8004406E GklWU8 31.88 fak_ub_b32 0.00 31.88 FORMAT "%5.2"
 /begin AXIS_DESCR COM_AXIS tmst temp_ub_q0p75_o48 10 -48.00 143.3 FORMAT "%5.1" AXIS_PTS_REF STN10TMUB /end AXIS_DESCR
/end CHARACTERISTIC
/begin CHARACTERISTIC KMSDK "" VALUE 0x80043500 KwWU16 7.999878 fak_uw_b8 0.00 7.999878 FORMAT "%8.6" /end CHARACTERISTIC
/begin CHARACTERISTIC KUMSIRL "" VALUE 0x8004376A KwWU16 0.003999938965 kumsrl_uw_b0p004 0.00 0.003999938965 FORMAT "%14.12" /end CHARACTERISTIC
/begin CHARACTERISTIC LASTCMN "" VALUE 0x80042D16 KwWU16 15.99976 fak_q0p000244 0.00 15.99976 FORMAT "%8.5" /end CHARACTERISTIC
/begin CHARACTERISTIC LASTCMX "" VALUE 0x80042D18 KwWU16 15.99976 fak_q0p000244 0.00 15.99976 FORMAT "%8.5" /end CHARACTERISTIC
/begin CHARACTERISTIC LNXQTMM "" CURVE 0x8004390A KlAxU8SstxU16WU16 255.9961 fak_uw_b256 0.00 255.9961 FORMAT "%8.4"
 /begin AXIS_DESCR STD_AXIS xqtmm_w fak_uw_b256 16 0.00 255.9961 FORMAT "%8.4" DEPOSIT ABSOLUTE /end AXIS_DESCR
/end CHARACTERISTIC
/begin CHARACTERISTIC MLTUMLIM "" VALUE 0x800441CB KwWU8 1020. m_ub_b1020 0.00 1020. FORMAT "%5.0" /end CHARACTERISTIC
/begin CHARACTERISTIC MLTUMTA "" VALUE 0x800441CC KwWU8 1020. m_ub_b1020 0.00 1020. FORMAT "%5.0" /end CHARACTERISTIC
/begin CHARACTERISTIC MSNLLSP "" CURVE 0x80043502 KlAxU8SstxU16WU16 102.3984 m_uw_b102p4 0.00 102.3984 FORMAT "%8.4"
 /begin AXIS_DESCR STD_AXIS IdleChrgActr_ratActVal Prc 16 0.00 100.0000 FORMAT "%8.4" DEPOSIT ABSOLUTE /end AXIS_DESCR
/end CHARACTERISTIC
/begin CHARACTERISTIC MSNRIRSP "" CURVE 0x800432FC KlAxU8SstxS16WU16 409.5938 m_q0p00625 0.00 409.5938 FORMAT "%8.4"
 /begin AXIS_DESCR STD_AXIS wgvum_w kw_sw_q0p0156 10 -512.00000 511.98438 DEPOSIT ABSOLUTE /end AXIS_DESCR
/end CHARACTERISTIC
/begin CHARACTERISTIC NMOTRLNBKV "" VALUE 0x800437BE KwWU16 16383.75 nmot_uw_q0p25 0.00 16383.75 FORMAT "%8.2" /end CHARACTERISTIC
/begin CHARACTERISTIC NPNDKGMN "" VALUE 0x800436CA KwWU16 16383.75 nmot_q0p25 0.00 16383.75 FORMAT "%8.2" /end CHARACTERISTIC
/begin CHARACTERISTIC NPSRSEG "" VALUE 0x800436E2 KwWU16 16383.75 nmot_q0p25 0.00 16383.75 FORMAT "%8.2" /end CHARACTERISTIC
/begin CHARACTERISTIC NPULSMN "" VALUE 0x800436E4 KwWU16 16383.75 nmot_q0p25 0.00 16383.75 FORMAT "%8.2" /end CHARACTERISTIC
/begin CHARACTERISTIC NRKTPATU "" CURVE 0x80044078 KlAxU8SstxU16WU16 50330880. relnmot_q768 0.00 50330880. FORMAT "%8.0"
 /begin AXIS_DESCR STD_AXIS tumgktpe_w temp_q0p0234_o273 4 -273.1500 1262.827 FORMAT "%8.3" DEPOSIT ABSOLUTE /end AXIS_DESCR
/end CHARACTERISTIC
/begin CHARACTERISTIC NRKTPFTU "" CURVE 0x8004408A KlAxU8SstxU16WU16 50330880. relnmot_q768 0.00 50330880. FORMAT "%8.0"
 /begin AXIS_DESCR STD_AXIS tumgktpe_w temp_q0p0234_o273 4 -273.1500 1262.827 FORMAT "%8.3" DEPOSIT ABSOLUTE /end AXIS_DESCR
/end CHARACTERISTIC
/begin CHARACTERISTIC NRKTPKTU "" CURVE 0x8004409C KlAxU8SstxU16WU16 50330880. relnmot_q768 0.00 50330880. FORMAT "%8.0"
 /begin AXIS_DESCR STD_AXIS tumgktpe_w temp_q0p0234_o273 4 -273.1500 1262.827 FORMAT "%8.3" DEPOSIT ABSOLUTE /end AXIS_DESCR
/end CHARACTERISTIC
/begin CHARACTERISTIC NRKTPKTUS "" CURVE 0x800440AE KlAxU8SstxU16WU16 50330880. relnmot_q768 0.00 50330880. FORMAT "%8.0"
 /begin AXIS_DESCR STD_AXIS tumgktpe_w temp_q0p0234_o273 4 -273.1500 1262.827 FORMAT "%8.3" DEPOSIT ABSOLUTE /end AXIS_DESCR
/end CHARACTERISTIC
/begin CHARACTERISTIC NWKEV "" VALUE 0x80043CC0 KwWU16 16383.75 nmot_q0p25 0.00 16383.75 FORMAT "%8.2" /end CHARACTERISTIC
/begin CHARACTERISTIC OFMSNDKTN "" VALUE 0x80043544 KwWS16 6553.500 m_q0p1 -3276.800 3276.700 FORMAT "%8.3" /end CHARACTERISTIC
/begin CHARACTERISTIC OFMSNDKTX "" VALUE 0x80043546 KwWS16 6553.500 m_q0p1 -3276.800 3276.700 FORMAT "%8.3" /end CHARACTERISTIC
/begin CHARACTERISTIC PBRINTMN "" VALUE 0x80043326 KwWU16 2559.961 p_uw_q0p039 0.00 2559.961 FORMAT "%8.3" /end CHARACTERISTIC
/begin CHARACTERISTIC PBRINTMX "" VALUE 0x80043328 KwWU16 2559.961 p_uw_q0p039 0.00 2559.961 FORMAT "%8.3" /end CHARACTERISTIC
/begin CHARACTERISTIC PLFMS "" CURVE 0x80043700 KlAxU8SstxU16WU16 5119.922 p_uw_q0p078 0.00 5119.922 FORMAT "%8.3"
 /begin AXIS_DESCR STD_AXIS msdk_w m_uw_b6553p5 8 0.00 6553.500 FORMAT "%8.3" DEPOSIT ABSOLUTE /end AXIS_DESCR
/end CHARACTERISTIC
/begin CHARACTERISTIC PSREMN "" VALUE 0x80043786 KwWU16 5119.922 p_q0p078 0.00 5119.922 FORMAT "%8.3" /end CHARACTERISTIC
/begin CHARACTERISTIC PSREMX "" VALUE 0x80043788 KwWU16 5119.922 p_q0p078 0.00 5119.922 FORMAT "%8.3" /end CHARACTERISTIC
/begin CHARACTERISTIC PUE "" VALUE 0x80043722 KwWU8 2550. p_ub_q10 0.00 2550. FORMAT "%5.0" /end CHARACTERISTIC
/begin CHARACTERISTIC PUMN "" VALUE 0x80043724 KwWU16 5119.922 p_uw_q0p078 0.00 5119.922 FORMAT "%8.3" /end CHARACTERISTIC
/begin CHARACTERISTIC PUMX "" VALUE 0x80043726 KwWU16 5119.922 p_uw_q0p078 0.00 5119.922 FORMAT "%8.3" /end CHARACTERISTIC
/begin CHARACTERISTIC PVDEMN "" VALUE 0x80043766 KwWU16 5119.922 p_uw_q0p078 0.00 5119.922 FORMAT "%8.3" /end CHARACTERISTIC
/begin CHARACTERISTIC PVDEMX "" VALUE 0x80043768 KwWU16 5119.922 p_uw_q0p078 0.00 5119.922 FORMAT "%8.3" /end CHARACTERISTIC
/begin CHARACTERISTIC RECIKAPPA "" VALUE 0x8004332A KwWU16 0.9999847 fak_uw_b1 0.00 0.9999847 FORMAT "%9.7" /end CHARACTERISTIC
/begin CHARACTERISTIC RLMNN "" CURVE 0x800437C0 KlAxU8SstxU16WU16 1535.977 rel_q0p02344 0.00 1535.977 FORMAT "%8.3"
 /begin AXIS_DESCR STD_AXIS nmot_w nmot_uw_q0p25 12 0.00 16383.75 FORMAT "%8.2" DEPOSIT ABSOLUTE /end AXIS_DESCR
/end CHARACTERISTIC
/begin CHARACTERISTIC RLMNSABKV "" VALUE 0x800437F2 KwWU16 1535.977 rel_q0p02344 0.00 1535.977 FORMAT "%8.3" /end CHARACTERISTIC
/begin CHARACTERISTIC RLMNSAN "" CURVE 0x800437F4 KlAxU8SstxU16WU16 1535.977 rel_q0p02344 0.00 1535.977 FORMAT "%8.3"
 /begin AXIS_DESCR STD_AXIS nmot_w nmot_uw_q0p25 12 0.00 16383.75 FORMAT "%8.2" DEPOSIT ABSOLUTE /end AXIS_DESCR
/end CHARACTERISTIC
/begin CHARACTERISTIC RLMNSATRN "" CURVE 0x80043826 KlAxU8SstxU16WU16 1535.977 rel_q0p02344 0.00 1535.977 FORMAT "%8.3"
 /begin AXIS_DESCR STD_AXIS nmot_w nmot_uw_q0p25 12 0.00 16383.75 FORMAT "%8.2" DEPOSIT ABSOLUTE /end AXIS_DESCR
/end CHARACTERISTIC
/begin CHARACTERISTIC RLMNTRN "" CURVE 0x80043858 KlAxU8SstxU16WU16 1535.977 rel_q0p02344 0.00 1535.977 FORMAT "%8.3"
 /begin AXIS_DESCR STD_AXIS nmot_w nmot_uw_q0p25 12 0.00 16383.75 FORMAT "%8.2" DEPOSIT ABSOLUTE /end AXIS_DESCR
/end CHARACTERISTIC
/begin CHARACTERISTIC RLNOT "" CURVE 0x8004376C KlAxU8SstxU8WU16 1535.977 rel_uw_q0p0234 0.00 1535.977 FORMAT "%8.3"
 /begin AXIS_DESCR STD_AXIS nmot nmot_ub_q40 6 0.00 10200. FORMAT "%5.0" DEPOSIT ABSOLUTE /end AXIS_DESCR
/end CHARACTERISTIC
/begin CHARACTERISTIC RVBRVL "" CURVE 0x8004388C KlAxU8SstxU8WU16 199.9922 rel_uw_q0p0234 0.00 199.9922 FORMAT "%8.4"
 /begin AXIS_DESCR STD_AXIS nmot nmot_ub_q40 12 0.00 10200. FORMAT "%5.0" DEPOSIT ABSOLUTE /end AXIS_DESCR
/end CHARACTERISTIC
/begin CHARACTERISTIC SAPSRR "" VALUE 0x800436E6 KwWU16 5119.922 p_q0p078 0.00 5119.922 FORMAT "%8.3" /end CHARACTERISTIC
/begin CHARACTERISTIC SF_TUM "" VAL_BLK 0x800441CE KwbWU16 86. dfp_verbal 0.00 86. FORMAT "%2.0" READ_ONLY NUMBER 7 /end CHARACTERISTIC
/begin AXIS_PTS STF10TMUW "" 0x800440C0 tafsost_w SstAU8SstU16 1535.977 temp_q0p0234_o273 10 -273.1500 1262.827 FORMAT "%8.3" DEPOSIT ABSOLUTE /end AXIS_PTS
/begin AXIS_PTS STH10TMUW "" 0x800440D6 tahsost_w SstAU8SstU16 1535.977 temp_q0p0234_o273 10 -273.1500 1262.827 FORMAT "%8.3" DEPOSIT ABSOLUTE /end AXIS_PTS
/begin AXIS_PTS STMS10TMUB "" 0x800440EC tmsttpe SstAU8SstU8 191.3 temp_ub_q0p75_o48 10 -48.00 143.3 FORMAT "%5.1" DEPOSIT ABSOLUTE /end AXIS_PTS
/begin AXIS_PTS STN10TMUB "" 0x800440F7 tmst SstAU8SstU8 191.3 temp_ub_q0p75_o48 10 -48.00 143.3 FORMAT "%5.1" DEPOSIT ABSOLUTE /end AXIS_PTS
/begin AXIS_PTS STS06TMUW "" 0x80044102 tabstlc_w SstAU8SstU16 65535.00 t1sxs_uw_q1 6 0.00 65535.00 FORMAT "%8.2" DEPOSIT ABSOLUTE /end AXIS_PTS
/begin AXIS_PTS STV10TMUW "" 0x80044110 tavsost_w SstAU8SstU16 1535.977 temp_q0p0234_o273 10 -273.1500 1262.827 FORMAT "%8.3" DEPOSIT ABSOLUTE /end AXIS_PTS
/begin CHARACTERISTIC SWTMOT "" VALUE 0x80043D60 KwWU8 191.3 temp_ub_q0p75_o48 -48.00 143.3 FORMAT "%5.1" /end CHARACTERISTIC
/begin CHARACTERISTIC SWTOSPM "" VALUE 0x80043D62 KwWU16 1535.977 temp_q0p0234_o273 -273.1500 1262.827 FORMAT "%8.3" /end CHARACTERISTIC
/begin CHARACTERISTIC TABMNTUM "" VALUE 0x800441DC KwWU16 65365.00 t1sxs_uw_q1 0.00 65365.00 FORMAT "%8.2" /end CHARACTERISTIC
/begin CHARACTERISTIC TABSTABMX "" VALUE 0x80044126 KwWU16 65535.00 t1sxs_uw_q1 0.00 65535.00 FORMAT "%8.2" /end CHARACTERISTIC
/begin CHARACTERISTIC TADMM "" VALUE 0x80043900 KwWU8 255.0 t_q1 0.00 255.0 FORMAT "%5.1" /end CHARACTERISTIC
/begin CHARACTERISTIC TAFSOMN "" VALUE 0x80044128 KwWU16 1535.977 temp_q0p0234_o273 -273.1500 1262.827 FORMAT "%8.3" /end CHARACTERISTIC
/begin CHARACTERISTIC TAHSOMN "" VALUE 0x8004412A KwWU16 1535.977 temp_q0p0234_o273 -273.1500 1262.827 FORMAT "%8.3" /end CHARACTERISTIC
/begin CHARACTERISTIC TALLOWOST "" VALUE 0x8004412C KwWU8 51.00 t_q0p2 0.00 51.00 FORMAT "%5.2" /end CHARACTERISTIC
/begin CHARACTERISTIC TASRMEW "" VALUE 0x800438C0 KwWU16 1535.977 temp_q0p0234_o273 -273.1500 1262.827 FORMAT "%8.3" /end CHARACTERISTIC
/begin CHARACTERISTIC TATMRTPA "" VALUE 0x8004412E KwWU16 13107.00 t_q0p2 0.00 13107.00 FORMAT "%8.2" /end CHARACTERISTIC
/begin CHARACTERISTIC TATMRTPFK "" VALUE 0x80044130 KwWU16 13107.00 t_q0p2 0.00 13107.00 FORMAT "%8.2" /end CHARACTERISTIC
/begin CHARACTERISTIC TATMRTPK "" VALUE 0x80044132 KwWU16 13107.00 t_q0p2 0.00 13107.00 FORMAT "%8.2" /end CHARACTERISTIC
/begin CHARACTERISTIC TATMSTI "" VALUE 0x80044134 KwWU16 1535.977 temp_q0p0234_o273 -273.1500 1262.827 FORMAT "%8.3" /end CHARACTERISTIC
/begin CHARACTERISTIC TAVDKMEW "" VALUE 0x800438C6 KwWU16 1535.977 temp_q0p0234_o273 -273.1500 1262.827 FORMAT "%8.3" /end CHARACTERISTIC
/begin CHARACTERISTIC TAVSOMN "" VALUE 0x80044136 KwWU16 1535.977 temp_q0p0234_o273 -273.1500 1262.827 FORMAT "%8.3" /end CHARACTERISTIC
/begin CHARACTERISTIC TBNMOTDEB "" VALUE 0x8004396C KwWU8 11.75 t_q0p05 1.000 12.75 FORMAT "%5.2" /end CHARACTERISTIC
/begin CHARACTERISTIC TDGTUMG "" VALUE 0x800441DE KwWU8 255.0 t_q1 0.00 255.0 FORMAT "%5.1" /end CHARACTERISTIC
/begin CHARACTERISTIC TDIPUDSS "" VALUE 0x80043728 KwWU8 255.0 t_q1 0.00 255.0 FORMAT "%5.1" /end CHARACTERISTIC
/begin CHARACTERISTIC TDKPV "" VALUE 0x800441F2 KwWU8 2.550 t10msxs_ub_b2p55 0.00 2.550 FORMAT "%5.3" /end CHARACTERISTIC
/begin CHARACTERISTIC TDRLNBKV "" VALUE 0x8004388A KwWU8 5.100 t_q0p02 0.00 5.100 FORMAT "%5.3" /end CHARACTERISTIC
/begin CHARACTERISTIC TDRLRLPMAX "" VALUE 0x800438BC KwWU16 655.3500 t_q0p01 0.00 655.3500 FORMAT "%8.4" /end CHARACTERISTIC
/begin CHARACTERISTIC TDTEVATI "" CURVE 0x80043CC2 KlAxU8SstxU16WU8 0.9961 fak_q0p0039 0.00 0.9961
 /begin AXIS_DESCR STD_AXIS anztib_w dez 6 0.00 65535.00 FORMAT "%8.2" DEPOSIT ABSOLUTE /end AXIS_DESCR
/end CHARACTERISTIC
/begin CHARACTERISTIC TECUOMDEF "" VALUE 0x8004394C KwWS32 2147483647.00 t_q1 0.00 2147483647.00 FORMAT "%13.2" /end CHARACTERISTIC
/begin CHARACTERISTIC TECUOMMNEX "" VALUE 0x80043950 KwWU16 3276.750 t_q0p05 0.00 3276.750 FORMAT "%8.3" /end CHARACTERISTIC
/begin CHARACTERISTIC TECUOMMXEX "" VALUE 0x80043952 KwWU16 3276.750 t_q0p05 0.00 3276.750 FORMAT "%8.3" /end CHARACTERISTIC
/begin CHARACTERISTIC TECUOMSDEF "" VALUE 0x80043954 KwWU8 1.000 dez 2.000 3.000 FORMAT "%5.3" /end CHARACTERISTIC
/begin CHARACTERISTIC TENGOMMX "" VALUE 0x80043958 KwWS32 2147483647.00 t_q1 0.00 2147483647.00 FORMAT "%13.2" /end CHARACTERISTIC
/begin CHARACTERISTIC TEVSMX "" VALUE 0x80043CD6 KwWU8 191.3 temp_q0p75_om48 -48.00 143.3 FORMAT "%5.1" /end CHARACTERISTIC
/begin CHARACTERISTIC TFA1RP "" VALUE 0x8004396E KwWU16 1535.977 temp_q0p0234_o273 -273.1500 1262.827 FORMAT "%8.3" /end CHARACTERISTIC
/begin CHARACTERISTIC TFTTAIKR "" VALUE 0x800436A2 KwWU16 3276.7499992 zk50msxs_uw_b3276p8 0.050000762951 3276.8000000 FORMAT "%12.7" /end CHARACTERISTIC
/begin CHARACTERISTIC TMDMMA "" VALUE 0x80043901 KwWU8 191.3 temp_ub_q0p75_o48 -48.00 143.3 FORMAT "%5.1" /end CHARACTERISTIC
/begin CHARACTERISTIC TMDMMEE "" VALUE 0x80043902 KwWU16 188.0010 temp_uw_q0p0029_o48 -48.00000 140.0010 FORMAT "%8.4" /end CHARACTERISTIC
/begin CHARACTERISTIC TMDMMES "" VALUE 0x80043904 KwWU8 191.3 temp_ub_q0p75_o48 -48.00 143.3 FORMAT "%5.1" /end CHARACTERISTIC
/begin CHARACTERISTIC TMMXTUM "" VALUE 0x800441DF KwWU8 191.3 temp_ub_q0p75_o48 -48.00 143.3 FORMAT "%5.1" /end CHARACTERISTIC
/begin CHARACTERISTIC TMOTABINI "" VALUE 0x80043905 KwWU8 191.3 temp_ub_q0p75_o48 -48.00 143.3 FORMAT "%5.1" /end CHARACTERISTIC
/begin CHARACTERISTIC TMOTICTRMN "" VALUE 0x800441E0 KwWU8 191.3 temp_ub_q0p75_o48 -48.00 143.3 FORMAT "%5.1" /end CHARACTERISTIC
/begin CHARACTERISTIC TMOTLTT "" VALUE 0x80043906 KwWU8 25.40 t_q0p1 0.1000 25.50 FORMAT "%5.2" /end CHARACTERISTIC
/begin CHARACTERISTIC TMOTWRMK "" VALUE 0x80043CD7 KwWU8 191.3 temp_q0p75_om48 -48.00 143.3 FORMAT "%5.1" /end CHARACTERISTIC
/begin CHARACTERISTIC TMSBRKR "" CURVE 0x8004332C KlAxU8SstxU16WU16 0.9999847 fak_uw_b1 0.00 0.9999847 FORMAT "%9.7"
 /begin AXIS_DESCR STD_AXIS vpsrabg_w fak_uw_b2 5 0.00 1.999969 FORMAT "%8.6" DEPOSIT ABSOLUTE /end AXIS_DESCR
/end CHARACTERISTIC
/begin CHARACTERISTIC TMSTINIT "" VALUE 0x80043907 KwWU8 191.3 temp_ub_q0p75_o48 -48.00 143.3 FORMAT "%5.1" /end CHARACTERISTIC
/begin CHARACTERISTIC TNMNSRMDK "" VALUE 0x8004378A KwWU16 655.3500 t_q0p01 0.00 655.3500 FORMAT "%8.4" /end CHARACTERISTIC
/begin CHARACTERISTIC TNSEOSC "" VALUE 0x8004369E KwWU16 6553.500 t100msxs_uw_b6553p5 0.00 6553.500 FORMAT "%8.3" /end CHARACTERISTIC
/begin CHARACTERISTIC TNSEPUSAFZ "" VALUE 0x80043729 KwWU8 25.50 t_q0p1 0.00 25.50 FORMAT "%5.2" /end CHARACTERISTIC
/begin CHARACTERISTIC TOFDMSMNSA "" VALUE 0x80044138 KwWU8 51.00 t_q0p2 0.00 51.00 FORMAT "%5.2" /end CHARACTERISTIC
/begin CHARACTERISTIC TOSPMQD "" VALUE 0x80043D64 KwWU16 65535.00 t_q1 0.00 65535.00 FORMAT "%8.2" /end CHARACTERISTIC
/begin CHARACTERISTIC TOSPMQDS "" VALUE 0x80043D66 KwWU16 65535.00 t_q1 0.00 65535.00 FORMAT "%8.2" /end CHARACTERISTIC
/begin CHARACTERISTIC TOSPMQWS "" VALUE 0x80043D68 KwWU8 191.3 temp_ub_q0p75_o48 -48.00 143.3 FORMAT "%5.1" /end CHARACTERISTIC
/begin CHARACTERISTIC TOSPMTWS "" VALUE 0x80043D6A KwWU16 65535.00 t_q1 0.00 65535.00 FORMAT "%8.2" /end CHARACTERISTIC
/begin CHARACTERISTIC TOSPREPL "" VALUE 0x80043D6C KwWU16 1535.977 temp_q0p0234_o273 -273.1500 1262.827 FORMAT "%8.3" /end CHARACTERISTIC
/begin CHARACTERISTIC TOSPREPLI "" VALUE 0x80043D6E KwWU16 1535.977 temp_q0p0234_o273 -273.1500 1262.827 FORMAT "%8.3" /end CHARACTERISTIC
/begin CHARACTERISTIC TTOCHLWTD "" VALUE 0x80043CEC KwWU8 255.0 t_q1 0.00 255.0 FORMAT "%5.1" /end CHARACTERISTIC
/begin CHARACTERISTIC TTOCHLWTP "" VALUE 0x80043CED KwWU8 254.0 t_q1 1.000 255.0 FORMAT "%5.1" /end CHARACTERISTIC
/begin CHARACTERISTIC TTOSPMVLD "" VALUE 0x80043D70 KwWU16 65535.00 t_q1 0.00 65535.00 FORMAT "%8.2" /end CHARACTERISTIC
/begin CHARACTERISTIC TTUMMICTR "" VALUE 0x800441E2 KwWU16 65535.00 t_q1 0.00 65535.00 FORMAT "%8.2" /end CHARACTERISTIC
/begin CHARACTERISTIC TUGDTX "" VALUE 0x80043548 KwWU8 2.550 t_q0p01 0.00 2.550 FORMAT "%5.3" /end CHARACTERISTIC
/begin CHARACTERISTIC TUMGTPEBU "" VALUE 0x8004413A KwWU16 1535.977 temp_q0p0234_o273 -273.1500 1262.827 FORMAT "%8.3" /end CHARACTERISTIC
/begin CHARACTERISTIC TUMMTANSMN "" VALUE 0x800441E4 KwWU8 191.3 temp_ub_q0p75_o48 -48.00 143.3 FORMAT "%5.1" /end CHARACTERISTIC
/begin CHARACTERISTIC TUMMTANSMX "" VALUE 0x800441E5 KwWU8 191.3 temp_ub_q0p75_o48 -48.00 143.3 FORMAT "%5.1" /end CHARACTERISTIC
/begin CHARACTERISTIC TUMMTMOTMN "" VALUE 0x800441E6 KwWU8 191.3 temp_ub_q0p75_o48 -48.00 143.3 FORMAT "%5.1" /end CHARACTERISTIC
/begin CHARACTERISTIC TUMMTMOTMX "" VALUE 0x800441E7 KwWU8 191.3 temp_ub_q0p75_o48 -48.00 143.3 FORMAT "%5.1" /end CHARACTERISTIC
/begin CHARACTERISTIC TUMTAI "" VALUE 0x800441E8 KwWU8 191.3 temp_ub_q0p75_o48 -48.00 143.3 FORMAT "%5.1" /end CHARACTERISTIC
/begin CHARACTERISTIC TVTUMTO "" VALUE 0x800441E9 KwWU8 255.0 t_q1 0.00 255.0 FORMAT "%5.1" /end CHARACTERISTIC
/begin CHARACTERISTIC TWTPEAPFSO "" VALUE 0x8004413C KwWU16 1535.977 temp_q0p0234_o273 -273.1500 1262.827 FORMAT "%8.3" /end CHARACTERISTIC
/begin CHARACTERISTIC TWTPEAPHSO "" VALUE 0x8004413E KwWU16 1535.977 temp_q0p0234_o273 -273.1500 1262.827 FORMAT "%8.3" /end CHARACTERISTIC
/begin CHARACTERISTIC TWTPEAPVSO "" VALUE 0x80044140 KwWU16 1535.977 temp_q0p0234_o273 -273.1500 1262.827 FORMAT "%8.3" /end CHARACTERISTIC
/begin CHARACTERISTIC VHA "" VALUE 0x8004372A KwWU8 318.8 vfzg_ub_q1p25 0.00 318.8 FORMAT "%5.1" /end CHARACTERISTIC
/begin CHARACTERISTIC VHAVFZG "" VALUE 0x8004372B KwWU8 318.8 vfzg_ub_q1p25 0.00 318.8 FORMAT "%5.1" /end CHARACTERISTIC
/begin CHARACTERISTIC VHUBZYL "" VALUE 0x8004378C KwWU16 46.00562 vol_q0p702Em3_dm3 0.00 46.00562 FORMAT "%8.5" /end CHARACTERISTIC
/begin CHARACTERISTIC VPPSRMSM "" VALUE 0x8004378E KwWU16 1.999969 fak_q3p0518Em5 0.00 1.999969 FORMAT "%8.6" /end CHARACTERISTIC
/begin CHARACTERISTIC VPPSRMSMHY "" VALUE 0x80043790 KwWU16 1.999969 fak_q3p0518Em5 0.00 1.999969 FORMAT "%8.6" /end CHARACTERISTIC
/begin CHARACTERISTIC VPSRMHVDUG "" VALUE 0x8004354A KwWU16 1.999969 fak_uw_b2 0.00 1.999969 FORMAT "%8.6" /end CHARACTERISTIC
/begin CHARACTERISTIC VPSRVDUGD "" VALUE 0x8004354C KwWU16 1.999969 fak_uw_b2 0.00 1.999969 FORMAT "%8.6" READ_ONLY /end CHARACTERISTIC
/begin CHARACTERISTIC VSAUGROHR "" VALUE 0x80043792 KwWU16 46.00491 vol_q0p702Em3_dm3 0.0007020007 46.00562 FORMAT "%8.5" /end CHARACTERISTIC
/begin CHARACTERISTIC VTUMTA "" VALUE 0x800441EA KwWU8 318.8 vfzg_ub_q1p25 0.00 318.8 FORMAT "%5.1" /end CHARACTERISTIC
/begin CHARACTERISTIC WDKHKDN "" CURVE 0x8004372C KlAxU8SstxU8WU8 100.0 relDK_q0p3922 0.00 100.0 FORMAT "%5.1"
 /begin AXIS_DESCR STD_AXIS nmot nmot_ub_q40 8 0.00 10200. FORMAT "%5.0" DEPOSIT ABSOLUTE /end AXIS_DESCR
/end CHARACTERISTIC
/begin CHARACTERISTIC WDKHKN "" CURVE 0x8004373D KlAxU8SstxU8WU8 100.0 relDK_q0p3922 0.00 100.0 FORMAT "%5.1"
 /begin AXIS_DESCR STD_AXIS nmot nmot_ub_q40 8 0.00 10200. FORMAT "%5.0" DEPOSIT ABSOLUTE /end AXIS_DESCR
/end CHARACTERISTIC
/begin CHARACTERISTIC WGVAS "" VALUE 0x800441F8 KwWS16 1023.984 kw_q0p0156 -512.0000 511.9844 FORMAT "%8.4" /end CHARACTERISTIC
/begin CHARACTERISTIC WGVEO "" VALUE 0x800441FA KwWS16 1023.984 kw_q0p0156 -512.0000 511.9844 FORMAT "%8.4" /end CHARACTERISTIC
/begin CHARACTERISTIC WZFTEMP "" CURVE 0x800436A4 KlAxU8SstxU16WU16 1.999939 fak_uw_b2 0.00003051758 1.999969 FORMAT "%8.6"
 /begin AXIS_DESCR STD_AXIS ttaikrs_w temp_q0p0234_o273 9 -273.1500 1262.827 FORMAT "%8.3" DEPOSIT ABSOLUTE /end AXIS_DESCR
/end CHARACTERISTIC
/begin CHARACTERISTIC ZBRT "" VALUE 0x80043CD8 KwWU16 6553.4999985 zk100msxs_uw_b6553 0.10000152590 6553.6000000 FORMAT "%12.7" /end CHARACTERISTIC
/begin CHARACTERISTIC ZFMODTUM "" VALUE 0x800441EC KwWU16 6553.400 t_q0p1 0.1000000 6553.500 FORMAT "%8.3" /end CHARACTERISTIC
/begin CHARACTERISTIC ZKORFKISRM "" VALUE 0x80043794 KwWU16 1.999969 fak_q3p0518Em5 0.00 1.999969 FORMAT "%8.6" /end CHARACTERISTIC
/begin CHARACTERISTIC ZKTABTUM "" CURVE 0x8004395C KlAxU8SstxU8WU16 65535.00 t_q1 0.00 65535.00 FORMAT "%8.2"
 /begin AXIS_DESCR STD_AXIS tumg temp_ub_q0p75_o48 4 -48.00 143.3 FORMAT "%5.1" DEPOSIT ABSOLUTE /end AXIS_DESCR
/end CHARACTERISTIC
/begin CHARACTERISTIC ZPUN "" VALUE 0x8004374E KwWU16 65534.00 t1sxs_uw_b65535 1.000000 65535.00 FORMAT "%8.2" /end CHARACTERISTIC
/begin CHARACTERISTIC ZPUSA "" VALUE 0x80043750 KwWU16 65534.00 t1sxs_uw_b65535 1.000000 65535.00 FORMAT "%8.2" /end CHARACTERISTIC
/begin CHARACTERISTIC ZPUVL "" VALUE 0x80043752 KwWU16 65534.00 t1sxs_uw_b65535 1.000000 65535.00 FORMAT "%8.2" /end CHARACTERISTIC
/begin CHARACTERISTIC ZTMMBR "" VALUE 0x800438C2 KwWU16 6553.4999985 zk100msxs_uw_b6553 0.10000152590 6553.6000000 FORMAT "%12.7" /end CHARACTERISTIC
/begin MEASUREMENT atmabkfso "" UBYTE fak_ub_b1 1 100 0.00 0.9961 ECU_ADDRESS 0xD0000C1C /end MEASUREMENT
/begin MEASUREMENT atmabkhso "" UBYTE fak_ub_b1 1 100 0.00 0.9961 ECU_ADDRESS 0xD0000C1D /end MEASUREMENT
/begin MEASUREMENT atmabkvso "" UBYTE fak_ub_b1 1 100 0.00 0.9961 ECU_ADDRESS 0xD0000C1E /end MEASUREMENT
/begin MEASUREMENT bfzgbkv_w "" SWORD bfzg_q0p1085069 1 100 -3555.556 3555.447 FORMAT "%8.3" ECU_ADDRESS 0xD000041A /end MEASUREMENT
/begin MEASUREMENT BGPBRINT_CL_akt.pbrintuk "" UWORD p_sw_q0p039 1 100 0.00 2559.961 FORMAT "%8.3" ECU_ADDRESS 0xD000106C /end MEASUREMENT
/begin MEASUREMENT BGPBRINT_CL_akt.rfkrbrrx "" UWORD rel_q0p02344 1 100 0.00 1535.977 FORMAT "%8.3" ECU_ADDRESS 0xD000106E /end MEASUREMENT
/begin MEASUREMENT BGPBRINT_CL_akt.rfrintX_w "" UWORD rel_q0p02344 1 100 0.00 1535.977 FORMAT "%8.3" ECU_ADDRESS 0xD0001070 /end MEASUREMENT
/begin MEASUREMENT BGPBRINT_CL_akt.rfriresX_w "" UWORD rel_q0p02344 1 100 0.00 1535.977 FORMAT "%8.3" ECU_ADDRESS 0xD0001072 /end MEASUREMENT
/begin MEASUREMENT BGPBRINT_CL_akt.rfrirspX_w "" UWORD rel_q0p02344 1 100 0.00 1535.977 FORMAT "%8.3" ECU_ADDRESS 0xD0001074 /end MEASUREMENT
/begin MEASUREMENT BGPBRINT_CL_akt.trfrintx "" UWORD temp_q0p0234_o273 1 100 -273.1500 1262.827 FORMAT "%8.3" ECU_ADDRESS 0xD0001076 /end MEASUREMENT
/begin MEASUREMENT BGRFIS_CL_ACTIVE.ririxs_w "" UWORD rel_uw_q0p0234 1 100 0.00 1535.977 FORMAT "%8.3" ECU_ADDRESS 0xD0001078 /end MEASUREMENT
/begin MEASUREMENT B_2synpmX "" UBYTE B_TRUE 1 100 0.00 1.00000000000 BIT_MASK 0x8 FORMAT "%13.11" ECU_ADDRESS 0xD0000053 /end MEASUREMENT
/begin MEASUREMENT B_abstgp "" UBYTE B_TRUE 1 100 0.00 1.00000000000 BIT_MASK 0x1 FORMAT "%13.11" ECU_ADDRESS 0xD0000BF9 /end MEASUREMENT
/begin MEASUREMENT B_abstinvd "" UBYTE B_TRUE 1 100 0.00 1.00000000000 BIT_MASK 0x1 FORMAT "%13.11" ECU_ADDRESS 0xAFE8015D /end MEASUREMENT
/begin MEASUREMENT B_abstnlgp "" UBYTE B_TRUE 1 100 0.00 1.00000000000 BIT_MASK 0x4 FORMAT "%13.11" ECU_ADDRESS 0xD0000BF9 /end MEASUREMENT
/begin MEASUREMENT B_abstnpl "" UBYTE B_TRUE 1 100 0.00 1.00000000000 BIT_MASK 0x2 FORMAT "%13.11" ECU_ADDRESS 0xD0000BF9 /end MEASUREMENT
/begin MEASUREMENT B_atmrtpa "" UBYTE B_TRUE 1 100 0.00 1.00000000000 BIT_MASK 0x10 FORMAT "%13.11" ECU_ADDRESS 0xD000002B /end MEASUREMENT
/begin MEASUREMENT B_atmrtpf "" UBYTE B_TRUE 1 100 0.00 1.00000000000 BIT_MASK 0x1 FORMAT "%13.11" ECU_ADDRESS 0xD000002C /end MEASUREMENT
/begin MEASUREMENT B_atmrtpk "" UBYTE B_TRUE 1 100 0.00 1.00000000000 BIT_MASK 0x40 FORMAT "%13.11" ECU_ADDRESS 0xD000002A /end MEASUREMENT
/begin MEASUREMENT B_atmst "" UBYTE B_TRUE 1 100 0.00 1.00000000000 BIT_MASK 0x20 FORMAT "%13.11" ECU_ADDRESS 0xD0000060 /end MEASUREMENT
/begin MEASUREMENT B_atmtpa "" UBYTE B_TRUE 1 100 0.00 1.00000000000 BIT_MASK 0x8 FORMAT "%13.11" ECU_ADDRESS 0xD000005E /end MEASUREMENT
/begin MEASUREMENT B_atmtpal "" UBYTE B_TRUE 1 100 0.00 1.00000000000 BIT_MASK 0x1 FORMAT "%13.11" ECU_ADDRESS 0xAFE8016A /end MEASUREMENT
/begin MEASUREMENT B_atmtpfk "" UBYTE B_TRUE 1 100 0.00 1.00000000000 BIT_MASK 0x4 FORMAT "%13.11" ECU_ADDRESS 0xD0000095 /end MEASUREMENT
/begin MEASUREMENT B_atmtpfl "" UBYTE B_TRUE 1 100 0.00 1.00000000000 BIT_MASK 0x10 FORMAT "%13.11" ECU_ADDRESS 0xAFE8016A /end MEASUREMENT
/begin MEASUREMENT B_atmtpk "" UBYTE B_TRUE 1 100 0.00 1.00000000000 BIT_MASK 0x80 FORMAT "%13.11" ECU_ADDRESS 0xD000006A /end MEASUREMENT
/begin MEASUREMENT B_atmtpkl "" UBYTE B_TRUE 1 100 0.00 1.00000000000 BIT_MASK 0x4 FORMAT "%13.11" ECU_ADDRESS 0xAFE8016A /end MEASUREMENT
/begin MEASUREMENT B_bfzgbkv "" UBYTE B_TRUE 1 100 0.00 1.00000000000 BIT_MASK 0x2 FORMAT "%13.11" ECU_ADDRESS 0xD0000029 /end MEASUREMENT
/begin MEASUREMENT B_dldclst "" UBYTE B_TRUE 1 100 0.00 1.00000000000 BIT_MASK 0x1 FORMAT "%13.11" ECU_ADDRESS 0xD0000C0C /end MEASUREMENT
/begin MEASUREMENT B_dmsvvdpg "" UBYTE B_TRUE 1 100 0.00 1.00000000000 BIT_MASK 0x80 FORMAT "%13.11" ECU_ADDRESS 0xD0000070 /end MEASUREMENT
/begin MEASUREMENT B_dsshfs "" UBYTE B_TRUE 1 100 0.00 1.00000000000 BIT_MASK 0x1 FORMAT "%13.11" ECU_ADDRESS 0xD0000BEF /end MEASUREMENT
/begin MEASUREMENT B_dugdhtx "" UBYTE B_TRUE 1 100 0.00 1.00000000000 BIT_MASK 0x10 FORMAT "%13.11" ECU_ADDRESS 0xD0000028 /end MEASUREMENT
/begin MEASUREMENT B_dugdtx "" UBYTE B_TRUE 1 100 0.00 1.00000000000 BIT_MASK 0x20 FORMAT "%13.11" ECU_ADDRESS 0xD0000068 /end MEASUREMENT
/begin MEASUREMENT B_engrot "" UBYTE B_TRUE 1 100 0.00 1.00000000000 BIT_MASK 0x4 FORMAT "%13.11" ECU_ADDRESS 0xD0000C0C /end MEASUREMENT
/begin MEASUREMENT B_enrtabst "" UBYTE B_TRUE 1 100 0.00 1.00000000000 BIT_MASK 0x1 FORMAT "%13.11" ECU_ADDRESS 0xD0000BF7 /end MEASUREMENT
/begin MEASUREMENT B_fedkapb "" UBYTE B_TRUE 1 100 0.00 1.00000000000 BIT_MASK 0x8 FORMAT "%13.11" ECU_ADDRESS 0xD0000BEF /end MEASUREMENT
/begin MEASUREMENT B_fedkb "" UBYTE B_TRUE 1 100 0.00 1.00000000000 BIT_MASK 0x10 FORMAT "%13.11" ECU_ADDRESS 0xD0000BEF /end MEASUREMENT
/begin MEASUREMENT B_fedkoab "" UBYTE B_TRUE 1 100 0.00 1.00000000000 BIT_MASK 0x1 FORMAT "%13.11" ECU_ADDRESS 0xD0000BF0 /end MEASUREMENT
/begin MEASUREMENT B_fedssb "" UBYTE B_TRUE 1 100 0.00 1.00000000000 BIT_MASK 0x20 FORMAT "%13.11" ECU_ADDRESS 0xD0000090 /end MEASUREMENT
/begin MEASUREMENT B_feete "" UBYTE B_TRUE 1 100 0.00 1.00000000000 BIT_MASK 0x2 FORMAT "%13.11" ECU_ADDRESS 0xD0000BF0 /end MEASUREMENT
/begin MEASUREMENT B_ferlnotb "" UBYTE B_TRUE 1 100 0.00 1.00000000000 BIT_MASK 0x8 FORMAT "%13.11" ECU_ADDRESS 0xD0000BF0 /end MEASUREMENT
/begin MEASUREMENT B_gtumg "" UBYTE B_TRUE 1 100 0.00 1.00000000000 BIT_MASK 0x20 FORMAT "%13.11" ECU_ADDRESS 0xD0000C25 /end MEASUREMENT
/begin MEASUREMENT B_hfmhfs "" UBYTE B_TRUE 1 100 0.00 1.00000000000 BIT_MASK 0x1 FORMAT "%13.11" ECU_ADDRESS 0xAFE8015C /end MEASUREMENT
/begin MEASUREMENT B_iwresa "" UBYTE B_TRUE 1 100 0.00 1.00000000000 BIT_MASK 0x40 FORMAT "%13.11" ECU_ADDRESS 0xD000002B /end MEASUREMENT
/begin MEASUREMENT B_iwresf "" UBYTE B_TRUE 1 100 0.00 1.00000000000 BIT_MASK 0x8 FORMAT "%13.11" ECU_ADDRESS 0xD000002C /end MEASUREMENT
/begin MEASUREMENT B_iwresk "" UBYTE B_TRUE 1 100 0.00 1.00000000000 BIT_MASK 0x2 FORMAT "%13.11" ECU_ADDRESS 0xD000002B /end MEASUREMENT
/begin MEASUREMENT B_iwseta "" UBYTE B_TRUE 1 100 0.00 1.00000000000 BIT_MASK 0x20 FORMAT "%13.11" ECU_ADDRESS 0xD000002B /end MEASUREMENT
/begin MEASUREMENT B_iwsetf "" UBYTE B_TRUE 1 100 0.00 1.00000000000 BIT_MASK 0x4 FORMAT "%13.11" ECU_ADDRESS 0xD000002C /end MEASUREMENT
/begin MEASUREMENT B_iwsetk "" UBYTE B_TRUE 1 100 0.00 1.00000000000 BIT_MASK 0x1 FORMAT "%13.11" ECU_ADDRESS 0xD000002B /end MEASUREMENT
/begin MEASUREMENT B_lasostc "" UBYTE B_TRUE 1 100 0.00 1.00000000000 BIT_MASK 0x1 FORMAT "%13.11" ECU_ADDRESS 0xD0000080 /end MEASUREMENT
/begin MEASUREMENT B_lctpepwf "" UBYTE B_TRUE 1 100 0.00 1.00000000000 BIT_MASK 0x1 FORMAT "%13.11" ECU_ADDRESS 0xAFE80169 /end MEASUREMENT
/begin MEASUREMENT B_measglpl "" UBYTE B_TRUE 1 100 0.00 1.00000000000 BIT_MASK 0x1 FORMAT "%13.11" ECU_ADDRESS 0xD0000029 /end MEASUREMENT
/begin MEASUREMENT B_msddkg "" UBYTE B_TRUE 1 100 0.00 1.00000000000 BIT_MASK 0x1 FORMAT "%13.11" ECU_ADDRESS 0xD0000BE6 /end MEASUREMENT
/begin MEASUREMENT B_msdkdsg "" UBYTE B_TRUE 1 100 0.00 1.00000000000 BIT_MASK 0x1 FORMAT "%13.11" ECU_ADDRESS 0xD0000BE7 /end MEASUREMENT
/begin MEASUREMENT B_msdkhfsg "" UBYTE B_TRUE 1 100 0.00 1.00000000000 BIT_MASK 0x10 FORMAT "%13.11" ECU_ADDRESS 0xD0000BF0 /end MEASUREMENT
/begin MEASUREMENT B_msdkpnxg "" UBYTE B_TRUE 1 100 0.00 1.00000000000 BIT_MASK 0x8 FORMAT "%13.11" ECU_ADDRESS 0xD0000BE6 /end MEASUREMENT
/begin MEASUREMENT B_msdpg "" UBYTE B_TRUE 1 100 0.00 1.00000000000 BIT_MASK 0x10 FORMAT "%13.11" ECU_ADDRESS 0xD0000BE6 /end MEASUREMENT
/begin MEASUREMENT B_mshfmdkg "" UBYTE B_TRUE 1 100 0.00 1.00000000000 BIT_MASK 0x1 FORMAT "%13.11" ECU_ADDRESS 0xD0000BE8 /end MEASUREMENT
/begin MEASUREMENT B_mshfmdsg "" UBYTE B_TRUE 1 100 0.00 1.00000000000 BIT_MASK 0x2 FORMAT "%13.11" ECU_ADDRESS 0xD0000BE8 /end MEASUREMENT
/begin MEASUREMENT B_msmntpa "" UBYTE B_TRUE 1 100 0.00 1.00000000000 BIT_MASK 0x8 FORMAT "%13.11" ECU_ADDRESS 0xD000002B /end MEASUREMENT
/begin MEASUREMENT B_msmntpf "" UBYTE B_TRUE 1 100 0.00 1.00000000000 BIT_MASK 0x80 FORMAT "%13.11" ECU_ADDRESS 0xD000002B /end MEASUREMENT
/begin MEASUREMENT B_msmntpk "" UBYTE B_TRUE 1 100 0.00 1.00000000000 BIT_MASK 0x20 FORMAT "%13.11" ECU_ADDRESS 0xD000002A /end MEASUREMENT
/begin MEASUREMENT B_mszsdkb "" UBYTE B_TRUE 1 100 0.00 1.00000000000 BIT_MASK 0x2 FORMAT "%13.11" ECU_ADDRESS 0xD000009D /end MEASUREMENT
/begin MEASUREMENT B_penmlint "" UBYTE B_TRUE 1 100 0.00 1.00000000000 BIT_MASK 0x80 FORMAT "%13.11" ECU_ADDRESS 0xD0000C20 /end MEASUREMENT
/begin MEASUREMENT B_pndkg "" UBYTE B_TRUE 1 100 0.00 1.00000000000 BIT_MASK 0x40 FORMAT "%13.11" ECU_ADDRESS 0xD0000063 /end MEASUREMENT
/begin MEASUREMENT B_psrg "" UBYTE B_TRUE 1 100 0.00 1.00000000000 BIT_MASK 0x8 FORMAT "%13.11" ECU_ADDRESS 0xD0000087 /end MEASUREMENT
/begin MEASUREMENT B_psrg1 "" UBYTE B_TRUE 1 100 0.00 1.00000000000 BIT_MASK 0x40 FORMAT "%13.11" ECU_ADDRESS 0xD000009D /end MEASUREMENT
/begin MEASUREMENT B_psrgg "" UBYTE B_TRUE 1 100 0.00 1.00000000000 BIT_MASK 0x40 FORMAT "%13.11" ECU_ADDRESS 0xD000008A /end MEASUREMENT
/begin MEASUREMENT B_psrgg1 "" UBYTE B_TRUE 1 100 0.00 1.00000000000 BIT_MASK 0x10 FORMAT "%13.11" ECU_ADDRESS 0xD000008B /end MEASUREMENT
/begin MEASUREMENT B_psrmhg "" UBYTE B_TRUE 1 100 0.00 1.00000000000 BIT_MASK 0x8 FORMAT "%13.11" ECU_ADDRESS 0xD0000070 /end MEASUREMENT
/begin MEASUREMENT B_psrmnxg "" UBYTE B_TRUE 1 100 0.00 1.00000000000 BIT_MASK 0x1 FORMAT "%13.11" ECU_ADDRESS 0xD0000063 /end MEASUREMENT
/begin MEASUREMENT B_psrmozdg "" UBYTE B_TRUE 1 100 0.00 1.00000000000 BIT_MASK 0x20 FORMAT "%13.11" ECU_ADDRESS 0xD000008F /end MEASUREMENT
/begin MEASUREMENT B_psrmozg "" UBYTE B_TRUE 1 100 0.00 1.00000000000 BIT_MASK 0x4 FORMAT "%13.11" ECU_ADDRESS 0xD000005F /end MEASUREMENT
/begin MEASUREMENT B_psrmpb "" UBYTE B_TRUE 1 100 0.00 1.00000000000 BIT_MASK 0x4 FORMAT "%13.11" ECU_ADDRESS 0xD0000029 /end MEASUREMENT
/begin MEASUREMENT B_pua "" UBYTE B_TRUE 1 100 0.00 1.00000000000 BIT_MASK 0x8 FORMAT "%13.11" ECU_ADDRESS 0xD0000BEA /end MEASUREMENT
/begin MEASUREMENT B_pug "" UBYTE B_TRUE 1 100 0.00 1.00000000000 BIT_MASK 0x4 FORMAT "%13.11" ECU_ADDRESS 0xD0000BEB /end MEASUREMENT
/begin MEASUREMENT B_pugd "" UBYTE B_TRUE 1 100 0.00 1.00000000000 BIT_MASK 0x8 FORMAT "%13.11" ECU_ADDRESS 0xD0000028 /end MEASUREMENT
/begin MEASUREMENT B_pugdp "" UBYTE B_TRUE 1 100 0.00 1.00000000000 BIT_MASK 0x4 FORMAT "%13.11" ECU_ADDRESS 0xD0000028 /end MEASUREMENT
/begin MEASUREMENT B_pumg "" UBYTE B_TRUE 1 100 0.00 1.00000000000 BIT_MASK 0x1 FORMAT "%13.11" ECU_ADDRESS 0xAFE8015B /end MEASUREMENT
/begin MEASUREMENT B_pvdg "" UBYTE B_TRUE 1 100 0.00 1.00000000000 BIT_MASK 0x20 FORMAT "%13.11" ECU_ADDRESS 0xD0000085 /end MEASUREMENT
/begin MEASUREMENT B_pvvg "" UBYTE B_TRUE 1 100 0.00 1.00000000000 BIT_MASK 0x2 FORMAT "%13.11" ECU_ADDRESS 0xD0000074 /end MEASUREMENT
/begin MEASUREMENT B_replst "" UBYTE B_TRUE 1 100 0.00 1.00000000000 BIT_MASK 0x2 FORMAT "%13.11" ECU_ADDRESS 0xD0000BFA /end MEASUREMENT
/begin MEASUREMENT B_rlrlpzr "" UBYTE B_TRUE 1 100 0.00 1.00000000000 BIT_MASK 0x4 FORMAT "%13.11" ECU_ADDRESS 0xD000006F /end MEASUREMENT
/begin MEASUREMENT B_rsiwmf "" UBYTE B_TRUE 1 100 0.00 1.00000000000 BIT_MASK 0x2 FORMAT "%13.11" ECU_ADDRESS 0xD000002C /end MEASUREMENT
/begin MEASUREMENT B_rsiwmk "" UBYTE B_TRUE 1 100 0.00 1.00000000000 BIT_MASK 0x80 FORMAT "%13.11" ECU_ADDRESS 0xD000002A /end MEASUREMENT
/begin MEASUREMENT B_rttumg "" UBYTE B_TRUE 1 100 0.00 1.00000000000 BIT_MASK 0x10 FORMAT "%13.11" ECU_ADDRESS 0xD000002A /end MEASUREMENT
/begin MEASUREMENT B_scmebb "" UBYTE B_TRUE 1 100 0.00 1.00000000000 BIT_MASK 0x80 FORMAT "%13.11" ECU_ADDRESS 0xD0000028 /end MEASUREMENT
/begin MEASUREMENT B_stndnl "" UBYTE B_TRUE 1 100 0.00 1.00000000000 BIT_MASK 0x1 FORMAT "%13.11" ECU_ADDRESS 0xD0000066 /end MEASUREMENT
/begin MEASUREMENT B_stt50ms "" UBYTE B_TRUE 1 100 0.00 1.00000000000 BIT_MASK 0x80 FORMAT "%13.11" ECU_ADDRESS 0xD0000029 /end MEASUREMENT
/begin MEASUREMENT B_stteslck "" UBYTE B_TRUE 1 100 0.00 1.00000000000 BIT_MASK 0x2 FORMAT "%13.11" ECU_ADDRESS 0xD0000BF7 /end MEASUREMENT
/begin MEASUREMENT B_syn2fe "" UBYTE B_TRUE 1 100 0.00 1.00000000000 BIT_MASK 0x8 FORMAT "%13.11" ECU_ADDRESS 0xD000008F /end MEASUREMENT
/begin MEASUREMENT B_sz "" UBYTE B_TRUE 1 100 0.00 1.00000000000 BIT_MASK 0x20 FORMAT "%13.11" ECU_ADDRESS 0xD0000BEA /end MEASUREMENT
/begin MEASUREMENT B_tabstpd "" UBYTE B_TRUE 1 100 0.00 1.00000000000 BIT_MASK 0x4 FORMAT "%13.11" ECU_ADDRESS 0xD0000BF7 /end MEASUREMENT
/begin MEASUREMENT B_tahevg "" UBYTE B_TRUE 1 100 0.00 1.00000000000 BIT_MASK 0x80 FORMAT "%13.11" ECU_ADDRESS 0xD000009A /end MEASUREMENT
/begin MEASUREMENT B_tasrg "" UBYTE B_TRUE 1 100 0.00 1.00000000000 BIT_MASK 0x80 FORMAT "%13.11" ECU_ADDRESS 0xD000008B /end MEASUREMENT
/begin MEASUREMENT B_tasrmg "" UBYTE B_TRUE 1 100 0.00 1.00000000000 BIT_MASK 0x2 FORMAT "%13.11" ECU_ADDRESS 0xD0000079 /end MEASUREMENT
/begin MEASUREMENT B_tavdkg "" UBYTE B_TRUE 1 100 0.00 1.00000000000 BIT_MASK 0x8 FORMAT "%13.11" ECU_ADDRESS 0xD0000098 /end MEASUREMENT
/begin MEASUREMENT B_tavdkg2 "" UBYTE B_TRUE 1 100 0.00 1.00000000000 BIT_MASK 0x80 FORMAT "%13.11" ECU_ADDRESS 0xD0000061 /end MEASUREMENT
/begin MEASUREMENT B_tavdkmg "" UBYTE B_TRUE 1 100 0.00 1.00000000000 BIT_MASK 0x1 FORMAT "%13.11" ECU_ADDRESS 0xD0000069 /end MEASUREMENT
/begin MEASUREMENT B_tcwrepl "" UBYTE B_TRUE 1 100 0.00 1.00000000000 BIT_MASK 0x2 FORMAT "%13.11" ECU_ADDRESS 0xD0000BFD /end MEASUREMENT
/begin MEASUREMENT B_tengsfr "" UBYTE B_TRUE 1 100 0.00 1.00000000000 BIT_MASK 0x1 FORMAT "%13.11" ECU_ADDRESS 0xD0000C0B /end MEASUREMENT
/begin MEASUREMENT B_tengsi "" UBYTE B_TRUE 1 100 0.00 1.00000000000 BIT_MASK 0x1 FORMAT "%13.11" ECU_ADDRESS 0xAFE80162 /end MEASUREMENT
/begin MEASUREMENT B_tengsnbr "" UBYTE B_TRUE 1 100 0.00 1.00000000000 BIT_MASK 0x2 FORMAT "%13.11" ECU_ADDRESS 0xD0000C0B /end MEASUREMENT
/begin MEASUREMENT B_tengsr "" UBYTE B_TRUE 1 100 0.00 1.00000000000 BIT_MASK 0x2 FORMAT "%13.11" ECU_ADDRESS 0xAFE80162 /end MEASUREMENT
/begin MEASUREMENT B_tengsri "" UBYTE B_TRUE 1 100 0.00 1.00000000000 BIT_MASK 0x4 FORMAT "%13.11" ECU_ADDRESS 0xAFE80162 /end MEASUREMENT
/begin MEASUREMENT B_tengsrir "" UBYTE B_TRUE 1 100 0.00 1.00000000000 BIT_MASK 0x4 FORMAT "%13.11" ECU_ADDRESS 0xD0000C0B /end MEASUREMENT
/begin MEASUREMENT B_tengszfn "" UBYTE B_TRUE 1 100 0.00 1.00000000000 BIT_MASK 0x2 FORMAT "%13.11" ECU_ADDRESS 0xD0000C0C /end MEASUREMENT
/begin MEASUREMENT B_tmabclnl "" UBYTE B_TRUE 1 100 0.00 1.00000000000 BIT_MASK 0x2 FORMAT "%13.11" ECU_ADDRESS 0xAFE8015E /end MEASUREMENT
/begin MEASUREMENT B_tmabzgg "" UBYTE B_TRUE 1 100 0.00 1.00000000000 BIT_MASK 0x8 FORMAT "%13.11" ECU_ADDRESS 0xD0000BFD /end MEASUREMENT
/begin MEASUREMENT B_tmabzlk "" UBYTE B_TRUE 1 100 0.00 1.00000000000 BIT_MASK 0x1 FORMAT "%13.11" ECU_ADDRESS 0xAFE80160 /end MEASUREMENT
/begin MEASUREMENT B_tmotabgg "" UBYTE B_TRUE 1 100 0.00 1.00000000000 BIT_MASK 0x1 FORMAT "%13.11" ECU_ADDRESS 0xAFE8015E /end MEASUREMENT
/begin MEASUREMENT B_tmstgg "" UBYTE B_TRUE 1 100 0.00 1.00000000000 BIT_MASK 0x1 FORMAT "%13.11" ECU_ADDRESS 0xD0000BFD /end MEASUREMENT
/begin MEASUREMENT B_tmstz "" UBYTE B_TRUE 1 100 0.00 1.00000000000 BIT_MASK 0x8 FORMAT "%13.11" ECU_ADDRESS 0xD0000BFA /end MEASUREMENT
/begin MEASUREMENT B_tmstzgg "" UBYTE B_TRUE 1 100 0.00 1.00000000000 BIT_MASK 0x4 FORMAT "%13.11" ECU_ADDRESS 0xD0000BFD /end MEASUREMENT
/begin MEASUREMENT B_tochg "" UBYTE B_TRUE 1 100 0.00 1.00000000000 BIT_MASK 0x1 FORMAT "%13.11" ECU_ADDRESS 0xD0000C13 /end MEASUREMENT
/begin MEASUREMENT B_tochlow "" UBYTE B_TRUE 1 100 0.00 1.00000000000 BIT_MASK 0x1 FORMAT "%13.11" ECU_ADDRESS 0xD0000C0F /end MEASUREMENT
/begin MEASUREMENT B_tofstrdl "" UBYTE B_TRUE 1 100 0.00 1.00000000000 BIT_MASK 0x2 FORMAT "%13.11" ECU_ADDRESS 0xD000002A /end MEASUREMENT
/begin MEASUREMENT B_tofstrdp "" UBYTE B_TRUE 1 100 0.00 1.00000000000 BIT_MASK 0x1 FORMAT "%13.11" ECU_ADDRESS 0xD000002A /end MEASUREMENT
/begin MEASUREMENT B_tospabg "" UBYTE B_TRUE 1 100 0.00 1.00000000000 BIT_MASK 0x1 FORMAT "%13.11" ECU_ADDRESS 0xAFE80163 /end MEASUREMENT
/begin MEASUREMENT B_tospabgg "" UBYTE B_TRUE 1 100 0.00 1.00000000000 BIT_MASK 0x2 FORMAT "%13.11" ECU_ADDRESS 0xAFE80163 /end MEASUREMENT
/begin MEASUREMENT B_tospg "" UBYTE B_TRUE 1 100 0.00 1.00000000000 BIT_MASK 0x1 FORMAT "%13.11" ECU_ADDRESS 0xD0000C15 /end MEASUREMENT
/begin MEASUREMENT B_tospgg "" UBYTE B_TRUE 1 100 0.00 1.00000000000 BIT_MASK 0x2 FORMAT "%13.11" ECU_ADDRESS 0xD0000C15 /end MEASUREMENT
/begin MEASUREMENT B_tospmadi "" UBYTE B_TRUE 1 100 0.00 1.00000000000 BIT_MASK 0x1 FORMAT "%13.11" ECU_ADDRESS 0xD0000C17 /end MEASUREMENT
/begin MEASUREMENT B_tospmefr "" UBYTE B_TRUE 1 100 0.00 1.00000000000 BIT_MASK 0x1 FORMAT "%13.11" ECU_ADDRESS 0xD0000C18 /end MEASUREMENT
/begin MEASUREMENT B_tospmg "" UBYTE B_TRUE 1 100 0.00 1.00000000000 BIT_MASK 0x2 FORMAT "%13.11" ECU_ADDRESS 0xD0000C18 /end MEASUREMENT
/begin MEASUREMENT B_tospmres "" UBYTE B_TRUE 1 100 0.00 1.00000000000 BIT_MASK 0x4 FORMAT "%13.11" ECU_ADDRESS 0xD0000C17 /end MEASUREMENT
/begin MEASUREMENT B_tospmwst "" UBYTE B_TRUE 1 100 0.00 1.00000000000 BIT_MASK 0x2 FORMAT "%13.11" ECU_ADDRESS 0xD0000C17 /end MEASUREMENT
/begin MEASUREMENT B_tosptmab "" UBYTE B_TRUE 1 100 0.00 1.00000000000 BIT_MASK 0x1 FORMAT "%13.11" ECU_ADDRESS 0xAFE80165 /end MEASUREMENT
/begin MEASUREMENT B_totab "" UBYTE B_TRUE 1 100 0.00 1.00000000000 BIT_MASK 0x2 FORMAT "%13.11" ECU_ADDRESS 0xD0000028 /end MEASUREMENT
/begin MEASUREMENT B_trigcomp "" UBYTE B_TRUE 1 100 0.00 1.00000000000 BIT_MASK 0x1 FORMAT "%13.11" ECU_ADDRESS 0xD0000C25 /end MEASUREMENT
/begin MEASUREMENT B_tumgg "" UBYTE B_TRUE 1 100 0.00 1.00000000000 BIT_MASK 0x4 FORMAT "%13.11" ECU_ADDRESS 0xD0000C25 /end MEASUREMENT
/begin MEASUREMENT B_tumkst "" UBYTE B_TRUE 1 100 0.00 1.00000000000 BIT_MASK 0x4 FORMAT "%13.11" ECU_ADDRESS 0xD0000C20 /end MEASUREMENT
/begin MEASUREMENT B_tummg "" UBYTE B_TRUE 1 100 0.00 1.00000000000 BIT_MASK 0x8 FORMAT "%13.11" ECU_ADDRESS 0xD0000C25 /end MEASUREMENT
/begin MEASUREMENT B_tummictr "" UBYTE B_TRUE 1 100 0.00 1.00000000000 BIT_MASK 0x80 FORMAT "%13.11" ECU_ADDRESS 0xD0000C21 /end MEASUREMENT
/begin MEASUREMENT B_tumnpl "" UBYTE B_TRUE 1 100 0.00 1.00000000000 BIT_MASK 0x2 FORMAT "%13.11" ECU_ADDRESS 0xD0000C25 /end MEASUREMENT
/begin MEASUREMENT B_ugd "" UBYTE B_TRUE 1 100 0.00 1.00000000000 BIT_MASK 0x4 FORMAT "%13.11" ECU_ADDRESS 0xD0000056 /end MEASUREMENT
/begin MEASUREMENT B_ugdtx "" UBYTE B_TRUE 1 100 0.00 1.00000000000 BIT_MASK 0x40 FORMAT "%13.11" ECU_ADDRESS 0xD0000BE6 /end MEASUREMENT
/begin MEASUREMENT B_upssttab "" UBYTE B_TRUE 1 100 0.00 1.00000000000 BIT_MASK 0x8 FORMAT "%13.11" ECU_ADDRESS 0xD000002A /end MEASUREMENT
/begin MEASUREMENT B_vpdkugd "" UBYTE B_TRUE 1 100 0.00 1.00000000000 BIT_MASK 0x20 FORMAT "%13.11" ECU_ADDRESS 0xD0000073 /end MEASUREMENT
/begin MEASUREMENT B_wdkp "" UBYTE B_TRUE 1 100 0.00 1.00000000000 BIT_MASK 0x40 FORMAT "%13.11" ECU_ADDRESS 0xD000002C /end MEASUREMENT
/begin MEASUREMENT CT_bTengsrSet "" UBYTE B_TRUE 1 100 0.00 1.00000000000 BIT_MASK 0x1 FORMAT "%13.11" ECU_ADDRESS 0xD0000BFA /end MEASUREMENT
/begin MEASUREMENT ddwdkba_w "" SWORD rel_sw_b50 1 100 -50.00000 49.99847 FORMAT "%8.5" ECU_ADDRESS 0xD00004D4 /end MEASUREMENT
/begin MEASUREMENT DMSDKUGD_CL.dmsdkugdX_w "" UWORD m_q0p1 1 100 0.00 6553.500 FORMAT "%8.3" ECU_ADDRESS 0xD00010CC /end MEASUREMENT
/begin MEASUREMENT DMSDKUGD_CL.fiuewdkX_w "" UWORD fak_uw_b2 1 100 0.00 1.999969 FORMAT "%8.6" ECU_ADDRESS 0xD00010CE /end MEASUREMENT
/begin MEASUREMENT DMSDKUGD_CL.wdkmsmxX_w "" UWORD rel_uw_b100 1 100 0.00 99.99847 FORMAT "%8.5" ECU_ADDRESS 0xD00010D0 /end MEASUREMENT
/begin MEASUREMENT dmsdkugd_w "" UWORD m_q0p1 1 100 0.00 6553.500 FORMAT "%8.3" ECU_ADDRESS 0xD0000310 /end MEASUREMENT
/begin MEASUREMENT dmsdkugp_w "" UWORD m_q0p1 1 100 0.00 6553.500 FORMAT "%8.3" ECU_ADDRESS 0xD00002E8 /end MEASUREMENT
/begin MEASUREMENT dmsvvdp_w "" SWORD m_q0p1 1 100 -3276.800 3276.700 FORMAT "%8.3" ECU_ADDRESS 0xD00003FA /end MEASUREMENT
/begin MEASUREMENT dpsfdhfb_w "" SWORD p_sw_q0p078 1 100 -2560.000 2559.922 FORMAT "%8.3" ECU_ADDRESS 0xD0000432 /end MEASUREMENT
/begin MEASUREMENT dpsrfdhf_w "" SWORD p_sw_q0p078 1 100 -2560.000 2559.922 FORMAT "%8.3" ECU_ADDRESS 0xD0000434 /end MEASUREMENT
/begin MEASUREMENT dpsrfgk_w "" SWORD p_sw_q0p078 1 100 -2560.000 2559.922 FORMAT "%8.3" ECU_ADDRESS 0xD0000436 /end MEASUREMENT
/begin MEASUREMENT dpsrfgmh_w "" SWORD p_q0p078 1 100 -2560.000 2559.922 FORMAT "%8.3" ECU_ADDRESS 0xD00003D4 /end MEASUREMENT
/begin MEASUREMENT dpsrfgmp_w "" SWORD p_q0p078 1 100 -2560.000 2559.922 FORMAT "%8.3" ECU_ADDRESS 0xD00003D6 /end MEASUREMENT
/begin MEASUREMENT dpsrfg_w "" SWORD p_q0p078 1 100 -2560.000 2559.922 FORMAT "%8.3" ECU_ADDRESS 0xD00003B8 /end MEASUREMENT
/begin MEASUREMENT dpsrfmp_w "" SWORD p_sw_q0p078 1 100 -2560.000 2559.922 FORMAT "%8.3" ECU_ADDRESS 0xD0000438 /end MEASUREMENT
/begin MEASUREMENT dpsrg1_w "" SWORD p_q0p078 1 100 -2560.000 2559.922 FORMAT "%8.3" ECU_ADDRESS 0xD0000390 /end MEASUREMENT
/begin MEASUREMENT dpsrg_w "" SWORD p_q0p078 1 100 -2560.000 2559.922 FORMAT "%8.3" ECU_ADDRESS 0xD0000392 /end MEASUREMENT
/begin MEASUREMENT dpsrpps_w "" SWORD p_sw_q0p078 1 100 -2560.000 2559.922 FORMAT "%8.3" ECU_ADDRESS 0xD000043A /end MEASUREMENT
/begin MEASUREMENT drlas_w "" SWORD rel_q0p02344 1 100 -768.0000 767.9766 FORMAT "%8.4" ECU_ADDRESS 0xD0000414 /end MEASUREMENT
/begin MEASUREMENT drlp_w "" SWORD rel_sw_q0p0234 1 100 -768.0000 767.9766 FORMAT "%8.4" ECU_ADDRESS 0xD0000446 /end MEASUREMENT
/begin MEASUREMENT drl_w "" SWORD rel_q0p0234 1 100 -768.0000 767.9766 FORMAT "%8.4" ECU_ADDRESS 0xD00003BA /end MEASUREMENT
/begin MEASUREMENT dtahevdy_w "" SWORD temp_q0p0234 1 100 -768.0000 767.9766 FORMAT "%8.4" ECU_ADDRESS 0xD0000482 /end MEASUREMENT
/begin MEASUREMENT dtengstabs "" UWORD t_q1 1 100 0.00 65535.00 FORMAT "%8.2" ECU_ADDRESS 0xAFE80056 /end MEASUREMENT
/begin MEASUREMENT evabkor_w "" UWORD fak_q4p883Em4 1 100 0.00 31.99951 FORMAT "%8.5" ECU_ADDRESS 0xD0000238 /end MEASUREMENT
/begin MEASUREMENT ExhMod_dmExhCat1B1 "" SWORD m_q0p1 1 100 -3276.800 3276.700 FORMAT "%8.3" ECU_ADDRESS 0xD0003522 /end MEASUREMENT
/begin MEASUREMENT ExhMod_dmExhS2B1 "" SWORD m_q0p1 1 100 -3276.800 3276.700 FORMAT "%8.3" ECU_ADDRESS 0xD0003524 /end MEASUREMENT
/begin MEASUREMENT ExhMod_mO2StrCat1B1 "" UWORD m_q0p1_mg 1 100 0.00 6553.500 FORMAT "%8.3" ECU_ADDRESS 0xD00035E2 /end MEASUREMENT
/begin MEASUREMENT ExhMod_ratO2StrCat1B1 "" UWORD fak_uw_b2 1 100 0.00 1.999969 FORMAT "%8.6" ECU_ADDRESS 0xD00035E4 /end MEASUREMENT
/begin MEASUREMENT ExhMod_tCat1B1 "" SWORD Temp_Cels 1 100 -3549.940 3003.560 FORMAT "%8.3" ECU_ADDRESS 0xD0003526 /end MEASUREMENT
/begin MEASUREMENT fapsrr_w "" SWORD fak_q3p0518Em5 1 100 -1.000000 0.9999695 FORMAT "%8.6" ECU_ADDRESS 0xD0000388 /end MEASUREMENT
/begin MEASUREMENT fcoscfk "" UBYTE fak_ub_b2 1 100 0.00 1.992188 FORMAT "%8.6" ECU_ADDRESS 0xAFE80159 /end MEASUREMENT
/begin MEASUREMENT fcoscfmn_w "" UWORD fak_uw_b2 1 100 0.00 1.999969 FORMAT "%8.6" ECU_ADDRESS 0xD0000368 /end MEASUREMENT
/begin MEASUREMENT fcoschk "" UBYTE fak_ub_b2 1 100 0.00 1.992188 FORMAT "%8.6" ECU_ADDRESS 0xAFE8015A /end MEASUREMENT
/begin MEASUREMENT fcoschmn_w "" UWORD fak_uw_b2 1 100 0.00 1.999969 FORMAT "%8.6" ECU_ADDRESS 0xD000036A /end MEASUREMENT
/begin MEASUREMENT fdpslma_w "" UWORD fak_q3p0518Em5 1 100 0.00 1.999969 FORMAT "%8.6" ECU_ADDRESS 0xD000038A /end MEASUREMENT
/begin MEASUREMENT fho "" UBYTE fak_ub_b4 1 100 0.00 3.984 FORMAT "%5.3" ECU_ADDRESS 0xD0000BEC /end MEASUREMENT
/begin MEASUREMENT fhom_w "" UWORD fak_uw_b4 1 100 0.00 3.999939 FORMAT "%8.6" ECU_ADDRESS 0xAFE80052 /end MEASUREMENT
/begin MEASUREMENT fho_w "" UWORD fak_uw_b4 1 100 0.00 3.999939 FORMAT "%8.6" ECU_ADDRESS 0xD00003A0 /end MEASUREMENT
/begin MEASUREMENT FILTER_CL_1.msrirspx "" UWORD m_q0p00625 1 100 0.00 409.5938 FORMAT "%8.4" ECU_ADDRESS 0xD000107C /end MEASUREMENT
/begin MEASUREMENT FILTER_CL_2.msrirspx "" UWORD m_q0p00625 1 100 0.00 409.5938 FORMAT "%8.4" ECU_ADDRESS 0xD0001084 /end MEASUREMENT
/begin MEASUREMENT FILTER_CL_3.msrirspx "" UWORD m_q0p00625 1 100 0.00 409.5938 FORMAT "%8.4" ECU_ADDRESS 0xD000108C /end MEASUREMENT
/begin MEASUREMENT FILTER_CL_4.msrirspx "" UWORD m_q0p00625 1 100 0.00 409.5938 FORMAT "%8.4" ECU_ADDRESS 0xD0001094 /end MEASUREMENT
/begin MEASUREMENT fisrm_w "" UWORD fak1_q0p000407_hPa_div_percent 1 100 0.00 26.66626 FORMAT "%8.5" ECU_ADDRESS 0xD00003D8 /end MEASUREMENT
/begin MEASUREMENT fiuewdk_w "" UWORD fak_uw_b2 1 100 0.00 1.999969 FORMAT "%8.6" ECU_ADDRESS 0xD0000312 /end MEASUREMENT
/begin MEASUREMENT fkisrm_w "" UWORD fak_q1p526Em5 1 100 0.00 0.9999847 FORMAT "%9.7" ECU_ADDRESS 0xD00003DA /end MEASUREMENT
/begin MEASUREMENT fkl1_w "" UWORD fak_uw_b2 1 100 0.00 1.999969 FORMAT "%8.6" ECU_ADDRESS 0xD000024C /end MEASUREMENT
/begin MEASUREMENT fkl2_w "" UWORD fak_uw_b2 1 100 0.00 1.999969 FORMAT "%8.6" ECU_ADDRESS 0xD000024E /end MEASUREMENT
/begin MEASUREMENT fklafa_w "" UWORD fak_uw_b2 1 100 0.00 1.999969 FORMAT "%8.6" ECU_ADDRESS 0xD0000314 /end MEASUREMENT
/begin MEASUREMENT fpabnav_w "" UWORD fak_uw_b8 1 100 0.00 7.999878 FORMAT "%8.6" ECU_ADDRESS 0xD0000374 /end MEASUREMENT
/begin MEASUREMENT fpbrpsg_w "" UWORD fak_uw_b4 1 100 0.00 3.999939 FORMAT "%8.6" ECU_ADDRESS 0xD0000250 /end MEASUREMENT
/begin MEASUREMENT fpbrpsmx_w "" UWORD fak_uw_b4 1 100 0.00 3.999939 FORMAT "%8.6" ECU_ADDRESS 0xD0000252 /end MEASUREMENT
/begin MEASUREMENT fpbrpssb_w "" UWORD fak_uw_b4 1 100 0.00 3.999939 FORMAT "%8.6" ECU_ADDRESS 0xD0000254 /end MEASUREMENT
/begin MEASUREMENT fpbrpsug_w "" UWORD fak_uw_b4 1 100 0.00 3.999939 FORMAT "%8.6" ECU_ADDRESS 0xD0000256 /end MEASUREMENT
/begin MEASUREMENT fpbrps_w "" UWORD fak_uw_b4 1 100 0.00 3.999939 FORMAT "%8.6" ECU_ADDRESS 0xD0000258 /end MEASUREMENT
/begin MEASUREMENT fpndk_w "" UWORD fak_uw_b8 1 100 0.00 7.999878 FORMAT "%8.6" ECU_ADDRESS 0xD000037A /end MEASUREMENT
/begin MEASUREMENT fpvd_w "" UWORD fak_uw_b8 1 100 0.00 7.999878 FORMAT "%8.6" ECU_ADDRESS 0xD00003A8 /end MEASUREMENT
/begin MEASUREMENT frhol_w "" UWORD fak_uw_b2 1 100 0.00 1.999969 FORMAT "%8.6" ECU_ADDRESS 0xD00003A2 /end MEASUREMENT
/begin MEASUREMENT frlmntp_w "" UWORD fak_q6p1035Em5 1 100 0.00 3.999939 FORMAT "%8.6" ECU_ADDRESS 0xD0000420 /end MEASUREMENT
/begin MEASUREMENT ftahevmx_w "" UWORD fak_uw_b2 1 100 0.00 1.999969 FORMAT "%8.6" ECU_ADDRESS 0xD0000488 /end MEASUREMENT
/begin MEASUREMENT ftahev_w "" UWORD fak_uw_b2 1 100 0.00 1.999969 FORMAT "%8.6" ECU_ADDRESS 0xD000048A /end MEASUREMENT
/begin MEASUREMENT ftaikr_w "" UWORD fak_uw_b2 1 100 0.00 1.999969 FORMAT "%8.6" ECU_ADDRESS 0xD0000376 /end MEASUREMENT
/begin MEASUREMENT ftavdkmn_w "" UWORD fak_uw_b2 1 100 0.00 1.999969 FORMAT "%8.6" ECU_ADDRESS 0xD000048C /end MEASUREMENT
/begin MEASUREMENT ftavdkmx_w "" UWORD fak_uw_b2 1 100 0.00 1.999969 FORMAT "%8.6" ECU_ADDRESS 0xD000048E /end MEASUREMENT
/begin MEASUREMENT ftochlw "" UBYTE fak_q0p00392 1 100 0.00 1.000 FORMAT "%5.3" ECU_ADDRESS 0xD0000C10 /end MEASUREMENT
/begin MEASUREMENT ftochwu "" UBYTE fak_q0p00392 1 100 0.00 1.000 FORMAT "%5.3" ECU_ADDRESS 0xD0000C11 /end MEASUREMENT
/begin MEASUREMENT ftpavdn_w "" UWORD fak_uw_b8 1 100 0.00 7.999878 FORMAT "%8.6" ECU_ADDRESS 0xD0000316 /end MEASUREMENT
/begin MEASUREMENT ftpavdx_w "" UWORD fak_uw_b8 1 100 0.00 7.999878 FORMAT "%8.6" ECU_ADDRESS 0xD0000318 /end MEASUREMENT
/begin MEASUREMENT ftpavd_w "" UWORD fak_uw_b8 1 100 0.00 7.999878 FORMAT "%8.6" ECU_ADDRESS 0xD000031A /end MEASUREMENT
/begin MEASUREMENT ftpvd_w "" UWORD fak_uw_b8 1 100 0.00 7.999878 FORMAT "%8.6" ECU_ADDRESS 0xD000031C /end MEASUREMENT
/begin MEASUREMENT ftsr_w "" UWORD fak_uw_b2 1 100 0.00 1.999969 FORMAT "%8.6" ECU_ADDRESS 0xD0000490 /end MEASUREMENT
/begin MEASUREMENT ftu "" UBYTE fak_ub_b2 1 100 0.00 1.992188 FORMAT "%8.6" ECU_ADDRESS 0xD0000C0E /end MEASUREMENT
/begin MEASUREMENT ftvdk_w "" UWORD fak_uw_b2 1 100 0.00 1.999969 FORMAT "%8.6" ECU_ADDRESS 0xD0000492 /end MEASUREMENT
/begin MEASUREMENT ftw_w "" UWORD fak_uw_b2 1 100 0.00 1.999969 FORMAT "%8.6" ECU_ADDRESS 0xD0000484 /end MEASUREMENT
/begin MEASUREMENT fupshoms_w "" UWORD rel_uw_b0p3 1 100 0.00 0.2999954 FORMAT "%9.7" ECU_ADDRESS 0xD0000278 /end MEASUREMENT
/begin MEASUREMENT fupsmxs_w "" UWORD rel_uw_b0p3 1 100 0.00 0.2999954 FORMAT "%9.7" ECU_ADDRESS 0xD000027A /end MEASUREMENT
/begin MEASUREMENT fupsrlmx_w "" UWORD rel_uw_b0p3 1 100 0.00 0.2999954 FORMAT "%9.7" ECU_ADDRESS 0xD000027C /end MEASUREMENT
/begin MEASUREMENT fupsrlro_w "" UWORD rel_uw_b0p3 1 100 0.00 0.2999954 FORMAT "%9.7" ECU_ADDRESS 0xD000025A /end MEASUREMENT
/begin MEASUREMENT fupsrls_w "" UWORD rel_uw_b0p3 1 100 0.00 0.2999954 FORMAT "%9.7" ECU_ADDRESS 0xD000027E /end MEASUREMENT
/begin MEASUREMENT fupsrltn_w "" UWORD rel_uw_b0p3 1 100 0.00 0.2999954 FORMAT "%9.7" ECU_ADDRESS 0xD0000280 /end MEASUREMENT
/begin MEASUREMENT fupsrltx_w "" UWORD rel_uw_b0p3 1 100 0.00 0.2999954 FORMAT "%9.7" ECU_ADDRESS 0xD0000282 /end MEASUREMENT
/begin MEASUREMENT fupsrlug_w "" UWORD rel_uw_b0p3 1 100 0.00 0.2999954 FORMAT "%9.7" ECU_ADDRESS 0xD0000284 /end MEASUREMENT
/begin MEASUREMENT fupsrl_w "" UWORD rel_uw_b0p3 1 100 0.00 0.2999954 FORMAT "%9.7" ECU_ADDRESS 0xD0000286 /end MEASUREMENT
/begin MEASUREMENT fupsugs_w "" UWORD rel_uw_b0p3 1 100 0.00 0.2999954 FORMAT "%9.7" ECU_ADDRESS 0xD0000288 /end MEASUREMENT
/begin MEASUREMENT FUPSXS_CL_akt.fkl1X_w "" UWORD fak_uw_b2 1 100 0.00 1.999969 FORMAT "%8.6" ECU_ADDRESS 0xD000109C /end MEASUREMENT
/begin MEASUREMENT FUPSXS_CL_akt.fkl2X_w "" UWORD fak_uw_b2 1 100 0.00 1.999969 FORMAT "%8.6" ECU_ADDRESS 0xD000109E /end MEASUREMENT
/begin MEASUREMENT FUPSXS_CL_akt.fpbrX_w "" UWORD fak_uw_b4 1 100 0.00 3.999939 FORMAT "%8.6" ECU_ADDRESS 0xD00010A0 /end MEASUREMENT
/begin MEASUREMENT FUPSXS_CL_akt.fpbrpsgX_w "" UWORD fak_uw_b4 1 100 0.00 3.999939 FORMAT "%8.6" ECU_ADDRESS 0xD00010A2 /end MEASUREMENT
/begin MEASUREMENT FUPSXS_CL_akt.fpbrpssbX_w "" UWORD fak_uw_b4 1 100 0.00 3.999939 FORMAT "%8.6" ECU_ADDRESS 0xD00010A4 /end MEASUREMENT
/begin MEASUREMENT FUPSXS_CL_akt.fpbrpswX_w "" UWORD fak_uw_b4 1 100 0.00 3.999939 FORMAT "%8.6" ECU_ADDRESS 0xD00010A6 /end MEASUREMENT
/begin MEASUREMENT FUPSXS_CL_akt.fpbrxmX_w "" UWORD fak_uw_b4 1 100 0.00 3.999939 FORMAT "%8.6" ECU_ADDRESS 0xD00010A8 /end MEASUREMENT
/begin MEASUREMENT FUPSXS_CL_akt.fpbrxugX_w "" UWORD fak_uw_b4 1 100 0.00 3.999939 FORMAT "%8.6" ECU_ADDRESS 0xD00010AA /end MEASUREMENT
/begin MEASUREMENT FUPSXS_CL_akt.fupsmX_w "" UWORD rel_uw_b0p3 1 100 0.00 0.2999954 FORMAT "%9.7" ECU_ADDRESS 0xD00010AC /end MEASUREMENT
/begin MEASUREMENT FUPSXS_CL_akt.fupsrlroX_w "" UWORD rel_uw_b0p3 1 100 0.00 0.2999954 FORMAT "%9.7" ECU_ADDRESS 0xD00010AE /end MEASUREMENT
/begin MEASUREMENT FUPSXS_CL_akt.fupsugX_w "" UWORD rel_uw_b0p3 1 100 0.00 0.2999954 FORMAT "%9.7" ECU_ADDRESS 0xD00010B0 /end MEASUREMENT
/begin MEASUREMENT FUPSXS_CL_akt.pbrseX_w "" UWORD p_uw_q0p078 1 100 0.00 5119.922 FORMAT "%8.3" ECU_ADDRESS 0xD00010B2 /end MEASUREMENT
/begin MEASUREMENT gdrlprlctr "" UBYTE dez 1 100 0.00 255.0 FORMAT "%5.1" ECU_ADDRESS 0xD0000BF5 /end MEASUREMENT
/begin MEASUREMENT imlatm "" UBYTE m_ub_b23p3 1 100 0.00 23.21 FORMAT "%5.2" ECU_ADDRESS 0xD0000C1F /end MEASUREMENT
/begin MEASUREMENT imlatmz_w "" UWORD m_uw_b23p3 1 100 0.00 23.30133 FORMAT "%8.5" ECU_ADDRESS 0xD00004BC /end MEASUREMENT
/begin MEASUREMENT imlatm_w "" UWORD m_uw_b23p3 1 100 0.00 23.30133 FORMAT "%8.5" ECU_ADDRESS 0xD00004BE /end MEASUREMENT
/begin MEASUREMENT imltumlm_w "" UWORD m_uw_b23p3 1 100 0.00 23.30133 FORMAT "%8.5" ECU_ADDRESS 0xD00004CC /end MEASUREMENT
/begin MEASUREMENT imltum_w "" UWORD m_uw_b23p3 1 100 0.00 23.30133 FORMAT "%8.5" ECU_ADDRESS 0xD00004CE /end MEASUREMENT
/begin MEASUREMENT iwmatmf_l "" ULONG q_q6p9peri4Em6_kJ 1 100 0.00 29826.1617708 FORMAT "%13.7" ECU_ADDRESS 0xD0001E38 /end MEASUREMENT
/begin MEASUREMENT iwmatmf_w "" UWORD q_q0p4551 1 100 0.00 29825.71 FORMAT "%8.2" ECU_ADDRESS 0xD00004C0 /end MEASUREMENT
/begin MEASUREMENT iwmatmk_l "" ULONG q_q6p9peri4Em6_kJ 1 100 0.00 29826.1617708 FORMAT "%13.7" ECU_ADDRESS 0xD0001E3C /end MEASUREMENT
/begin MEASUREMENT iwmatmk_w "" UWORD q_q0p4551 1 100 0.00 29825.71 FORMAT "%8.2" ECU_ADDRESS 0xD00004C2 /end MEASUREMENT
/begin MEASUREMENT iwmatm_l "" ULONG q_q6p9peri4Em6_kJ 1 100 0.00 29826.1617708 FORMAT "%13.7" ECU_ADDRESS 0xD0001E40 /end MEASUREMENT
/begin MEASUREMENT iwmatm_w "" UWORD q_q0p4551 1 100 0.00 29825.71 FORMAT "%8.2" ECU_ADDRESS 0xD00004C4 /end MEASUREMENT
/begin MEASUREMENT iwmsf_l "" ULONG q_q6p9peri4Em6_kJ 1 100 0.00 29826.1617708 FORMAT "%13.7" ECU_ADDRESS 0xD0001E2C /end MEASUREMENT
/begin MEASUREMENT iwmsk_l "" ULONG q_q6p9peri4Em6_kJ 1 100 0.00 29826.1617708 FORMAT "%13.7" ECU_ADDRESS 0xD0001E30 /end MEASUREMENT
/begin MEASUREMENT iwmsv_l "" ULONG q_q6p9peri4Em6_kJ 1 100 0.00 29826.1617708 FORMAT "%13.7" ECU_ADDRESS 0xD0001E34 /end MEASUREMENT
/begin MEASUREMENT kmsdk_w "" UWORD fak_uw_b1 1 100 0.00 0.9999847 FORMAT "%9.7" ECU_ADDRESS 0xD00002EA /end MEASUREMENT
/begin MEASUREMENT ktmewini "" UBYTE fak_ub_b1 1 100 0.00 0.9961 ECU_ADDRESS 0xD0000BFB /end MEASUREMENT
/begin MEASUREMENT labbris_w "" UWORD fak_uw_b16 1 100 0.00 15.99976 FORMAT "%8.5" ECU_ADDRESS 0xD000025C /end MEASUREMENT
/begin MEASUREMENT labbrm_w "" UWORD fak_q0p000244 1 100 0.00 15.99976 FORMAT "%8.5" ECU_ADDRESS 0xD0000240 /end MEASUREMENT
/begin MEASUREMENT labrgs_w "" UWORD fak_q0p000244 1 100 0.00 15.99976 FORMAT "%8.5" ECU_ADDRESS 0xD0000242 /end MEASUREMENT
/begin MEASUREMENT lamsbrs_w "" UWORD fak_q0p000244 1 100 0.00 15.99976 FORMAT "%8.5" ECU_ADDRESS 0xD0000244 /end MEASUREMENT
/begin MEASUREMENT lamsobd_w "" UWORD fak_q0p000244 1 100 0.00 15.99976 FORMAT "%8.5" ECU_ADDRESS 0xD0000246 /end MEASUREMENT
/begin MEASUREMENT lamsons_w "" UWORD fak_q0p000244 1 100 0.00 15.99976 FORMAT "%8.5" ECU_ADDRESS 0xD0000248 /end MEASUREMENT
/begin MEASUREMENT lassa_w "" UWORD fak_q0p000244 1 100 0.00 15.99976 FORMAT "%8.5" ECU_ADDRESS 0xD000024A /end MEASUREMENT
/begin MEASUREMENT mabikrs_w "" UWORD m_q2p777Em5 1 100 0.00 1.820417 FORMAT "%8.6" ECU_ADDRESS 0xD000034A /end MEASUREMENT
/begin MEASUREMENT mabnavs_w "" UWORD m_q2p777Em5 1 100 0.00 1.820417 FORMAT "%8.6" ECU_ADDRESS 0xD000034C /end MEASUREMENT
/begin MEASUREMENT mabnhks_w "" UWORD m_q2p777Em5 1 100 0.00 1.820417 FORMAT "%8.6" ECU_ADDRESS 0xD000034E /end MEASUREMENT
/begin MEASUREMENT mabnvks_w "" UWORD m_q2p777Em5 1 100 0.00 1.820417 FORMAT "%8.6" ECU_ADDRESS 0xD0000350 /end MEASUREMENT
/begin MEASUREMENT mabvhks_w "" UWORD m_q2p777Em5 1 100 0.00 1.820417 FORMAT "%8.6" ECU_ADDRESS 0xD0000352 /end MEASUREMENT
/begin MEASUREMENT mabvvks_w "" UWORD m_q2p777Em5 1 100 0.00 1.820417 FORMAT "%8.6" ECU_ADDRESS 0xD0000354 /end MEASUREMENT
/begin MEASUREMENT ml "" UBYTE m_q4_kg_DIV_h 1 100 0.00 1020. FORMAT "%5.0" ECU_ADDRESS 0xD0000BF1 /end MEASUREMENT
/begin MEASUREMENT mlbb_w "" UWORD m_uw_b6553p5 1 100 0.00 6553.500 FORMAT "%8.3" ECU_ADDRESS 0xD00002BC /end MEASUREMENT
/begin MEASUREMENT mll1 "" UBYTE m_ub_b1020 1 100 0.00 1020. FORMAT "%5.0" ECU_ADDRESS 0xD0000BFE /end MEASUREMENT
/begin MEASUREMENT ml_w "" UWORD m_q0p1 1 100 0.00 6553.500 FORMAT "%8.3" ECU_ADDRESS 0xD00003BC /end MEASUREMENT
/begin MEASUREMENT msabg "" UBYTE m_ub_b1020 1 100 0.00 1020. FORMAT "%5.0" ECU_ADDRESS 0xD0000BE9 /end MEASUREMENT
/begin MEASUREMENT msabgar_w "" UWORD m_uw_b6553p5 1 100 0.00 6553.500 FORMAT "%8.3" ARRAY_SIZE 13 ECU_ADDRESS 0xD00002BE /end MEASUREMENT
/begin MEASUREMENT msabg_w "" UWORD m_uw_b6553p5 1 100 0.00 6553.500 FORMAT "%8.3" ECU_ADDRESS 0xD0000356 /end MEASUREMENT
/begin MEASUREMENT msabikr_w "" UWORD m_uw_b6553p5 1 100 0.00 6553.500 FORMAT "%8.3" ECU_ADDRESS 0xD0000358 /end MEASUREMENT
/begin MEASUREMENT msabnav_w "" UWORD m_uw_b6553p5 1 100 0.00 6553.500 FORMAT "%8.3" ECU_ADDRESS 0xD00002D8 /end MEASUREMENT
/begin MEASUREMENT msabnhk_w "" UWORD m_uw_b6553p5 1 100 0.00 6553.500 FORMAT "%8.3" ECU_ADDRESS 0xD000035A /end MEASUREMENT
/begin MEASUREMENT msabnvk_w "" UWORD m_uw_b6553p5 1 100 0.00 6553.500 FORMAT "%8.3" ECU_ADDRESS 0xD000035C /end MEASUREMENT
/begin MEASUREMENT msabvhk_w "" UWORD m_uw_b6553p5 1 100 0.00 6553.500 FORMAT "%8.3" ECU_ADDRESS 0xD000035E /end MEASUREMENT
/begin MEASUREMENT msabvvk_w "" UWORD m_uw_b6553p5 1 100 0.00 6553.500 FORMAT "%8.3" ECU_ADDRESS 0xD0000360 /end MEASUREMENT
/begin MEASUREMENT msaovhk_w "" UWORD m_uw_b6553p5 1 100 0.00 6553.500 FORMAT "%8.3" ECU_ADDRESS 0xD0000362 /end MEASUREMENT
/begin MEASUREMENT msaovvk_w "" UWORD m_uw_b6553p5 1 100 0.00 6553.500 FORMAT "%8.3" ECU_ADDRESS 0xD0000364 /end MEASUREMENT
/begin MEASUREMENT MSAV_CL_akt.fafrspX_w "" UWORD fak_uw_b2 1 100 0.00 1.999969 FORMAT "%8.6" ECU_ADDRESS 0xD00010B4 /end MEASUREMENT
/begin MEASUREMENT MSAV_CL_akt.msbrkrrX_w "" UWORD m_q0p00625 1 100 0.00 409.5938 FORMAT "%8.4" ECU_ADDRESS 0xD00010B6 /end MEASUREMENT
/begin MEASUREMENT MSAV_CL_akt.msrirsprX_w "" UWORD m_q0p00625 1 100 0.00 409.5938 FORMAT "%8.4" ECU_ADDRESS 0xD00010B8 /end MEASUREMENT
/begin MEASUREMENT MSAV_CL_akt.pabnavmwX_w "" UWORD p_uw_q0p078 1 100 0.00 5119.922 FORMAT "%8.3" ECU_ADDRESS 0xD00010BA /end MEASUREMENT
/begin MEASUREMENT MSAV_CL_akt.pbrsaX_w "" UWORD p_uw_q0p078 1 100 0.00 5119.922 FORMAT "%8.3" ECU_ADDRESS 0xD00010BC /end MEASUREMENT
/begin MEASUREMENT MSAV_CL_akt.rfriresrX_w "" UWORD rel_q0p02344 1 100 0.00 1535.977 FORMAT "%8.3" ECU_ADDRESS 0xD00010BE /end MEASUREMENT
/begin MEASUREMENT MSAV_CL_akt.taikrmX_w "" UWORD temp_q0p0234_o273 1 100 -273.1500 1262.827 FORMAT "%8.3" ECU_ADDRESS 0xD00010C0 /end MEASUREMENT
/begin MEASUREMENT MSAV_CL_akt.vpabgsrX_w "" UWORD fak_uw_b2 1 100 0.00 1.999969 FORMAT "%8.6" ECU_ADDRESS 0xD00010C2 /end MEASUREMENT
/begin MEASUREMENT MSAV_CL_akt.vpsrabgX_w "" UWORD fak_uw_b2 1 100 0.00 1.999969 FORMAT "%8.6" ECU_ADDRESS 0xD00010C4 /end MEASUREMENT
/begin MEASUREMENT MSAV_CL_akt.wgvspumX_w "" SWORD kw_sw_q0p0156 1 100 -512.00000 511.98438 ECU_ADDRESS 0xD00010C6 /end MEASUREMENT
/begin MEASUREMENT MSAV_CL_akt.wgvumX_w "" SWORD kw_q0p0156 1 100 -512.0000 511.9844 FORMAT "%8.4" ECU_ADDRESS 0xD00010C8 /end MEASUREMENT
/begin MEASUREMENT msbrkrr_w "" UWORD m_q0p00625 1 100 0.00 409.5938 FORMAT "%8.4" ECU_ADDRESS 0xD000025E /end MEASUREMENT
/begin MEASUREMENT msdkalm_w "" UWORD m_q0p1 1 100 0.00 6553.500 FORMAT "%8.3" ECU_ADDRESS 0xD00003FC /end MEASUREMENT
/begin MEASUREMENT msdkds_w "" UWORD m_q0p1 1 100 0.00 6553.500 FORMAT "%8.3" ECU_ADDRESS 0xD0000342 /end MEASUREMENT
/begin MEASUREMENT msdkhfs_w "" UWORD m_q0p1 1 100 0.00 6553.500 FORMAT "%8.3" ECU_ADDRESS 0xD00003BE /end MEASUREMENT
/begin MEASUREMENT msdkmx_w "" UWORD m_uw_b6553p5 1 100 0.00 6553.500 FORMAT "%8.3" ECU_ADDRESS 0xD0000336 /end MEASUREMENT
/begin MEASUREMENT msdkosa_w "" UWORD m_q0p1 1 100 0.00 6553.500 FORMAT "%8.3" ECU_ADDRESS 0xD000031E /end MEASUREMENT
/begin MEASUREMENT MSDKOUE_CL.msdkoueX_w "" UWORD m_q0p1 1 100 0.00 6553.500 FORMAT "%8.3" ECU_ADDRESS 0xD00010D2 /end MEASUREMENT
/begin MEASUREMENT MSDKOUE_CL.msndkX_w "" UWORD m_q0p1 1 100 0.00 6553.500 FORMAT "%8.3" ECU_ADDRESS 0xD00010D4 /end MEASUREMENT
/begin MEASUREMENT MSDKOUE_CL.msndkooX_w "" UWORD m_q0p1 1 100 0.00 6553.500 FORMAT "%8.3" ECU_ADDRESS 0xD00010D6 /end MEASUREMENT
/begin MEASUREMENT MSDKOUE_CL.msnllsX_w "" UWORD m_uw_b102p4 1 100 0.00 102.3984 FORMAT "%8.4" ECU_ADDRESS 0xD00010D8 /end MEASUREMENT
/begin MEASUREMENT MSDKOUE_CL.ummsnmsX_w "" UWORD fak_uw_b8 1 100 0.00 7.999878 FORMAT "%8.6" ECU_ADDRESS 0xD00010DA /end MEASUREMENT
/begin MEASUREMENT MSDKOUE_CL.vpsrvdbX_w "" UWORD fak_uw_b2 1 100 0.00 1.999969 FORMAT "%8.6" ECU_ADDRESS 0xD00010DC /end MEASUREMENT
/begin MEASUREMENT msdkoue_w "" UWORD m_q0p1 1 100 0.00 6553.500 FORMAT "%8.3" ECU_ADDRESS 0xD00002EC /end MEASUREMENT
/begin MEASUREMENT msdkpmn_w "" UWORD m_q0p1 1 100 0.00 6553.500 FORMAT "%8.3" ECU_ADDRESS 0xD0000320 /end MEASUREMENT
/begin MEASUREMENT msdkpmx_w "" UWORD m_q0p1 1 100 0.00 6553.500 FORMAT "%8.3" ECU_ADDRESS 0xD0000322 /end MEASUREMENT
/begin MEASUREMENT msdkugd_w "" UWORD m_uw_b6553p5 1 100 0.00 6553.500 FORMAT "%8.3" ECU_ADDRESS 0xD0000338 /end MEASUREMENT
/begin MEASUREMENT msdkugpn_w "" UWORD m_uw_b6553p5 1 100 0.00 6553.500 FORMAT "%8.3" ECU_ADDRESS 0xD000033A /end MEASUREMENT
/begin MEASUREMENT msdkugtx_w "" UWORD m_uw_b6553p5 1 100 0.00 6553.500 FORMAT "%8.3" ECU_ADDRESS 0xD000033C /end MEASUREMENT
/begin MEASUREMENT msdk_w "" UWORD m_q0p1 1 100 0.00 6553.500 FORMAT "%8.3" ECU_ADDRESS 0xD0000324 /end MEASUREMENT
/begin MEASUREMENT msdouep_w "" UWORD m_q0p1 1 100 0.00 6553.500 FORMAT "%8.3" ECU_ADDRESS 0xD00002EE /end MEASUREMENT
/begin MEASUREMENT msdpmn_w "" UWORD m_q0p1 1 100 0.00 6553.500 FORMAT "%8.3" ECU_ADDRESS 0xD00002F0 /end MEASUREMENT
/begin MEASUREMENT msdpvf_w "" UWORD m_q0p1 1 100 0.00 6553.500 FORMAT "%8.3" ECU_ADDRESS 0xD00002F2 /end MEASUREMENT
/begin MEASUREMENT msdp_w "" UWORD m_q0p1 1 100 0.00 6553.500 FORMAT "%8.3" ECU_ADDRESS 0xD0000326 /end MEASUREMENT
/begin MEASUREMENT msdue_w "" UWORD m_q0p1 1 100 0.00 6553.500 FORMAT "%8.3" ECU_ADDRESS 0xD00002F4 /end MEASUREMENT
/begin MEASUREMENT msdvf_w "" UWORD m_q0p1 1 100 0.00 6553.500 FORMAT "%8.3" ECU_ADDRESS 0xD00002F6 /end MEASUREMENT
/begin MEASUREMENT msfabr_w "" UWORD m_q0p1 1 100 0.00 6553.500 FORMAT "%8.3" ECU_ADDRESS 0xD00003C0 /end MEASUREMENT
/begin MEASUREMENT mshfmdk_w "" UWORD m_uw_b6553p5 1 100 0.00 6553.500 FORMAT "%8.3" ECU_ADDRESS 0xD0000344 /end MEASUREMENT
/begin MEASUREMENT mshfmds_w "" UWORD m_uw_b6553p5 1 100 0.00 6553.500 FORMAT "%8.3" ECU_ADDRESS 0xD0000346 /end MEASUREMENT
/begin MEASUREMENT mshfmmod_w "" UWORD m_uw_b6553p5 1 100 0.00 6553.500 FORMAT "%8.3" ECU_ADDRESS 0xD0000348 /end MEASUREMENT
/begin MEASUREMENT mskgb_w "" UWORD m_uw_b6553p5 1 100 0.00 6553.500 FORMAT "%8.3" ECU_ADDRESS 0xD00002DA /end MEASUREMENT
/begin MEASUREMENT msllss_w "" UWORD m_uw_b102p4 1 100 0.00 102.3984 FORMAT "%8.4" ECU_ADDRESS 0xD000033E /end MEASUREMENT
/begin MEASUREMENT msndkoo_w "" UWORD m_q0p1 1 100 0.00 6553.500 FORMAT "%8.3" ECU_ADDRESS 0xD0000328 /end MEASUREMENT
/begin MEASUREMENT msndk_w "" UWORD m_q0p1 1 100 0.00 6553.500 FORMAT "%8.3" ECU_ADDRESS 0xD000032A /end MEASUREMENT
/begin MEASUREMENT msnlls_w "" UWORD m_uw_b102p4 1 100 0.00 102.3984 FORMAT "%8.4" ECU_ADDRESS 0xD000032C /end MEASUREMENT
/begin MEASUREMENT msrirspr_w "" UWORD m_q0p00625 1 100 0.00 409.5938 FORMAT "%8.4" ECU_ADDRESS 0xD0000260 /end MEASUREMENT
/begin MEASUREMENT msrirsp_w "" UWORD m_q0p00625 1 100 0.00 409.5938 FORMAT "%8.4" ECU_ADDRESS 0xD0000262 /end MEASUREMENT
/begin MEASUREMENT nmotalt_w "" UWORD nmot_uw_q0p25 1 100 0.00 16383.75 FORMAT "%8.2" ECU_ADDRESS 0xD0000410 /end MEASUREMENT
/begin MEASUREMENT nmottkor_w "" UWORD nmot_uw_q0p25 1 100 0.00 16383.75 FORMAT "%8.2" ECU_ADDRESS 0xD0000264 /end MEASUREMENT
/begin MEASUREMENT nrkatm_w "" UWORD relnmot_q768 1 100 0.00 50330880. FORMAT "%8.0" ECU_ADDRESS 0xD00004A8 /end MEASUREMENT
/begin MEASUREMENT oafpsrr_w "" SWORD p_q0p078 1 100 -2560.000 2559.922 FORMAT "%8.3" ECU_ADDRESS 0xD000038C /end MEASUREMENT
/begin MEASUREMENT oschkm_w "" UWORD m_q0p1_mg 1 100 0.00 6553.500 FORMAT "%8.3" ECU_ADDRESS 0xD000036C /end MEASUREMENT
/begin MEASUREMENT oschn_w "" UWORD m_q0p1_mg 1 100 0.00 6553.500 FORMAT "%8.3" ECU_ADDRESS 0xD000036E /end MEASUREMENT
/begin MEASUREMENT oschop_w "" UWORD m_q0p1_mg 1 100 0.00 6553.500 FORMAT "%8.3" ECU_ADDRESS 0xD0000370 /end MEASUREMENT
/begin MEASUREMENT pabnav_w "" UWORD p_uw_q0p078 1 100 0.00 5119.922 FORMAT "%8.3" ECU_ADDRESS 0xD0000378 /end MEASUREMENT
/begin MEASUREMENT pbrimxs_w "" UWORD p_uw_q0p039 1 100 0.00 2559.961 FORMAT "%8.3" ECU_ADDRESS 0xD000028A /end MEASUREMENT
/begin MEASUREMENT pbrintc_w "" UWORD p_q0p078 1 100 0.00 5119.922 FORMAT "%8.3" ECU_ADDRESS 0xD00003D2 /end MEASUREMENT
/begin MEASUREMENT pbrintmx_w "" UWORD p_uw_q0p039 1 100 0.00 2559.961 FORMAT "%8.3" ECU_ADDRESS 0xD000028C /end MEASUREMENT
/begin MEASUREMENT pbrints_w "" UWORD p_uw_q0p039 1 100 0.00 2559.961 FORMAT "%8.3" ECU_ADDRESS 0xD000028E /end MEASUREMENT
/begin MEASUREMENT pbrinttn_w "" UWORD p_uw_q0p039 1 100 0.00 2559.961 FORMAT "%8.3" ECU_ADDRESS 0xD0000290 /end MEASUREMENT
/begin MEASUREMENT pbrinttx_w "" UWORD p_uw_q0p039 1 100 0.00 2559.961 FORMAT "%8.3" ECU_ADDRESS 0xD0000292 /end MEASUREMENT
/begin MEASUREMENT pbrintug_w "" UWORD p_uw_q0p039 1 100 0.00 2559.961 FORMAT "%8.3" ECU_ADDRESS 0xD0000294 /end MEASUREMENT
/begin MEASUREMENT pbrintuk_w "" UWORD p_uw_q0p039 1 100 0.00 2559.961 FORMAT "%8.3" ECU_ADDRESS 0xD0000296 /end MEASUREMENT
/begin MEASUREMENT pbrint_w "" UWORD p_uw_q0p039 1 100 0.00 2559.961 FORMAT "%8.3" ECU_ADDRESS 0xD0000298 /end MEASUREMENT
/begin MEASUREMENT pbriugs_w "" UWORD p_uw_q0p039 1 100 0.00 2559.961 FORMAT "%8.3" ECU_ADDRESS 0xD000029A /end MEASUREMENT
/begin MEASUREMENT pbrsa_w "" UWORD p_uw_q0p078 1 100 0.00 5119.922 FORMAT "%8.3" ECU_ADDRESS 0xD0000266 /end MEASUREMENT
/begin MEASUREMENT pbrse_w "" UWORD p_uw_q0p078 1 100 0.00 5119.922 FORMAT "%8.3" ECU_ADDRESS 0xD0000268 /end MEASUREMENT
/begin MEASUREMENT plfmsdk_w "" UWORD p_uw_q0p078 1 100 0.00 5119.922 FORMAT "%8.3" ECU_ADDRESS 0xD00003A4 /end MEASUREMENT
/begin MEASUREMENT pndk_w "" UWORD p_q0p078 1 100 0.00 5119.922 FORMAT "%8.3" ECU_ADDRESS 0xD000037C /end MEASUREMENT
/begin MEASUREMENT psdkugdn_w "" UWORD p_uw_q0p078 1 100 0.00 5119.922 FORMAT "%8.3" ECU_ADDRESS 0xD000037E /end MEASUREMENT
/begin MEASUREMENT psdkugdx_w "" UWORD p_uw_q0p078 1 100 0.00 5119.922 FORMAT "%8.3" ECU_ADDRESS 0xD0000380 /end MEASUREMENT
/begin MEASUREMENT psr1_w "" UWORD p_q0p078 1 100 0.00 5119.922 FORMAT "%8.3" ECU_ADDRESS 0xD0000394 /end MEASUREMENT
/begin MEASUREMENT psrdkugd_w "" UWORD p_uw_q0p078 1 100 0.00 5119.922 FORMAT "%8.3" ECU_ADDRESS 0xD0000382 /end MEASUREMENT
/begin MEASUREMENT psrfgmh_w "" UWORD p_q0p078 1 100 0.00 5119.922 FORMAT "%8.3" ECU_ADDRESS 0xD00003DC /end MEASUREMENT
/begin MEASUREMENT psrfgmp_w "" UWORD p_q0p078 1 100 0.00 5119.922 FORMAT "%8.3" ECU_ADDRESS 0xD00003DE /end MEASUREMENT
/begin MEASUREMENT psrfg_w "" UWORD p_q0p078 1 100 0.00 5119.922 FORMAT "%8.3" ECU_ADDRESS 0xD00003C2 /end MEASUREMENT
/begin MEASUREMENT psrg1_w "" UWORD p_q0p078 1 100 0.00 5119.922 FORMAT "%8.3" ECU_ADDRESS 0xD0000396 /end MEASUREMENT
/begin MEASUREMENT psrgsm_w "" UWORD p_q0p078 1 100 0.00 5119.922 FORMAT "%8.3" ECU_ADDRESS 0xD0000398 /end MEASUREMENT
/begin MEASUREMENT psrg_w "" UWORD p_q0p078 1 100 0.00 5119.922 FORMAT "%8.3" ECU_ADDRESS 0xD000039A /end MEASUREMENT
/begin MEASUREMENT psrmgx_w "" UWORD p_q0p078 1 100 0.00 5119.922 FORMAT "%8.3" ECU_ADDRESS 0xD00003E0 /end MEASUREMENT
/begin MEASUREMENT psrmhmi_w "" UWORD p_q0p078 1 100 0.07812500 5119.922 FORMAT "%8.3" ECU_ADDRESS 0xD00003E2 /end MEASUREMENT
/begin MEASUREMENT PSRMH_2SYN_CL.dpsrfgmh_w "" SWORD p_q0p078 1 100 -2560.000 2559.922 FORMAT "%8.3" ECU_ADDRESS 0xD000110C /end MEASUREMENT
/begin MEASUREMENT PSRMH_2SYN_CL.dpsrmh_w "" SWORD p_q0p078 1 100 -2560.000 2559.922 FORMAT "%8.3" ECU_ADDRESS 0xD000110E /end MEASUREMENT
/begin MEASUREMENT PSRMH_2SYN_CL.psrfgmh_w "" UWORD p_q0p078 1 100 0.00 5119.922 FORMAT "%8.3" ECU_ADDRESS 0xD0001110 /end MEASUREMENT
/begin MEASUREMENT PSRMH_2SYN_CL.psrmh_w "" UWORD p_q0p078 1 100 0.07812500 5119.922 FORMAT "%8.3" ECU_ADDRESS 0xD0001112 /end MEASUREMENT
/begin MEASUREMENT PSRMH_2SYN_CL.psrmhmi_w "" UWORD p_q0p078 1 100 0.07812500 5119.922 FORMAT "%8.3" ECU_ADDRESS 0xD0001114 /end MEASUREMENT
/begin MEASUREMENT PSRMH_2SYN_CL.rlfsrbrh_w "" UWORD rel_q0p0234 1 100 0.00 1535.977 FORMAT "%8.3" ECU_ADDRESS 0xD0001118 /end MEASUREMENT
/begin MEASUREMENT PSRMH_2SYN_CL.INT_PSRX_CL.dpsrmX_w "" SWORD p_q0p078 1 100 -2560.000 2559.922 FORMAT "%8.3" ECU_ADDRESS 0xD000111A /end MEASUREMENT
/begin MEASUREMENT PSRMH_2SYN_CL.INT_PSRX_CL.psrmXneu_w "" UWORD p_q0p078 1 100 0.00 5119.922 FORMAT "%8.3" ECU_ADDRESS 0xD000111C /end MEASUREMENT
/begin MEASUREMENT psrmh_w "" UWORD p_q0p078 1 100 0.07812500 5119.922 FORMAT "%8.3" ECU_ADDRESS 0xD00003E4 /end MEASUREMENT
/begin MEASUREMENT PSRMMN_2SYN_CL.psrmX_w "" UWORD p_q0p078 1 100 0.00 5119.922 FORMAT "%8.3" ECU_ADDRESS 0xD0001120 /end MEASUREMENT
/begin MEASUREMENT PSRMMN_2SYN_CL.rfasrX_w "" UWORD rel_q0p0234 1 100 0.00 1535.977 FORMAT "%8.3" ECU_ADDRESS 0xD0001122 /end MEASUREMENT
/begin MEASUREMENT PSRMMN_2SYN_CL.rfzsrX_w "" UWORD rel_q0p0234 1 100 0.00 1535.977 FORMAT "%8.3" ECU_ADDRESS 0xD0001124 /end MEASUREMENT
/begin MEASUREMENT psrmmn_w "" UWORD p_q0p078 1 100 0.00 5119.922 FORMAT "%8.3" ECU_ADDRESS 0xD00003E6 /end MEASUREMENT
/begin MEASUREMENT PSRMMX_2SYN_CL.psrmX_w "" UWORD p_q0p078 1 100 0.00 5119.922 FORMAT "%8.3" ECU_ADDRESS 0xD000112A /end MEASUREMENT
/begin MEASUREMENT PSRMMX_2SYN_CL.rfasrX_w "" UWORD rel_q0p0234 1 100 0.00 1535.977 FORMAT "%8.3" ECU_ADDRESS 0xD000112C /end MEASUREMENT
/begin MEASUREMENT PSRMMX_2SYN_CL.rfzsrX_w "" UWORD rel_q0p0234 1 100 0.00 1535.977 FORMAT "%8.3" ECU_ADDRESS 0xD000112E /end MEASUREMENT
/begin MEASUREMENT psrmmx_w "" UWORD p_q0p078 1 100 0.00 5119.922 FORMAT "%8.3" ECU_ADDRESS 0xD00003E8 /end MEASUREMENT
/begin MEASUREMENT psrmp_w "" UWORD p_uw_q0p078 1 100 0.00 5119.922 FORMAT "%8.3" ECU_ADDRESS 0xD0000448 /end MEASUREMENT
/begin MEASUREMENT psrpmx_w "" UWORD p_uw_q0p078 1 100 0.00 5119.922 FORMAT "%8.3" ECU_ADDRESS 0xD000043C /end MEASUREMENT
/begin MEASUREMENT psrrf_w "" UWORD p_q0p078 1 100 0.00 5119.922 FORMAT "%8.3" ECU_ADDRESS 0xD000039C /end MEASUREMENT
/begin MEASUREMENT psrrl_w "" UWORD p_q0p078 1 100 0.00 5119.922 FORMAT "%8.3" ECU_ADDRESS 0xD00003C4 /end MEASUREMENT
/begin MEASUREMENT psr_w "" UWORD p_q0p078 1 100 0.00 5119.922 FORMAT "%8.3" ECU_ADDRESS 0xD000039E /end MEASUREMENT
/begin MEASUREMENT pu "" UBYTE p_ub_q5 1 100 0.00 1275. FORMAT "%5.0" ECU_ADDRESS 0xD0000BED /end MEASUREMENT
/begin MEASUREMENT pum_w "" UWORD p_uw_q0p039 1 100 0.00 2559.961 FORMAT "%8.3" ECU_ADDRESS 0xAFE80054 /end MEASUREMENT
/begin MEASUREMENT pu_w "" UWORD p_uw_q0p039 1 100 0.00 2559.961 FORMAT "%8.3" ECU_ADDRESS 0xD00003A6 /end MEASUREMENT
/begin MEASUREMENT pvdmn_w "" UWORD p_uw_q0p078 1 100 0.00 5119.922 FORMAT "%8.3" ECU_ADDRESS 0xD00003AA /end MEASUREMENT
/begin MEASUREMENT pvdmx_w "" UWORD p_uw_q0p078 1 100 0.00 5119.922 FORMAT "%8.3" ECU_ADDRESS 0xD00003AC /end MEASUREMENT
/begin MEASUREMENT pvd_w "" UWORD p_uw_q0p078 1 100 0.00 5119.922 FORMAT "%8.3" ECU_ADDRESS 0xD00003AE /end MEASUREMENT
/begin MEASUREMENT pvlf_w "" UWORD p_uw_q0p078 1 100 0.00 5119.922 FORMAT "%8.3" ECU_ADDRESS 0xD00003B0 /end MEASUREMENT
/begin MEASUREMENT pvv_w "" UWORD p_uw_q0p039 1 100 0.00 2559.961 FORMAT "%8.3" ECU_ADDRESS 0xD00003B4 /end MEASUREMENT
/begin MEASUREMENT qtitimnh "" UBYTE fak_ub_b4 1 100 0.00 3.984 FORMAT "%5.3" ECU_ADDRESS 0xD0000BEE /end MEASUREMENT
/begin MEASUREMENT quotntke_w "" UWORD fak_uw_b8 1 100 0.00 7.999878 FORMAT "%8.6" ECU_ADDRESS 0xD0000494 /end MEASUREMENT
/begin MEASUREMENT rfdsorgi_w "" UWORD rel_q0p0234 1 100 0.00 1535.977 FORMAT "%8.3" ECU_ADDRESS 0xD00003EA /end MEASUREMENT
/begin MEASUREMENT rfdsorim_w "" UWORD rel_q0p0234 1 100 0.00 1535.977 FORMAT "%8.3" ECU_ADDRESS 0xD00003EC /end MEASUREMENT
/begin MEASUREMENT rfges_w "" UWORD rel_q0p0234 1 100 0.00 1535.977 FORMAT "%8.3" ECU_ADDRESS 0xD00003C6 /end MEASUREMENT
/begin MEASUREMENT rfkrbrr_w "" UWORD rel_uw_q0p0234 1 100 0.00 1535.977 FORMAT "%8.3" ECU_ADDRESS 0xD000026A /end MEASUREMENT
/begin MEASUREMENT rflmorgi_w "" UWORD rel_q0p0234 1 100 0.00 1535.977 FORMAT "%8.3" ECU_ADDRESS 0xD00003EE /end MEASUREMENT
/begin MEASUREMENT rforgi_w "" UWORD rel_q0p0234 1 100 0.00 1535.977 FORMAT "%8.3" ECU_ADDRESS 0xD00003C8 /end MEASUREMENT
/begin MEASUREMENT rforidmx_w "" UWORD rel_q0p02344 1 100 0.00 1535.977 FORMAT "%8.3" ECU_ADDRESS 0xD000044C /end MEASUREMENT
/begin MEASUREMENT rforidug_w "" UWORD rel_q0p02344 1 100 0.00 1535.977 FORMAT "%8.3" ECU_ADDRESS 0xD000044E /end MEASUREMENT
/begin MEASUREMENT rfrimx_w "" UWORD rel_uw_q0p0234 1 100 0.00 1535.977 FORMAT "%8.3" ECU_ADDRESS 0xD000026C /end MEASUREMENT
/begin MEASUREMENT rfrints_w "" UWORD rel_uw_q0p0234 1 100 0.00 1535.977 FORMAT "%8.3" ECU_ADDRESS 0xD000029C /end MEASUREMENT
/begin MEASUREMENT rfrint_w "" UWORD rel_uw_q0p0234 1 100 0.00 1535.977 FORMAT "%8.3" ECU_ADDRESS 0xD000029E /end MEASUREMENT
/begin MEASUREMENT rfriresr_w "" UWORD rel_q0p02344 1 100 0.00 1535.977 FORMAT "%8.3" ECU_ADDRESS 0xD000026E /end MEASUREMENT
/begin MEASUREMENT rfrires_w "" UWORD rel_uw_q0p0234 1 100 0.00 1535.977 FORMAT "%8.3" ECU_ADDRESS 0xD00002A0 /end MEASUREMENT
/begin MEASUREMENT rfrirsp_w "" UWORD rel_uw_q0p0234 1 100 0.00 1535.977 FORMAT "%8.3" ECU_ADDRESS 0xD00002A2 /end MEASUREMENT
/begin MEASUREMENT rfriug_w "" UWORD rel_uw_q0p0234 1 100 0.00 1535.977 FORMAT "%8.3" ECU_ADDRESS 0xD0000270 /end MEASUREMENT
/begin MEASUREMENT rfr_w "" UWORD rel_uw_q0p0234 1 100 0.00 1535.977 FORMAT "%8.3" ECU_ADDRESS 0xD00002A4 /end MEASUREMENT
/begin MEASUREMENT rfzuugpn_w "" UWORD rel_q0p02344 1 100 0.00 1535.977 FORMAT "%8.3" ECU_ADDRESS 0xD0000450 /end MEASUREMENT
/begin MEASUREMENT rfzuugtx_w "" UWORD rel_q0p02344 1 100 0.00 1535.977 FORMAT "%8.3" ECU_ADDRESS 0xD0000452 /end MEASUREMENT
/begin MEASUREMENT rirints_w "" UWORD rel_uw_q0p0234 1 100 0.00 1535.977 FORMAT "%8.3" ECU_ADDRESS 0xD00002A6 /end MEASUREMENT
/begin MEASUREMENT rirint_w "" UWORD rel_uw_q0p0234 1 100 0.00 1535.977 FORMAT "%8.3" ECU_ADDRESS 0xD00002A8 /end MEASUREMENT
/begin MEASUREMENT rir_w "" UWORD rel_uw_q0p0234 1 100 0.00 1535.977 FORMAT "%8.3" ECU_ADDRESS 0xD00002AA /end MEASUREMENT
/begin MEASUREMENT rklabbr_w "" UWORD rel_q0p046875 1 100 0.00 3071.953 FORMAT "%8.3" ECU_ADDRESS 0xD000023A /end MEASUREMENT
/begin MEASUREMENT rl "" UBYTE rel_q0p75 1 100 0.00 191.3 FORMAT "%5.1" ECU_ADDRESS 0xD0000BF2 /end MEASUREMENT
/begin MEASUREMENT rlabs_w "" UWORD rel_uw_q0p0234 1 100 0.00 1535.977 FORMAT "%8.3" ECU_ADDRESS 0xD00003CE /end MEASUREMENT
/begin MEASUREMENT rlaltas_w "" UWORD rel_uw_q0p0234 1 100 0.00 1535.977 FORMAT "%8.3" ECU_ADDRESS 0xD0000412 /end MEASUREMENT
/begin MEASUREMENT rldkmx_w "" UWORD rel_q0p02344 1 100 0.00 1535.977 FORMAT "%8.3" ECU_ADDRESS 0xD0000454 /end MEASUREMENT
/begin MEASUREMENT rldkugd_w "" UWORD rel_q0p02344 1 100 0.00 1535.977 FORMAT "%8.3" ECU_ADDRESS 0xD0000456 /end MEASUREMENT
/begin MEASUREMENT rlfdkroh_w "" UWORD rel_uw_q0p0234 1 100 0.00 1535.977 FORMAT "%8.3" ECU_ADDRESS 0xD00003FE /end MEASUREMENT
/begin MEASUREMENT rlfgdssm_w "" UWORD rel_q0p0234 1 100 0.00 1535.977 FORMAT "%8.3" ECU_ADDRESS 0xD00003F0 /end MEASUREMENT
/begin MEASUREMENT rlfgds_w "" UWORD rel_q0p0234 1 100 0.00 1535.977 FORMAT "%8.3" ECU_ADDRESS 0xD00003F2 /end MEASUREMENT
/begin MEASUREMENT rlfglm_w "" UWORD rel_q0p0234 1 100 0.00 1535.977 FORMAT "%8.3" ECU_ADDRESS 0xD00003F4 /end MEASUREMENT
/begin MEASUREMENT rlfgmnho_w "" UWORD rel_q0p02344 1 100 0.00 1535.977 FORMAT "%8.3" ECU_ADDRESS 0xD0000426 /end MEASUREMENT
/begin MEASUREMENT rlfgmp_w "" UWORD rel_uw_q0p0234 1 100 0.00 1535.977 FORMAT "%8.3" ECU_ADDRESS 0xD000043E /end MEASUREMENT
/begin MEASUREMENT rlfgroh_w "" UWORD rel_uw_q0p0234 1 100 0.00 1535.977 FORMAT "%8.3" ECU_ADDRESS 0xD0000400 /end MEASUREMENT
/begin MEASUREMENT rlfg_w "" UWORD rel_q0p0234 1 100 0.00 1535.977 FORMAT "%8.3" ECU_ADDRESS 0xD00003CA /end MEASUREMENT
/begin MEASUREMENT rlgas_w "" SWORD rel_q0p02344 1 100 -768.0000 767.9766 FORMAT "%8.4" ECU_ADDRESS 0xD0000416 /end MEASUREMENT
/begin MEASUREMENT rllabbr_w "" UWORD rel_q0p0234 1 100 0.00 1535.977 FORMAT "%8.3" ECU_ADDRESS 0xD000023C /end MEASUREMENT
/begin MEASUREMENT rlminhom_w "" UWORD rel_q0p02344 1 100 0.00 1535.977 FORMAT "%8.3" ECU_ADDRESS 0xD0000428 /end MEASUREMENT
/begin MEASUREMENT rlmin_w "" UWORD rel_q0p02344 1 100 0.00 1535.977 FORMAT "%8.3" ECU_ADDRESS 0xD000042A /end MEASUREMENT
/begin MEASUREMENT rlmnsa_w "" UWORD rel_q0p02344 1 100 0.00 1535.977 FORMAT "%8.3" ECU_ADDRESS 0xD0000422 /end MEASUREMENT
/begin MEASUREMENT rlmn_w "" UWORD rel_q0p02344 1 100 0.00 1535.977 FORMAT "%8.3" ECU_ADDRESS 0xD0000424 /end MEASUREMENT
/begin MEASUREMENT rlmxsoe_w "" UWORD rel_uw_q0p0234 1 100 0.00 1535.977 FORMAT "%8.3" ECU_ADDRESS 0xD00003D0 /end MEASUREMENT
/begin MEASUREMENT rlmxvl_w "" UWORD rel_uw_q0p0234 1 100 0.00 1535.977 FORMAT "%8.3" ECU_ADDRESS 0xD000042C /end MEASUREMENT
/begin MEASUREMENT rlnotn_w "" UWORD rel_uw_q0p0234 1 100 0.00 1535.977 FORMAT "%8.3" ECU_ADDRESS 0xD00003F8 /end MEASUREMENT
/begin MEASUREMENT rlp "" UBYTE rel_ub_q0p75 1 100 0.00 191.3 FORMAT "%5.1" ECU_ADDRESS 0xD0000BF6 /end MEASUREMENT
/begin MEASUREMENT rlpnb_w "" UWORD rel_uw_q0p0234 1 100 0.00 1535.977 FORMAT "%8.3" ECU_ADDRESS 0xD0000440 /end MEASUREMENT
/begin MEASUREMENT rlpu_w "" UWORD rel_uw_q0p0234 1 100 0.00 1535.977 FORMAT "%8.3" ECU_ADDRESS 0xD0000442 /end MEASUREMENT
/begin MEASUREMENT rlp_w "" UWORD rel_uw_q0p0234 1 100 0.00 1535.977 FORMAT "%8.3" ECU_ADDRESS 0xD000044A /end MEASUREMENT
/begin MEASUREMENT rlrints_w "" UWORD rel_uw_q0p0234 1 100 0.00 1535.977 FORMAT "%8.3" ECU_ADDRESS 0xD00002AC /end MEASUREMENT
/begin MEASUREMENT rlrint_w "" UWORD rel_uw_q0p0234 1 100 0.00 1535.977 FORMAT "%8.3" ECU_ADDRESS 0xD00002AE /end MEASUREMENT
/begin MEASUREMENT rlrohmp_w "" UWORD rel_uw_q0p0234 1 100 0.00 1535.977 FORMAT "%8.3" ECU_ADDRESS 0xD0000444 /end MEASUREMENT
/begin MEASUREMENT rlr_w "" UWORD rel_uw_q0p0234 1 100 0.00 1535.977 FORMAT "%8.3" ECU_ADDRESS 0xD00002B0 /end MEASUREMENT
/begin MEASUREMENT rl_w "" UWORD rel_q0p0234 1 100 0.00 1535.977 FORMAT "%8.3" ECU_ADDRESS 0xD00003CC /end MEASUREMENT
/begin MEASUREMENT rml "" UBYTE rel_ub_b99p6 1 100 0.00 99.61 FORMAT "%5.2" ECU_ADDRESS 0xD0000BF3 /end MEASUREMENT
/begin MEASUREMENT rri_w "" UWORD rel_uw_b100 1 100 0.00 99.99847 FORMAT "%8.5" ECU_ADDRESS 0xD00002B2 /end MEASUREMENT
/begin MEASUREMENT rr_w "" UWORD rel_uw_b100 1 100 0.00 99.99847 FORMAT "%8.5" ECU_ADDRESS 0xD00002B4 /end MEASUREMENT
/begin MEASUREMENT s1fl2p46 "" UBYTE dez 1 100 0.00 255.0 FORMAT "%5.1" ARRAY_SIZE 2 ECU_ADDRESS 0xD0000C26 /end MEASUREMENT
/begin MEASUREMENT tabstcor_w "" UWORD t_q0p2 1 100 0.00 13107.00 FORMAT "%8.2" ECU_ADDRESS 0xD00004AA /end MEASUREMENT
/begin MEASUREMENT tabstlc_w "" UWORD t1sxs_uw_q1 1 100 0.00 65535.00 FORMAT "%8.2" ECU_ADDRESS 0xD00004AC /end MEASUREMENT
/begin MEASUREMENT tabst_w "" UWORD t1sxs_uw_q1 1 100 0.00 65535.00 FORMAT "%8.2" ECU_ADDRESS 0xD000045A /end MEASUREMENT
/begin MEASUREMENT tadk_w "" UWORD temp_q0p0234_o273 1 100 -273.1500 1262.827 FORMAT "%8.3" ECU_ADDRESS 0xD000045E /end MEASUREMENT
/begin MEASUREMENT taev_w "" UWORD temp_q0p0234_o273 1 100 -273.1500 1262.827 FORMAT "%8.3" ECU_ADDRESS 0xD0000496 /end MEASUREMENT
/begin MEASUREMENT tafsoab_w "" UWORD temp_q0p0234_o273 1 100 -273.1500 1262.827 FORMAT "%8.3" ECU_ADDRESS 0xAFE80060 /end MEASUREMENT
/begin MEASUREMENT tafsoak_w "" UWORD temp_q0p0234_o273 1 100 -273.1500 1262.827 FORMAT "%8.3" ECU_ADDRESS 0xD00004AE /end MEASUREMENT
/begin MEASUREMENT tafsost_w "" UWORD temp_q0p0234_o273 1 100 -273.1500 1262.827 FORMAT "%8.3" ECU_ADDRESS 0xD00004C6 /end MEASUREMENT
/begin MEASUREMENT tahevkor_w "" UWORD temp_q0p0234_o273 1 100 -273.1500 1262.827 FORMAT "%8.3" ECU_ADDRESS 0xD0000486 /end MEASUREMENT
/begin MEASUREMENT tahev_w "" UWORD temp_q0p0234_o273 1 100 -273.1500 1262.827 FORMAT "%8.3" ECU_ADDRESS 0xD0000498 /end MEASUREMENT
/begin MEASUREMENT tahsoab_w "" UWORD temp_q0p0234_o273 1 100 -273.1500 1262.827 FORMAT "%8.3" ECU_ADDRESS 0xAFE80062 /end MEASUREMENT
/begin MEASUREMENT tahsoak_w "" UWORD temp_q0p0234_o273 1 100 -273.1500 1262.827 FORMAT "%8.3" ECU_ADDRESS 0xD00004B0 /end MEASUREMENT
/begin MEASUREMENT tahsost_w "" UWORD temp_q0p0234_o273 1 100 -273.1500 1262.827 FORMAT "%8.3" ECU_ADDRESS 0xD00004C8 /end MEASUREMENT
/begin MEASUREMENT tasrm_w "" UWORD temp_q0p0234_o273 1 100 -273.1500 1262.827 FORMAT "%8.3" ECU_ADDRESS 0xD0000460 /end MEASUREMENT
/begin MEASUREMENT tasr_w "" UWORD temp_q0p0234_o273 1 100 -273.1500 1262.827 FORMAT "%8.3" ECU_ADDRESS 0xD000045C /end MEASUREMENT
/begin MEASUREMENT tas_w "" UWORD t_q16us 1 100 0.00 1048560. FORMAT "%8.0" ECU_ADDRESS 0xD0000418 /end MEASUREMENT
/begin MEASUREMENT tatrigst "" UBYTE temp_ub_q0p75_o48 1 100 -48.00 143.3 FORMAT "%5.1" ECU_ADDRESS 0xD0000C22 /end MEASUREMENT
/begin MEASUREMENT tavdk2_w "" UWORD temp_q0p0234_o273 1 100 -273.1500 1262.827 FORMAT "%8.3" ECU_ADDRESS 0xD0000464 /end MEASUREMENT
/begin MEASUREMENT tavdkmn2_w "" UWORD temp_q0p0234_o273 1 100 -273.1500 1262.827 FORMAT "%8.3" ECU_ADDRESS 0xD0000466 /end MEASUREMENT
/begin MEASUREMENT tavdkmn_w "" UWORD temp_q0p0234_o273 1 100 -273.1500 1262.827 FORMAT "%8.3" ECU_ADDRESS 0xD0000468 /end MEASUREMENT
/begin MEASUREMENT tavdkmx2_w "" UWORD temp_q0p0234_o273 1 100 -273.1500 1262.827 FORMAT "%8.3" ECU_ADDRESS 0xD000046A /end MEASUREMENT
/begin MEASUREMENT tavdkmx_w "" UWORD temp_q0p0234_o273 1 100 -273.1500 1262.827 FORMAT "%8.3" ECU_ADDRESS 0xD000046C /end MEASUREMENT
/begin MEASUREMENT tavdkm_w "" UWORD temp_q0p0234_o273 1 100 -273.1500 1262.827 FORMAT "%8.3" ECU_ADDRESS 0xD0000470 /end MEASUREMENT
/begin MEASUREMENT tavdk_w "" UWORD temp_q0p0234_o273 1 100 -273.1500 1262.827 FORMAT "%8.3" ECU_ADDRESS 0xD000046E /end MEASUREMENT
/begin MEASUREMENT tavsoab_w "" UWORD temp_q0p0234_o273 1 100 -273.1500 1262.827 FORMAT "%8.3" ECU_ADDRESS 0xAFE80064 /end MEASUREMENT
/begin MEASUREMENT tavsoak_w "" UWORD temp_q0p0234_o273 1 100 -273.1500 1262.827 FORMAT "%8.3" ECU_ADDRESS 0xD00004B2 /end MEASUREMENT
/begin MEASUREMENT tavsost_w "" UWORD temp_q0p0234_o273 1 100 -273.1500 1262.827 FORMAT "%8.3" ECU_ADDRESS 0xD00004CA /end MEASUREMENT
/begin MEASUREMENT tecuolclst "" UBYTE dez 1 100 0.00 255.0 FORMAT "%5.1" ECU_ADDRESS 0xD0000C08 /end MEASUREMENT
/begin MEASUREMENT tecuolc_l "" SLONG t_q1 1 100 0.00 2147483647.00 FORMAT "%13.2" ECU_ADDRESS 0xD0001E08 /end MEASUREMENT
/begin MEASUREMENT tecuolst "" UBYTE dez 1 100 0.00 255.0 FORMAT "%5.1" ECU_ADDRESS 0xD0000C07 /end MEASUREMENT
/begin MEASUREMENT tecuomlst "" UBYTE dez 1 100 0.00 255.0 FORMAT "%5.1" ECU_ADDRESS 0xAFE80161 /end MEASUREMENT
/begin MEASUREMENT tecuomwt_w "" UWORD t_q0p05 1 100 0.00 3276.750 FORMAT "%8.3" ECU_ADDRESS 0xD0000474 /end MEASUREMENT
/begin MEASUREMENT tecuom_l "" SLONG t_q1 1 100 0.00 2147483647.00 FORMAT "%13.2" ECU_ADDRESS 0xAFE80008 /end MEASUREMENT
/begin MEASUREMENT tecuo_l "" SLONG t_q1 1 100 0.00 2147483647.00 FORMAT "%13.2" ECU_ADDRESS 0xD0001E00 /end MEASUREMENT
/begin MEASUREMENT tengom_l "" SLONG t_q1 1 100 0.00 2147483647.00 FORMAT "%13.2" ECU_ADDRESS 0xD0001E04 /end MEASUREMENT
/begin MEASUREMENT tengsi_l "" SLONG t_q1 1 100 0.00 2147483647.00 FORMAT "%13.2" ECU_ADDRESS 0xAFE8000C /end MEASUREMENT
/begin MEASUREMENT tengslst "" UBYTE dez 1 100 0.00 255.0 FORMAT "%5.1" ECU_ADDRESS 0xD0000C09 /end MEASUREMENT
/begin MEASUREMENT tengsold_w "" UWORD t_q1 1 100 0.00 65535.00 FORMAT "%8.2" ECU_ADDRESS 0xD0000458 /end MEASUREMENT
/begin MEASUREMENT tengsq1z_w "" UWORD t_q1 1 100 0.00 65535.00 FORMAT "%8.2" ECU_ADDRESS 0xD0000478 /end MEASUREMENT
/begin MEASUREMENT tengsq1_w "" UWORD t_q1 1 100 0.00 65535.00 FORMAT "%8.2" ECU_ADDRESS 0xD000047A /end MEASUREMENT
/begin MEASUREMENT tengsstold "" UBYTE dez 1 100 0.00 255.0 FORMAT "%5.1" ECU_ADDRESS 0xD0000BF8 /end MEASUREMENT
/begin MEASUREMENT tengszlst "" UBYTE dez 1 100 0.00 255.0 FORMAT "%5.1" ECU_ADDRESS 0xD0000C0A /end MEASUREMENT
/begin MEASUREMENT tengsz_l "" SLONG t_q1 1 100 0.00 2147483647.00 FORMAT "%13.2" ECU_ADDRESS 0xD0001E0C /end MEASUREMENT
/begin MEASUREMENT tengsz_w "" UWORD t_q4_s 1 100 0.00 262140.0 FORMAT "%8.1" ECU_ADDRESS 0xD000047C /end MEASUREMENT
/begin MEASUREMENT tengs_l "" SLONG t_q1 1 100 0.00 2147483647.00 FORMAT "%13.2" ECU_ADDRESS 0xD0001E10 /end MEASUREMENT
/begin MEASUREMENT tengs_w "" UWORD t_q4_s 1 100 0.00 262140.0 FORMAT "%8.1" ECU_ADDRESS 0xD000047E /end MEASUREMENT
/begin MEASUREMENT testk15o_w "" UWORD t_q0p2 1 100 0.00 13107.00 FORMAT "%8.2" ECU_ADDRESS 0xAFE8005E /end MEASUREMENT
/begin MEASUREMENT tev_w "" UWORD temp_q0p0234_o273 1 100 -273.1500 1262.827 FORMAT "%8.3" ECU_ADDRESS 0xD000049A /end MEASUREMENT
/begin MEASUREMENT tfa1m_w "" UWORD temp_q0p0234_o273 1 100 -273.1500 1262.827 FORMAT "%8.3" ECU_ADDRESS 0xD0000480 /end MEASUREMENT
/begin MEASUREMENT thki_w "" UWORD temp_q0p0234_o273 1 100 -273.1500 1262.827 FORMAT "%8.3" ECU_ADDRESS 0xD0000366 /end MEASUREMENT
/begin MEASUREMENT tlrsk_w "" UWORD t_q0p01 1 100 0.00 655.3500 FORMAT "%8.4" ECU_ADDRESS 0xD000023E /end MEASUREMENT
/begin MEASUREMENT tmew "" UBYTE temp_ub_q0p75_o48 1 100 -48.00 143.3 FORMAT "%5.1" ECU_ADDRESS 0xD0000BFF /end MEASUREMENT
/begin MEASUREMENT tmmodkorrf "" UBYTE fak_ub_b2 1 100 0.00 1.992188 FORMAT "%8.6" ECU_ADDRESS 0xD0000C00 /end MEASUREMENT
/begin MEASUREMENT tmot "" UBYTE temp_ub_q0p75_o48 1 100 -48.00 143.3 FORMAT "%5.1" ECU_ADDRESS 0xD0000C01 /end MEASUREMENT
/begin MEASUREMENT tmotab "" UBYTE temp_ub_q0p75_o48 1 100 -48.00 143.3 FORMAT "%5.1" ECU_ADDRESS 0xAFE8015F /end MEASUREMENT
/begin MEASUREMENT tmotabz "" UBYTE temp_ub_q0p75_o48 1 100 -48.00 143.3 FORMAT "%5.1" ECU_ADDRESS 0xD0000C02 /end MEASUREMENT
/begin MEASUREMENT tmotdifk "" UBYTE temp_q0p75 1 100 0.00 191.3 FORMAT "%5.1" ECU_ADDRESS 0xD0000C0D /end MEASUREMENT
/begin MEASUREMENT tmotfilk_w "" UWORD temp_q0p0234_o273 1 100 -273.1500 1262.827 FORMAT "%8.3" ECU_ADDRESS 0xAFE80058 /end MEASUREMENT
/begin MEASUREMENT tmotlinst "" UBYTE temp_ub_q0p75_o48 1 100 -48.00 143.3 FORMAT "%5.1" ECU_ADDRESS 0xD0000C03 /end MEASUREMENT
/begin MEASUREMENT tmotlinstz "" UBYTE temp_ub_q0p75_o48 1 100 -48.00 143.3 FORMAT "%5.1" ECU_ADDRESS 0xD0000C04 /end MEASUREMENT
/begin MEASUREMENT tmotvt "" UBYTE temp_ub_q0p75_o48 1 100 -48.00 143.3 FORMAT "%5.1" ECU_ADDRESS 0xD0000BFC /end MEASUREMENT
/begin MEASUREMENT tmst "" UBYTE temp_ub_q0p75_o48 1 100 -48.00 143.3 FORMAT "%5.1" ECU_ADDRESS 0xD0000C05 /end MEASUREMENT
/begin MEASUREMENT tmsttpe "" UBYTE temp_ub_q0p75_o48 1 100 -48.00 143.3 FORMAT "%5.1" ECU_ADDRESS 0xD0000C1B /end MEASUREMENT
/begin MEASUREMENT tmstz "" UBYTE temp_ub_q0p75_o48 1 100 -48.00 143.3 FORMAT "%5.1" ECU_ADDRESS 0xD0000C06 /end MEASUREMENT
/begin MEASUREMENT toch "" UBYTE temp_ub_q0p75_o48 1 100 -48.00 143.3 FORMAT "%5.1" ECU_ADDRESS 0xD0000C14 /end MEASUREMENT
/begin MEASUREMENT tochlw "" UBYTE temp_ub_q0p75_o48 1 100 -48.00 143.3 FORMAT "%5.1" ECU_ADDRESS 0xD0000C12 /end MEASUREMENT
/begin MEASUREMENT tosp "" UBYTE temp_ub_q0p75_o48 1 100 -48.00 143.3 FORMAT "%5.1" ECU_ADDRESS 0xD0000C16 /end MEASUREMENT
/begin MEASUREMENT tospab "" UBYTE temp_ub_q0p75_o48 1 100 -48.00 143.3 FORMAT "%5.1" ECU_ADDRESS 0xAFE80164 /end MEASUREMENT
/begin MEASUREMENT tospm "" UBYTE temp_ub_q0p75_o48 1 100 -48.00 143.3 FORMAT "%5.1" ECU_ADDRESS 0xD0000C19 /end MEASUREMENT
/begin MEASUREMENT tospmab_w "" UWORD temp_q0p0234_o273 1 100 -273.1500 1262.827 FORMAT "%8.3" ECU_ADDRESS 0xAFE8005C /end MEASUREMENT
/begin MEASUREMENT tospmbm_w "" UWORD temp_q0p0234_o273 1 100 -273.1500 1262.827 FORMAT "%8.3" ECU_ADDRESS 0xD000049C /end MEASUREMENT
/begin MEASUREMENT tospmloc_w "" UWORD temp_q0p0234_o273 1 100 -273.1500 1262.827 FORMAT "%8.3" ECU_ADDRESS 0xAFE8005A /end MEASUREMENT
/begin MEASUREMENT tospmnf_w "" UWORD temp_q0p0234_o273 1 100 -273.1500 1262.827 FORMAT "%8.3" ECU_ADDRESS 0xD000049E /end MEASUREMENT
/begin MEASUREMENT tospmq "" UBYTE dez 1 100 0.00 255.0 FORMAT "%5.1" ECU_ADDRESS 0xD0000C1A /end MEASUREMENT
/begin MEASUREMENT tospmr_w "" UWORD temp_q0p0234_o273 1 100 -273.1500 1262.827 FORMAT "%8.3" ECU_ADDRESS 0xD00004A0 /end MEASUREMENT
/begin MEASUREMENT tospmst "" UBYTE dez 1 100 0.00 255.0 FORMAT "%5.1" ECU_ADDRESS 0xAFE80166 /end MEASUREMENT
/begin MEASUREMENT tospmstab "" UBYTE dez 1 100 0.00 255.0 FORMAT "%5.1" ECU_ADDRESS 0xAFE80167 /end MEASUREMENT
/begin MEASUREMENT tospmtdr_w "" UWORD t_q1 1 100 0.00 65535.00 FORMAT "%8.2" ECU_ADDRESS 0xD00004A2 /end MEASUREMENT
/begin MEASUREMENT tosptmab "" UBYTE temp_uw_q0p75_o48 1 100 -48.00 143.3 FORMAT "%5.1" ECU_ADDRESS 0xAFE80168 /end MEASUREMENT
/begin MEASUREMENT tppsrifd_w "" UWORD fak_q3p0518Em5 1 100 0.00 1.999969 FORMAT "%8.6" ECU_ADDRESS 0xD000038E /end MEASUREMENT
/begin MEASUREMENT trfrint_w "" UWORD temp_q0p0234_o273 1 100 -273.1500 1262.827 FORMAT "%8.3" ECU_ADDRESS 0xD00002B6 /end MEASUREMENT
/begin MEASUREMENT ttaikrs_w "" UWORD temp_q0p0234_o273 1 100 -273.1500 1262.827 FORMAT "%8.3" ECU_ADDRESS 0xD0000372 /end MEASUREMENT
/begin MEASUREMENT ttospmr "" UWORD t_q1 1 100 1.000000 65535.00 FORMAT "%8.2" ECU_ADDRESS 0xD00004A4 /end MEASUREMENT
/begin MEASUREMENT ttospmrsw "" UWORD t_q0p1 1 100 0.00 25.50000 FORMAT "%8.5" ECU_ADDRESS 0xD00004A6 /end MEASUREMENT
/begin MEASUREMENT ttummoffst "" UBYTE temp_ub_q0p75_o48 1 100 -48.00 143.3 FORMAT "%5.1" ECU_ADDRESS 0xD0000C23 /end MEASUREMENT
/begin MEASUREMENT tum "" UBYTE temp_ub_q0p75_o48 1 100 -48.00 143.3 FORMAT "%5.1" ECU_ADDRESS 0xAFE8016E /end MEASUREMENT
/begin MEASUREMENT tumg "" UBYTE temp_ub_q0p75_o48 1 100 -48.00 143.3 FORMAT "%5.1" ECU_ADDRESS 0xD0000C28 /end MEASUREMENT
/begin MEASUREMENT tumgktpe_w "" UWORD temp_q0p0234_o273 1 100 -273.1500 1262.827 FORMAT "%8.3" ECU_ADDRESS 0xD00004B4 /end MEASUREMENT
/begin MEASUREMENT tumgk_w "" UWORD temp_q0p0234_o273 1 100 -273.1500 1262.827 FORMAT "%8.3" ECU_ADDRESS 0xD00004D2 /end MEASUREMENT
/begin MEASUREMENT tumm "" UBYTE temp_ub_q0p75_o48 1 100 -48.00 143.3 FORMAT "%5.1" ECU_ADDRESS 0xD0000C29 /end MEASUREMENT
/begin MEASUREMENT tummictr "" UWORD t_q1 1 100 0.00 65535.00 FORMAT "%8.2" ECU_ADDRESS 0xD00004D0 /end MEASUREMENT
/begin MEASUREMENT tumti2 "" UBYTE temp_ub_q1_o40 1 100 -40.00 215.0 FORMAT "%5.1" ECU_ADDRESS 0xD0000C2A /end MEASUREMENT
/begin MEASUREMENT tumtmp "" UBYTE temp_ub_q0p75_o48 1 100 -48.00 143.3 FORMAT "%5.1" ECU_ADDRESS 0xD0000C24 /end MEASUREMENT
/begin MEASUREMENT twfsool_w "" UWORD temp_q0p0234_o273 1 100 -273.1500 1262.827 FORMAT "%8.3" ECU_ADDRESS 0xD00004B6 /end MEASUREMENT
/begin MEASUREMENT twhsool_w "" UWORD temp_q0p0234_o273 1 100 -273.1500 1262.827 FORMAT "%8.3" ECU_ADDRESS 0xD00004B8 /end MEASUREMENT
/begin MEASUREMENT twvev_w "" UWORD temp_q0p0234_o273 1 100 -273.1500 1262.827 FORMAT "%8.3" ECU_ADDRESS 0xD0000462 /end MEASUREMENT
/begin MEASUREMENT twvsool_w "" UWORD temp_q0p0234_o273 1 100 -273.1500 1262.827 FORMAT "%8.3" ECU_ADDRESS 0xD00004BA /end MEASUREMENT
/begin MEASUREMENT ummsnms1_w "" UWORD fak_uw_b8 1 100 0.00 7.999878 FORMAT "%8.6" ECU_ADDRESS 0xD00002F8 /end MEASUREMENT
/begin MEASUREMENT ummsnms2_w "" UWORD fak_uw_b8 1 100 0.00 7.999878 FORMAT "%8.6" ECU_ADDRESS 0xD00002FA /end MEASUREMENT
/begin MEASUREMENT ummsnms_w "" UWORD fak_uw_b8 1 100 0.00 7.999878 FORMAT "%8.6" ECU_ADDRESS 0xD000032E /end MEASUREMENT
/begin MEASUREMENT umsnms1f_w "" UWORD fak_uw_b8 1 100 0.00 7.999878 FORMAT "%8.6" ECU_ADDRESS 0xD00002FC /end MEASUREMENT
/begin MEASUREMENT umsnms1n_w "" UWORD fak_uw_b8 1 100 0.00 7.999878 FORMAT "%8.6" ECU_ADDRESS 0xD00002FE /end MEASUREMENT
/begin MEASUREMENT umsnms1x_w "" UWORD fak_uw_b8 1 100 0.00 7.999878 FORMAT "%8.6" ECU_ADDRESS 0xD0000300 /end MEASUREMENT
/begin MEASUREMENT umsnms2f_w "" UWORD fak_uw_b8 1 100 0.00 7.999878 FORMAT "%8.6" ECU_ADDRESS 0xD0000302 /end MEASUREMENT
/begin MEASUREMENT umsnms2n_w "" UWORD fak_uw_b8 1 100 0.00 7.999878 FORMAT "%8.6" ECU_ADDRESS 0xD0000304 /end MEASUREMENT
/begin MEASUREMENT umsnms2x_w "" UWORD fak_uw_b8 1 100 0.00 7.999878 FORMAT "%8.6" ECU_ADDRESS 0xD0000306 /end MEASUREMENT
/begin MEASUREMENT umsrln_w "" UWORD m_q0p0005 1 100 0.00 32.76750 FORMAT "%8.5" ECU_ADDRESS 0xD0000402 /end MEASUREMENT
/begin MEASUREMENT verhmsb_w "" UWORD fak_uw_b2 1 100 0.00 1.999969 FORMAT "%8.6" ECU_ADDRESS 0xD00002DC /end MEASUREMENT
/begin MEASUREMENT vpabgsr_w "" UWORD fak_uw_b2 1 100 0.00 1.999969 FORMAT "%8.6" ECU_ADDRESS 0xD00002B8 /end MEASUREMENT
/begin MEASUREMENT vpsrabg_w "" UWORD fak_uw_b2 1 100 0.00 1.999969 FORMAT "%8.6" ECU_ADDRESS 0xD0000272 /end MEASUREMENT
/begin MEASUREMENT vpsrvdb_w "" UWORD fak_uw_b2 1 100 0.00 1.999969 FORMAT "%8.6" ECU_ADDRESS 0xD0000330 /end MEASUREMENT
/begin MEASUREMENT vpsrvdk_w "" UWORD fak_uw_b2 1 100 0.00 1.999969 FORMAT "%8.6" ECU_ADDRESS 0xD0000332 /end MEASUREMENT
/begin MEASUREMENT vpvdkpu_w "" UWORD fak_q0p000122 1 100 0.00 7.999878 FORMAT "%8.6" ECU_ADDRESS 0xD00003B2 /end MEASUREMENT
/begin MEASUREMENT vsaugr_w "" UWORD vol_q0p702Em3_dm3 1 100 0.00 46.00562 FORMAT "%8.5" ECU_ADDRESS 0xD00003F6 /end MEASUREMENT
/begin MEASUREMENT wdkbap_w "" UWORD rel_uw_b100 1 100 0.00 99.99847 FORMAT "%8.5" ECU_ADDRESS 0xD00004D6 /end MEASUREMENT
/begin MEASUREMENT wdkmsmx_w "" UWORD rel_uw_b100 1 100 0.00 99.99847 FORMAT "%8.5" ECU_ADDRESS 0xD0000334 /end MEASUREMENT
/begin MEASUREMENT wdkm_w "" UWORD rel_uw_b100 1 100 0.00 99.99847 FORMAT "%8.5" ECU_ADDRESS 0xD0000308 /end MEASUREMENT
/begin MEASUREMENT wdkpmm_w "" UWORD rel_uw_b100 1 100 0.00 99.99847 FORMAT "%8.5" ECU_ADDRESS 0xD000030A /end MEASUREMENT
/begin MEASUREMENT wdktn_w "" UWORD rel_uw_b100 1 100 0.00 99.99847 FORMAT "%8.5" ECU_ADDRESS 0xD000030C /end MEASUREMENT
/begin MEASUREMENT wdktx_w "" UWORD rel_uw_b100 1 100 0.00 99.99847 FORMAT "%8.5" ECU_ADDRESS 0xD000030E /end MEASUREMENT
/begin MEASUREMENT wgvoma_w "" SWORD kw_q0p0156 1 100 -512.0000 511.9844 FORMAT "%8.4" ECU_ADDRESS 0xD00004D8 /end MEASUREMENT
/begin MEASUREMENT wgvome_w "" SWORD kw_q0p0156 1 100 -512.0000 511.9844 FORMAT "%8.4" ECU_ADDRESS 0xD00004DA /end MEASUREMENT
/begin MEASUREMENT wgvosa_w "" SWORD kw_q0p0156 1 100 -512.0000 511.9844 FORMAT "%8.4" ECU_ADDRESS 0xD00004DC /end MEASUREMENT
/begin MEASUREMENT wgvose_w "" SWORD kw_q0p0156 1 100 -512.0000 511.9844 FORMAT "%8.4" ECU_ADDRESS 0xD00004DE /end MEASUREMENT
/begin MEASUREMENT wgvsma_w "" SWORD kw_q0p0156 1 100 -512.0000 511.9844 FORMAT "%8.4" ECU_ADDRESS 0xD00004E0 /end MEASUREMENT
/begin MEASUREMENT wgvsme_w "" SWORD kw_q0p0156 1 100 -512.0000 511.9844 FORMAT "%8.4" ECU_ADDRESS 0xD00004E2 /end MEASUREMENT
/begin MEASUREMENT wgvspum_w "" SWORD kw_q0p0156 1 100 -512.0000 511.9844 FORMAT "%8.4" ECU_ADDRESS 0xD0000274 /end MEASUREMENT
/begin MEASUREMENT wgvssa_w "" SWORD kw_q0p0156 1 100 -512.0000 511.9844 FORMAT "%8.4" ECU_ADDRESS 0xD00004E4 /end MEASUREMENT
/begin MEASUREMENT wgvsse_w "" SWORD kw_q0p0156 1 100 -512.0000 511.9844 FORMAT "%8.4" ECU_ADDRESS 0xD00004E6 /end MEASUREMENT
/begin MEASUREMENT wgvums_w "" SWORD kw_q0p0156 1 100 -512.0000 511.9844 FORMAT "%8.4" ECU_ADDRESS 0xD0000276 /end MEASUREMENT
/begin MEASUREMENT wgvum_w "" SWORD kw_q0p0156 1 100 -512.0000 511.9844 FORMAT "%8.4" ECU_ADDRESS 0xD00002BA /end MEASUREMENT
/begin MEASUREMENT xqtmm_w "" UWORD fak_uw_b256 1 100 0.00 255.9961 FORMAT "%8.4" ECU_ADDRESS 0xD0000476 /end MEASUREMENT
/begin MEASUREMENT zwmatma "" UBYTE dez 1 100 0.00 255.0 FORMAT "%5.1" ECU_ADDRESS 0xAFE8016B /end MEASUREMENT
/begin MEASUREMENT zwmatmf "" UBYTE dez 1 100 0.00 255.0 FORMAT "%5.1" ECU_ADDRESS 0xAFE8016C /end MEASUREMENT
/begin MEASUREMENT zwmatmk "" UBYTE dez 1 100 0.00 255.0 FORMAT "%5.1" ECU_ADDRESS 0xAFE8016D /end MEASUREMENT
/begin FUNCTION BGLASO "1.10.0" /begin DEF_CHARACTERISTIC CWBGLASO FRIRLABBR LASTCMN LASTCMX /end DEF_CHARACTERISTIC
 /begin IN_MEASUREMENT B_lr B_stendes lamsbg_w nmot_w redistb1 rir_w rllaso_w tlrsl_w zlrs_w /end IN_MEASUREMENT
 /begin OUT_MEASUREMENT B_lasostc labbrm_w labrgs_w lamsbrs_w lamsobd_w lamsons_w lassa_w /end OUT_MEASUREMENT
 /begin LOC_MEASUREMENT B_totab evabkor_w rklabbr_w rllabbr_w tlrsk_w /end LOC_MEASUREMENT
 FUNCTION_VERSION "1.10.0" /end FUNCTION
/begin FUNCTION BGLWM "3.6.1"
 /begin DEF_CHARACTERISTIC CWBGLWM DPBRINTTN DPBRINTTX FAFRSPVP FFUPSRLTN FFUPSRLTX FTMSDV FUPSRLMN FUPSRLMX FVBR KFFKPBRRES KFFKUPRLMX KFFPBR MSNRIRSP PBRINTMN PBRINTMX RECIKAPPA TMSBRKR /end DEF_CHARACTERISTIC
 /begin IN_MEASUREMENT tahev_w umsrln_w fiuewdk_w ftahev_w nmot_w pabnav_w psrdkugd_w psr_w pu_w pvd_w rfges_w taev_w taikr_w tasr_w wgvome_w wgvose_w wgvsma_w wgvsme_w wgvssa_w wgvsse_w /end IN_MEASUREMENT
 /begin OUT_MEASUREMENT fupshoms_w fupsmxs_w fupsrlmx_w fupsrls_w fupsrltn_w fupsrltx_w fupsrlug_w fupsrl_w fupsugs_w pbrimxs_w pbrintmx_w pbrints_w pbrinttn_w pbrinttx_w pbrintug_w pbrintuk_w pbrint_w pbriugs_w rfrints_w rfrint_w rfrires_w rfrirsp_w rfr_w rirints_w rirint_w rir_w rlrints_w rlrint_w rlr_w rri_w rr_w trfrint_w vpabgsr_w wgvum_w /end OUT_MEASUREMENT
 /begin LOC_MEASUREMENT BGPBRINT_CL_akt.pbrintuk BGPBRINT_CL_akt.rfkrbrrx BGPBRINT_CL_akt.rfrintX_w BGPBRINT_CL_akt.rfriresX_w BGPBRINT_CL_akt.rfrirspX_w BGPBRINT_CL_akt.trfrintx BGRFIS_CL_ACTIVE.ririxs_w FILTER_CL_1.msrirspx FILTER_CL_2.msrirspx FILTER_CL_3.msrirspx FILTER_CL_4.msrirspx fkl1_w fkl2_w fpbrpsg_w fpbrpsmx_w fpbrpssb_w fpbrpsug_w fpbrps_w fupsrlro_w FUPSXS_CL_akt.fkl1X_w FUPSXS_CL_akt.fkl2X_w FUPSXS_CL_akt.fpbrX_w FUPSXS_CL_akt.fpbrpsgX_w FUPSXS_CL_akt.fpbrpssbX_w FUPSXS_CL_akt.fpbrpswX_w FUPSXS_CL_akt.fpbrxmX_w FUPSXS_CL_akt.fpbrxugX_w FUPSXS_CL_akt.fupsmX_w FUPSXS_CL_akt.fupsrlroX_w FUPSXS_CL_akt.fupsugX_w FUPSXS_CL_akt.pbrseX_w labbris_w MSAV_CL_akt.fafrspX_w MSAV_CL_akt.msbrkrrX_w MSAV_CL_akt.msrirsprX_w MSAV_CL_akt.pabnavmwX_w MSAV_CL_akt.pbrsaX_w MSAV_CL_akt.rfriresrX_w MSAV_CL_akt.taikrmX_w MSAV_CL_akt.vpabgsrX_w MSAV_CL_akt.vpsrabgX_w MSAV_CL_akt.wgvspumX_w MSAV_CL_akt.wgvumX_w msbrkrr_w msrirspr_w msrirsp_w nmottkor_w pbrsa_w pbrse_w rfkrbrr_w rfrimx_w rfriresr_w rfriug_w vpsrabg_w wgvspum_w wgvums_w /end LOC_MEASUREMENT
 FUNCTION_VERSION "3.6.1" /end FUNCTION
/begin FUNCTION BGMSABG "1.0.0" /begin REF_CHARACTERISTIC ATMSTAR CWATMSTAR /end REF_CHARACTERISTIC /begin IN_MEASUREMENT B_nmin B_sa msfabr_w rkg_w umsrln_w /end IN_MEASUREMENT /begin OUT_MEASUREMENT mlbb_w msabgar_w msabnav_w mskgb_w verhmsb_w /end OUT_MEASUREMENT FUNCTION_VERSION "1.0.0" /end FUNCTION
/begin FUNCTION BGMSDK "10.1.0"
 /begin DEF_CHARACTERISTIC CWBGMSDK DANZSYN DWDKMXWDK FIUWMSDKXN FKVDVP FMSNDKTN FMSNDKTX KFMSNWDKVP KMSDK MSNLLSP OFMSNDKTN OFMSNDKTX TUGDTX VPSRMHVDUG VPSRVDUGD /end DEF_CHARACTERISTIC
 /begin IN_MEASUREMENT nmot_w B_edks B_nmin B_psrgg B_psrmozdg B_psrmozg B_pvdg B_rlp B_syn2fe B_tavdkg dkpsrmh_w fkmsdks_w fkmsdk_w fpvd_w ftavdkmn_w ftavdkmx_w ftvdk_w IdleChrgActr_ratActVal IdleChrgActr_ratActValMax IdleChrgActr_ratActValMin msdkmx_w msdkugd_w msdkugpn_w ofmsndk_w psrgsm_w psrmhmi_w psrmh_w psrmmn_w psrmmx_w psrmp_w pvdmn_w pvdmx_w pvd_w wdkbap_w wdkma_w wdkmi_w wdkpm_w wdkugd_w wdkugtx_w wdk_w /end IN_MEASUREMENT
 /begin OUT_MEASUREMENT B_2synpmX B_dugdtx B_msddkg B_msdkpnxg B_msdpg B_ugd B_ugdtx B_vpdkugd dmsdkugd_w fiuewdk_w fklafa_w ftpavdn_w ftpavdx_w ftpavd_w ftpvd_w msdkosa_w msdkpmn_w msdkpmx_w msdk_w msdp_w msndkoo_w msndk_w msnlls_w ummsnms_w vpsrvdb_w vpsrvdk_w wdkmsmx_w /end OUT_MEASUREMENT
 /begin LOC_MEASUREMENT B_dugdhtx B_pugd B_pugdp DMSDKUGD_CL.dmsdkugdX_w DMSDKUGD_CL.fiuewdkX_w DMSDKUGD_CL.wdkmsmxX_w dmsdkugp_w kmsdk_w MSDKOUE_CL.msdkoueX_w MSDKOUE_CL.msndkX_w MSDKOUE_CL.msndkooX_w MSDKOUE_CL.msnllsX_w MSDKOUE_CL.ummsnmsX_w MSDKOUE_CL.vpsrvdbX_w msdkoue_w msdouep_w msdpmn_w msdpvf_w msdue_w msdvf_w ummsnms1_w ummsnms2_w umsnms1f_w umsnms1n_w umsnms1x_w umsnms2f_w umsnms2n_w umsnms2x_w wdkm_w wdkpmm_w wdktn_w wdktx_w /end LOC_MEASUREMENT
 FUNCTION_VERSION "10.1.0" /end FUNCTION
/begin FUNCTION BGMSDKS "10.1.0"
 /begin IN_MEASUREMENT drlllss_w mste rfzuugpn_w rfzuugtx_w rldkmx_w rldkugd_w umsrln_w /end IN_MEASUREMENT
 /begin OUT_MEASUREMENT msdkmx_w msdkugd_w msdkugpn_w msdkugtx_w msllss_w /end OUT_MEASUREMENT
 FUNCTION_VERSION "10.1.0" /end FUNCTION
/begin FUNCTION BGMSDSS "1.4.0"
 /begin IN_MEASUREMENT B_psrgg B_psrmozdg B_rlrlpzr dpsrfgmp_w fisrm_w mste rlfgdssm_w umsrln_w /end IN_MEASUREMENT
 /begin OUT_MEASUREMENT B_msdkdsg msdkds_w /end OUT_MEASUREMENT
 FUNCTION_VERSION "1.4.0" /end FUNCTION
/begin FUNCTION BGMSHMDK "1.4.1" /begin DEF_CHARACTERISTIC CWBGMSHMDK /end DEF_CHARACTERISTIC /begin IN_MEASUREMENT B_msddkg B_msdkdsg B_rlrlpzr msdkds_w msdk_w /end IN_MEASUREMENT /begin OUT_MEASUREMENT B_mshfmdkg B_mshfmdsg mshfmdk_w mshfmds_w mshfmmod_w /end OUT_MEASUREMENT FUNCTION_VERSION "1.4.1" /end FUNCTION
/begin FUNCTION BGMSIFACE "1.0.2" /begin IN_MEASUREMENT fcoschk msabnav_w mskgb_w oschkm_w tkihkm_w /end IN_MEASUREMENT
 /begin OUT_MEASUREMENT ExhMod_dmExhCat1B1 ExhMod_dmExhS2B1 ExhMod_mO2StrCat1B1 ExhMod_ratO2StrCat1B1 ExhMod_tCat1B1 mabikrs_w mabnavs_w mabnhks_w mabnvks_w mabvhks_w mabvvks_w msabg msabg_w msabikr_w msabnhk_w msabnvk_w msabvhk_w msabvvk_w msaovhk_w msaovvk_w /end OUT_MEASUREMENT
 FUNCTION_VERSION "1.0.2" /end FUNCTION
/begin FUNCTION BGOSC "2.9.1" /begin DEF_CHARACTERISTIC CWBGOSC CWOSCRSC FCOSCHKM FCOSCOP KFOSCHN KFOSCHOP TNSEOSC /end DEF_CHARACTERISTIC /begin IN_MEASUREMENT B_mdkat B_stend msabvhk_w thkmid_w tkihkm_w tnse_w /end IN_MEASUREMENT
 /begin OUT_MEASUREMENT fcoscfk fcoscfmn_w fcoschk fcoschmn_w oschkm_w oschn_w oschop_w /end OUT_MEASUREMENT
 /begin LOC_MEASUREMENT B_measglpl B_scmebb thki_w /end LOC_MEASUREMENT
 FUNCTION_VERSION "2.9.1" /end FUNCTION
/begin FUNCTION BGPABNAV "3.5.0" /begin DEF_CHARACTERISTIC CWPABNAV TFTTAIKR WZFTEMP /end DEF_CHARACTERISTIC /begin IN_MEASUREMENT pabvvk_w puabg_w taikr_w ttaikr_w /end IN_MEASUREMENT /begin OUT_MEASUREMENT fpabnav_w ftaikr_w pabnav_w /end OUT_MEASUREMENT /begin LOC_MEASUREMENT ttaikrs_w /end LOC_MEASUREMENT FUNCTION_VERSION "3.5.0" /end FUNCTION
/begin FUNCTION BGPNDK "1.2.0" /begin DEF_CHARACTERISTIC NPNDKGMN /end DEF_CHARACTERISTIC /begin IN_MEASUREMENT B_psrg nmot_w psr_w /end IN_MEASUREMENT /begin OUT_MEASUREMENT B_pndkg fpndk_w pndk_w /end OUT_MEASUREMENT FUNCTION_VERSION "1.2.0" /end FUNCTION
/begin FUNCTION BGPSMAX "1.11.0" /begin REF_CHARACTERISTIC VPSRVDUGD /end REF_CHARACTERISTIC /begin IN_MEASUREMENT pvdmn_w pvdmx_w pvd_w /end IN_MEASUREMENT /begin OUT_MEASUREMENT psdkugdn_w psdkugdx_w psrdkugd_w /end OUT_MEASUREMENT FUNCTION_VERSION "1.11.0" /end FUNCTION
/begin FUNCTION BGPSR "1.4.0" /begin DEF_CHARACTERISTIC KLTPPSRIFD NPSRSEG NPULSMN SAPSRR /end DEF_CHARACTERISTIC
 /begin IN_MEASUREMENT B_psrmhg B_psrmw B_psrpl B_psrrg nmot_w ofpsr_w psrmh_w psrrldc_w psrr_w /end IN_MEASUREMENT
 /begin OUT_MEASUREMENT B_psrg B_psrg1 B_psrgg B_psrgg1 dpsrg1_w dpsrg_w psr1_w psrg1_w psrgsm_w psrg_w psrrf_w psr_w /end OUT_MEASUREMENT
 /begin LOC_MEASUREMENT fapsrr_w fdpslma_w oafpsrr_w tppsrifd_w /end LOC_MEASUREMENT
 FUNCTION_VERSION "1.4.0" /end FUNCTION
/begin FUNCTION BGPU "1.6.1"
 /begin DEF_CHARACTERISTIC CWBGPU CWDSS FHOMN FHOMX FZPUSA PLFMS PUE PUMN PUMX TDIPUDSS TNSEPUSAFZ VHA VHAVFZG WDKHKDN WDKHKN ZPUN ZPUSA ZPUVL /end DEF_CHARACTERISTIC
 /begin IN_MEASUREMENT B_dkpu B_edks B_ells B_etavdk B_fgabgl B_fkpvdk B_ll B_nmin B_psrgg B_psrrg B_sa B_ugd fkmsdk_w ftu msdk_w nmot psrr_w pvd_w vfzg wdkba /end IN_MEASUREMENT
 /begin OUT_MEASUREMENT B_pug fho fhom_w fho_w frhol_w plfmsdk_w pu pum_w pu_w /end OUT_MEASUREMENT
 /begin LOC_MEASUREMENT B_pua B_pumg B_sz /end LOC_MEASUREMENT
 FUNCTION_VERSION "1.6.1" /end FUNCTION
/begin FUNCTION BGPVD "1.1.0" /begin DEF_CHARACTERISTIC DPTPVDMN DPTPVDMX DPVLFVFZG PVDEMN PVDEMX /end DEF_CHARACTERISTIC /begin IN_MEASUREMENT B_pug plfmsdk_w pur_w pu_w vfzg /end IN_MEASUREMENT /begin OUT_MEASUREMENT B_pvdg fpvd_w pvdmn_w pvdmx_w pvd_w pvlf_w vpvdkpu_w /end OUT_MEASUREMENT FUNCTION_VERSION "1.1.0" /end FUNCTION
/begin FUNCTION BGPVV "1.1.0" /begin IN_MEASUREMENT B_pug plfmsdk_w pu_w /end IN_MEASUREMENT /begin OUT_MEASUREMENT B_pvvg pvv_w /end OUT_MEASUREMENT FUNCTION_VERSION "1.1.0" /end FUNCTION
/begin FUNCTION BGQTITIMN "1.1.2" /begin REF_CHARACTERISTIC TEMN /end REF_CHARACTERISTIC /begin IN_MEASUREMENT evz_austot tez_l /end IN_MEASUREMENT /begin OUT_MEASUREMENT qtitimnh /end OUT_MEASUREMENT FUNCTION_VERSION "1.1.2" /end FUNCTION
/begin FUNCTION BGRL "5.1.0" /begin DEF_CHARACTERISTIC CWBGRL /end DEF_CHARACTERISTIC
 /begin IN_MEASUREMENT B_dkpiu B_psrgg B_rlrlpzr dpsrfgmh_w dpsrfgmp_w msdkds_w psrfgmh_w psrfgmp_w psrg_w psrmh_w rfdsorgi_w rflmorgi_w rir_w rlfgds_w rlfglm_w rlr_w umsrln_w /end IN_MEASUREMENT
 /begin OUT_MEASUREMENT B_dsshfs B_fedkapb B_fedkb B_fedkoab B_fedssb B_feete B_ferlnotb B_hfmhfs B_msdkhfsg dpsrfg_w drl_w ml ml_w msdkhfs_w msfabr_w psrfg_w psrrl_w rfges_w rforgi_w rl rlfg_w rl_w /end OUT_MEASUREMENT
 FUNCTION_VERSION "5.1.0" /end FUNCTION
/begin FUNCTION BGRL2SV "2.2.0" /begin IN_MEASUREMENT nmot rlmxvl_w rl_w /end IN_MEASUREMENT /begin OUT_MEASUREMENT rlabs_w rlmxsoe_w rml /end OUT_MEASUREMENT FUNCTION_VERSION "2.2.0" /end FUNCTION
/begin FUNCTION BGRLFG "1.7.0"
 /begin DEF_CHARACTERISTIC FPSPULSMN FPSPULSMX FPVMXST PSREMN PSREMX TNMNSRMDK VHUBZYL VPPSRMSM VPPSRMSMHY VSAUGROHR ZKORFKISRM /end DEF_CHARACTERISTIC
 /begin REF_CHARACTERISTIC MSNTEVO /end REF_CHARACTERISTIC
 /begin IN_MEASUREMENT B_dugdtx B_msddkg B_msdkpnxg B_nmin B_nmot B_psrgg B_pug B_rlrlpzr B_stend B_tahevg B_ugdtx dpsrg_w ftsr_w fupsrltn_w fupsrltx_w fupsrl_w msdkpmn_w msdkpmx_w nmot_w pbrinttn_w pbrinttx_w pbrint_w psrgsm_w psrg_w pu_w pvdmn_w pvdmx_w pvd_w rlfgroh_w umsrln_w /end IN_MEASUREMENT
 /begin OUT_MEASUREMENT B_psrmhg B_psrmnxg B_psrmozdg B_psrmozg dpsrfgmh_w dpsrfgmp_w fisrm_w fkisrm_w psrfgmh_w psrfgmp_w psrmgx_w psrmhmi_w psrmh_w psrmmn_w psrmmx_w rfdsorgi_w rfdsorim_w rflmorgi_w rlfgdssm_w rlfgds_w rlfglm_w vsaugr_w /end OUT_MEASUREMENT
 /begin LOC_MEASUREMENT pbrintc_w PSRMH_2SYN_CL.dpsrfgmh_w PSRMH_2SYN_CL.dpsrmh_w PSRMH_2SYN_CL.psrfgmh_w PSRMH_2SYN_CL.psrmh_w PSRMH_2SYN_CL.psrmhmi_w PSRMH_2SYN_CL.rlfsrbrh_w PSRMH_2SYN_CL.INT_PSRX_CL.dpsrmX_w PSRMH_2SYN_CL.INT_PSRX_CL.psrmXneu_w PSRMMN_2SYN_CL.psrmX_w PSRMMN_2SYN_CL.rfasrX_w PSRMMN_2SYN_CL.rfzsrX_w PSRMMX_2SYN_CL.psrmX_w PSRMMX_2SYN_CL.rfasrX_w PSRMMX_2SYN_CL.rfzsrX_w /end LOC_MEASUREMENT
 FUNCTION_VERSION "1.7.0" /end FUNCTION
/begin FUNCTION BGRLFGZS "2.12.0" /begin DEF_CHARACTERISTIC KUMSIRL RLNOT /end DEF_CHARACTERISTIC /begin IN_MEASUREMENT B_dkpiu msdk_w mste nmot nmot_w /end IN_MEASUREMENT
 /begin OUT_MEASUREMENT B_dmsvvdpg B_mszsdkb B_rlrlpzr dmsvvdp_w msdkalm_w rlfdkroh_w rlfgroh_w umsrln_w /end OUT_MEASUREMENT
 /begin LOC_MEASUREMENT rlnotn_w /end LOC_MEASUREMENT
 FUNCTION_VERSION "2.12.0" /end FUNCTION
/begin FUNCTION BGRLG "1.1.0" /begin IN_MEASUREMENT nmot_w rl_w /end IN_MEASUREMENT /begin OUT_MEASUREMENT drlas_w rlgas_w tas_w /end OUT_MEASUREMENT /begin LOC_MEASUREMENT nmotalt_w rlaltas_w /end LOC_MEASUREMENT FUNCTION_VERSION "1.1.0" /end FUNCTION
/begin FUNCTION BGRLMIN "1.6.0"
 /begin DEF_CHARACTERISTIC BFZGRLNBKV FRLMNPU FRLMNTMOT NMOTRLNBKV RLMNN RLMNSABKV RLMNSAN RLMNSATRN RLMNTRN TDRLNBKV /end DEF_CHARACTERISTIC
 /begin IN_MEASUREMENT B_fcotr B_sa nmot_w pu_w rltedte_w tmot vfzg_w /end IN_MEASUREMENT
 /begin OUT_MEASUREMENT rlfgmnho_w rlminhom_w rlmin_w /end OUT_MEASUREMENT
 /begin LOC_MEASUREMENT bfzgbkv_w B_bfzgbkv frlmntp_w rlmnsa_w rlmn_w /end LOC_MEASUREMENT
 FUNCTION_VERSION "1.6.0" /end FUNCTION
/begin FUNCTION BGRLMXS "10.0.0" /begin DEF_CHARACTERISTIC RVBRVL /end DEF_CHARACTERISTIC /begin IN_MEASUREMENT fho_w ftahevmx_w nmot /end IN_MEASUREMENT /begin OUT_MEASUREMENT rlmxvl_w /end OUT_MEASUREMENT FUNCTION_VERSION "10.0.0" /end FUNCTION
/begin FUNCTION BGRLP "1.11.1" /begin DEF_CHARACTERISTIC DPLMDK DRLRLPMAX DRLRLPU FGDPSMPDVS FPVMXP TDRLRLPMAX /end DEF_CHARACTERISTIC /begin REF_CHARACTERISTIC CWBGRLP /end REF_CHARACTERISTIC
 /begin IN_MEASUREMENT B_fedssb B_rlp B_rlrlpzr dpsrfgmh_w dpsrfg_w fisrm_w fupsrl_w fwprs_w msdp_w pbrint_w psrmh_w psr_w pvd_w rlfdkroh_w rlfg_w rl_w umsrln_w /end IN_MEASUREMENT
 /begin OUT_MEASUREMENT B_syn2fe drlp_w psrmp_w rlp rlp_w /end OUT_MEASUREMENT
 /begin LOC_MEASUREMENT B_psrmpb dpsfdhfb_w dpsrfdhf_w dpsrfgk_w dpsrfmp_w dpsrpps_w gdrlprlctr psrpmx_w rlfgmp_w rlpnb_w rlpu_w rlrohmp_w /end LOC_MEASUREMENT
 FUNCTION_VERSION "1.11.1" /end FUNCTION
/begin FUNCTION BGRLSOL "10.0.0"
 /begin IN_MEASUREMENT fupsrlmx_w fupsrltx_w fupsrlug_w pbrintmx_w pbrinttn_w pbrintug_w psdkugdn_w psdkugdx_w psrdkugd_w pvd_w /end IN_MEASUREMENT
 /begin OUT_MEASUREMENT rfzuugpn_w rfzuugtx_w rldkmx_w rldkugd_w /end OUT_MEASUREMENT
 /begin LOC_MEASUREMENT rforidmx_w rforidug_w /end LOC_MEASUREMENT
 FUNCTION_VERSION "10.0.0" /end FUNCTION
/begin FUNCTION BGTABSTAD "1.2.0" /begin IN_MEASUREMENT B_nmot B_stend tengslst tengsq1_w /end IN_MEASUREMENT /begin OUT_MEASUREMENT B_abstgp B_abstnlgp B_abstnpl tabst_w /end OUT_MEASUREMENT
 /begin LOC_MEASUREMENT B_abstinvd B_enrtabst B_stteslck B_tabstpd dtengstabs tengsold_w tengsstold /end LOC_MEASUREMENT
 FUNCTION_VERSION "1.2.0" /end FUNCTION
/begin FUNCTION BGTASR "1.2.0" /begin DEF_CHARACTERISTIC CWBGTASR /end DEF_CHARACTERISTIC /begin IN_MEASUREMENT B_tasrgg B_tasrmg tasrg_w tasrm_w /end IN_MEASUREMENT /begin OUT_MEASUREMENT B_tasrg tasr_w /end OUT_MEASUREMENT FUNCTION_VERSION "1.2.0" /end FUNCTION
/begin FUNCTION BGTASRM "1.5.0" /begin DEF_CHARACTERISTIC TASRMEW ZTMMBR /end DEF_CHARACTERISTIC /begin IN_MEASUREMENT B_eepwf tavdk_w tmotk_w /end IN_MEASUREMENT /begin OUT_MEASUREMENT B_tasrmg tadk_w tasrm_w twvev_w /end OUT_MEASUREMENT /begin LOC_MEASUREMENT tmotfilk_w /end LOC_MEASUREMENT FUNCTION_VERSION "1.5.0" /end FUNCTION
/begin FUNCTION BGTAVDK "1.2.0" /begin DEF_CHARACTERISTIC DTAVDKMX /end DEF_CHARACTERISTIC /begin IN_MEASUREMENT B_tavdkmg tavdkm_w /end IN_MEASUREMENT
 /begin OUT_MEASUREMENT B_tavdkg B_tavdkg2 tavdk2_w tavdkmn2_w tavdkmn_w tavdkmx2_w tavdkmx_w tavdk_w /end OUT_MEASUREMENT
 FUNCTION_VERSION "1.2.0" /end FUNCTION
/begin FUNCTION BGTAVDKM "1.1.0" /begin DEF_CHARACTERISTIC TAVDKMEW /end DEF_CHARACTERISTIC /begin IN_MEASUREMENT B_tasrgg tasrg_w /end IN_MEASUREMENT /begin OUT_MEASUREMENT B_tavdkmg tavdkm_w /end OUT_MEASUREMENT FUNCTION_VERSION "1.1.0" /end FUNCTION
/begin FUNCTION BGTCW "1.6.0"
 /begin DEF_CHARACTERISTIC CWBGTCW FABSTT FTMEW KFDTMTE1S TADMM TMDMMA TMDMMEE TMDMMES TMOTABINI TMOTLTT TMSTINIT /end DEF_CHARACTERISTIC
 /begin IN_MEASUREMENT B_eepwf B_engrot B_tengsr B_tmotgg ml tengslst tengs_w tfa1linf tmotlinf /end IN_MEASUREMENT
 /begin OUT_MEASUREMENT B_tcwrepl B_tmabclnl B_tmabzgg B_tmotabgg B_tmstgg B_tmstzgg mll1 tmew tmmodkorrf tmot tmotab tmotabz tmotlinst tmotlinstz tmst tmstz /end OUT_MEASUREMENT
 /begin LOC_MEASUREMENT B_replst B_tmstz CT_bTengsrSet ktmewini tmotvt /end LOC_MEASUREMENT
 FUNCTION_VERSION "1.6.0" /end FUNCTION
/begin FUNCTION BGTECUOFF "3.1.0" /begin IN_MEASUREMENT tecuomlst tecuom_l /end IN_MEASUREMENT /begin OUT_MEASUREMENT tecuolst tecuo_l /end OUT_MEASUREMENT FUNCTION_VERSION "3.1.0" /end FUNCTION
/begin FUNCTION BGTECUOFFM "2.0.0"
 /begin DEF_CHARACTERISTIC DTTUTMECUO LNXQTMM TECUOMDEF TECUOMMNEX TECUOMMXEX TECUOMSDEF TENGOMMX ZKTABTUM /end DEF_CHARACTERISTIC
 /begin IN_MEASUREMENT B_tengsi B_tengsr B_tmotgg B_tmstzgg B_tumgg tengsi_l tmotabz tmstz tumg /end IN_MEASUREMENT
 /begin OUT_MEASUREMENT tecuomlst tecuom_l /end OUT_MEASUREMENT
 /begin LOC_MEASUREMENT B_tmabzlk tecuomwt_w tengom_l xqtmm_w /end LOC_MEASUREMENT
 FUNCTION_VERSION "2.0.0" /end FUNCTION
/begin FUNCTION BGTENGS "1.1.0" /begin IN_MEASUREMENT B_tengsi B_tengsr B_tengszfn tecuolst tecuo_l tengsi_l /end IN_MEASUREMENT
 /begin OUT_MEASUREMENT tengslst tengsq1z_w tengsq1_w tengszlst tengsz_l tengsz_w tengs_l tengs_w /end OUT_MEASUREMENT
 /begin LOC_MEASUREMENT tecuolclst tecuolc_l /end LOC_MEASUREMENT
 FUNCTION_VERSION "1.1.0" /end FUNCTION
/begin FUNCTION BGTENGSZS "1.1.0" /begin DEF_CHARACTERISTIC TBNMOTDEB /end DEF_CHARACTERISTIC /begin IN_MEASUREMENT B_eepwf B_engrestr B_nmot /end IN_MEASUREMENT
 /begin OUT_MEASUREMENT B_dldclst B_engrot B_tengsi B_tengsr B_tengsri B_tengszfn tengsi_l /end OUT_MEASUREMENT
 /begin LOC_MEASUREMENT B_tengsfr B_tengsnbr B_tengsrir /end LOC_MEASUREMENT
 FUNCTION_VERSION "1.1.0" /end FUNCTION
/begin FUNCTION BGTFA1 "1.0.0" /begin DEF_CHARACTERISTIC TFA1RP /end DEF_CHARACTERISTIC /begin OUT_MEASUREMENT tfa1m_w /end OUT_MEASUREMENT FUNCTION_VERSION "1.0.0" /end FUNCTION
/begin FUNCTION BGTMPK "6.0.0"
 /begin DEF_CHARACTERISTIC CWBGTMPK DTEVS FTVDKTAVDK KFDTR KFDTZ KFFWLKFTBR KFWTBR KLFEXPSL NWKEV TDTEVATI TEVSMX TMOTWRMK ZBRT /end DEF_CHARACTERISTIC
 /begin IN_MEASUREMENT anztib_w B_tasrg B_tmotgg nmot_w psr_w tadk_w tasr_w tavdkmn_w tavdkmx_w tavdk_w tmot tmotk_w tmst toch twvev_w /end IN_MEASUREMENT
 /begin OUT_MEASUREMENT B_tahevg ftahevmx_w ftahev_w ftavdkmn_w ftavdkmx_w ftsr_w ftu ftvdk_w quotntke_w taev_w tahev_w tev_w /end OUT_MEASUREMENT
 /begin LOC_MEASUREMENT dtahevdy_w ftw_w tahevkor_w tmotdifk /end LOC_MEASUREMENT
 FUNCTION_VERSION "6.0.0" /end FUNCTION
/begin FUNCTION BGTOCH "1.2.0" /begin DEF_CHARACTERISTIC FTOCHLWIN KFTOCHLW TTOCHLWTD TTOCHLWTP /end DEF_CHARACTERISTIC /begin IN_MEASUREMENT B_nmot B_tospg ml nmot tmot tosp /end IN_MEASUREMENT /begin OUT_MEASUREMENT B_tochg toch /end OUT_MEASUREMENT /begin LOC_MEASUREMENT B_tochlow ftochlw ftochwu tochlw /end LOC_MEASUREMENT FUNCTION_VERSION "1.2.0" /end FUNCTION
/begin FUNCTION BGTOSP "1.1.0" /begin IN_MEASUREMENT B_tengsi B_tengsr B_tospmg tospm /end IN_MEASUREMENT /begin OUT_MEASUREMENT B_tospabg B_tospabgg B_tospg B_tospgg tosp tospab /end OUT_MEASUREMENT FUNCTION_VERSION "1.1.0" /end FUNCTION
/begin FUNCTION BGTOSPM "1.4.0"
 /begin DEF_CHARACTERISTIC CWTOSPM KFTOSPMVML KFTOSPMWC KLTOSPM_N KLTOSPM_TU KLTSWITCH KLTTOSPM1 KLTTOSPM2 SWTMOT SWTOSPM TOSPMQD TOSPMQDS TOSPMQWS TOSPMTWS TOSPREPL TOSPREPLI TTOSPMVLD /end DEF_CHARACTERISTIC
 /begin IN_MEASUREMENT B_engrot B_nmin B_sa B_tengsi B_tengsr B_tmotgg ml_w nmot tmot tumg vfzg /end IN_MEASUREMENT
 /begin OUT_MEASUREMENT B_tospmefr B_tospmg tospm tospmab_w tospmq /end OUT_MEASUREMENT
 /begin LOC_MEASUREMENT B_tospmadi B_tospmres B_tospmwst B_tosptmab tospmbm_w tospmloc_w tospmnf_w tospmr_w tospmst tospmstab tospmtdr_w tosptmab ttospmr ttospmrsw /end LOC_MEASUREMENT
 FUNCTION_VERSION "1.4.0" /end FUNCTION
/begin FUNCTION BGTPABG "1.13.0"
 /begin DEF_CHARACTERISTIC ACREWFSO ACREWHSO ACREWVSO ATMABKA ATMABKF ATMABKK CWRTPE CWTPE CWTPEBAST CWTPETWAB FWMABGW FWMFKW FWMKATW FWMZAPWF FWMZFPWF FWMZKPWF KFWMABG KFWMFK KFWMKAT KLKIWMA KLKIWMFK KLKIWMK KLWMKHFOEX KLWMKHHOEX KLWMKHVOEX KLWMKKHFSO KLWMKKHHSO KLWMKKHVSO NRKTPATU NRKTPFTU NRKTPKTU NRKTPKTUS STF10TMUW STH10TMUW STMS10TMUB STN10TMUB STS06TMUW STV10TMUW TABSTABMX TAFSOMN TAHSOMN TALLOWOST TATMRTPA TATMRTPFK TATMRTPK TATMSTI TAVSOMN TOFDMSMNSA TUMGTPEBU TWTPEAPFSO TWTPEAPHSO TWTPEAPVSO /end DEF_CHARACTERISTIC
 /begin IN_MEASUREMENT B_eepwf B_gtumg B_kh B_khakt B_kl15 B_nachl B_sa B_stend B_stendz B_trkonz mabikrs_w mabnhks_w mabnvks_w ml_w msabikr_w msabnhk_w msabnvk_w nmot_w rkg_w tafso_w tahso_w tanskst_w tavso_w tengslst tengs_l tmst tumgk_w twfso_w twhso_w twvso_w /end IN_MEASUREMENT
 /begin OUT_MEASUREMENT atmabkfso atmabkhso atmabkvso B_atmst B_atmtpa B_atmtpal B_atmtpfk B_atmtpfl B_atmtpk B_atmtpkl B_stndnl imlatm imlatmz_w imlatm_w iwmatmf_l iwmatmf_w iwmatmk_l iwmatmk_w iwmatm_l iwmatm_w tafsoab_w tafsost_w tahsoab_w tahsost_w tavsoab_w tavsost_w zwmatma zwmatmf zwmatmk /end OUT_MEASUREMENT
 /begin LOC_MEASUREMENT B_atmrtpa B_atmrtpf B_atmrtpk B_iwresa B_iwresf B_iwresk B_iwseta B_iwsetf B_iwsetk B_lctpepwf B_msmntpa B_msmntpf B_msmntpk B_rsiwmf B_rsiwmk B_rttumg B_stt50ms B_tofstrdl B_tofstrdp B_upssttab iwmsf_l iwmsk_l iwmsv_l nrkatm_w tabstcor_w tabstlc_w tafsoak_w tahsoak_w tavsoak_w testk15o_w tmsttpe tumgktpe_w twfsool_w twhsool_w twvsool_w /end LOC_MEASUREMENT
 FUNCTION_VERSION "1.13.0" /end FUNCTION
/begin FUNCTION BGTUMG "3.5.0"
 /begin DEF_CHARACTERISTIC CWKONGTU CWKONGTU3 DTMTATUM DTUMDRLPMN DTUMDRLPMX IMLTUMAMN IMLTUMAMX KFDTUMTAV KLIMLTUMA KLMLNMOTMX MLTUMLIM MLTUMTA SF_TUM TABMNTUM TDGTUMG TMMXTUM TMOTICTRMN TTUMMICTR TUMMTANSMN TUMMTANSMX TUMMTMOTMN TUMMTMOTMX TUMTAI TVTUMTO VTUMTA ZFMODTUM /end DEF_CHARACTERISTIC
 /begin IN_MEASUREMENT B_eepwf B_nmot B_sa B_tmsrt drlp_w ml nmot tabst_w tans tmot tmst vfzg /end IN_MEASUREMENT
 /begin OUT_MEASUREMENT B_gtumg B_trigcomp B_tumgg B_tummg B_tumnpl s1fl2p46 tum tumg tumgk_w tumm tumti2 /end OUT_MEASUREMENT
 /begin LOC_MEASUREMENT B_penmlint B_tumkst B_tummictr imltumlm_w imltum_w tatrigst ttummoffst tummictr tumtmp /end LOC_MEASUREMENT
 FUNCTION_VERSION "3.5.0" /end FUNCTION
/begin FUNCTION BGWDKM "10.0.0" /begin DEF_CHARACTERISTIC DWDKPU DWDKUDAS TDKPV /end DEF_CHARACTERISTIC /begin IN_MEASUREMENT dwdkba_w wdkba_w /end IN_MEASUREMENT /begin OUT_MEASUREMENT wdkbap_w /end OUT_MEASUREMENT /begin LOC_MEASUREMENT B_wdkp ddwdkba_w /end LOC_MEASUREMENT FUNCTION_VERSION "10.0.0" /end FUNCTION
/begin FUNCTION BGWGWV "1.5.0" /begin DEF_CHARACTERISTIC DWOGVA DWOGVE WGVAS WGVEO /end DEF_CHARACTERISTIC /begin IN_MEASUREMENT tnst_w /end IN_MEASUREMENT
 /begin OUT_MEASUREMENT wgvoma_w wgvome_w wgvosa_w wgvose_w wgvsma_w wgvsme_w wgvssa_w wgvsse_w /end OUT_MEASUREMENT
 FUNCTION_VERSION "1.5.0" /end FUNCTION
/begin COMPU_METHOD bfzg_q0p1085069 "" RAT_FUNC "%6.3" "m/s^2" COEFFS 0 31248000 0 0 0 3390625 /end COMPU_METHOD
/begin COMPU_METHOD B_TRUE "" TAB_VERB "%6.3" "" COMPU_TAB_REF B_TRUE /end COMPU_METHOD
/begin COMPU_VTAB B_TRUE "" TAB_VERB 2 0 "----" 1 "TRUE" /end COMPU_VTAB
/begin COMPU_METHOD dez "" RAT_FUNC "%6.2" "" COEFFS 0 1 0 0 0 1 /end COMPU_METHOD
/begin COMPU_METHOD dfp_verbal "" TAB_VERB "%2.1" "-" COMPU_TAB_REF dfp_verbal /end COMPU_METHOD
/begin COMPU_VTAB dfp_verbal "" TAB_VERB 87 0 "DFP_AAA" 1 "DFP_BM" 2 "DFP_DK" 3 "DFP_DKVS" 4 "DFP_DSS" 5 "DFP_DVEV" 6 "DFP_DYLSU" 7 "DFP_DZKU0" 8 "DFP_DZKU1" 9 "DFP_DZKU2" 10 "DFP_EGFE" 11 "DFP_ENWS" 12 "DFP_ENWSE" 13 "DFP_EV1" 14 "DFP_EV2" 15 "DFP_EV3" 16 "DFP_FMAS" 17 "DFP_FP1P" 18 "DFP_FP2P" 19 "DFP_FRA" 20 "DFP_FRAU" 21 "DFP_FTDLA" 22 "DFP_HELSU" 23 "DFP_HRE" 24 "DFP_HSH" 25 "DFP_HSHE" 26 "DFP_HSV" 27 "DFP_HSVE" 28 "DFP_HSVSA" 29 "DFP_ICLSU" 30 "DFP_KAT" 31 "DFP_KATF" 32 "DFP_KPE" 33 "DFP_KRNT" 34 "DFP_KROF" 35 "DFP_KRTP" 36 "DFP_KUPPL" 37 "DFP_LASH" 38 "DFP_LLR" 39 "DFP_LLRKH" 40 "DFP_LM" 41 "DFP_LSH" 42 "DFP_LSUKS" 43 "DFP_LSUUN" 44 "DFP_LSV" 45 "DFP_LUES1E" 46 "DFP_LZSR" 47 "DFP_MD" 48 "DFP_N" 49 "DFP_NWKW" 50 "DFP_NWKWE" 51 "DFP_ORA" 52 "DFP_PH" 53 "DFP_PHE" 54 "DFP_PLLSU" 55 "DFP_PS1E" 56 "DFP_PS2E" 57 "DFP_PS3E" 58 "DFP_PSR" 59 "DFP_PSR1" 60 "DFP_PSRB" 61 "DFP_PSRE" 62 "DFP_PSRP" 63 "DFP_PVD" 64 "DFP_RKAT" 65 "DFP_RKAZ" 66 "DFP_STKLSV" 67 "DFP_TA" 68 "DFP_TACS" 69 "DFP_TAR" 70 "DFP_TASR" 71 "DFP_TASRE" 72 "DFP_TES" 73 "DFP_TEVE" 74 "DFP_THM" 75 "DFP_TM" 76 "DFP_TMCS" 77 "DFP_TME" 78 "DFP_TMKI" 79 "DFP_TMP" 80 "DFP_TUM" 81 "DFP_UB" 82 "DFP_UBR" 83 "DFP_ULSU" 84 "DFP_VFZ" 85 "DFP_VFZG" 86 "DFP_ZZZ" DEFAULT_VALUE "---" /end COMPU_VTAB
/begin COMPU_METHOD DIABAS_AVSSTD_SY_Compu "" RAT_FUNC "%6.2" "" COEFFS 0 1 0 0 0 1 /end COMPU_METHOD
/begin COMPU_METHOD DIABAS_AVSTST_SY_Compu "" TAB_VERB "%6.3" "" COMPU_TAB_REF DIABAS_AVSTST_SY_Compu /end COMPU_METHOD
/begin COMPU_VTAB DIABAS_AVSTST_SY_Compu "" TAB_VERB 2 1 "TRUE" 0 "FALSE" /end COMPU_VTAB
/begin COMPU_METHOD DIABAS_AVS_SY_Compu "" TAB_VERB "%6.3" "" COMPU_TAB_REF DIABAS_AVS_SY_Compu /end COMPU_METHOD
/begin COMPU_VTAB DIABAS_AVS_SY_Compu "" TAB_VERB 2 0 "False" 1 "True" /end COMPU_VTAB
/begin COMPU_METHOD DIABAS_CRCTAB_SY_Compu "" TAB_VERB "%6.3" "" COMPU_TAB_REF DIABAS_CRCTAB_SY_Compu /end COMPU_METHOD
/begin COMPU_VTAB DIABAS_CRCTAB_SY_Compu "" TAB_VERB 2 0 "False" 1 "True" /end COMPU_VTAB
/begin COMPU_METHOD DIABAS_ETCTST_SY_Compu "" TAB_VERB "%6.3" "" COMPU_TAB_REF DIABAS_ETCTST_SY_Compu /end COMPU_METHOD
/begin COMPU_VTAB DIABAS_ETCTST_SY_Compu "" TAB_VERB 2 0 "FALSE" 1 "TRUE" /end COMPU_VTAB
/begin COMPU_METHOD DIABAS_I15031TST_SY_Compu "" TAB_VERB "%6.3" "" COMPU_TAB_REF DIABAS_I15031TST_SY_Compu /end COMPU_METHOD
/begin COMPU_VTAB DIABAS_I15031TST_SY_Compu "" TAB_VERB 2 0 "FALSE" 1 "TRUE" /end COMPU_VTAB
/begin COMPU_METHOD DIABAS_NODIAP_SY_Compu "" TAB_VERB "%6.3" "" COMPU_TAB_REF DIABAS_NODIAP_SY_Compu /end COMPU_METHOD
/begin COMPU_VTAB DIABAS_NODIAP_SY_Compu "" TAB_VERB 2 0 "False" 1 "True" /end COMPU_VTAB
/begin COMPU_METHOD DIABAS_SCRCTL_RCNT_RESET_SY_Compu "" TAB_VERB "%6.3" "" COMPU_TAB_REF DIABAS_SCRCTL_RCNT_RESET_SY_Compu /end COMPU_METHOD
/begin COMPU_VTAB DIABAS_SCRCTL_RCNT_RESET_SY_Compu "" TAB_VERB 2 0 "False" 1 "True" /end COMPU_VTAB
/begin COMPU_METHOD DIABAS_SIGNALSTST_SY_Compu "" TAB_VERB "%6.3" "" COMPU_TAB_REF DIABAS_SIGNALSTST_SY_Compu /end COMPU_METHOD
/begin COMPU_VTAB DIABAS_SIGNALSTST_SY_Compu "" TAB_VERB 2 0 "FALSE" 1 "TRUE" /end COMPU_VTAB
/begin COMPU_METHOD DIABAS_VAR_SY_Compu "" TAB_VERB "%6.3" "" COMPU_TAB_REF DIABAS_VAR_SY_Compu /end COMPU_METHOD
/begin COMPU_VTAB DIABAS_VAR_SY_Compu "" TAB_VERB 32 1 "DAI" 3 "VWW" 5 "AUD" 22 "FOR" 147 "HYU" 999 "ALL" 214 "AVT" 9 "FIA" 21 "GMU" 159 "HON" 160 "MAZ" 123 "MIT" 20 "NIS" 14 "PSA" 4 "POR" 15 "REN" 248 "SUZ" 308 "TAT" 72 "TOY" 6 "OPE" 19 "VOL" 55 "ROL" 18 "SAB" 69 "FER" 51 "SEA" 204 "VVW" 17 "ALF" 289 "AMG" 11 "BMW" 183 "CU" 385 "UAES" 243 "DMC" /end COMPU_VTAB
/begin COMPU_METHOD DIACPV_SY_Compu "" TAB_VERB "%6.3" "" COMPU_TAB_REF DIACPV_SY_Compu /end COMPU_METHOD
/begin COMPU_VTAB DIACPV_SY_Compu "" TAB_VERB 8 1 "01 only %DTEV-based incl. passive check" 11 "11 only tank presure sensor based" 12 "12 tank pressure sensor based + add on %DTEV" 21 "21 only based on DMTL-pump" 2 "02 %DTEV-based without passive check" 0 "No CPV diagnosis" 16 "CPV-check with DTESP" 22 "CPV-check with DMTL or DTEV-based" /end COMPU_VTAB
/begin COMPU_METHOD DIAGCOM_BOOTPART_SY_Compu "" TAB_VERB "%6.3" "" COMPU_TAB_REF DIAGCOM_BOOTPART_SY_Compu /end COMPU_METHOD
/begin COMPU_VTAB DIAGCOM_BOOTPART_SY_Compu "" TAB_VERB 2 0 "False" 1 "True" /end COMPU_VTAB
/begin COMPU_METHOD DIAGCOM_RDPI_SY_Compu "" TAB_VERB "%6.3" "" COMPU_TAB_REF DIAGCOM_RDPI_SY_Compu /end COMPU_METHOD
/begin COMPU_VTAB DIAGCOM_RDPI_SY_Compu "" TAB_VERB 2 0 "0" 1 "1" /end COMPU_VTAB
/begin COMPU_METHOD DIAGCOM_RESPONEVT_SY_Compu "" TAB_VERB "%6.3" "" COMPU_TAB_REF DIAGCOM_RESPONEVT_SY_Compu /end COMPU_METHOD
/begin COMPU_VTAB DIAGCOM_RESPONEVT_SY_Compu "" TAB_VERB 2 0 "FALSE" 1 "TRUE" /end COMPU_VTAB
/begin COMPU_METHOD DIAGCOM_RINGBUF_SY_Compu "" TAB_VERB "%6.3" "" COMPU_TAB_REF DIAGCOM_RINGBUF_SY_Compu /end COMPU_METHOD
/begin COMPU_VTAB DIAGCOM_RINGBUF_SY_Compu "" TAB_VERB 2 0 "False" 1 "True" /end COMPU_VTAB
/begin COMPU_METHOD DIAGSRV_LTCV_SY_Compu "" TAB_VERB "%6.3" "" COMPU_TAB_REF DIAGSRV_LTCV_SY_Compu /end COMPU_METHOD
/begin COMPU_VTAB DIAGSRV_LTCV_SY_Compu "" TAB_VERB 2 0 "False" 1 "True" /end COMPU_VTAB
/begin COMPU_METHOD DIAG_SVRPTCOL_SY_Compu "" TAB_VERB "%6.3" "" COMPU_TAB_REF DIAG_SVRPTCOL_SY_Compu /end COMPU_METHOD
/begin COMPU_VTAB DIAG_SVRPTCOL_SY_Compu "" TAB_VERB 2 1 "DIAG_KWP2000" 0 "DIAG_UDS" /end COMPU_VTAB
/begin COMPU_METHOD DIBOX_SY_Compu "" TAB_VERB "%6.3" "" COMPU_TAB_REF DIBOX_SY_Compu /end COMPU_METHOD
/begin COMPU_VTAB DIBOX_SY_Compu "" TAB_VERB 2 0 "False" 1 "True" /end COMPU_VTAB
/begin COMPU_METHOD DIFFPRT_SY_Compu "" TAB_VERB "%6.3" "" COMPU_TAB_REF DIFFPRT_SY_Compu /end COMPU_METHOD
/begin COMPU_VTAB DIFFPRT_SY_Compu "" TAB_VERB 2 1 "TRUE" 0 "FALSE" /end COMPU_VTAB
/begin COMPU_METHOD DINH_MONINHBCNT_SC_Compu "" RAT_FUNC "%6.2" "" COEFFS 0 1 0 0 0 1 /end COMPU_METHOD
/begin COMPU_METHOD DIPO_SY_Compu "" TAB_VERB "%6.3" "" COMPU_TAB_REF DIPO_SY_Compu /end COMPU_METHOD
/begin COMPU_VTAB DIPO_SY_Compu "" TAB_VERB 2 1 "1" 0 "0" /end COMPU_VTAB
/begin COMPU_METHOD DISTAB_SY_Compu "" TAB_VERB "%6.3" "" COMPU_TAB_REF DISTAB_SY_Compu /end COMPU_METHOD
/begin COMPU_VTAB DISTAB_SY_Compu "" TAB_VERB 2 1 "Distab" 0 "No Distab" /end COMPU_VTAB
/begin COMPU_METHOD DIUMPR_500MD_SY_Compu "" TAB_VERB "%6.3" "" COMPU_TAB_REF DIUMPR_500MD_SY_Compu /end COMPU_METHOD
/begin COMPU_VTAB DIUMPR_500MD_SY_Compu "" TAB_VERB 2 0 "0" 1 "1" /end COMPU_VTAB
/begin COMPU_METHOD DIUMPR_EVAPDEN_SY_Compu "" TAB_VERB "%6.3" "" COMPU_TAB_REF DIUMPR_EVAPDEN_SY_Compu /end COMPU_METHOD
/begin COMPU_VTAB DIUMPR_EVAPDEN_SY_Compu "" TAB_VERB 2 0 "False" 1 "True" /end COMPU_VTAB
/begin COMPU_METHOD DIUMPR_NUMDENOMIDXGRP_SY_Compu "" TAB_VERB "%6.3" "" COMPU_TAB_REF DIUMPR_NUMDENOMIDXGRP_SY_Compu /end COMPU_METHOD
/begin COMPU_VTAB DIUMPR_NUMDENOMIDXGRP_SY_Compu "" TAB_VERB 2 0 "False" 1 "True" /end COMPU_VTAB
/begin COMPU_METHOD DKVSTDFC_SC_Compu "" TAB_VERB "%6.3" "" COMPU_TAB_REF DKVSTDFC_SC_Compu /end COMPU_METHOD
/begin COMPU_VTAB DKVSTDFC_SC_Compu "" TAB_VERB 2 0 "False" 1 "True" /end COMPU_VTAB
/begin COMPU_METHOD DLSASV06_SY_Compu "" TAB_VERB "%6.3" "" COMPU_TAB_REF DLSASV06_SY_Compu /end COMPU_METHOD
/begin COMPU_VTAB DLSASV06_SY_Compu "" TAB_VERB 2 0 "DLSASV06_SY==0" 1 "DLSASV06_SY==1" /end COMPU_VTAB
/begin COMPU_METHOD DOGOVENA_SY_Compu "" TAB_VERB "%6.3" "" COMPU_TAB_REF DOGOVENA_SY_Compu /end COMPU_METHOD
/begin COMPU_VTAB DOGOVENA_SY_Compu "" TAB_VERB 2 1 "TRUE" 0 "FALSE" /end COMPU_VTAB
/begin COMPU_METHOD DOGOVTYP_SY_Compu "" TAB_VERB "%6.3" "" COMPU_TAB_REF DOGOVTYP_SY_Compu /end COMPU_METHOD
/begin COMPU_VTAB DOGOVTYP_SY_Compu "" TAB_VERB 5 0 "0" 1 "1" 2 "2" 3 "3" 4 "4" /end COMPU_VTAB
/begin COMPU_METHOD DOGOV_SY_Compu "" TAB_VERB "%6.3" "" COMPU_TAB_REF DOGOV_SY_Compu /end COMPU_METHOD
/begin COMPU_VTAB DOGOV_SY_Compu "" TAB_VERB 2 0 "False" 1 "True" /end COMPU_VTAB
/begin COMPU_METHOD DRCTSTRT_SY_Compu "" TAB_VERB "%6.3" "" COMPU_TAB_REF DRCTSTRT_SY_Compu /end COMPU_METHOD
/begin COMPU_VTAB DRCTSTRT_SY_Compu "" TAB_VERB 3 0 "DRCTSTRT_DISBL" 1 "DRCTSTRT_STASUPRT" 2 "DRCTSTRT_NOSTASUPRT" /end COMPU_VTAB
/begin COMPU_METHOD DRVPRGLMP_HWSEL_SY_Compu "" TAB_VERB "%6.3" "" COMPU_TAB_REF DRVPRGLMP_HWSEL_SY_Compu /end COMPU_METHOD
/begin COMPU_VTAB DRVPRGLMP_HWSEL_SY_Compu "" TAB_VERB 2 0 "False" 1 "True" /end COMPU_VTAB
/begin COMPU_METHOD DRVPRGSWT_NUMWNTR_Compu "" RAT_FUNC "%6.2" "" COEFFS 0 1 0 0 0 1 /end COMPU_METHOD
/begin COMPU_METHOD DSCHED_COEOM_SY_Compu "" TAB_VERB "%6.3" "" COMPU_TAB_REF DSCHED_COEOM_SY_Compu /end COMPU_METHOD
/begin COMPU_VTAB DSCHED_COEOM_SY_Compu "" TAB_VERB 2 0 "False" 1 "True" /end COMPU_VTAB
/begin COMPU_METHOD DSCHED_FIDMAXPRIOLST_SY_Compu "" RAT_FUNC "%6.2" "" COEFFS 0 1 0 0 0 1 /end COMPU_METHOD
/begin COMPU_METHOD DSCHED_FTI_SY_Compu "" TAB_VERB "%6.3" "" COMPU_TAB_REF DSCHED_FTI_SY_Compu /end COMPU_METHOD
/begin COMPU_VTAB DSCHED_FTI_SY_Compu "" TAB_VERB 2 0 "DSCHED_FTI_DISBL" 1 "DSCHED_FTI_ENA" /end COMPU_VTAB
/begin COMPU_METHOD DSCHED_PRIOACTVJMP_SY_Compu "" TAB_VERB "%6.3" "" COMPU_TAB_REF DSCHED_PRIOACTVJMP_SY_Compu /end COMPU_METHOD
/begin COMPU_VTAB DSCHED_PRIOACTVJMP_SY_Compu "" TAB_VERB 2 0 "DSCHED_PRIOACTVJMP_DISBL" 1 "DSCHED_PRIOACTVJMP_ENA" /end COMPU_VTAB
/begin COMPU_METHOD DSCHED_PRIODFCSTLDF_SY_Compu "" TAB_VERB "%6.3" "" COMPU_TAB_REF DSCHED_PRIODFCSTLDF_SY_Compu /end COMPU_METHOD
/begin COMPU_VTAB DSCHED_PRIODFCSTLDF_SY_Compu "" TAB_VERB 3 0 "DSCHED_DFCSTLDF_DISBL" 1 "DSCHED_DFCSTLDF_ENA_UNIF" 2 "DSCHED_DFCSTLDF_ENA_INDIV" /end COMPU_VTAB
/begin COMPU_METHOD DSCHED_PRIODFCSTTST_SY_Compu "" TAB_VERB "%6.3" "" COMPU_TAB_REF DSCHED_PRIODFCSTTST_SY_Compu /end COMPU_METHOD
/begin COMPU_VTAB DSCHED_PRIODFCSTTST_SY_Compu "" TAB_VERB 3 0 "DSCHED_DFCSTTST_DISBL" 1 "DSCHED_DFCSTTST_ENA_UNIF" 2 "DSCHED_DFCSTTST_ENA_INDIV" /end COMPU_VTAB
/begin COMPU_METHOD DSCHED_PRIOPHYSURGENCY_SY_Compu "" TAB_VERB "%6.3" "" COMPU_TAB_REF DSCHED_PRIOPHYSURGENCY_SY_Compu /end COMPU_METHOD
/begin COMPU_VTAB DSCHED_PRIOPHYSURGENCY_SY_Compu "" TAB_VERB 2 0 "DSCHED_PHYSURGENCY_DISBL" 1 "DSCHED_PHYSURGENCY_ENA" /end COMPU_VTAB
/begin COMPU_METHOD DSCHED_PRIORMPCALC_SY_Compu "" TAB_VERB "%6.3" "" COMPU_TAB_REF DSCHED_PRIORMPCALC_SY_Compu /end COMPU_METHOD
/begin COMPU_VTAB DSCHED_PRIORMPCALC_SY_Compu "" TAB_VERB 2 0 "DSCHED_PRIORMPCALC_DISBL" 1 "DSCHED_PRIORMPCALC_ENA" /end COMPU_VTAB
/begin COMPU_METHOD DSCHED_RATECALC_SY_Compu "" TAB_VERB "%6.3" "" COMPU_TAB_REF DSCHED_RATECALC_SY_Compu /end COMPU_METHOD
/begin COMPU_VTAB DSCHED_RATECALC_SY_Compu "" TAB_VERB 2 1 "DSCHED_RATECALC_ENA" 0 "DSCHED_RATECALC_DISBL" /end COMPU_VTAB
/begin COMPU_METHOD DSCHED_WTT_SY_Compu "" TAB_VERB "%6.3" "" COMPU_TAB_REF DSCHED_WTT_SY_Compu /end COMPU_METHOD
/begin COMPU_VTAB DSCHED_WTT_SY_Compu "" TAB_VERB 2 1 "DSCHED_WTT_ENA" 0 "DSCHED_WTT_DISBL" /end COMPU_VTAB
/begin COMPU_METHOD DSM2AUTOSAR_SC_Compu "" TAB_VERB "%6.3" "" COMPU_TAB_REF DSM2AUTOSAR_SC_Compu /end COMPU_METHOD
/begin COMPU_VTAB DSM2AUTOSAR_SC_Compu "" TAB_VERB 2 0 "False" 1 "True" /end COMPU_VTAB
/begin COMPU_METHOD DSM2SG_ASCETINF_SC_Compu "" TAB_VERB "%6.3" "" COMPU_TAB_REF DSM2SG_ASCETINF_SC_Compu /end COMPU_METHOD
/begin COMPU_VTAB DSM2SG_ASCETINF_SC_Compu "" TAB_VERB 2 0 "False" 1 "True" /end COMPU_VTAB
/begin COMPU_METHOD DSM2SG_DFC_SY_Compu "" TAB_VERB "%6.3" "" COMPU_TAB_REF DSM2SG_DFC_SY_Compu /end COMPU_METHOD
/begin COMPU_VTAB DSM2SG_DFC_SY_Compu "" TAB_VERB 2 0 "False" 1 "True" /end COMPU_VTAB
/begin COMPU_METHOD DSM2SG_DSQ_SY_Compu "" TAB_VERB "%6.3" "" COMPU_TAB_REF DSM2SG_DSQ_SY_Compu /end COMPU_METHOD
/begin COMPU_VTAB DSM2SG_DSQ_SY_Compu "" TAB_VERB 2 0 "False" 1 "True" /end COMPU_VTAB
/begin COMPU_METHOD DSM2SG_FID_SY_Compu "" TAB_VERB "%6.3" "" COMPU_TAB_REF DSM2SG_FID_SY_Compu /end COMPU_METHOD
/begin COMPU_VTAB DSM2SG_FID_SY_Compu "" TAB_VERB 2 0 "False" 1 "True" /end COMPU_VTAB
/begin COMPU_METHOD DSMAUX_TCSORT_SY_Compu "" TAB_VERB "%6.3" "" COMPU_TAB_REF DSMAUX_TCSORT_SY_Compu /end COMPU_METHOD
/begin COMPU_VTAB DSMAUX_TCSORT_SY_Compu "" TAB_VERB 2 0 "TCSORT_disabled" 1 "TCSORT_enabled" /end COMPU_VTAB
/begin COMPU_METHOD DSMBAS_VAR_SY_Compu "" TAB_VERB "%6.3" "" COMPU_TAB_REF DSMBAS_VAR_SY_Compu /end COMPU_METHOD
/begin COMPU_VTAB DSMBAS_VAR_SY_Compu "" TAB_VERB 32 1 "DAI" 3 "VWW" 5 "AUD" 22 "FOR" 147 "HYU" 999 "ALL" 214 "AVT" 9 "FIA" 21 "GMU" 159 "HON" 160 "MAZ" 123 "MIT" 20 "NIS" 14 "PSA" 4 "POR" 15 "REN" 248 "SUZ" 308 "TAT" 72 "TOY" 6 "OPE" 19 "VOL" 55 "ROL" 18 "SAB" 69 "FER" 51 "SEA" 204 "VVW" 17 "ALF" 289 "AMG" 11 "BMW" 183 "CU" 385 "UAES" 243 "DMC" /end COMPU_VTAB
/begin COMPU_METHOD DSMBDEP_SY_Compu "" TAB_VERB "%6.3" "" COMPU_TAB_REF DSMBDEP_SY_Compu /end COMPU_METHOD
/begin COMPU_VTAB DSMBDEP_SY_Compu "" TAB_VERB 2 0 "False" 1 "True" /end COMPU_VTAB
/begin COMPU_METHOD DSMDUR_MIL_GLB_SY_Compu "" TAB_VERB "%6.3" "" COMPU_TAB_REF DSMDUR_MIL_GLB_SY_Compu /end COMPU_METHOD
/begin COMPU_VTAB DSMDUR_MIL_GLB_SY_Compu "" TAB_VERB 2 0 "FALSE" 1 "TRUE" /end COMPU_VTAB
/begin COMPU_METHOD DSMRDY_ENGSPEC_SY_Compu "" TAB_VERB "%6.3" "" COMPU_TAB_REF DSMRDY_ENGSPEC_SY_Compu /end COMPU_METHOD
/begin COMPU_VTAB DSMRDY_ENGSPEC_SY_Compu "" TAB_VERB 2 1 "TRUE" 0 "FALSE" /end COMPU_VTAB
/begin COMPU_METHOD DSMRDY_INHP41_SY_Compu "" RAT_FUNC "%6.2" "" COEFFS 0 1 0 0 0 1 /end COMPU_METHOD
/begin COMPU_METHOD DSMRDY_SUPPID41_SY_Compu "" TAB_VERB "%6.3" "" COMPU_TAB_REF DSMRDY_SUPPID41_SY_Compu /end COMPU_METHOD
/begin COMPU_VTAB DSMRDY_SUPPID41_SY_Compu "" TAB_VERB 2 1 "TRUE" 0 "FALSE" /end COMPU_VTAB
/begin COMPU_METHOD DSMRDY_VERS_SC_Compu "" TAB_VERB "%6.3" "" COMPU_TAB_REF DSMRDY_VERS_SC_Compu /end COMPU_METHOD
/begin COMPU_VTAB DSMRDY_VERS_SC_Compu "" TAB_VERB 2 0 "DSMRDY_PRE_2009" 1 "DSMRDY_2009" /end COMPU_VTAB
/begin COMPU_METHOD DSM_CONF_READONLY_DINH_SY_Compu "" TAB_VERB "%6.3" "" COMPU_TAB_REF DSM_CONF_READONLY_DINH_SY_Compu /end COMPU_METHOD
/begin COMPU_VTAB DSM_CONF_READONLY_DINH_SY_Compu "" TAB_VERB 2 0 "read-write" 1 "readonly" /end COMPU_VTAB
/begin COMPU_METHOD DSM_CONF_READONLY_EXCLU_SY_Compu "" TAB_VERB "%6.3" "" COMPU_TAB_REF DSM_CONF_READONLY_EXCLU_SY_Compu /end COMPU_METHOD
/begin COMPU_VTAB DSM_CONF_READONLY_EXCLU_SY_Compu "" TAB_VERB 2 0 "read-write" 1 "readonly" /end COMPU_VTAB
/begin COMPU_METHOD DSM_DISBLGRPSIZE_SY_Compu "" RAT_FUNC "%6.2" "" COEFFS 0 1 0 0 0 1 /end COMPU_METHOD
/begin COMPU_METHOD DSM_DSM2SG_SY_Compu "" TAB_VERB "%6.3" "" COMPU_TAB_REF DSM_DSM2SG_SY_Compu /end COMPU_METHOD
/begin COMPU_VTAB DSM_DSM2SG_SY_Compu "" TAB_VERB 2 0 "False" 1 "True" /end COMPU_VTAB
/begin COMPU_METHOD DSM_FAILCNT_SY_Compu "" TAB_VERB "%6.3" "" COMPU_TAB_REF DSM_FAILCNT_SY_Compu /end COMPU_METHOD
/begin COMPU_VTAB DSM_FAILCNT_SY_Compu "" TAB_VERB 2 0 "False" 1 "True" /end COMPU_VTAB
/begin COMPU_METHOD DSM_FAULTSEQ_SY_Compu "" TAB_VERB "%6.3" "" COMPU_TAB_REF DSM_FAULTSEQ_SY_Compu /end COMPU_METHOD
/begin COMPU_VTAB DSM_FAULTSEQ_SY_Compu "" TAB_VERB 2 0 "False" 1 "True" /end COMPU_VTAB
/begin COMPU_METHOD DSM_HDOBD_SY_Compu "" TAB_VERB "%6.3" "" COMPU_TAB_REF DSM_HDOBD_SY_Compu /end COMPU_METHOD
/begin COMPU_VTAB DSM_HDOBD_SY_Compu "" TAB_VERB 2 0 "False" 1 "True" /end COMPU_VTAB
/begin COMPU_METHOD DSM_INHRLS_SY_Compu "" TAB_VERB "%6.3" "" COMPU_TAB_REF DSM_INHRLS_SY_Compu /end COMPU_METHOD
/begin COMPU_VTAB DSM_INHRLS_SY_Compu "" TAB_VERB 2 0 "0" 1 "1" /end COMPU_VTAB
/begin COMPU_METHOD DSM_MDOBD_SY_Compu "" TAB_VERB "%6.3" "" COMPU_TAB_REF DSM_MDOBD_SY_Compu /end COMPU_METHOD
/begin COMPU_VTAB DSM_MDOBD_SY_Compu "" TAB_VERB 2 0 "False" 1 "True" /end COMPU_VTAB
/begin COMPU_METHOD DSM_PDTCTSTRA_SY_Compu "" TAB_VERB "%6.3" "" COMPU_TAB_REF DSM_PDTCTSTRA_SY_Compu /end COMPU_METHOD
/begin COMPU_VTAB DSM_PDTCTSTRA_SY_Compu "" TAB_VERB 2 0 "DISABLED" 1 "ENABLED" /end COMPU_VTAB
/begin COMPU_METHOD DSM_STDCONF_DSMRDY_SY_Compu "" TAB_VERB "%6.3" "" COMPU_TAB_REF DSM_STDCONF_DSMRDY_SY_Compu /end COMPU_METHOD
/begin COMPU_VTAB DSM_STDCONF_DSMRDY_SY_Compu "" TAB_VERB 2 0 "False" 1 "True" /end COMPU_VTAB
/begin COMPU_METHOD DSM_WUCDET_SY_Compu "" TAB_VERB "%6.3" "" COMPU_TAB_REF DSM_WUCDET_SY_Compu /end COMPU_METHOD
/begin COMPU_VTAB DSM_WUCDET_SY_Compu "" TAB_VERB 3 0 "0" 1 "1" 2 "2" /end COMPU_VTAB
/begin COMPU_METHOD DSM_XDI_ENA_SC_Compu "" TAB_VERB "%6.3" "" COMPU_TAB_REF DSM_XDI_ENA_SC_Compu /end COMPU_METHOD
/begin COMPU_VTAB DSM_XDI_ENA_SC_Compu "" TAB_VERB 2 0 "False" 1 "True" /end COMPU_VTAB
/begin COMPU_METHOD DSS_SY_Compu "" TAB_VERB "%6.3" "" COMPU_TAB_REF DSS_SY_Compu /end COMPU_METHOD
/begin COMPU_VTAB DSS_SY_Compu "" TAB_VERB 2 0 "False" 1 "True" /end COMPU_VTAB
/begin COMPU_METHOD Dst "" RAT_FUNC "%6.1" "km" COEFFS 0 0.04 0 0 0 1 /end COMPU_METHOD
/begin COMPU_METHOD Dst1 "" RAT_FUNC "%6.0" "km" COEFFS 0 0.002 0 0 0 1 /end COMPU_METHOD
/begin COMPU_METHOD DTEVAP_SC_Compu "" TAB_VERB "%6.3" "" COMPU_TAB_REF DTEVAP_SC_Compu /end COMPU_METHOD
/begin COMPU_VTAB DTEVAP_SC_Compu "" TAB_VERB 2 0 "False" 1 "True" /end COMPU_VTAB
/begin COMPU_METHOD dTrq "" RAT_FUNC "%6.3" "Nm/s" COEFFS 0 10 0 0 0 1 /end COMPU_METHOD
/begin COMPU_METHOD dTrqPrpHigh_20ms "" RAT_FUNC "%6.2" "Nm/s" COEFFS 0 0.2 0 0 0 1 /end COMPU_METHOD
/begin COMPU_METHOD DTR_LEGIFC_SY_Compu "" TAB_VERB "%6.3" "" COMPU_TAB_REF DTR_LEGIFC_SY_Compu /end COMPU_METHOD
/begin COMPU_VTAB DTR_LEGIFC_SY_Compu "" TAB_VERB 2 0 "DISABLED" 1 "ENABLED" /end COMPU_VTAB
/begin COMPU_METHOD DtTemp_KPerSec_q0p01_COMPU "" RAT_FUNC "%6.4" "K/s" COEFFS 0 100 0 0 0 1 /end COMPU_METHOD
/begin COMPU_METHOD ECLTYP_SY_Compu "" TAB_VERB "%6.3" "" COMPU_TAB_REF ECLTYP_SY_Compu /end COMPU_METHOD
/begin COMPU_VTAB ECLTYP_SY_Compu "" TAB_VERB 3 0 "ECLTYP_NOCLTH" 1 "ECLTYP_IMPCLTH" 2 "ECLTYP_PROPCLTH" /end COMPU_VTAB
/begin COMPU_METHOD ECUIDECL_SY_Compu "" TAB_VERB "%6.3" "" COMPU_TAB_REF ECUIDECL_SY_Compu /end COMPU_METHOD
/begin COMPU_VTAB ECUIDECL_SY_Compu "" TAB_VERB 2 0 "NO_ECUIDECL_AVAIL" 1 "ECUIDECL_AVAIL" /end COMPU_VTAB
/begin COMPU_METHOD ECUNUM_SY_Compu "" TAB_VERB "%6.3" "" COMPU_TAB_REF ECUNUM_SY_Compu /end COMPU_METHOD
/begin COMPU_VTAB ECUNUM_SY_Compu "" TAB_VERB 3 1 "ECUNUM_1" 2 "ECUNUM_2" 3 "ECUNUM_3" /end COMPU_VTAB
/begin COMPU_METHOD ECUOFF_TMR_SY_Compu "" TAB_VERB "%6.3" "" COMPU_TAB_REF ECUOFF_TMR_SY_Compu /end COMPU_METHOD
/begin COMPU_VTAB ECUOFF_TMR_SY_Compu "" TAB_VERB 4 2 "2" 1 "1" 0 "0" 3 "3" /end COMPU_VTAB
/begin COMPU_METHOD ECU_GENR_SY_Compu "" TAB_VERB "%6.3" "" COMPU_TAB_REF ECU_GENR_SY_Compu /end COMPU_METHOD
/begin COMPU_VTAB ECU_GENR_SY_Compu "" TAB_VERB 5 0 "Mx7" 1 "Mx9" 2 "Mx17" 3 "EDC17" 4 "VMx17" /end COMPU_VTAB
/begin COMPU_METHOD ECU_TRICORE_SY_Compu "" TAB_VERB "%6.3" "" COMPU_TAB_REF ECU_TRICORE_SY_Compu /end COMPU_METHOD
/begin COMPU_VTAB ECU_TRICORE_SY_Compu "" TAB_VERB 19 9 "TC1797" 11 "TC1736F80" 13 "TC1793F200" 4 "TC1792" 6 "TC1764" 2 "TC1766" 18 "TC1712" 14 "TC1793F260" 16 "TC1728F40" 7 "TC1796F180" 8 "TC1767" 15 "TC1782" 1 "TC1796" 5 "TC1762" 10 "TC1736F40" 17 "TC1728F80" 3 "TC1782M" 0 "no_TriCore" 12 "TC1732" /end COMPU_VTAB
/begin COMPU_METHOD EECR_BLDPRC_SY_Compu "" TAB_VERB "%6.3" "" COMPU_TAB_REF EECR_BLDPRC_SY_Compu /end COMPU_METHOD
/begin COMPU_VTAB EECR_BLDPRC_SY_Compu "" TAB_VERB 8 0 "NO_ENCRYPT" 1 "TS3_WFS4" 2 "TS3_WFS5" 3 "TS4_WFS4" 4 "TS4_WFS5" 5 "TS4_WFS4UDS" 6 "TS4_WFS4TC17x7" 7 "TS4_WFS5TC17x7" /end COMPU_VTAB
/begin COMPU_METHOD EEOT_SY_Compu "" TAB_VERB "%6.3" "" COMPU_TAB_REF EEOT_SY_Compu /end COMPU_METHOD
/begin COMPU_VTAB EEOT_SY_Compu "" TAB_VERB 3 0 "0" 1 "PCA8565" 2 "ESC151" /end COMPU_VTAB
/begin COMPU_METHOD EEPKRA_SY_Compu "" TAB_VERB "%6.3" "" COMPU_TAB_REF EEPKRA_SY_Compu /end COMPU_METHOD
/begin COMPU_VTAB EEPKRA_SY_Compu "" TAB_VERB 2 0 "False" 1 "True" /end COMPU_VTAB
/begin COMPU_METHOD EGRVLVLP_TYPAVL_SY_Compu "" TAB_VERB "%6.3" "" COMPU_TAB_REF EGRVLVLP_TYPAVL_SY_Compu /end COMPU_METHOD
/begin COMPU_VTAB EGRVLVLP_TYPAVL_SY_Compu "" TAB_VERB 2 0 "FALSE" 1 "TRUE" /end COMPU_VTAB
/begin COMPU_METHOD EGRVLV_TYPAVL_SY_Compu "" TAB_VERB "%6.3" "" COMPU_TAB_REF EGRVLV_TYPAVL_SY_Compu /end COMPU_METHOD
/begin COMPU_VTAB EGRVLV_TYPAVL_SY_Compu "" TAB_VERB 2 0 "FALSE" 1 "TRUE" /end COMPU_VTAB
/begin COMPU_METHOD EGR_SY_Compu "" TAB_VERB "%6.3" "" COMPU_TAB_REF EGR_SY_Compu /end COMPU_METHOD
/begin COMPU_VTAB EGR_SY_Compu "" TAB_VERB 2 0 "False" 1 "True" /end COMPU_VTAB
/begin COMPU_METHOD EngN_HiRes "" RAT_FUNC "%6.4" "rpm" COEFFS 0 32 0 0 0 1 /end COMPU_METHOD
/begin COMPU_METHOD ENGOPMODE_SY_Compu "" TAB_VERB "%6.3" "" COMPU_TAB_REF ENGOPMODE_SY_Compu /end COMPU_METHOD
/begin COMPU_VTAB ENGOPMODE_SY_Compu "" TAB_VERB 2 0 "False" 1 "True" /end COMPU_VTAB
/begin COMPU_METHOD ENGRESTRT_SY_Compu "" TAB_VERB "%6.3" "" COMPU_TAB_REF ENGRESTRT_SY_Compu /end COMPU_METHOD
/begin COMPU_VTAB ENGRESTRT_SY_Compu "" TAB_VERB 2 0 "False" 1 "True" /end COMPU_VTAB
/begin COMPU_METHOD ENGSPD_LIMSTRT_SY_Compu "" TAB_VERB "%6.3" "" COMPU_TAB_REF ENGSPD_LIMSTRT_SY_Compu /end COMPU_METHOD
/begin COMPU_VTAB ENGSPD_LIMSTRT_SY_Compu "" TAB_VERB 2 0 "0" 1 "1" /end COMPU_VTAB
/begin COMPU_METHOD ENGSPD_SWTENA_SY_Compu "" TAB_VERB "%6.3" "" COMPU_TAB_REF ENGSPD_SWTENA_SY_Compu /end COMPU_METHOD
/begin COMPU_VTAB ENGSPD_SWTENA_SY_Compu "" TAB_VERB 2 0 "FALSE" 1 "TRUE" /end COMPU_VTAB
/begin COMPU_METHOD EnrgPerMass "" RAT_FUNC "%6.3" "MJ/Kg" COEFFS 0 10 0 0 0 1 /end COMPU_METHOD
/begin COMPU_METHOD Enrg_Wh_COMPU "" RAT_FUNC "%6.2" "Wh" COEFFS 0 1 0 0 0 1 /end COMPU_METHOD
/begin COMPU_METHOD EPMHWE_RTM_SY_Compu "" TAB_VERB "%6.3" "" COMPU_TAB_REF EPMHWE_RTM_SY_Compu /end COMPU_METHOD
/begin COMPU_VTAB EPMHWE_RTM_SY_Compu "" TAB_VERB 2 0 "NO_RTM" 1 "RTM" /end COMPU_VTAB
/begin COMPU_METHOD EPMHWE_SWTCPU_SY_Compu "" TAB_VERB "%6.3" "" COMPU_TAB_REF EPMHWE_SWTCPU_SY_Compu /end COMPU_METHOD
/begin COMPU_VTAB EPMHWE_SWTCPU_SY_Compu "" TAB_VERB 2 0 "PCP" 1 "CPU" /end COMPU_VTAB
/begin COMPU_METHOD EpmNPT "" RAT_FUNC "%6.2" "rpm/s" COEFFS 0 1 0 0 0 1 /end COMPU_METHOD
/begin COMPU_METHOD EPMRRS_SY_Compu "" TAB_VERB "%6.3" "" COMPU_TAB_REF EPMRRS_SY_Compu /end COMPU_METHOD
/begin COMPU_VTAB EPMRRS_SY_Compu "" TAB_VERB 3 0 "NO_RRS" 1 "REV" 2 "REV_STOP" /end COMPU_VTAB
/begin COMPU_METHOD EPMRVSROTYMETH_SY_Compu "" TAB_VERB "%6.3" "" COMPU_TAB_REF EPMRVSROTYMETH_SY_Compu /end COMPU_METHOD
/begin COMPU_VTAB EPMRVSROTYMETH_SY_Compu "" TAB_VERB 2 0 "TOOTHPERD" 1 "PLSTI" /end COMPU_VTAB
/begin COMPU_METHOD EPM_ATS_SY_Compu "" TAB_VERB "%6.3" "" COMPU_TAB_REF EPM_ATS_SY_Compu /end COMPU_METHOD
/begin COMPU_VTAB EPM_ATS_SY_Compu "" TAB_VERB 2 0 "NO_ACCESS" 1 "ACCESS" /end COMPU_VTAB
/begin COMPU_METHOD EPM_DIAGSPC_SY_Compu "" TAB_VERB "%6.3" "" COMPU_TAB_REF EPM_DIAGSPC_SY_Compu /end COMPU_METHOD
/begin COMPU_VTAB EPM_DIAGSPC_SY_Compu "" TAB_VERB 4 0 "NOSPC" 1 "SPCCRS" 2 "SPCCAS" 3 "SPCCRSCAS" /end COMPU_VTAB
/begin COMPU_METHOD EPM_GTCRED_SY_Compu "" TAB_VERB "%6.3" "" COMPU_TAB_REF EPM_GTCRED_SY_Compu /end COMPU_METHOD
/begin COMPU_VTAB EPM_GTCRED_SY_Compu "" TAB_VERB 2 0 "TWO_GTC_CAS" 1 "ONE_GTC_CAS" /end COMPU_VTAB
/begin COMPU_METHOD EPM_KEEPDGISYNC_SC_Compu "" TAB_VERB "%6.3" "" COMPU_TAB_REF EPM_KEEPDGISYNC_SC_Compu /end COMPU_METHOD
/begin COMPU_VTAB EPM_KEEPDGISYNC_SC_Compu "" TAB_VERB 2 0 "STD" 1 "KEEPDGISYNC" /end COMPU_VTAB
/begin COMPU_METHOD EPM_MEASURE_SY_Compu "" TAB_VERB "%6.3" "" COMPU_TAB_REF EPM_MEASURE_SY_Compu /end COMPU_METHOD
/begin COMPU_VTAB EPM_MEASURE_SY_Compu "" TAB_VERB 3 0 "NO_MP" 2 "RAW_AG_TEST_MP" 1 "TEST_MP" /end COMPU_VTAB
/begin COMPU_METHOD EPM_SPD_CALC_SY_Compu "" TAB_VERB "%6.3" "" COMPU_TAB_REF EPM_SPD_CALC_SY_Compu /end COMPU_METHOD
/begin COMPU_VTAB EPM_SPD_CALC_SY_Compu "" TAB_VERB 2 0 "SPD_IN_IGNEDGE" 1 "SPD_IN_WAITGAP" /end COMPU_VTAB
/begin COMPU_METHOD EPM_SWTSRV_SY_Compu "" RAT_FUNC "%6.2" "" COEFFS 0 1 0 0 0 1 /end COMPU_METHOD
/begin COMPU_METHOD EPM_SYNCSLV_SY_Compu "" TAB_VERB "%6.3" "" COMPU_TAB_REF EPM_SYNCSLV_SY_Compu /end COMPU_METHOD
/begin COMPU_VTAB EPM_SYNCSLV_SY_Compu "" TAB_VERB 2 0 "NO_SLV_SYNC" 1 "SLV_VIA_CAN_SYNC" /end COMPU_VTAB
/begin COMPU_METHOD EPM_TDCDSTCLB_SC_Compu "" TAB_VERB "%6.3" "" COMPU_TAB_REF EPM_TDCDSTCLB_SC_Compu /end COMPU_METHOD
/begin COMPU_VTAB EPM_TDCDSTCLB_SC_Compu "" TAB_VERB 2 0 "STANDARD" 1 "ARRAY" /end COMPU_VTAB
/begin COMPU_METHOD EPM_TIMING_SY_Compu "" TAB_VERB "%6.3" "" COMPU_TAB_REF EPM_TIMING_SY_Compu /end COMPU_METHOD
/begin COMPU_VTAB EPM_TIMING_SY_Compu "" TAB_VERB 3 0 "STD" 1 "HE_ONEBOX" 2 "RC_MASLV" /end COMPU_VTAB
/begin COMPU_METHOD EPM_VAR_SY_Compu "" TAB_VERB "%6.3" "" COMPU_TAB_REF EPM_VAR_SY_Compu /end COMPU_METHOD
/begin COMPU_VTAB EPM_VAR_SY_Compu "" TAB_VERB 32 1 "DAI" 3 "VWW" 5 "AUD" 22 "FOR" 147 "HYU" 999 "ALL" 214 "AVT" 9 "FIA" 21 "GMU" 159 "HON" 160 "MAZ" 123 "MIT" 20 "NIS" 14 "PSA" 4 "POR" 15 "REN" 248 "SUZ" 308 "TAT" 72 "TOY" 6 "OPE" 19 "VOL" 55 "ROL" 18 "SAB" 69 "FER" 51 "SEA" 204 "VVW" 17 "ALF" 289 "AMG" 11 "BMW" 183 "CU" 385 "UAES" 243 "DMC" /end COMPU_VTAB
/begin COMPU_METHOD ERRLMP_CUST_SY_Compu "" TAB_VERB "%6.3" "" COMPU_TAB_REF ERRLMP_CUST_SY_Compu /end COMPU_METHOD
/begin COMPU_VTAB ERRLMP_CUST_SY_Compu "" TAB_VERB 4 0 "ERRLMP_RB" 1 "ERRLMP_VAG" 3 "ERRLMP_DAcom" 2 "ERRLMP_BMW" /end COMPU_VTAB
/begin COMPU_METHOD ERRREACHPINJVLVSTK_SY_Compu "" TAB_VERB "%6.3" "" COMPU_TAB_REF ERRREACHPINJVLVSTK_SY_Compu /end COMPU_METHOD
/begin COMPU_VTAB ERRREACHPINJVLVSTK_SY_Compu "" TAB_VERB 2 0 "FALSE" 1 "TRUE" /end COMPU_VTAB
/begin COMPU_METHOD ESNSAD_INHCUST_SY_Compu "" TAB_VERB "%6.3" "" COMPU_TAB_REF ESNSAD_INHCUST_SY_Compu /end COMPU_METHOD
/begin COMPU_VTAB ESNSAD_INHCUST_SY_Compu "" TAB_VERB 2 0 "False" 1 "True" /end COMPU_VTAB
/begin COMPU_METHOD Eta "" RAT_FUNC "%6.4" "Nm/(mg/cyc)" COEFFS 0 128 0 0 0 1 /end COMPU_METHOD
/begin COMPU_METHOD Eta1 "" RAT_FUNC "%6.4" "-" COEFFS 0 128 0 0 0 1 /end COMPU_METHOD
/begin COMPU_METHOD Eta2 "" RAT_FUNC "%6.4" "" COEFFS 0 128 0 0 0 1 /end COMPU_METHOD
/begin COMPU_METHOD ETC_Act_SY_Compu "" TAB_VERB "%6.3" "" COMPU_TAB_REF ETC_Act_SY_Compu /end COMPU_METHOD
/begin COMPU_VTAB ETC_Act_SY_Compu "" TAB_VERB 2 0 "False" 1 "True" /end COMPU_VTAB
/begin COMPU_METHOD ETKS_SY_Compu "" TAB_VERB "%6.3" "" COMPU_TAB_REF ETKS_SY_Compu /end COMPU_METHOD
/begin COMPU_VTAB ETKS_SY_Compu "" TAB_VERB 2 0 "No ETKS" 1 "ETKS" /end COMPU_VTAB
/begin COMPU_METHOD EulerNum "" RAT_FUNC "%6.3" "-" COEFFS 0 10 0 0 0 1 /end COMPU_METHOD
/begin COMPU_METHOD EVTYP_SY_Compu "" TAB_VERB "%6.3" "" COMPU_TAB_REF EVTYP_SY_Compu /end COMPU_METHOD
/begin COMPU_VTAB EVTYP_SY_Compu "" TAB_VERB 2 0 "NOEV" 1 "EV" /end COMPU_VTAB
/begin COMPU_METHOD EXHBNKNUM_SY_Compu "" RAT_FUNC "%6.2" "" COEFFS 0 1 0 0 0 1 /end COMPU_METHOD
/begin COMPU_METHOD EXHMOD_NRCATB1_SC_Compu "" RAT_FUNC "%6.2" "" COEFFS 0 1 0 0 0 1 /end COMPU_METHOD
/begin COMPU_METHOD EXHMOD_NRCATB2_SC_Compu "" RAT_FUNC "%6.2" "" COEFFS 0 1 0 0 0 1 /end COMPU_METHOD
/begin COMPU_METHOD EXHMOD_NRCATUSS2B1_SC_Compu "" RAT_FUNC "%6.2" "" COEFFS 0 1 0 0 0 1 /end COMPU_METHOD
/begin COMPU_METHOD EXHMOD_VAR_SY_Compu "" TAB_VERB "%6.3" "" COMPU_TAB_REF EXHMOD_VAR_SY_Compu /end COMPU_METHOD
/begin COMPU_VTAB EXHMOD_VAR_SY_Compu "" TAB_VERB 32 1 "DAI" 3 "VWW" 5 "AUD" 22 "FOR" 147 "HYU" 999 "ALL" 214 "AVT" 9 "FIA" 21 "GMU" 159 "HON" 160 "MAZ" 123 "MIT" 20 "NIS" 14 "PSA" 4 "POR" 15 "REN" 248 "SUZ" 308 "TAT" 72 "TOY" 6 "OPE" 19 "VOL" 55 "ROL" 18 "SAB" 69 "FER" 51 "SEA" 204 "VVW" 17 "ALF" 289 "AMG" 11 "BMW" 183 "CU" 385 "UAES" 243 "DMC" /end COMPU_VTAB
/begin COMPU_METHOD EXH_NUM_TFLDSIZE_SY_Compu "" RAT_FUNC "%6.2" "" COEFFS 0 1 0 0 0 1 /end COMPU_METHOD
/begin COMPU_METHOD Fact100 "" RAT_FUNC "%6.4" "-" COEFFS 0 100 0 0 0 1 /end COMPU_METHOD
/begin COMPU_METHOD Fact1000 "" RAT_FUNC "%6.5" "-" COEFFS 0 1000 0 0 0 1 /end COMPU_METHOD
/begin COMPU_METHOD Fact256 "" RAT_FUNC "%6.4" "-" COEFFS 0 256 0 0 0 1 /end COMPU_METHOD
/begin COMPU_METHOD Fact6 "" RAT_FUNC "%6.4" "-" COEFFS 0 500 0 0 0 1 /end COMPU_METHOD
/begin COMPU_METHOD fak1_q0p000407_hPa_div_percent "" RAT_FUNC "%6.5" "hPa/%" COEFFS 0 12288 0 0 0 5 /end COMPU_METHOD
/begin COMPU_METHOD fak_q0p000122 "" RAT_FUNC "%6.5" "1/(g*s)" COEFFS 0 65536 0 0 0 8 /end COMPU_METHOD
/begin COMPU_METHOD fak_q0p000244 "" RAT_FUNC "%6.5" "-" COEFFS 0 65536 0 0 0 16 /end COMPU_METHOD
/begin COMPU_METHOD fak_q0p0039 "" RAT_FUNC "%6.4" "-" COEFFS 0 256 0 0 0 1 /end COMPU_METHOD
/begin COMPU_METHOD fak_q0p00392 "" RAT_FUNC "%6.4" "-" COEFFS 0 255 0 0 0 1 /end COMPU_METHOD
/begin COMPU_METHOD fak_q0p0078 "" RAT_FUNC "%6.4" "-" COEFFS 0 128 0 0 0 1 /end COMPU_METHOD
/begin COMPU_METHOD fak_q1p526Em5 "" RAT_FUNC "%7.6" "-" COEFFS 0 65536 0 0 0 1 /end COMPU_METHOD
/begin COMPU_METHOD fak_q3p0518Em5 "" RAT_FUNC "%7.6" "" COEFFS 0 32768 0 0 0 1 /end COMPU_METHOD
/begin COMPU_METHOD fak_q4p883Em4 "" RAT_FUNC "%6.5" "-" COEFFS 0 65536 0 0 0 32 /end COMPU_METHOD
/begin COMPU_METHOD fak_q6p1035Em5 "" RAT_FUNC "%7.6" "-" COEFFS 0 65536 0 0 0 4 /end COMPU_METHOD
/begin COMPU_METHOD fak_ub_b1 "" RAT_FUNC "%6.4" "-" COEFFS 0 256 0 0 0 1 /end COMPU_METHOD
/begin COMPU_METHOD fak_ub_b2 "" RAT_FUNC "%8.5" "-" COEFFS 0 256 0 0 0 2 /end COMPU_METHOD
/begin COMPU_METHOD fak_ub_b32 "" RAT_FUNC "%6.3" "-" COEFFS 0 256 0 0 0 32 /end COMPU_METHOD
/begin COMPU_METHOD fak_ub_b4 "" RAT_FUNC "%6.4" "-" COEFFS 0 256 0 0 0 4 /end COMPU_METHOD
/begin COMPU_METHOD fak_ub_q0p00392 "" RAT_FUNC "%6.4" "-" COEFFS 0 255 0 0 0 1 /end COMPU_METHOD
/begin COMPU_METHOD fak_uw_b1 "" RAT_FUNC "%7.6" "-" COEFFS 0 65536 0 0 0 1 /end COMPU_METHOD
/begin COMPU_METHOD fak_uw_b16 "" RAT_FUNC "%6.5" "-" COEFFS 0 65536 0 0 0 16 /end COMPU_METHOD
/begin COMPU_METHOD fak_uw_b2 "" RAT_FUNC "%7.6" "-" COEFFS 0 65536 0 0 0 2 /end COMPU_METHOD
/begin COMPU_METHOD fak_uw_b256 "" RAT_FUNC "%6.4" "-" COEFFS 0 65536 0 0 0 256 /end COMPU_METHOD
/begin COMPU_METHOD fak_uw_b4 "" RAT_FUNC "%7.6" "-" COEFFS 0 65536 0 0 0 4 /end COMPU_METHOD
/begin COMPU_METHOD fak_uw_b8 "" RAT_FUNC "%6.5" "-" COEFFS 0 65536 0 0 0 8 /end COMPU_METHOD
/begin COMPU_METHOD kumsrl_uw_b0p004 "" RAT_FUNC "%13.12" "(kg/h)/(1/min)(%)" COEFFS 0 16384000 0 0 0 1 /end COMPU_METHOD
/begin COMPU_METHOD kw_q0p0156 "" RAT_FUNC "%6.4" "Grad KW" COEFFS 0 64 0 0 0 1 /end COMPU_METHOD
/begin COMPU_METHOD kw_sw_q0p0156 "" RAT_FUNC "%9.5" "deg KW" COEFFS 0 64 0 0 0 1 /end COMPU_METHOD
/begin COMPU_METHOD m_q0p0005 "" RAT_FUNC "%6.5" "kg/(h*%)" COEFFS 0 1 0 0 0 0.0005 /end COMPU_METHOD
/begin COMPU_METHOD m_q0p00625 "" RAT_FUNC "%6.4" "kg/h" COEFFS 0 160 0 0 0 1 /end COMPU_METHOD
/begin COMPU_METHOD m_q0p1 "" RAT_FUNC "%6.3" "kg/h" COEFFS 0 10 0 0 0 1 /end COMPU_METHOD
/begin COMPU_METHOD m_q0p1_mg "" RAT_FUNC "%6.3" "mg" COEFFS 0 1 0 0 0 0.1 /end COMPU_METHOD
/begin COMPU_METHOD m_q2p777Em5 "" RAT_FUNC "%7.6" "kg/s" COEFFS 0 3600 0 0 0 0.1 /end COMPU_METHOD
/begin COMPU_METHOD m_q4_kg_DIV_h "" RAT_FUNC "%6.2" "kg/h" COEFFS 0 1 0 0 0 4 /end COMPU_METHOD
/begin COMPU_METHOD m_ub_b1020 "" RAT_FUNC "%6.2" "kg/h" COEFFS 0 1 0 0 0 4 /end COMPU_METHOD
/begin COMPU_METHOD m_ub_b23p3 "" RAT_FUNC "%6.3" "kg" COEFFS 0 2812.5 0 0 0 256 /end COMPU_METHOD
/begin COMPU_METHOD m_uw_b102p4 "" RAT_FUNC "%6.4" "kg/h" COEFFS 0 65536 0 0 0 102.4 /end COMPU_METHOD
/begin COMPU_METHOD m_uw_b23p3 "" RAT_FUNC "%6.5" "kg" COEFFS 0 2812.5 0 0 0 1 /end COMPU_METHOD
/begin COMPU_METHOD m_uw_b6553p5 "" RAT_FUNC "%6.3" "kg/h" COEFFS 0 1 0 0 0 0.1 /end COMPU_METHOD
/begin COMPU_METHOD nmot_q0p25 "" RAT_FUNC "%6.3" "1/min" COEFFS 0 4 0 0 0 1 /end COMPU_METHOD
/begin COMPU_METHOD nmot_ub_q40 "" RAT_FUNC "%6.1" "1/min" COEFFS 0 1 0 0 0 40 /end COMPU_METHOD
/begin COMPU_METHOD nmot_uw_q0p25 "" RAT_FUNC "%6.3" "1/min" COEFFS 0 1 0 0 0 0.25 /end COMPU_METHOD
/begin COMPU_METHOD Prc "" RAT_FUNC "%6.4" "%" COEFFS 0 81.92 0 0 0 1 /end COMPU_METHOD
/begin COMPU_METHOD p_q0p078 "" RAT_FUNC "%6.4" "hPa" COEFFS 0 64 0 0 0 5 /end COMPU_METHOD
/begin COMPU_METHOD p_sw_q0p039 "" RAT_FUNC "%6.4" "hPa" COEFFS 0 256 0 0 0 10 /end COMPU_METHOD
/begin COMPU_METHOD p_sw_q0p078 "" RAT_FUNC "%6.4" "hPa" COEFFS 0 65536 0 0 0 5120 /end COMPU_METHOD
/begin COMPU_METHOD p_ub_q10 "" RAT_FUNC "%6.1" "hPa" COEFFS 0 1 0 0 0 10 /end COMPU_METHOD
/begin COMPU_METHOD p_ub_q5 "" RAT_FUNC "%6.2" "hPa" COEFFS 0 1 0 0 0 5 /end COMPU_METHOD
/begin COMPU_METHOD p_uw_q0p039 "" RAT_FUNC "%6.4" "hPa" COEFFS 0 256 0 0 0 10 /end COMPU_METHOD
/begin COMPU_METHOD p_uw_q0p078 "" RAT_FUNC "%6.4" "hPa" COEFFS 0 256 0 0 0 20 /end COMPU_METHOD
/begin COMPU_METHOD q0p003556_KJ_DIV_s_K "" RAT_FUNC "%6.4" "kJ/(s*K)" COEFFS 0 1125 0 0 0 4 /end COMPU_METHOD
/begin COMPU_METHOD q_q0p4551 "" RAT_FUNC "%6.3" "kJ" COEFFS 0 36000 0 0 0 16384 /end COMPU_METHOD
/begin COMPU_METHOD q_q6p9peri4Em6_kJ "" RAT_FUNC "%8.7" "kJ" COEFFS 0 144000 0 0 0 1 /end COMPU_METHOD
/begin COMPU_METHOD relDK_q0p3922 "" RAT_FUNC "%6.3" "%DK" COEFFS 0 255 0 0 0 100 /end COMPU_METHOD
/begin COMPU_METHOD relDK_uw_b100 "" RAT_FUNC "%6.4" "%DK" COEFFS 0 65535 0 0 0 100 /end COMPU_METHOD
/begin COMPU_METHOD relnmot_q768 "" RAT_FUNC "%6.0" "%/min" COEFFS 0 1 0 0 0 768 /end COMPU_METHOD
/begin COMPU_METHOD rel_q0p0234 "" RAT_FUNC "%6.4" "%" COEFFS 0 128 0 0 0 3 /end COMPU_METHOD
/begin COMPU_METHOD rel_q0p02344 "" RAT_FUNC "%6.4" "%" COEFFS 0 32 0 0 0 0.75 /end COMPU_METHOD
/begin COMPU_METHOD rel_q0p046875 "" RAT_FUNC "%6.4" "%" COEFFS 0 65536 0 0 0 3072 /end COMPU_METHOD
/begin COMPU_METHOD rel_q0p75 "" RAT_FUNC "%6.3" "%" COEFFS 0 4 0 0 0 3 /end COMPU_METHOD
/begin COMPU_METHOD rel_sw_b50 "" RAT_FUNC "%6.4" "%" COEFFS 0 65536 0 0 0 100 /end COMPU_METHOD
/begin COMPU_METHOD rel_sw_q0p0234 "" RAT_FUNC "%6.4" "%/seg" COEFFS 0 32 0 0 0 0.75 /end COMPU_METHOD
/begin COMPU_METHOD rel_ub_b99p6 "" RAT_FUNC "%6.3" "%" COEFFS 0 256 0 0 0 100 /end COMPU_METHOD
/begin COMPU_METHOD rel_ub_q0p75 "" RAT_FUNC "%6.3" "%" COEFFS 0 1 0 0 0 0.75 /end COMPU_METHOD
/begin COMPU_METHOD rel_uw_b0p3 "" RAT_FUNC "%8.7" "%/hPa" COEFFS 0 65536 0 0 0 0.3 /end COMPU_METHOD
/begin COMPU_METHOD rel_uw_b100 "" RAT_FUNC "%6.4" "%" COEFFS 0 65536 0 0 0 100 /end COMPU_METHOD
/begin COMPU_METHOD rel_uw_q0p0234 "" RAT_FUNC "%6.4" "%" COEFFS 0 32 0 0 0 0.75 /end COMPU_METHOD
/begin COMPU_METHOD t100msxs_uw_b6553p5 "" RAT_FUNC "%6.3" "s" COEFFS 0 1 0 0 0 0.1 /end COMPU_METHOD
/begin COMPU_METHOD t10msxs_ub_b2p55 "" RAT_FUNC "%6.4" "s" COEFFS 0 1 0 0 0 0.01 /end COMPU_METHOD
/begin COMPU_METHOD t1sxs_uw_b65535 "" RAT_FUNC "%6.2" "s" COEFFS 0 1 0 0 0 1 /end COMPU_METHOD
/begin COMPU_METHOD t1sxs_uw_q1 "" RAT_FUNC "%6.2" "s" COEFFS 0 1 0 0 0 1 /end COMPU_METHOD
/begin COMPU_METHOD Temp_Cels "" RAT_FUNC "%6.1" "deg C" COEFFS 0 10 2731.4 0 0 1 /end COMPU_METHOD
/begin COMPU_METHOD temp_q0p01172 "" RAT_FUNC "%6.4" "K" COEFFS 0 65536 0 0 0 768 /end COMPU_METHOD
/begin COMPU_METHOD temp_q0p0234 "" RAT_FUNC "%6.4" "K" COEFFS 0 256 0 0 0 6 /end COMPU_METHOD
/begin COMPU_METHOD temp_q0p0234_o273 "" RAT_FUNC "%6.1" "Grad C" COEFFS 0 1 273.15 0 0 0.0234375 /end COMPU_METHOD
/begin COMPU_METHOD temp_q0p75 "" RAT_FUNC "%6.3" "GradC" COEFFS 0 4 0 0 0 3 /end COMPU_METHOD
/begin COMPU_METHOD temp_q0p75_om48 "" RAT_FUNC "%6.2" "Grad C" COEFFS 0 4 192 0 0 3 /end COMPU_METHOD
/begin COMPU_METHOD temp_ub_b191p25 "" RAT_FUNC "%6.3" "Grad C" COEFFS 0 1 0 0 0 0.75 /end COMPU_METHOD
/begin COMPU_METHOD temp_ub_q0p75_o48 "" RAT_FUNC "%6.2" "Grad C" COEFFS 0 1 48 0 0 0.75 /end COMPU_METHOD
/begin COMPU_METHOD temp_ub_q1_o40 "" RAT_FUNC "%6.2" "Grad C" COEFFS 0 1 40 0 0 1 /end COMPU_METHOD
/begin COMPU_METHOD temp_uw_q0p0029_o48 "" RAT_FUNC "%6.2" "Grad C" COEFFS 0 256 12288 0 0 0.75 /end COMPU_METHOD
/begin COMPU_METHOD temp_uw_q0p75_o48 "" RAT_FUNC "%6.2" "Grad C" COEFFS 0 1 48 0 0 0.75 /end COMPU_METHOD
/begin COMPU_METHOD t_q0p01 "" RAT_FUNC "%6.4" "" COEFFS 0 100 0 0 0 1 /end COMPU_METHOD
/begin COMPU_METHOD t_q0p02 "" RAT_FUNC "%6.4" "s" COEFFS 0 100 0 0 0 2 /end COMPU_METHOD
/begin COMPU_METHOD t_q0p05 "" RAT_FUNC "%6.4" "s" COEFFS 0 100 0 0 0 5 /end COMPU_METHOD
/begin COMPU_METHOD t_q0p1 "" RAT_FUNC "%6.3" "s" COEFFS 0 10 0 0 0 1 /end COMPU_METHOD
/begin COMPU_METHOD t_q0p2 "" RAT_FUNC "%6.3" "s" COEFFS 0 10 0 0 0 2 /end COMPU_METHOD
/begin COMPU_METHOD t_q1 "" RAT_FUNC "%6.2" "s" COEFFS 0 1 0 0 0 1 /end COMPU_METHOD
/begin COMPU_METHOD t_q16us "" RAT_FUNC "%6.1" "us" COEFFS 0 1 0 0 0 16 /end COMPU_METHOD
/begin COMPU_METHOD t_q4_s "" RAT_FUNC "%6.2" "s" COEFFS 0 1 0 0 0 4 /end COMPU_METHOD
/begin COMPU_METHOD vfzg_ub_q1p25 "" RAT_FUNC "%6.2" "km/h" COEFFS 0 1 0 0 0 1.25 /end COMPU_METHOD
/begin COMPU_METHOD vol_q0p702Em3_dm3 "" RAT_FUNC "%6.5" "dm^3" COEFFS 0 2849 0 0 0 2 /end COMPU_METHOD
/begin COMPU_METHOD zk100msxs_uw_b6553 "" RAT_FUNC "%6.1" "s" COEFFS 0 0 65536 0 10 0 /end COMPU_METHOD
/begin COMPU_METHOD zk50msxs_uw_b3276p8 "" RAT_FUNC "%6.1" "s" COEFFS 0 0 65536 0 20 0 /end COMPU_METHOD
/begin RECORD_LAYOUT FklWU16 FNC_VALUES 1 UWORD COLUMN_DIR DIRECT /end RECORD_LAYOUT
/begin RECORD_LAYOUT GkfWU16 FNC_VALUES 1 UWORD COLUMN_DIR DIRECT /end RECORD_LAYOUT
/begin RECORD_LAYOUT GklWU8 FNC_VALUES 1 UBYTE COLUMN_DIR DIRECT /end RECORD_LAYOUT
/begin RECORD_LAYOUT KfAxU8AyU8SstxS16SstyU16WU16 NO_AXIS_PTS_X 1 UBYTE NO_AXIS_PTS_Y 2 UBYTE AXIS_PTS_X 3 SWORD INDEX_INCR DIRECT AXIS_PTS_Y 4 UWORD INDEX_INCR DIRECT FNC_VALUES 5 UWORD COLUMN_DIR DIRECT /end RECORD_LAYOUT
/begin RECORD_LAYOUT KfAxU8AyU8SstxU16SstyU16WU16 NO_AXIS_PTS_X 1 UWORD NO_AXIS_PTS_Y 2 UWORD AXIS_PTS_X 3 UWORD INDEX_INCR DIRECT AXIS_PTS_Y 4 UWORD INDEX_INCR DIRECT FNC_VALUES 5 UWORD COLUMN_DIR DIRECT /end RECORD_LAYOUT
/begin RECORD_LAYOUT KfAxU8AyU8SstxU16SstyU8WU8 NO_AXIS_PTS_X 1 UBYTE NO_AXIS_PTS_Y 2 UBYTE AXIS_PTS_X 3 UWORD INDEX_INCR DIRECT AXIS_PTS_Y 4 UBYTE INDEX_INCR DIRECT FNC_VALUES 5 UBYTE COLUMN_DIR DIRECT /end RECORD_LAYOUT
/begin RECORD_LAYOUT KfAxU8AyU8SstxU8SstyU8WS8 NO_AXIS_PTS_X 1 UBYTE NO_AXIS_PTS_Y 2 UBYTE AXIS_PTS_X 3 UBYTE INDEX_INCR DIRECT AXIS_PTS_Y 4 UBYTE INDEX_INCR DIRECT FNC_VALUES 5 SBYTE COLUMN_DIR DIRECT /end RECORD_LAYOUT
/begin RECORD_LAYOUT KfAxU8AyU8SstxU8SstyU8WU8 NO_AXIS_PTS_X 1 UBYTE NO_AXIS_PTS_Y 2 UBYTE AXIS_PTS_X 3 UBYTE INDEX_INCR DIRECT AXIS_PTS_Y 4 UBYTE INDEX_INCR DIRECT FNC_VALUES 5 UBYTE COLUMN_DIR DIRECT /end RECORD_LAYOUT
/begin RECORD_LAYOUT KlAxU8SstxS16WU16 NO_AXIS_PTS_X 1 UWORD AXIS_PTS_X 2 SWORD INDEX_INCR DIRECT FNC_VALUES 3 UWORD COLUMN_DIR DIRECT /end RECORD_LAYOUT
/begin RECORD_LAYOUT KlAxU8SstxU16WU16 NO_AXIS_PTS_X 1 UWORD AXIS_PTS_X 2 UWORD INDEX_INCR DIRECT FNC_VALUES 3 UWORD COLUMN_DIR DIRECT /end RECORD_LAYOUT
/begin RECORD_LAYOUT KlAxU8SstxU16WU8 NO_AXIS_PTS_X 1 UWORD AXIS_PTS_X 2 UWORD INDEX_INCR DIRECT FNC_VALUES 3 UBYTE COLUMN_DIR DIRECT /end RECORD_LAYOUT
/begin RECORD_LAYOUT KlAxU8SstxU8WU16 NO_AXIS_PTS_X 1 UBYTE AXIS_PTS_X 2 UBYTE INDEX_INCR DIRECT FNC_VALUES 3 UWORD COLUMN_DIR DIRECT /end RECORD_LAYOUT
/begin RECORD_LAYOUT KlAxU8SstxU8WU8 NO_AXIS_PTS_X 1 UBYTE AXIS_PTS_X 2 UBYTE INDEX_INCR DIRECT FNC_VALUES 3 UBYTE COLUMN_DIR DIRECT /end RECORD_LAYOUT
/begin RECORD_LAYOUT KwbWU16 FNC_VALUES 1 UWORD COLUMN_DIR DIRECT /end RECORD_LAYOUT
/begin RECORD_LAYOUT KwWS16 FNC_VALUES 1 SWORD COLUMN_DIR DIRECT /end RECORD_LAYOUT
/begin RECORD_LAYOUT KwWS32 FNC_VALUES 1 SLONG COLUMN_DIR DIRECT /end RECORD_LAYOUT
/begin RECORD_LAYOUT KwWU16 FNC_VALUES 1 UWORD COLUMN_DIR DIRECT /end RECORD_LAYOUT
/begin RECORD_LAYOUT KwWU8 FNC_VALUES 1 UBYTE COLUMN_DIR DIRECT /end RECORD_LAYOUT
/begin RECORD_LAYOUT SstAU8SstU16 NO_AXIS_PTS_X 1 UWORD AXIS_PTS_X 2 UWORD INDEX_INCR DIRECT /end RECORD_LAYOUT
/begin RECORD_LAYOUT SstAU8SstU8 NO_AXIS_PTS_X 1 UBYTE AXIS_PTS_X 2 UBYTE INDEX_INCR DIRECT /end RECORD_LAYOUT
/end MODULE
/end PROJECT
