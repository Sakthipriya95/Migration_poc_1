ASAP2_VERSION 1 4
/begin PROJECT M17955S3CC411_110Y0320 "M17955S3CC411_110Y0320"
/begin HEADER "" VERSION "M17955S3CC411_110Y0320" PROJECT_NO M17955S3CC411_110Y0320 /end HEADER
/begin MODULE DIM ""
/begin MOD_COMMON "" BYTE_ORDER MSB_LAST ALIGNMENT_BYTE 1 ALIGNMENT_WORD 2 ALIGNMENT_LONG 4 ALIGNMENT_FLOAT32_IEEE 4 /end MOD_COMMON
/begin CHARACTERISTIC CoVeh_trqAcs_C "" VALUE 0x8004AC3A KwWS16 6553.500 Trq -3276.800 3276.700 FORMAT "%8.3" /end CHARACTERISTIC
/begin CHARACTERISTIC CWIGC "" VALUE 0x8004AD12 KwWU8 255.0 dez 0.00 255.0 FORMAT "%5.1" /end CHARACTERISTIC
/begin CHARACTERISTIC CWZWWLE "" VALUE 0x8004B26C KwWU8 255.0 dez 0.00 255.0 FORMAT "%5.1" /end CHARACTERISTIC
/begin CHARACTERISTIC DFZWMNST "" VALUE 0x8004B04C KwWU16 0.9999847 fak_uw_b1 0.00 0.9999847 FORMAT "%9.7" /end CHARACTERISTIC
/begin CHARACTERISTIC DZWSTFHO "" CURVE 0x8004B226 KlAxU8SstxU8WS8 191.3 zw_sb_q0p75 -96.00 95.25 FORMAT "%5.2"
 /begin AXIS_DESCR STD_AXIS fho fak_ub_b4 5 0.00 3.984 FORMAT "%5.3" DEPOSIT ABSOLUTE /end AXIS_DESCR
/end CHARACTERISTIC
/begin CHARACTERISTIC DZWSTTA "" CURVE 0x8004B232 KlAxU8SstxU8WS8 191.3 zw_sb_q0p75 -96.00 95.25 FORMAT "%5.2"
 /begin AXIS_DESCR STD_AXIS tans temp_ub_q0p75_o48 6 -48.00 143.3 FORMAT "%5.1" DEPOSIT ABSOLUTE /end AXIS_DESCR
/end CHARACTERISTIC
/begin CHARACTERISTIC FKSFHO "" CURVE 0x8004AE8A KlAUbSstUbWUb 0.9961 fak_ub_b1 0.00 0.9961
 /begin AXIS_DESCR STD_AXIS fho fak_ub_b4 6 0.00 3.984 FORMAT "%5.3" DEPOSIT ABSOLUTE /end AXIS_DESCR
/end CHARACTERISTIC
/begin CHARACTERISTIC FZWWLRLN "" MAP 0x8004B26D KfAxU8AyU8SstxU8SstyU8WU8 1.992188 fak_ub_b2 0.00 1.992188 FORMAT "%8.6"
 /begin AXIS_DESCR STD_AXIS nmot nmot_ub_q40 10 0.00 10200. FORMAT "%5.0" DEPOSIT ABSOLUTE /end AXIS_DESCR
 /begin AXIS_DESCR STD_AXIS rl rel_ub_q0p75 10 0.00 191.3 FORMAT "%5.1" DEPOSIT ABSOLUTE /end AXIS_DESCR
/end CHARACTERISTIC
/begin CHARACTERISTIC KFDZMNST "" MAP 0x8004B04E KfAxU8AyU8SstxU8SstyU8WS8 191.3 kw_q0p75 -96.00 95.25 FORMAT "%5.2"
 /begin AXIS_DESCR STD_AXIS nmot nmot_ub_q40 4 0.00 10200. FORMAT "%5.0" DEPOSIT ABSOLUTE /end AXIS_DESCR
 /begin AXIS_DESCR STD_AXIS tmst temp_ub_q0p75_o48 6 -48.00 143.3 FORMAT "%5.1" DEPOSIT ABSOLUTE /end AXIS_DESCR
/end CHARACTERISTIC
/begin CHARACTERISTIC KFDZWKG "" MAP 0x8004AD16 KfAxU8AyU8SstxU8SstyU8WS8 191.3 kw_q0p75 -96.00 95.25 FORMAT "%5.2"
 /begin AXIS_DESCR STD_AXIS nmot nmot_ub_q40 8 0.00 10200. FORMAT "%5.0" DEPOSIT ABSOLUTE /end AXIS_DESCR
 /begin AXIS_DESCR STD_AXIS lambas fak_ub_b2 12 0.00 1.992188 FORMAT "%8.6" DEPOSIT ABSOLUTE /end AXIS_DESCR
/end CHARACTERISTIC
/begin CHARACTERISTIC KFFSZNM "" MAP 0x8004AC40 GkfWU8 0.9961 fak_ub_b1 0.00 0.9961
 /begin AXIS_DESCR COM_AXIS nmot nmot_ub_q40 8 0.00 10200. FORMAT "%5.0" AXIS_PTS_REF SNM08ZUUB /end AXIS_DESCR
 /begin AXIS_DESCR COM_AXIS tmot temp_ub_q0p75_o48 8 -48.00 143.3 FORMAT "%5.1" AXIS_PTS_REF STM08__UB /end AXIS_DESCR
/end CHARACTERISTIC
/begin CHARACTERISTIC KFFWK "" MAP 0x8004AE97 GkfWSb 0.9922 fak_sb_b1 0.00 0.9922
 /begin AXIS_DESCR COM_AXIS nmot nmot_ub_q40 24 0.00 10200. FORMAT "%5.0" AXIS_PTS_REF SNM24ZUUB /end AXIS_DESCR
 /begin AXIS_DESCR COM_AXIS rl rel_q0p75 16 0.00 191.3 FORMAT "%5.1" AXIS_PTS_REF SRL16ZUUB /end AXIS_DESCR
/end CHARACTERISTIC
/begin CHARACTERISTIC KFSZT "" MAP 0x8004AC80 GkfWU16 65.53500 t_q0p001 0.00 65.53500 FORMAT "%8.5"
 /begin AXIS_DESCR COM_AXIS ubsq spg_q0p1 8 0.00 25.50 FORMAT "%5.2" AXIS_PTS_REF SUB08ZUUB /end AXIS_DESCR
 /begin AXIS_DESCR COM_AXIS tmot temp_ub_q0p75_o48 8 -48.00 143.3 FORMAT "%5.1" AXIS_PTS_REF STM08__UB /end AXIS_DESCR
/end CHARACTERISTIC
/begin CHARACTERISTIC KFWK "" MAP 0x8004B018 KfAxUbAyUbSstxUbSstyUbWSb 96.00 zw_sb_q0p75 -96.00 0.00 FORMAT "%5.2"
 /begin AXIS_DESCR STD_AXIS tmot temp_ub_q0p75_o48 6 -48.00 143.3 FORMAT "%5.1" DEPOSIT ABSOLUTE /end AXIS_DESCR
 /begin AXIS_DESCR STD_AXIS tans temp_ub_q0p75_o48 6 -48.00 143.3 FORMAT "%5.1" DEPOSIT ABSOLUTE /end AXIS_DESCR
/end CHARACTERISTIC
/begin CHARACTERISTIC KFZW "" MAP 0x8004AD8C GkfWS8 191.3 kw_q0p75 -96.00 95.25 FORMAT "%5.2"
 /begin AXIS_DESCR COM_AXIS nmot_w nmot_uw_q0p25 16 0.00 16383.75 FORMAT "%8.2" AXIS_PTS_REF SNMXZUUW /end AXIS_DESCR
 /begin AXIS_DESCR COM_AXIS rl_w rel_q0p0234 12 0.00 1535.977 FORMAT "%8.3" AXIS_PTS_REF SRLXZUUW /end AXIS_DESCR
/end CHARACTERISTIC
/begin CHARACTERISTIC KFZWMN "" MAP 0x8004B072 GkfWS8 191.3 kw_q0p75 -96.00 95.25 FORMAT "%5.2"
 /begin AXIS_DESCR COM_AXIS nmot_w nmot_uw_q0p25 16 0.00 16383.75 FORMAT "%8.2" AXIS_PTS_REF SNM16ZUUW /end AXIS_DESCR
 /begin AXIS_DESCR COM_AXIS rl_w rel_q0p0234 12 0.00 1535.977 FORMAT "%8.3" AXIS_PTS_REF SRL12ZUUW /end AXIS_DESCR
/end CHARACTERISTIC
/begin CHARACTERISTIC KFZWMNKHLL "" MAP 0x8004B132 KfAxU8AyU8SstxU8SstyU8WS8 191.3 kw_q0p75 -96.00 95.25 FORMAT "%5.2"
 /begin AXIS_DESCR STD_AXIS nmot nmot_ub_q40 4 0.00 10200. FORMAT "%5.0" DEPOSIT ABSOLUTE /end AXIS_DESCR
 /begin AXIS_DESCR STD_AXIS rl rel_ub_q0p75 4 0.00 191.3 FORMAT "%5.1" DEPOSIT ABSOLUTE /end AXIS_DESCR
/end CHARACTERISTIC
/begin CHARACTERISTIC KFZWMNLB "" MAP 0x8004B14C GkfWS8 191.3 zw_sb_q0p75 -96.00 95.25 FORMAT "%5.2"
 /begin AXIS_DESCR COM_AXIS nmot_w nmot_uw_q0p25 16 0.00 16383.75 FORMAT "%8.2" AXIS_PTS_REF SNM16ZUUW /end AXIS_DESCR
 /begin AXIS_DESCR COM_AXIS rl_w rel_q0p0234 12 0.00 1535.977 FORMAT "%8.3" AXIS_PTS_REF SRL12ZUUW /end AXIS_DESCR
/end CHARACTERISTIC
/begin CHARACTERISTIC KFZWSTTM "" MAP 0x8004B240 KfAxU8AyU8SstxU8SstyU8WS8 191.3 zw_sb_q0p75 -96.00 95.25 FORMAT "%5.2"
 /begin AXIS_DESCR STD_AXIS nmotzwstt nmot_ub_q40 5 0.00 10200. FORMAT "%5.0" DEPOSIT ABSOLUTE /end AXIS_DESCR
 /begin AXIS_DESCR STD_AXIS tmzwstt temp_q1_om40 6 -40.00 215.0 FORMAT "%5.1" DEPOSIT ABSOLUTE /end AXIS_DESCR
/end CHARACTERISTIC
/begin CHARACTERISTIC KFZWWLNMOT "" MAP 0x8004B2E8 KfAxU8AyU8SstxU16SstyU16WS16 191.2500 zw_sb_q0p75 -96.00000 95.25000 FORMAT "%8.5"
 /begin AXIS_DESCR STD_AXIS nmot nmot_ub_q40 10 0.00 10200.00 FORMAT "%8.2" DEPOSIT ABSOLUTE /end AXIS_DESCR
 /begin AXIS_DESCR STD_AXIS tyzwwlnm_w temp_q0p0234_o273 10 -273.1500 1262.827 FORMAT "%8.3" DEPOSIT ABSOLUTE /end AXIS_DESCR
/end CHARACTERISTIC
/begin CHARACTERISTIC KFZWWLRL "" MAP 0x8004B3DC KfAxU8AyU8SstxU8SstyU8WS8 191.3 zw_sb_q0p75 -96.00 95.25 FORMAT "%5.2"
 /begin AXIS_DESCR STD_AXIS tmot temp_ub_q0p75_o48 10 -48.00 143.3 FORMAT "%5.1" DEPOSIT ABSOLUTE /end AXIS_DESCR
 /begin AXIS_DESCR STD_AXIS rl rel_ub_q0p75 10 0.00 191.3 FORMAT "%5.1" DEPOSIT ABSOLUTE /end AXIS_DESCR
/end CHARACTERISTIC
/begin CHARACTERISTIC KIVMXG "" CURVE 0x8004ABFC KlAxU8SstxU8WU16 499.992371 rel_q0p007629 0.00 499.992371
 /begin AXIS_DESCR STD_AXIS gangi OneToOne 8 0.00 255.0 FORMAT "%5.1" DEPOSIT ABSOLUTE /end AXIS_DESCR
/end CHARACTERISTIC
/begin CHARACTERISTIC KLDZWMNLAM "" CURVE 0x8004B20C KlAxU8SstxU8WS8 191.3 kw_q0p75 -96.00 95.25 FORMAT "%5.2"
 /begin AXIS_DESCR STD_AXIS lambas fak_ub_b2 8 0.00 1.992188 FORMAT "%8.6" DEPOSIT ABSOLUTE /end AXIS_DESCR
/end CHARACTERISTIC
/begin CHARACTERISTIC KLDZWMNTM "" CURVE 0x8004B21E GklWS8 191.3 kw_q0p75 -96.00 95.25 FORMAT "%5.2"
 /begin AXIS_DESCR COM_AXIS tmot temp_ub_q0p75_o48 8 -48.00 143.3 FORMAT "%5.1" AXIS_PTS_REF STM08__UB /end AXIS_DESCR
/end CHARACTERISTIC
/begin CHARACTERISTIC KPVMXG "" CURVE 0x8004AC16 KlAxU8SstxU8WU8 99.70 rel_ub_q0p391 0.00 99.70 FORMAT "%5.2"
 /begin AXIS_DESCR STD_AXIS gangi OneToOne 8 0.00 255.0 FORMAT "%5.1" DEPOSIT ABSOLUTE /end AXIS_DESCR
/end CHARACTERISTIC
/begin CHARACTERISTIC KSZWE "" VALUE 0x8004B04A KwSb 96.00 zw_sb_q0p75 -96.00 0.00 FORMAT "%5.2" /end CHARACTERISTIC
/begin CHARACTERISTIC LRHIMN "" VALUE 0x8004A78A KwWS16 1.999969 fak_sw_b1 -1.000000 0.9999695 FORMAT "%8.6" /end CHARACTERISTIC
/begin CHARACTERISTIC LRHIMX "" VALUE 0x8004A78C KwWS16 1.999969 fak_sw_b1 -1.000000 0.9999695 FORMAT "%8.6" /end CHARACTERISTIC
/begin CHARACTERISTIC NMZWGRUSYN "" VALUE 0x8004AE4C KwWU8 10200. nmot_ub_q40 0.00 10200. FORMAT "%5.0" /end CHARACTERISTIC
/begin AXIS_PTS SNM08ZUUB "" 0x8004AD00 nmot SstAU8SstU8 10200. nmot_ub_q40 8 0.00 10200. FORMAT "%5.0" DEPOSIT ABSOLUTE /end AXIS_PTS
/begin AXIS_PTS SNM16ZUUW "" 0x80049EE8 nmot_w SstAUwSstUw 16383.75 nmot_uw_q0p25 16 0.00 16383.75 FORMAT "%8.2" DEPOSIT ABSOLUTE /end AXIS_PTS
/begin AXIS_PTS SNM24ZUUB "" 0x80049F0A nmot SstAU8SstU8 10200. nmot_ub_q40 24 0.00 10200. FORMAT "%5.0" DEPOSIT ABSOLUTE /end AXIS_PTS
/begin AXIS_PTS SNMXZUUW "" 0x8004AE4E nmot_w SstAU8SstU16 16383.75 nmot_uw_q0p25 16 0.00 16383.75 FORMAT "%8.2" DEPOSIT ABSOLUTE /end AXIS_PTS
/begin AXIS_PTS SRL12ZUUW "" 0x80049F3C rl_w SstAUwSstUw 1535.977 rel_q0p0234 12 0.00 1535.977 FORMAT "%8.3" DEPOSIT ABSOLUTE /end AXIS_PTS
/begin AXIS_PTS SRL16ZUUB "" 0x80049F56 rl SstAU8SstU8 191.3 rel_q0p75 16 0.00 191.3 FORMAT "%5.1" DEPOSIT ABSOLUTE /end AXIS_PTS
/begin AXIS_PTS SRLXZUUW "" 0x8004AE70 rl_w SstAU8SstU16 1535.977 rel_q0p0234 12 0.00 1535.977 FORMAT "%8.3" DEPOSIT ABSOLUTE /end AXIS_PTS
/begin AXIS_PTS STM08__UB "" 0x80049F90 tmot SstAUbSstUb 191.3 temp_ub_q0p75_o48 8 -48.00 143.3 FORMAT "%5.1" DEPOSIT ABSOLUTE /end AXIS_PTS
/begin AXIS_PTS SUB08ZUUB "" 0x8004AD09 ubsq SstAU8SstU8 25.50 spg_q0p1 8 0.00 25.50 FORMAT "%5.2" DEPOSIT ABSOLUTE /end AXIS_PTS
/begin CHARACTERISTIC TVMXPRG "" CURVE 0x8004AC27 KlAxU8SstxU8WU8 5.100 t20msxs_ub_q0p02 0.00 5.100 FORMAT "%5.3"
 /begin AXIS_DESCR STD_AXIS gangi OneToOne 8 0.00 255.0 FORMAT "%5.1" DEPOSIT ABSOLUTE /end AXIS_DESCR
/end CHARACTERISTIC
/begin CHARACTERISTIC TWCC_BalCat1B1_I.facOSCPurge_C "" VALUE 0x8004A73C KwWU8 1.992188 fak_ub_b2 0.00 1.992188 FORMAT "%8.6" /end CHARACTERISTIC
/begin CHARACTERISTIC TWCC_BalCat1B1_I.facOSCState_C "" VALUE 0x8004A73D KwWU8 1.992188 fak_ub_b2 0.00 1.992188 FORMAT "%8.6" /end CHARACTERISTIC
/begin CHARACTERISTIC TWCC_BalCat1B1_I.mO2DisThresPurge_C "" VALUE 0x8004A73E KwWU16 6553.500 m_q0p1_mg 0.00 6553.500 FORMAT "%8.3" /end CHARACTERISTIC
/begin CHARACTERISTIC TWCC_BalCat1B1_I.mO2EngOff_CUR "" CURVE 0x8004A740 KlAxU8SstxU16WU16 6553.500 m_q0p1_mg 0.00 6553.500 FORMAT "%8.3"
 /begin AXIS_DESCR STD_AXIS NO_INPUT_QUANTITY t_q1 2 0.00 65535.00 FORMAT "%8.2" DEPOSIT ABSOLUTE /end AXIS_DESCR
/end CHARACTERISTIC
/begin CHARACTERISTIC TWCC_dLoadTrim_C "" VALUE 0x8004A75C KwWU16 1535.977 rel_q0p02344 0.00 1535.977 FORMAT "%8.3" /end CHARACTERISTIC
/begin CHARACTERISTIC TWCC_dmMaxTrim_C "" VALUE 0x8004A75E KwWS16 6553.500 m_q0p1 -3276.800 3276.700 FORMAT "%8.3" /end CHARACTERISTIC
/begin CHARACTERISTIC TWCC_dmMinTrim_C "" VALUE 0x8004A760 KwWS16 6553.500 m_q0p1 -3276.800 3276.700 FORMAT "%8.3" /end CHARACTERISTIC
/begin CHARACTERISTIC TWCC_drIDLaH2Pri_C "" VALUE 0x8004A996 KwWS16 0.1999969 fak_q3p0518Em6 -0.1000000 0.09999695 FORMAT "%9.7" /end CHARACTERISTIC
/begin CHARACTERISTIC TWCC_facCorO2Purg_C "" VALUE 0x8004A6E4 KwWU8 1.992188 fak_ub_b2 0.00 1.992188 FORMAT "%8.6" /end CHARACTERISTIC
/begin CHARACTERISTIC TWCC_facCtlLowTrim_C "" VALUE 0x8004A762 KwWU16 0.9999847 fak_uw_b1 0.00 0.9999847 FORMAT "%9.7" /end CHARACTERISTIC
/begin CHARACTERISTIC TWCC_facCtlTrim_C "" VALUE 0x8004A764 KwWU16 0.9999847 fak_uw_b1 0.00 0.9999847 FORMAT "%9.7" /end CHARACTERISTIC
/begin CHARACTERISTIC TWCC_facDeltaLamTrim_C "" VALUE 0x8004A766 KwWU16 0.9999847 fak_uw_b1 0.00 0.9999847 FORMAT "%9.7" /end CHARACTERISTIC
/begin CHARACTERISTIC TWCC_facFltActPTPri_C "" VALUE 0x8004A78E KwWU8 1.992 fak_q0p0078 0.00 1.992 FORMAT "%5.3" /end CHARACTERISTIC
/begin CHARACTERISTIC TWCC_facIGnCtlPriB1_CUR "" CURVE 0x8004A790 KlAxU8SstxU16WU16 9.999847 fak_q0p00015259 0.00 9.999847 FORMAT "%8.6"
 /begin AXIS_DESCR STD_AXIS msabnhk_w m_uw_b6553p5 8 0.00 6553.500 FORMAT "%8.3" DEPOSIT ABSOLUTE /end AXIS_DESCR
/end CHARACTERISTIC
/begin CHARACTERISTIC TWCC_facILamLinPri_CUR "" CURVE 0x8004A7B2 KlAxU8SstxS16WS16 1.999969 fak_sw_b1 -1.000000 0.9999695 FORMAT "%8.6"
 /begin AXIS_DESCR STD_AXIS NO_INPUT_QUANTITY fak_sw_b1 9 -1.000000 0.9999695 FORMAT "%8.6" DEPOSIT ABSOLUTE /end AXIS_DESCR
/end CHARACTERISTIC
/begin CHARACTERISTIC TWCC_facIOSCAbsPriB1_CUR "" CURVE 0x8004A7D8 KlAxU8SstxU16WU8 0.9961 fak_ub_b1 0.00 0.9961
 /begin AXIS_DESCR STD_AXIS NO_INPUT_QUANTITY m_q0p1_mg 4 0.00 6553.500 FORMAT "%8.3" DEPOSIT ABSOLUTE /end AXIS_DESCR
/end CHARACTERISTIC
/begin CHARACTERISTIC TWCC_facIOSCPriB1_CUR "" CURVE 0x8004A7E6 KlAxU8SstxU8WU8 0.9961 fak_ub_b1 0.00 0.9961
 /begin AXIS_DESCR STD_AXIS fcoscxk fak_q0p0078 4 0.00 1.992 FORMAT "%5.3" DEPOSIT ABSOLUTE /end AXIS_DESCR
/end CHARACTERISTIC
/begin CHARACTERISTIC TWCC_facIOSCRlsH2Pri_C "" VALUE 0x8004A998 KwWU16 1.999969 fak_uw_b2 0.00 1.999969 FORMAT "%8.6" /end CHARACTERISTIC
/begin AXIS_PTS TWCC_facOSCPri_GCUR "" 0x8004A99A TWCC_facOSCPriB1 SstAU8SstU16 1.999969 fak_uw_b2 2 0.00 1.999969 FORMAT "%8.6" DEPOSIT ABSOLUTE /end AXIS_PTS
/begin CHARACTERISTIC TWCC_facPGnCtlPriB1_CUR "" CURVE 0x8004A7F0 KlAxU8SstxU16WU8 3.984 fak_ub_b4 0.00 3.984 FORMAT "%5.3"
 /begin AXIS_DESCR STD_AXIS msabnhk_w m_uw_b6553p5 8 0.00 6553.500 FORMAT "%8.3" DEPOSIT ABSOLUTE /end AXIS_DESCR
/end CHARACTERISTIC
/begin CHARACTERISTIC TWCC_facPLamLinPri_CUR "" CURVE 0x8004A80A KlAxU8SstxS16WS16 1.999969 fak_sw_b1 -1.000000 0.9999695 FORMAT "%8.6"
 /begin AXIS_DESCR STD_AXIS NO_INPUT_QUANTITY fak_sw_b1 9 -1.000000 0.9999695 FORMAT "%8.6" DEPOSIT ABSOLUTE /end AXIS_DESCR
/end CHARACTERISTIC
/begin CHARACTERISTIC TWCC_facPOSCAbsPriB1_CUR "" CURVE 0x8004A830 KlAxU8SstxU16WU8 0.9961 fak_ub_b1 0.00 0.9961
 /begin AXIS_DESCR STD_AXIS oschkm_w m_q0p1_mg 4 0.00 6553.500 FORMAT "%8.3" DEPOSIT ABSOLUTE /end AXIS_DESCR
/end CHARACTERISTIC
/begin CHARACTERISTIC TWCC_facPOSCPriB1_CUR "" CURVE 0x8004A83E KlAxU8SstxU8WU8 0.9961 fak_ub_b1 0.00 0.9961
 /begin AXIS_DESCR STD_AXIS fcoscxk fak_q0p0078 4 0.00 1.992 FORMAT "%5.3" DEPOSIT ABSOLUTE /end AXIS_DESCR
/end CHARACTERISTIC
/begin CHARACTERISTIC TWCC_HldTrim_C "" VALUE 0x8004A768 KwWU16 6553.500 m_q0p1_g 0.00 6553.500 FORMAT "%8.3" /end CHARACTERISTIC
/begin CHARACTERISTIC TWCC_mEnaDynTrim_C "" VALUE 0x8004A76A KwWU16 6553.500 m_q0p1_g 0.00 6553.500 FORMAT "%8.3" /end CHARACTERISTIC
/begin CHARACTERISTIC TWCC_mEnaMaxTrim_C "" VALUE 0x8004A76C KwWU16 6553.500 m_uw_b6553p5 0.00 6553.500 FORMAT "%8.3" /end CHARACTERISTIC
/begin CHARACTERISTIC TWCC_mEnaMinTrim_C "" VALUE 0x8004A76E KwWU16 6553.500 m_uw_b6553p5 0.00 6553.500 FORMAT "%8.3" /end CHARACTERISTIC
/begin CHARACTERISTIC TWCC_mIBalPPri_CUR "" CURVE 0x8004A9A0 GklWU16 7281.667 m_uw_b7281 0.00 7281.667 FORMAT "%8.3"
 /begin AXIS_DESCR COM_AXIS TWCC_facOSCPriB1 fak_uw_b2 2 0.00 1.999969 FORMAT "%8.6" AXIS_PTS_REF TWCC_facOSCPri_GCUR /end AXIS_DESCR
/end CHARACTERISTIC
/begin CHARACTERISTIC TWCC_mIBalPri_CUR "" CURVE 0x8004A9A4 GklWU16 7281.667 m_uw_b7281 0.00 7281.667 FORMAT "%8.3"
 /begin AXIS_DESCR COM_AXIS TWCC_facOSCPriB1 fak_uw_b2 2 0.00 1.999969 FORMAT "%8.6" AXIS_PTS_REF TWCC_facOSCPri_GCUR /end AXIS_DESCR
/end CHARACTERISTIC
/begin CHARACTERISTIC TWCC_mIOscRlsH2Pri_C "" VALUE 0x8004A9A8 KwWU16 1310.700 m_q0p02_mgO2 0.00 1310.700 FORMAT "%8.3" /end CHARACTERISTIC
/begin CHARACTERISTIC TWCC_mO2MinThresCat1Purg_C "" VALUE 0x8004A6E6 KwWU16 6553.500 m_q0p1_mg 0.00 6553.500 FORMAT "%8.3" /end CHARACTERISTIC
/begin CHARACTERISTIC TWCC_mPBalPri_CUR "" CURVE 0x8004A9AA GklWU16 7281.667 m_uw_b7281 0.00 7281.667 FORMAT "%8.3"
 /begin AXIS_DESCR COM_AXIS TWCC_facOSCPriB1 fak_uw_b2 2 0.00 1.999969 FORMAT "%8.6" AXIS_PTS_REF TWCC_facOSCPri_GCUR /end AXIS_DESCR
/end CHARACTERISTIC
/begin CHARACTERISTIC TWCC_nIMaxPri_C "" VALUE 0x8004A9AE KwWU8 10200. nmot_ub_q40 0.00 10200. FORMAT "%5.0" /end CHARACTERISTIC
/begin CHARACTERISTIC TWCC_nIMinPri_C "" VALUE 0x8004A9AF KwWU8 10200. nmot_ub_q40 0.00 10200. FORMAT "%5.0" /end CHARACTERISTIC
/begin CHARACTERISTIC TWCC_numErrDebTrim_C "" VALUE 0x8004A770 KwWU8 255.0 dez 0.00 255.0 FORMAT "%5.1" /end CHARACTERISTIC
/begin CHARACTERISTIC TWCC_numLamJmpTrim_C "" VALUE 0x8004A75A KwWU8 255.0 dez 0.00 255.0 FORMAT "%5.1" /end CHARACTERISTIC
/begin CHARACTERISTIC TWCC_numStabTrim_C "" VALUE 0x8004A771 KwWU8 255.0 dez 0.00 255.0 FORMAT "%5.1" /end CHARACTERISTIC
/begin CHARACTERISTIC TWCC_OSCCat1B1_I.facOSCKNBB_C "" VALUE 0x8004A74C KwWU8 3.984 fak_ub_b4 0.00 3.984 FORMAT "%5.3" /end CHARACTERISTIC
/begin CHARACTERISTIC TWCC_OSCCat1B1_I.facOSCK_C "" VALUE 0x8004A74D KwWU8 3.984 fak_ub_b4 0.00 3.984 FORMAT "%5.3" /end CHARACTERISTIC
/begin CHARACTERISTIC TWCC_rDynSetPIniPri_CUR "" CURVE 0x8004A848 KlAxU8SstxS16WS16 1.999969 fak_sw_b1 -1.000000 0.9999695 FORMAT "%8.6"
 /begin AXIS_DESCR STD_AXIS fcoschk fak_q0p0078 2 0.00 1.992188 FORMAT "%8.6" DEPOSIT ABSOLUTE /end AXIS_DESCR
/end CHARACTERISTIC
/begin CHARACTERISTIC TWCC_rICtlInitPriB1_C "" VALUE 0x8004A852 KwWS16 1.999969 fak_sw_b1 -1.000000 0.9999695 FORMAT "%8.6" /end CHARACTERISTIC
/begin CHARACTERISTIC TWCC_rIDecLdPri_C "" VALUE 0x8004A9B0 KwWS16 1535.977 rel_q0p02344 -768.0000 767.9766 FORMAT "%8.4" /end CHARACTERISTIC
/begin CHARACTERISTIC TWCC_rIDLaH2Pri_C "" VALUE 0x8004A9B2 KwWS16 1.999969 fak_q3p0518Em5 -1.000000 0.9999695 FORMAT "%8.6" /end CHARACTERISTIC
/begin CHARACTERISTIC TWCC_rIFlCPPri_C "" VALUE 0x8004A9B4 KwWU16 0.9999847 fak_uw_b1 0.00 0.9999847 FORMAT "%9.7" /end CHARACTERISTIC
/begin CHARACTERISTIC TWCC_rIIncLdPri_C "" VALUE 0x8004A9B6 KwWS16 1535.977 rel_q0p02344 -768.0000 767.9766 FORMAT "%8.4" /end CHARACTERISTIC
/begin CHARACTERISTIC TWCC_rILamMaxPri_C "" VALUE 0x8004A854 KwWS16 1.999969 fak_sw_b1 -1.000000 0.9999695 FORMAT "%8.6" /end CHARACTERISTIC
/begin CHARACTERISTIC TWCC_rILamMinPri_C "" VALUE 0x8004A856 KwWS16 1.999969 fak_sw_b1 -1.000000 0.9999695 FORMAT "%8.6" /end CHARACTERISTIC
/begin CHARACTERISTIC TWCC_rILdMaxPri_CUR "" CURVE 0x8004A9B8 KlAxU8SstxU8WU8 191.3 rel_ub_q0p75 0.00 191.3 FORMAT "%5.1"
 /begin AXIS_DESCR STD_AXIS Epm_nEngLRes nmot_ub_q40 8 0.00 10200. FORMAT "%5.0" DEPOSIT ABSOLUTE /end AXIS_DESCR
/end CHARACTERISTIC
/begin CHARACTERISTIC TWCC_rILdMinPri_CUR "" CURVE 0x8004A9C9 KlAxU8SstxU8WU8 191.3 rel_ub_q0p75 0.00 191.3 FORMAT "%5.1"
 /begin AXIS_DESCR STD_AXIS Epm_nEngLRes nmot_ub_q40 8 0.00 10200. FORMAT "%5.0" DEPOSIT ABSOLUTE /end AXIS_DESCR
/end CHARACTERISTIC
/begin CHARACTERISTIC TWCC_rInvLamLinPri_CUR "" CURVE 0x8004A858 KlAxU8SstxU16WU8 1.245 spg_q0p00488 0.00 1.245 FORMAT "%5.3"
 /begin AXIS_DESCR STD_AXIS TWCC_rLamSetPPriB1 fak_uw_b2 15 0.00 1.999969 FORMAT "%8.6" DEPOSIT ABSOLUTE /end AXIS_DESCR
/end CHARACTERISTIC
/begin CHARACTERISTIC TWCC_rLamCtlMaxPri_C "" VALUE 0x8004A888 KwWS16 1.999969 fak_sw_b1 -1.000000 0.9999695 FORMAT "%8.6" /end CHARACTERISTIC
/begin CHARACTERISTIC TWCC_rLamCtlMinPri_C "" VALUE 0x8004A88A KwWS16 1.999969 fak_sw_b1 -1.000000 0.9999695 FORMAT "%8.6" /end CHARACTERISTIC
/begin CHARACTERISTIC TWCC_rLamLinPri_CUR "" CURVE 0x8004A88C KlAxU8SstxU8WU16 1.999969 fak_uw_b2 0.00 1.999969 FORMAT "%8.6"
 /begin AXIS_DESCR STD_AXIS HEGO_uS2B1 spg_q0p00488 15 0.00 1.245 FORMAT "%5.3" DEPOSIT ABSOLUTE /end AXIS_DESCR
/end CHARACTERISTIC
/begin CHARACTERISTIC TWCC_rLamMaxErrTrim_C "" VALUE 0x8004A772 KwWS16 1.999969 fak_sw_b1 -1.000000 0.9999695 FORMAT "%8.6" /end CHARACTERISTIC
/begin CHARACTERISTIC TWCC_rLamMaxTrim_C "" VALUE 0x8004A774 KwWS16 1.999969 fak_sw_b1 -1.000000 0.9999695 FORMAT "%8.6" /end CHARACTERISTIC
/begin CHARACTERISTIC TWCC_rLamMinErrTrim_C "" VALUE 0x8004A776 KwWS16 1.999969 fak_sw_b1 -1.000000 0.9999695 FORMAT "%8.6" /end CHARACTERISTIC
/begin CHARACTERISTIC TWCC_rLamMinTrim_C "" VALUE 0x8004A778 KwWS16 1.999969 fak_sw_b1 -1.000000 0.9999695 FORMAT "%8.6" /end CHARACTERISTIC
/begin CHARACTERISTIC TWCC_rLamSetPPurg_MAP "" MAP 0x8004A6E8 KfAxU8AyU8SstxU16SstyU16WU16 15.99976 fak_uw_b16 0.00 15.99976 FORMAT "%8.5"
 /begin AXIS_DESCR STD_AXIS NO_INPUT_QUANTITY m_q0p1_mg 5 0.00 6553.500 FORMAT "%8.3" DEPOSIT ABSOLUTE /end AXIS_DESCR
 /begin AXIS_DESCR STD_AXIS NO_INPUT_QUANTITY m_q0p1 4 0.00 3276.700 FORMAT "%8.3" DEPOSIT ABSOLUTE /end AXIS_DESCR
/end CHARACTERISTIC
/begin CHARACTERISTIC TWCC_rLamTrim_C "" VALUE 0x8004A77A KwWU16 1.999969 fak_uw_b2 0.00 1.999969 FORMAT "%8.6" /end CHARACTERISTIC
/begin CHARACTERISTIC TWCC_rMinThresEngResPurg_C "" VALUE 0x8004A726 KwWU8 10200. nmot_q40 0.00 10200. FORMAT "%5.0" /end CHARACTERISTIC
/begin CHARACTERISTIC TWCC_rPBalDLaPri_MAP "" MAP 0x8004A8BA KfAxU8AyU8SstxS16SstyS16WS16 1.999969 fak_sw_b1 -1.000000 0.9999695 FORMAT "%8.6"
 /begin AXIS_DESCR STD_AXIS TWCC_rPCtlErrPriB1 fak_sw_b1 7 -1.000000 0.9999695 FORMAT "%8.6" DEPOSIT ABSOLUTE /end AXIS_DESCR
 /begin AXIS_DESCR STD_AXIS TWCC_rPMsO2BalPriB1 fak_sw_b1 7 -1.000000 0.9999695 FORMAT "%8.6" DEPOSIT ABSOLUTE /end AXIS_DESCR
/end CHARACTERISTIC
/begin CHARACTERISTIC TWCC_rPBalHysDLaPri_C "" VALUE 0x8004A93C KwWS16 1.999969 fak_sw_b1 -1.000000 0.9999695 FORMAT "%8.6" /end CHARACTERISTIC
/begin CHARACTERISTIC TWCC_rPCoUsPri_C "" VALUE 0x8004A9DA KwWU8 100.5 rel_ub_q0p75 0.00 100.5 FORMAT "%5.1" /end CHARACTERISTIC
/begin CHARACTERISTIC TWCC_rSetPUsGlb_CUR "" CURVE 0x8004A750 KlAxU8SstxU16WS16 1.999969 fak_q3p0518Em5 -1.000000 0.9999695 FORMAT "%8.6"
 /begin AXIS_DESCR STD_AXIS TWCC_facOSCGlbB1 fak_q0p0078 2 0.00 1.992188 FORMAT "%8.6" DEPOSIT ABSOLUTE /end AXIS_DESCR
/end CHARACTERISTIC
/begin CHARACTERISTIC TWCC_stEngStTiPurg_C "" VALUE 0x8004A727 KwWU8 1.000 dez 0.00 1.000 FORMAT "%5.3" /end CHARACTERISTIC
/begin CHARACTERISTIC TWCC_stOBDFuelTrim_CW "" VALUE 0x8004A77C KwWU8 255.0 dez 0.00 255.0 FORMAT "%5.1" /end CHARACTERISTIC
/begin CHARACTERISTIC TWCC_stPriCont_CW "" VALUE 0x8004A93E KwWU16 65535.00 dez 0.00 65535.00 FORMAT "%8.2" /end CHARACTERISTIC
/begin CHARACTERISTIC TWCC_stPriEna_CW "" VALUE 0x8004A9DC KwWU16 65535.00 dez 0.00 65535.00 FORMAT "%8.2" /end CHARACTERISTIC
/begin CHARACTERISTIC TWCC_stPurg2_CW "" VALUE 0x8004A728 KwWU8 255.0 dez 0.00 255.0 FORMAT "%5.1" /end CHARACTERISTIC
/begin CHARACTERISTIC TWCC_stPurg_CW "" VALUE 0x8004A72A KwWU16 65535.00 dez 0.00 65535.00 FORMAT "%8.2" /end CHARACTERISTIC
/begin CHARACTERISTIC TWCC_tCatMaxTrim_C "" VALUE 0x8004A77E KwWU16 1535.977 temp_q0p0234_om273 -273.1500 1262.827 FORMAT "%8.3" /end CHARACTERISTIC
/begin CHARACTERISTIC TWCC_tCatMinTrim_C "" VALUE 0x8004A780 KwWU16 1535.977 temp_q0p0234_om273 -273.1500 1262.827 FORMAT "%8.3" /end CHARACTERISTIC
/begin CHARACTERISTIC TWCC_tiDebEngOnKSPurg_C "" VALUE 0x8004A72C KwWU16 655.3500 t_q0p01 0.00 655.3500 FORMAT "%8.4" /end CHARACTERISTIC
/begin CHARACTERISTIC TWCC_tiDebEngOnPurg_C "" VALUE 0x8004A72E KwWU16 655.3500 t_q0p01 0.00 655.3500 FORMAT "%8.4" /end CHARACTERISTIC
/begin CHARACTERISTIC TWCC_tiDynSetPPri_CUR "" CURVE 0x8004A940 KlAxU8SstxU16WU16 3276.700 t_q0p05 0.05000000 3276.750 FORMAT "%8.3"
 /begin AXIS_DESCR STD_AXIS msabnhk_w m_uw_b6553p5 4 0.00 6553.500 FORMAT "%8.3" DEPOSIT ABSOLUTE /end AXIS_DESCR
/end CHARACTERISTIC
/begin CHARACTERISTIC TWCC_tiEnaTrim_C "" VALUE 0x8004A782 KwWU16 655.34999985 zk10msxs_uw_b655p36 0.010000152590 655.36000000 FORMAT "%12.8" /end CHARACTERISTIC
/begin CHARACTERISTIC TWCC_tIEngPri_C "" VALUE 0x8004A9DE KwWU8 191.3 temp_q0p75_om48 -48.00 143.3 FORMAT "%5.1" /end CHARACTERISTIC
/begin CHARACTERISTIC TWCC_tiIDebFlCutPri_C "" VALUE 0x8004A9DF KwWU8 25.50 t_q0p1 0.00 25.50 FORMAT "%5.2" /end CHARACTERISTIC
/begin CHARACTERISTIC TWCC_tiIDebIdlSpdPri_C "" VALUE 0x8004A9E0 KwWU8 25.50 t_q0p1 0.00 25.50 FORMAT "%5.2" /end CHARACTERISTIC
/begin CHARACTERISTIC TWCC_tiIDebLdGradPri_C "" VALUE 0x8004A9E1 KwWU8 25.50 t_q0p1 0.00 25.50 FORMAT "%5.2" /end CHARACTERISTIC
/begin CHARACTERISTIC TWCC_tiIDebNLdPri_C "" VALUE 0x8004A9E2 KwWU8 25.50 t_q0p1 0.00 25.50 FORMAT "%5.2" /end CHARACTERISTIC
/begin CHARACTERISTIC TWCC_tiILamGradH2Pri_C "" VALUE 0x8004A9E4 KwWU16 65534.000000 zk1sxs_uw_b65535 1.0000000000 65535.000000 FORMAT "%12.6" /end CHARACTERISTIC
/begin CHARACTERISTIC TWCC_tiILamSwtH2Pri_C "" VALUE 0x8004A9E6 KwWU8 255.0 t_q1 0.00 255.0 FORMAT "%5.1" /end CHARACTERISTIC
/begin CHARACTERISTIC TWCC_tiILckDecelPri_C "" VALUE 0x8004A9E8 KwWU16 6553.500 t_q0p1 0.00 6553.500 FORMAT "%8.3" /end CHARACTERISTIC
/begin CHARACTERISTIC TWCC_tiILpLdGradPri_C "" VALUE 0x8004A9EA KwWU16 655.34999985 zk10msxs_uw_b655p36 0.010000152590 655.36000000 FORMAT "%12.8" /end CHARACTERISTIC
/begin CHARACTERISTIC TWCC_tiLpActPri_CUR "" CURVE 0x8004A952 KlAxU8SstxU16WU16 1310.6999997 zk20msxs_uw_b1310p72 0.020000305180 1310.7200000 FORMAT "%12.7"
 /begin AXIS_DESCR STD_AXIS msabnhk_w m_uw_b6553p5 4 0.00 6553.500 FORMAT "%8.3" DEPOSIT ABSOLUTE /end AXIS_DESCR
/end CHARACTERISTIC
/begin CHARACTERISTIC TWCC_tIMaxPri_C "" VALUE 0x8004A9EC KwWS16 6553.500 Temp_Cels -3549.940 3003.560 FORMAT "%8.3" /end CHARACTERISTIC
/begin CHARACTERISTIC TWCC_tIMinPri_CUR "" CURVE 0x8004A9EE GklWS16 6553.500 Temp_Cels -3549.940 3003.560 FORMAT "%8.3"
 /begin AXIS_DESCR COM_AXIS TWCC_facOSCPriB1 fak_uw_b2 2 0.00 1.999969 FORMAT "%8.6" AXIS_PTS_REF TWCC_facOSCPri_GCUR /end AXIS_DESCR
/end CHARACTERISTIC
/begin CHARACTERISTIC TWCC_tIMinTstReqPri_C "" VALUE 0x8004A9F2 KwWS16 6553.500 Temp_Cels -3549.940 3003.560 FORMAT "%8.3" /end CHARACTERISTIC
/begin CHARACTERISTIC TWCC_tiPDebCoUsPri_C "" VALUE 0x8004A9F4 KwWU8 25.50 t_q0p1 0.00 25.50 FORMAT "%5.2" /end CHARACTERISTIC
/begin CHARACTERISTIC TWCC_tiPDebLam1DrctPri_C "" VALUE 0x8004A9F5 KwWU8 25.50 t_q0p1 0.00 25.50 FORMAT "%5.2" /end CHARACTERISTIC
/begin CHARACTERISTIC TWCC_tiPDebLam1ErrPri_C "" VALUE 0x8004A9F6 KwWU8 25.50 t_q0p1 0.00 25.50 FORMAT "%5.2" /end CHARACTERISTIC
/begin CHARACTERISTIC TWCC_tiPLpCoUsPri_C "" VALUE 0x8004A9F7 KwWU8 25.4996 zk100msxs_ub_b25p5 0.100392 25.6000 FORMAT "%7.4" /end CHARACTERISTIC
/begin CHARACTERISTIC TWCC_tiPriOffTrim_C "" VALUE 0x8004A784 KwWU16 6553.500 t_q0p1 0.00 6553.500 FORMAT "%8.3" /end CHARACTERISTIC
/begin CHARACTERISTIC TWCC_tiPriOnTrim_C "" VALUE 0x8004A786 KwWU16 6553.500 t_q0p1 0.00 6553.500 FORMAT "%8.3" /end CHARACTERISTIC
/begin CHARACTERISTIC TWCC_tiRichTOutPurg_C "" VALUE 0x8004A730 KwWU16 1310.700 t_q0p02 0.00 1310.700 FORMAT "%8.3" /end CHARACTERISTIC
/begin CHARACTERISTIC TWCC_tiRmpLambdaSetPPurg_C "" VALUE 0x8004A732 KwWU16 1310.6999997 zk20msxs_uw_b1310p72 0.020000305180 1310.7200000 FORMAT "%12.7" /end CHARACTERISTIC
/begin CHARACTERISTIC TWCC_tMinThresPurg_C "" VALUE 0x8004A734 KwWS16 6553.500 Temp_Cels -3549.940 3003.560 FORMAT "%8.3" /end CHARACTERISTIC
/begin CHARACTERISTIC TWCC_tMotMinTrim_C "" VALUE 0x8004A788 KwWU8 191.3 temp_ub_q0p75_o48 -48.00 143.3 FORMAT "%5.1" /end CHARACTERISTIC
/begin CHARACTERISTIC TWCC_tPMaxPri_C "" VALUE 0x8004A9F8 KwWS16 6553.500 Temp_Cels -3549.940 3003.560 FORMAT "%8.3" /end CHARACTERISTIC
/begin CHARACTERISTIC TWCC_tPMinPri_CUR "" CURVE 0x8004A9FA GklWS16 6553.500 Temp_Cels -3549.940 3003.560 FORMAT "%8.3"
 /begin AXIS_DESCR COM_AXIS TWCC_facOSCPriB1 fak_uw_b2 2 0.00 1.999969 FORMAT "%8.6" AXIS_PTS_REF TWCC_facOSCPri_GCUR /end AXIS_DESCR
/end CHARACTERISTIC
/begin CHARACTERISTIC TWCC_tPMinTstReqPri_C "" VALUE 0x8004A9FE KwWS16 6553.500 Temp_Cels -3549.940 3003.560 FORMAT "%8.3" /end CHARACTERISTIC
/begin CHARACTERISTIC TWCC_uSetPPriB1_MAP "" MAP 0x8004A964 KfAxU8AyU8SstxU8SstyU8WU8 1.245 spg_q0p00488 0.00 1.245 FORMAT "%5.3"
 /begin AXIS_DESCR STD_AXIS Epm_nEngLRes nmot_ub_q40 6 0.00 10200. FORMAT "%5.0" DEPOSIT ABSOLUTE /end AXIS_DESCR
 /begin AXIS_DESCR STD_AXIS rl rel_ub_q0p75 6 0.00 191.3 FORMAT "%5.1" DEPOSIT ABSOLUTE /end AXIS_DESCR
/end CHARACTERISTIC
/begin CHARACTERISTIC TWCC_uThresLeanCat1Purg_C "" VALUE 0x8004A736 KwWU8 1.245 spg_q0p00488 0.00 1.245 FORMAT "%5.3" /end CHARACTERISTIC
/begin CHARACTERISTIC TWCC_uThresRichCat1Purg_C "" VALUE 0x8004A737 KwWU8 1.245 spg_q0p00488 0.00 1.245 FORMAT "%5.3" /end CHARACTERISTIC
/begin CHARACTERISTIC TWCD_AmpCompAppl_CW "" VALUE 0x8004AA5E KwWU8 255.0 dez 0.00 255.0 FORMAT "%5.1" /end CHARACTERISTIC
/begin CHARACTERISTIC TWCD_AmpComp_CW "" VALUE 0x8004AA5F KwWU8 255.0 dez 0.00 255.0 FORMAT "%5.1" /end CHARACTERISTIC
/begin CHARACTERISTIC TWCD_dmCatLdOfs_C "" VALUE 0x8004AA60 KwWU8 221.4 mgrad_ub_b221p35 0.00 221.4 FORMAT "%5.1" /end CHARACTERISTIC
/begin CHARACTERISTIC TWCD_facAmpComp_C "" VALUE 0x8004AA61 KwWU8 0.9961 fak_ub_b1 0.00 0.9961 /end CHARACTERISTIC
/begin CHARACTERISTIC TWCD_facAmplLamCtrlTstReq_C "" VALUE 0x8004AA62 KwWU8 7.969 fak_ub_b8 0.00 7.969 FORMAT "%5.3" /end CHARACTERISTIC
/begin CHARACTERISTIC TWCD_facAmplLamCtrl_C "" VALUE 0x8004AA63 KwWU8 7.969 fak_ub_b8 0.00 7.969 FORMAT "%5.3" /end CHARACTERISTIC
/begin CHARACTERISTIC TWCD_facAmp_C "" VALUE 0x8004AA64 KwWU8 25.50 fak_q0p1 0.00 25.50 FORMAT "%5.2" /end CHARACTERISTIC
/begin CHARACTERISTIC TWCD_facCatAgeIni_C "" VALUE 0x8004AA65 KwWU8 0.9961 fak_ub_b1 0.00 0.9961 /end CHARACTERISTIC
/begin CHARACTERISTIC TWCD_facCatLdRich_C "" VALUE 0x8004AA66 KwWU16 10000.00 q11p1_mg_DIV_V_s 0.00 10000.00 FORMAT "%8.2" /end CHARACTERISTIC
/begin CHARACTERISTIC TWCD_facCorAmp_CUR "" CURVE 0x8004AA68 KlAxU8SstxU16WU8 1.992188 fak_ub_b2 0.00 1.992188 FORMAT "%8.6"
 /begin AXIS_DESCR STD_AXIS TWCD_tAvrgCatB1 temp_q0p0234_o273 5 -273.1500 1262.827 FORMAT "%8.3" DEPOSIT ABSOLUTE /end AXIS_DESCR
/end CHARACTERISTIC
/begin CHARACTERISTIC TWCD_facCorAmp_MAP "" MAP 0x8004AA7A KfAxU8AyU8SstxU16SstyU16WU16 1.999969 fak_uw_b2 0.00 1.999969 FORMAT "%8.6"
 /begin AXIS_DESCR STD_AXIS TWCD_dmExhIntB1 m_uw_b6553p5 5 0.00 6553.500 FORMAT "%8.3" DEPOSIT ABSOLUTE /end AXIS_DESCR
 /begin AXIS_DESCR STD_AXIS TWCD_tAvrgCatB1 temp_q0p0234_o273 5 -273.1500 1262.827 FORMAT "%8.3" DEPOSIT ABSOLUTE /end AXIS_DESCR
/end CHARACTERISTIC
/begin CHARACTERISTIC TWCD_facCorS1Dyn_CUR "" CURVE 0x8004AAC4 KlAxU8SstxU16WU8 0.9961 fak_ub_b1 0.00 0.9961
 /begin AXIS_DESCR STD_AXIS HEGOD_tiDeltaFltPerB1 t_q0p01 3 0.00 655.3500 FORMAT "%8.4" DEPOSIT ABSOLUTE /end AXIS_DESCR
/end CHARACTERISTIC
/begin CHARACTERISTIC TWCD_facMaxLamCtrl_C "" VALUE 0x8004AAD0 KwWU8 0.9961 fak_ub_b1 0.00 0.9961 /end CHARACTERISTIC
/begin CHARACTERISTIC TWCD_facOSCInc_MAP "" MAP 0x8004AAD2 KfAxU8AyU8SstxU16SstyU16WU16 6553.500 m_q0p1_mg 0.00 6553.500 FORMAT "%8.3"
 /begin AXIS_DESCR STD_AXIS TWCD_dmExhIntB1 m_uw_b6553p5 10 0.00 6553.500 FORMAT "%8.3" DEPOSIT ABSOLUTE /end AXIS_DESCR
 /begin AXIS_DESCR STD_AXIS TWCD_tAvrgCatB1 temp_q0p0234_o273 10 -273.1500 1262.827 FORMAT "%8.3" DEPOSIT ABSOLUTE /end AXIS_DESCR
/end CHARACTERISTIC
/begin CHARACTERISTIC TWCD_frqCatO2LdMaxTstReq_C "" VALUE 0x8004AA00 KwWS16 1023.984 freq_sw_b512 -512.0000 511.9844 FORMAT "%8.4" /end CHARACTERISTIC
/begin CHARACTERISTIC TWCD_frqCatO2LdMax_CUR "" CURVE 0x8004AA02 KlAxU8SstxU16WS16 1023.969 freq_sw_b512 -511.9844 511.9844 FORMAT "%8.4"
 /begin AXIS_DESCR STD_AXIS ml_w m_uw_b6553p5 5 0.00 6553.500 FORMAT "%8.3" DEPOSIT ABSOLUTE /end AXIS_DESCR
/end CHARACTERISTIC
/begin CHARACTERISTIC TWCD_mCatStrMdl_C "" VALUE 0x8004ABC6 KwWU8 220.5 m_ub_b221p35 0.8681 221.4 FORMAT "%5.1" /end CHARACTERISTIC
/begin CHARACTERISTIC TWCD_nEngMax_C "" VALUE 0x8004AA18 KwWU8 10200. nmot_ub_q40 0.00 10200. FORMAT "%5.0" /end CHARACTERISTIC
/begin CHARACTERISTIC TWCD_nEngMin_C "" VALUE 0x8004AA19 KwWU8 10200. nmot_ub_q40 0.00 10200. FORMAT "%5.0" /end CHARACTERISTIC
/begin CHARACTERISTIC TWCD_nEngTstReqMax_C "" VALUE 0x8004AA1A KwWU8 10200. nmot_ub_q40 0.00 10200. FORMAT "%5.0" /end CHARACTERISTIC
/begin CHARACTERISTIC TWCD_nEngTstReqMin_C "" VALUE 0x8004AA1B KwWU8 10200. nmot_ub_q40 0.00 10200. FORMAT "%5.0" /end CHARACTERISTIC
/begin CHARACTERISTIC TWCD_rAmpAbsHys_C "" VALUE 0x8004ABC7 KwWU8 0.9961 fak_ub_b1 0.00 0.9961 /end CHARACTERISTIC
/begin CHARACTERISTIC TWCD_rAmpMin_C "" VALUE 0x8004ABC8 KwWU8 0.9961 fak_ub_b1 0.00 0.9961 /end CHARACTERISTIC
/begin CHARACTERISTIC TWCD_rAmpRelHys_C "" VALUE 0x8004ABC9 KwWU8 0.9961 fak_ub_b1 0.00 0.9961 /end CHARACTERISTIC
/begin CHARACTERISTIC TWCD_rCatLdIntglMax_C "" VALUE 0x8004AA1C KwWS8 1.992 fak_sb_b1 -1.000 0.9922 FORMAT "%5.3" /end CHARACTERISTIC
/begin CHARACTERISTIC TWCD_rCatLdMinTstReq_C "" VALUE 0x8004ABCA KwWU8 0.9961 fak_ub_b1 0.00 0.9961 /end CHARACTERISTIC
/begin CHARACTERISTIC TWCD_rCatLdMin_C "" VALUE 0x8004ABCB KwWU8 0.9961 fak_ub_b1 0.00 0.9961 /end CHARACTERISTIC
/begin CHARACTERISTIC TWCD_rLdChgMaxTstReq_C "" VALUE 0x8004AA1D KwWU8 191.3 rel_ub_q0p75 0.00 191.3 FORMAT "%5.1" /end CHARACTERISTIC
/begin CHARACTERISTIC TWCD_rLdChgMax_C "" VALUE 0x8004AA1E KwWU8 191.3 rel_ub_q0p75 0.00 191.3 FORMAT "%5.1" /end CHARACTERISTIC
/begin CHARACTERISTIC TWCD_rLdMax_CUR "" CURVE 0x8004AA1F KlAxU8SstxU8WU8 191.3 rel_ub_q0p75 0.00 191.3 FORMAT "%5.1"
 /begin AXIS_DESCR STD_AXIS Epm_nEngLRes nmot_ub_q40 5 0.00 10200. FORMAT "%5.0" DEPOSIT ABSOLUTE /end AXIS_DESCR
/end CHARACTERISTIC
/begin CHARACTERISTIC TWCD_rLdMin_CUR "" CURVE 0x8004AA2A KlAxU8SstxU8WU8 191.3 rel_ub_q0p75 0.00 191.3 FORMAT "%5.1"
 /begin AXIS_DESCR STD_AXIS Epm_nEngLRes nmot_ub_q40 5 0.00 10200. FORMAT "%5.0" DEPOSIT ABSOLUTE /end AXIS_DESCR
/end CHARACTERISTIC
/begin CHARACTERISTIC TWCD_rLdTstReqMax_C "" VALUE 0x8004AA35 KwWU8 191.3 rel_ub_q0p75 0.00 191.3 FORMAT "%5.1" /end CHARACTERISTIC
/begin CHARACTERISTIC TWCD_rLdTstReqMin_C "" VALUE 0x8004AA36 KwWU8 191.3 rel_ub_q0p75 0.00 191.3 FORMAT "%5.1" /end CHARACTERISTIC
/begin CHARACTERISTIC TWCD_rOSCThresB1_C "" VALUE 0x8004ABF2 KwWU16 15.99976 fak_uw_b16 0.00 15.99976 FORMAT "%8.5" /end CHARACTERISTIC
/begin CHARACTERISTIC TWCD_rOSCThresTstReqB1_C "" VALUE 0x8004ABF4 KwWU16 15.99976 fak_uw_b16 0.00 15.99976 FORMAT "%8.5" /end CHARACTERISTIC
/begin CHARACTERISTIC TWCD_stAmpEna_CW "" VALUE 0x8004AA37 KwWU8 255.0 dez 0.00 255.0 FORMAT "%5.1" /end CHARACTERISTIC
/begin CHARACTERISTIC TWCD_tEngStrtMin_C "" VALUE 0x8004AA38 KwWU8 191.3 temp_ub_q0p75_o48 -48.00 143.3 FORMAT "%5.1" /end CHARACTERISTIC
/begin CHARACTERISTIC TWCD_tiDebLdCng_C "" VALUE 0x8004AA39 KwWU8 12.75 t_q0p05 0.00 12.75 FORMAT "%5.2" /end CHARACTERISTIC
/begin CHARACTERISTIC TWCD_tiDiagTstReq_C "" VALUE 0x8004ABCC KwWU16 819.0000 t_q0p05 0.00 819.0000 FORMAT "%8.4" /end CHARACTERISTIC
/begin CHARACTERISTIC TWCD_tiDiag_C "" VALUE 0x8004ABCE KwWU16 819.0000 t_q0p05 0.00 819.0000 FORMAT "%8.4" /end CHARACTERISTIC
/begin CHARACTERISTIC TWCD_tiDlyBal_C "" VALUE 0x8004ABD0 KwWU8 12.75 t_q0p05 0.00 12.75 FORMAT "%5.2" /end CHARACTERISTIC
/begin CHARACTERISTIC TWCD_tiFltAmp_C "" VALUE 0x8004ABD2 KwWU16 3276.7499992 zk50msxs_uw_b3276p8 0.050000762951 3276.8000000 FORMAT "%12.7" /end CHARACTERISTIC
/begin CHARACTERISTIC TWCD_tiFltCatLdB1_CUR "" CURVE 0x8004ABD4 KlAxU8SstxU16WU8 12.70 t_q0p05 0.05000 12.75 FORMAT "%5.2"
 /begin AXIS_DESCR STD_AXIS TWCD_dmExhIntB1 m_uw_b6553p5 5 0.00 6553.500 FORMAT "%8.3" DEPOSIT ABSOLUTE /end AXIS_DESCR
/end CHARACTERISTIC
/begin CHARACTERISTIC TWCD_tiFltEngLd_C "" VALUE 0x8004AA3A KwWU8 12.7498 zk50msxs_ub_b12p8 0.0501961 12.8000 FORMAT "%7.4" /end CHARACTERISTIC
/begin CHARACTERISTIC TWCD_tiFltLamCtrl_C "" VALUE 0x8004ABE6 KwWU16 3276.7499992 zk50msxs_uw_b3276p8 0.050000762951 3276.8000000 FORMAT "%12.7" /end CHARACTERISTIC
/begin CHARACTERISTIC TWCD_tiFltMeanVltg_C "" VALUE 0x8004ABE8 KwWU8 12.7498 zk50msxs_ub_b12p8 0.0501961 12.8000 FORMAT "%7.4" /end CHARACTERISTIC
/begin CHARACTERISTIC TWCD_tiFltTemp_C "" VALUE 0x8004AA3C KwWU16 13106.999997 zk200msxs_uw_b13107p2 0.20000305180 13107.200000 FORMAT "%12.6" /end CHARACTERISTIC
/begin CHARACTERISTIC TWCD_tiFltVltgDif_C "" VALUE 0x8004ABE9 KwWU8 12.7498 zk50msxs_ub_b12p8 0.0501961 12.8000 FORMAT "%7.4" /end CHARACTERISTIC
/begin CHARACTERISTIC TWCD_tiGasMixBefCat_C "" VALUE 0x8004ABEA KwWU16 3276.7499992 zk50msxs_uw_b3276p8 0.050000762951 3276.8000000 FORMAT "%12.7" /end CHARACTERISTIC
/begin CHARACTERISTIC TWCD_tiIniInteg_C "" VALUE 0x8004ABEC KwWU16 3276.750 t_q0p05 0.00 3276.750 FORMAT "%8.3" /end CHARACTERISTIC
/begin CHARACTERISTIC TWCD_tiStopDeb_C "" VALUE 0x8004AA3E KwWU8 12.75 t_q0p05 0.00 12.75 FORMAT "%5.2" /end CHARACTERISTIC
/begin CHARACTERISTIC TWCD_tiStopLdCng_CUR "" CURVE 0x8004AA3F KlAxU8SstxU8WU8 12.75 t_q0p05 0.00 12.75 FORMAT "%5.2"
 /begin AXIS_DESCR STD_AXIS TWCD_rLdCng rel_ub_q0p75 3 0.00 191.3 FORMAT "%5.1" DEPOSIT ABSOLUTE /end AXIS_DESCR
/end CHARACTERISTIC
/begin CHARACTERISTIC TWCD_tiStopTempGrdt_CUR "" CURVE 0x8004AA46 KlAxU8SstxU16WU16 13107.00 t_q0p2 0.00 13107.00 FORMAT "%8.2"
 /begin AXIS_DESCR STD_AXIS TWCD_tGrdtB1 temp_q0p0234 4 0.00 1535.977 FORMAT "%8.3" DEPOSIT ABSOLUTE /end AXIS_DESCR
/end CHARACTERISTIC
/begin CHARACTERISTIC TWCD_tMax_C "" VALUE 0x8004AA58 KwWU16 1535.977 temp_q0p0234_o273 -273.1500 1262.827 FORMAT "%8.3" /end CHARACTERISTIC
/begin CHARACTERISTIC TWCD_tMin_C "" VALUE 0x8004AA5A KwWU16 1535.977 temp_q0p0234_o273 -273.1500 1262.827 FORMAT "%8.3" /end CHARACTERISTIC
/begin CHARACTERISTIC TWCD_trqResv_C "" VALUE 0x8004ABEE KwWU16 99.99847 rel_uw_b100 0.00 99.99847 FORMAT "%8.5" /end CHARACTERISTIC
/begin CHARACTERISTIC TWCD_tTstReqMin_C "" VALUE 0x8004AA5C KwWU16 1535.977 temp_q0p0234_o273 -273.1500 1262.827 FORMAT "%8.3" /end CHARACTERISTIC
/begin CHARACTERISTIC TWCD_uS2MdlFac_C "" VALUE 0x8004ABF0 KwWU8 1.245 spg_q0p00488 0.00 1.245 FORMAT "%5.3" /end CHARACTERISTIC
/begin CHARACTERISTIC TWCD_uS2MdlMean_C "" VALUE 0x8004ABF1 KwWU8 1.245 spg_q0p00488 0.00 1.245 FORMAT "%5.3" /end CHARACTERISTIC
/begin CHARACTERISTIC VehMot_rTrqDfftl_C "" VALUE 0x8004AC3C KwWS16 655.3500 TransR -327.6800 327.6700 FORMAT "%8.4" /end CHARACTERISTIC
/begin CHARACTERISTIC VehV_ctDvtMax_C "" VALUE 0x8004BF14 Val_Wu8 255.0 OneToOne 0.00 255.0 FORMAT "%5.1" /end CHARACTERISTIC
/begin CHARACTERISTIC VehV_ctDvtMin_C "" VALUE 0x8004BF15 Val_Wu8 255.0 OneToOne 0.00 255.0 FORMAT "%5.1" /end CHARACTERISTIC
/begin CHARACTERISTIC VehV_facTireAxlCorrMax_C "" VALUE 0x8004BF18 Val_Wu32 16033212.0000 PerKm 10000.0000000 16043212.0000 FORMAT "%13.4" /end CHARACTERISTIC
/begin CHARACTERISTIC VehV_facTireAxlCorrMin_C "" VALUE 0x8004BF1C Val_Wu32 16043212.0000 PerKm 0.00 16043212.0000 FORMAT "%13.4" /end CHARACTERISTIC
/begin CHARACTERISTIC VehV_nThresPla_C "" VALUE 0x8004BF34 Val_Ws16 16383.50 EngN 0.00 16383.50 FORMAT "%8.2" /end CHARACTERISTIC
/begin CHARACTERISTIC VehV_numSegSens_C "" VALUE 0x8004BF20 Val_Wu8 49.00 OneToOne 1.000 50.00 FORMAT "%5.2" /end CHARACTERISTIC
/begin CHARACTERISTIC VehV_rAxl_C "" VALUE 0x8004BF24 Val_Wu32 4.00000000000 Fact0002 2.00000000000 6.00000000000 FORMAT "%13.11" /end CHARACTERISTIC
/begin CHARACTERISTIC VehV_rThresWhlErr_C "" VALUE 0x8004BF28 Val_Ws16 655.3500 Prc_q0p01_COMPU -327.6800 327.6700 FORMAT "%8.4" /end CHARACTERISTIC
/begin CHARACTERISTIC VehV_swtCANSensErrEna_C "" VALUE 0x8004BF36 Val_Wu8 1.000 OneToOne 0.00 1.000 FORMAT "%5.3" /end CHARACTERISTIC
/begin CHARACTERISTIC VehV_swtSig_C "" VALUE 0x8004BF2A Val_Wu8 1.000 OneToOne 0.00 1.000 FORMAT "%5.3" /end CHARACTERISTIC
/begin CHARACTERISTIC VehV_swtTrqSel_C "" VALUE 0x8004BF37 Val_Wu8 1.000 OneToOne 0.00 1.000 FORMAT "%5.3" /end CHARACTERISTIC
/begin CHARACTERISTIC VehV_tiAPT1_C "" VALUE 0x8004BF38 Val_Ws32 4294.9672940 TimeDelay_s 0.000002000000001 4294.9672960 FORMAT "%12.7" /end CHARACTERISTIC
/begin CHARACTERISTIC VehV_tiDebMonPla_C "" VALUE 0x8004BF3C Val_Ws16 327670.0 Time_ms 0.00 327670.0 FORMAT "%8.1" /end CHARACTERISTIC
/begin CHARACTERISTIC VehV_tiPerMax_C "" VALUE 0x8004BF2C Val_Ws32 8134407.75000 Time_PwmHigh 0.00 8134407.75000 FORMAT "%13.5" /end CHARACTERISTIC
/begin CHARACTERISTIC VehV_tiVPT1_C "" VALUE 0x8004BF40 Val_Ws32 4294.9672940 TimeDelay_s 0.000002000000001 4294.9672960 FORMAT "%12.7" /end CHARACTERISTIC
/begin CHARACTERISTIC VehV_tiVRawPT1_C "" VALUE 0x8004BF44 Val_Ws32 4294.9672940 TimeDelay_s 0.000002000000001 4294.9672960 FORMAT "%12.7" /end CHARACTERISTIC
/begin CHARACTERISTIC VehV_trqThresPla_C "" VALUE 0x8004BF48 Val_Ws16 3276.700 Trq 0.00 3276.700 FORMAT "%8.3" /end CHARACTERISTIC
/begin CHARACTERISTIC VehV_vDfl_C "" VALUE 0x8004BF4A Val_Ws16 327.6700 Vel 0.00 327.6700 FORMAT "%8.4" /end CHARACTERISTIC
/begin CHARACTERISTIC VehV_vLowThres_C "" VALUE 0x8004BF4C Val_Ws16 327.6700 Vel 0.00 327.6700 FORMAT "%8.4" /end CHARACTERISTIC
/begin CHARACTERISTIC VehV_vMaxFix_C "" VALUE 0x8004BF4E Val_Ws16 327.6700 Vel 0.00 327.6700 FORMAT "%8.4" /end CHARACTERISTIC
/begin CHARACTERISTIC VehV_vMax_C "" VALUE 0x8004BF50 Val_Ws16 327.6700 Vel 0.00 327.6700 FORMAT "%8.4" /end CHARACTERISTIC
/begin CHARACTERISTIC VehV_vMin_C "" VALUE 0x8004BF52 Val_Ws16 20.00000 Vel 0.00 20.00000 FORMAT "%8.5" /end CHARACTERISTIC
/begin CHARACTERISTIC VehV_vThresPla_C "" VALUE 0x8004BF54 Val_Ws16 327.6700 Vel 0.00 327.6700 FORMAT "%8.4" /end CHARACTERISTIC
/begin CHARACTERISTIC VehV_vWhlErrMax_C "" VALUE 0x8004BF30 Val_Ws16 655.3500 Vel -327.6800 327.6700 FORMAT "%8.4" /end CHARACTERISTIC
/begin CHARACTERISTIC VehV_vWhlErrMin_C "" VALUE 0x8004BF32 Val_Ws16 655.3500 Vel -327.6800 327.6700 FORMAT "%8.4" /end CHARACTERISTIC
/begin CHARACTERISTIC VFZGMX "" VALUE 0x8004AC38 KwWU16 511.9922 vfzg_uw_q0p00781 0.00 511.9922 FORMAT "%8.4" /end CHARACTERISTIC
/begin CHARACTERISTIC VFZMN "" VALUE 0x8004AC3E KwWU16 511.9922 vfzg_uw_b512 0.00 511.9922 FORMAT "%8.4" /end CHARACTERISTIC
/begin CHARACTERISTIC ZWAPPL "" VALUE 0x8004AD13 KwWS8 191.3 kw_q0p75 -96.00 95.25 FORMAT "%5.2" /end CHARACTERISTIC
/begin CHARACTERISTIC ZWBASFST "" VALUE 0x8004AD14 KwWS8 191.3 kw_q0p75 -96.00 95.25 FORMAT "%5.2" /end CHARACTERISTIC
/begin MEASUREMENT ahkat "" UBYTE fak_ub_b1 1 100 0.00 0.9961 ECU_ADDRESS 0xD0000EDF /end MEASUREMENT
/begin MEASUREMENT ahkatn "" UBYTE fak_ub_b1 1 100 0.00 0.9961 ECU_ADDRESS 0xD0000EE0 /end MEASUREMENT
/begin MEASUREMENT ahktki_w "" UWORD t50msxs_uw_b819p2 1 100 0.00 819.1875 FORMAT "%8.4" ECU_ADDRESS 0xD0000AF6 /end MEASUREMENT
/begin MEASUREMENT ahktnk "" UBYTE fak_ub_b1 1 100 0.00 0.9961 ECU_ADDRESS 0xD0000EE1 /end MEASUREMENT
/begin MEASUREMENT akatbn "" UBYTE fak_ub_b1 1 100 0.00 0.9961 ECU_ADDRESS 0xD0000EE2 /end MEASUREMENT
/begin MEASUREMENT avkatf "" UBYTE fak_ub_b1 1 100 0.00 0.9961 ECU_ADDRESS 0xAFE801AF /end MEASUREMENT
/begin MEASUREMENT BFlSign_EB.buffer "" UBYTE B_TRUE 1 100 0.00 1.00000000000 BIT_MASK 0x1 FORMAT "%13.11" ECU_ADDRESS 0xD00017C4 /end MEASUREMENT
/begin MEASUREMENT BFlSign_EB.oldSignal "" UBYTE B_TRUE 1 100 0.00 1.00000000000 BIT_MASK 0x1 FORMAT "%13.11" ECU_ADDRESS 0xD00017C5 /end MEASUREMENT
/begin MEASUREMENT bfzgl_w "" SWORD bfzg_sw_q4p239Em4 1 100 -13.8903552 13.8899313 ECU_ADDRESS 0xD0000B0E /end MEASUREMENT
/begin MEASUREMENT B_clhker "" UBYTE B_TRUE 1 100 0.00 1.00000000000 BIT_MASK 0x40 FORMAT "%13.11" ECU_ADDRESS 0xD0000084 /end MEASUREMENT
/begin MEASUREMENT B_dktakt "" UBYTE B_TRUE 1 100 0.00 1.00000000000 BIT_MASK 0x2 FORMAT "%13.11" ECU_ADDRESS 0xD0000072 /end MEASUREMENT
/begin MEASUREMENT B_dktcfin "" UBYTE B_TRUE 1 100 0.00 1.00000000000 BIT_MASK 0x1 FORMAT "%13.11" ECU_ADDRESS 0xD0000070 /end MEASUREMENT
/begin MEASUREMENT B_dktlk "" UBYTE B_TRUE 1 100 0.00 1.00000000000 BIT_MASK 0x8 FORMAT "%13.11" ECU_ADDRESS 0xD000009D /end MEASUREMENT
/begin MEASUREMENT B_dktlp "" UBYTE B_TRUE 1 100 0.00 1.00000000000 BIT_MASK 0x20 FORMAT "%13.11" ECU_ADDRESS 0xD000005A /end MEASUREMENT
/begin MEASUREMENT B_dktnr "" UBYTE B_TRUE 1 100 0.00 1.00000000000 BIT_MASK 0x1 FORMAT "%13.11" ECU_ADDRESS 0xD000008D /end MEASUREMENT
/begin MEASUREMENT B_dktsb "" UBYTE B_TRUE 1 100 0.00 1.00000000000 BIT_MASK 0x4 FORMAT "%13.11" ECU_ADDRESS 0xD0000067 /end MEASUREMENT
/begin MEASUREMENT B_dktsp "" UBYTE B_TRUE 1 100 0.00 1.00000000000 BIT_MASK 0x40 FORMAT "%13.11" ECU_ADDRESS 0xD000005C /end MEASUREMENT
/begin MEASUREMENT B_dktst "" UBYTE B_TRUE 1 100 0.00 1.00000000000 BIT_MASK 0x10 FORMAT "%13.11" ECU_ADDRESS 0xD0000098 /end MEASUREMENT
/begin MEASUREMENT B_dktt "" UBYTE B_TRUE 1 100 0.00 1.00000000000 BIT_MASK 0x10 FORMAT "%13.11" ECU_ADDRESS 0xD000006E /end MEASUREMENT
/begin MEASUREMENT B_dkttk "" UBYTE B_TRUE 1 100 0.00 1.00000000000 BIT_MASK 0x20 FORMAT "%13.11" ECU_ADDRESS 0xD0000086 /end MEASUREMENT
/begin MEASUREMENT B_fakatv "" UBYTE B_TRUE 1 100 0.00 1.00000000000 BIT_MASK 0x1 FORMAT "%13.11" ECU_ADDRESS 0xD0000093 /end MEASUREMENT
/begin MEASUREMENT B_ff "" UBYTE B_TRUE 1 100 0.00 1.00000000000 BIT_MASK 0x4 FORMAT "%13.11" ECU_ADDRESS 0xD0000058 /end MEASUREMENT
/begin MEASUREMENT B_lamka "" UBYTE B_TRUE 1 100 0.00 1.00000000000 BIT_MASK 0x8 FORMAT "%13.11" ECU_ADDRESS 0xD0000080 /end MEASUREMENT
/begin MEASUREMENT B_lrhk "" UBYTE B_TRUE 1 100 0.00 1.00000000000 BIT_MASK 0x40 FORMAT "%13.11" ECU_ADDRESS 0xD000006A /end MEASUREMENT
/begin MEASUREMENT B_lrhkp "" UBYTE B_TRUE 1 100 0.00 1.00000000000 BIT_MASK 0x8 FORMAT "%13.11" ECU_ADDRESS 0xD0000085 /end MEASUREMENT
/begin MEASUREMENT B_lrka "" UBYTE B_TRUE 1 100 0.00 1.00000000000 BIT_MASK 0x10 FORMAT "%13.11" ECU_ADDRESS 0xD000005E /end MEASUREMENT
/begin MEASUREMENT B_lrkat "" UBYTE B_TRUE 1 100 0.00 1.00000000000 BIT_MASK 0x10 FORMAT "%13.11" ECU_ADDRESS 0xD0000058 /end MEASUREMENT
/begin MEASUREMENT B_stz_ER.buffer "" UBYTE B_TRUE 1 100 0.00 1.00000000000 BIT_MASK 0x1 FORMAT "%13.11" ECU_ADDRESS 0xD0001774 /end MEASUREMENT
/begin MEASUREMENT B_stz_ER.oldSignal "" UBYTE B_TRUE 1 100 0.00 1.00000000000 BIT_MASK 0x1 FORMAT "%13.11" ECU_ADDRESS 0xD0001775 /end MEASUREMENT
/begin MEASUREMENT B_st_EF.buffer "" UBYTE B_TRUE 1 100 0.00 1.00000000000 BIT_MASK 0x1 FORMAT "%13.11" ECU_ADDRESS 0xD0001770 /end MEASUREMENT
/begin MEASUREMENT B_st_EF.oldSignal "" UBYTE B_TRUE 1 100 0.00 1.00000000000 BIT_MASK 0x1 FORMAT "%13.11" ECU_ADDRESS 0xD0001771 /end MEASUREMENT
/begin MEASUREMENT B_st_FF.status "" UBYTE B_TRUE 1 100 0.00 1.00000000000 BIT_MASK 0x1 FORMAT "%13.11" ECU_ADDRESS 0xD0001772 /end MEASUREMENT
/begin MEASUREMENT B_tmsdkt "" UBYTE B_TRUE 1 100 0.00 1.00000000000 BIT_MASK 0x8 FORMAT "%13.11" ECU_ADDRESS 0xD0000083 /end MEASUREMENT
/begin MEASUREMENT B_vekat "" UBYTE B_TRUE 1 100 0.00 1.00000000000 BIT_MASK 0x10 FORMAT "%13.11" ECU_ADDRESS 0xD000007C /end MEASUREMENT
/begin MEASUREMENT B_vekati "" UBYTE B_TRUE 1 100 0.00 1.00000000000 BIT_MASK 0x20 FORMAT "%13.11" ECU_ADDRESS 0xD0000072 /end MEASUREMENT
/begin MEASUREMENT B_vmax "" UBYTE B_TRUE 1 100 0.00 1.00000000000 BIT_MASK 0x80 FORMAT "%13.11" ECU_ADDRESS 0xD0000083 /end MEASUREMENT
/begin MEASUREMENT B_vnull "" UBYTE B_TRUE 1 100 0.00 1.00000000000 BIT_MASK 0x10 FORMAT "%13.11" ECU_ADDRESS 0xD000008A /end MEASUREMENT
/begin MEASUREMENT B_zdkti "" UBYTE B_TRUE 1 100 0.00 1.00000000000 BIT_MASK 0x20 FORMAT "%13.11" ECU_ADDRESS 0xD0000091 /end MEASUREMENT
/begin MEASUREMENT B_zwgrusyn "" UBYTE B_TRUE 1 100 0.00 1.00000000000 BIT_MASK 0x4 FORMAT "%13.11" ECU_ADDRESS 0xD0000072 /end MEASUREMENT
/begin MEASUREMENT B_zwmnst "" UBYTE B_TRUE 1 100 0.00 1.00000000000 BIT_MASK 0x8 FORMAT "%13.11" ECU_ADDRESS 0xD0000054 /end MEASUREMENT
/begin MEASUREMENT B_zwspae "" UBYTE B_TRUE 1 100 0.00 1.00000000000 BIT_MASK 0x10 FORMAT "%13.11" ECU_ADDRESS 0xD0000061 /end MEASUREMENT
/begin MEASUREMENT CoVeh_trqAcs "" SWORD Trq 1 100 -3276.800 3276.700 FORMAT "%8.3" ECU_ADDRESS 0xD00034AE /end MEASUREMENT
/begin MEASUREMENT dkatakt_w "" UWORD t_q0p05 1 100 0.00 3276.750 FORMAT "%8.3" ECU_ADDRESS 0xD0000AF8 /end MEASUREMENT
/begin MEASUREMENT dktval_w "" UWORD fak_uw_b16 1 100 0.00 15.99976 FORMAT "%8.5" ECU_ADDRESS 0xD0000B0C /end MEASUREMENT
/begin MEASUREMENT dlahc_w "" SWORD fak_q3p0518Em5 1 100 -1.000000 0.9999695 FORMAT "%8.6" ECU_ADDRESS 0xD0000ACC /end MEASUREMENT
/begin MEASUREMENT dlahi_w "" SWORD fak_q3p0518Em5 1 100 -1.000000 0.9999695 FORMAT "%8.6" ECU_ADDRESS 0xD0000ACE /end MEASUREMENT
/begin MEASUREMENT dlahkab_w "" SWORD fak_q3p0518Em5 1 100 -1.000000 0.9999695 FORMAT "%8.6" ECU_ADDRESS 0xD0000AD0 /end MEASUREMENT
/begin MEASUREMENT dlahp_w "" SWORD fak_q3p0518Em5 1 100 -1.000000 0.9999695 FORMAT "%8.6" ECU_ADDRESS 0xD0000AD2 /end MEASUREMENT
/begin MEASUREMENT dlashk_w "" SWORD fak_q3p0518Em5 1 100 -1.000000 0.9999695 FORMAT "%8.6" ECU_ADDRESS 0xD0000AD4 /end MEASUREMENT
/begin MEASUREMENT dlaskat_w "" SWORD fak_q3p0518Em5 1 100 -1.000000 0.9999695 FORMAT "%8.6" ECU_ADDRESS 0xD0000AA2 /end MEASUREMENT
/begin MEASUREMENT dlastrm_w "" SWORD fak_q3p0518Em5 1 100 -1.000000 0.9999695 FORMAT "%8.6" ECU_ADDRESS 0xD0000AD6 /end MEASUREMENT
/begin MEASUREMENT dlatrmc_w "" SWORD fak_q3p0518Em5 1 100 -1.000000 0.9999695 FORMAT "%8.6" ECU_ADDRESS 0xD0000AD8 /end MEASUREMENT
/begin MEASUREMENT dlatrmi_w "" SWORD fak_q3p0518Em5 1 100 -1.000000 0.9999695 FORMAT "%8.6" ECU_ADDRESS 0xD0000ADA /end MEASUREMENT
/begin MEASUREMENT dmrdkt_w "" UWORD rel_uw_b100 1 100 0.00 99.99847 FORMAT "%8.5" ECU_ADDRESS 0xD0000AFA /end MEASUREMENT
/begin MEASUREMENT dvsi_w "" SWORD vfzg_sw_q0p00781 1 100 -256.0000 255.9922 FORMAT "%8.4" ECU_ADDRESS 0xD0000B14 /end MEASUREMENT
/begin MEASUREMENT dzwkg "" SBYTE kw_q0p75 1 100 -96.00 95.25 FORMAT "%5.2" ECU_ADDRESS 0xD0000EF6 /end MEASUREMENT
/begin MEASUREMENT dzwks "" SBYTE zw_sb_q0p75 1 100 -96.00 95.25 FORMAT "%5.2" ECU_ADDRESS 0xD0000EFB /end MEASUREMENT
/begin MEASUREMENT dzwmnlam "" SBYTE kw_q0p75 1 100 -96.00 95.25 FORMAT "%5.2" ECU_ADDRESS 0xD0000EFD /end MEASUREMENT
/begin MEASUREMENT dzwmntm "" SBYTE kw_q0p75 1 100 -96.00 95.25 FORMAT "%5.2" ECU_ADDRESS 0xD0000EFE /end MEASUREMENT
/begin MEASUREMENT dzwwl "" SBYTE zw_sb_q0p75 1 100 -96.00 95.25 FORMAT "%5.2" ECU_ADDRESS 0xD0000F11 /end MEASUREMENT
/begin MEASUREMENT falrdkt "" UBYTE fak_ub_b8 1 100 0.00 7.969 FORMAT "%5.3" ECU_ADDRESS 0xD0000EE3 /end MEASUREMENT
/begin MEASUREMENT fcoscxk "" UBYTE fak_q0p0078 1 100 0.00 1.992 FORMAT "%5.3" ECU_ADDRESS 0xD0000ED4 /end MEASUREMENT
/begin MEASUREMENT fcoscxk_EB.buffer "" UBYTE B_TRUE 1 100 0.00 1.00000000000 BIT_MASK 0x1 FORMAT "%13.11" ECU_ADDRESS 0xD00017EC /end MEASUREMENT
/begin MEASUREMENT fcoscxk_EB.oldSignal "" UBYTE B_TRUE 1 100 0.00 1.00000000000 BIT_MASK 0x1 FORMAT "%13.11" ECU_ADDRESS 0xD00017ED /end MEASUREMENT
/begin MEASUREMENT fdktav_w "" UWORD fak_uw_b16 1 100 0.00 15.99976 FORMAT "%8.5" ECU_ADDRESS 0xD0000AFC /end MEASUREMENT
/begin MEASUREMENT ftsztl "" UBYTE fak_ub_b1 1 100 0.00 0.9961 ECU_ADDRESS 0xD0000EEC /end MEASUREMENT
/begin MEASUREMENT fubaanz "" UBYTE dez 1 100 0.00 255.0 FORMAT "%5.1" ECU_ADDRESS 0xD0000EED /end MEASUREMENT
/begin MEASUREMENT fzwmn_w "" UWORD fak_uw_b1 1 100 0.00 0.9999847 FORMAT "%9.7" ECU_ADDRESS 0xD0000B24 /end MEASUREMENT
/begin MEASUREMENT katbf "" UBYTE spg_ub_q0p0052_o0p2 1 100 -0.2000 1.130 FORMAT "%5.3" ECU_ADDRESS 0xD0000EE4 /end MEASUREMENT
/begin MEASUREMENT katbfi_w "" SWORD freq_sw_b512 1 100 -512.0000 511.9844 FORMAT "%8.4" ECU_ADDRESS 0xD0000AFE /end MEASUREMENT
/begin MEASUREMENT KATBFML_LT.memory "" SLONG fak_q4p657Em10 1 100 -0.999999370426 0.999999369961 FORMAT "%14.12" ECU_ADDRESS 0xD0001824 /end MEASUREMENT
/begin MEASUREMENT katbfs "" SBYTE fak_sb_b1 1 100 -1.000 0.9922 FORMAT "%5.3" ECU_ADDRESS 0xD0000EE5 /end MEASUREMENT
/begin MEASUREMENT katbshd_w "" SWORD mgrad_sw_b28p44 1 100 -28.44444 28.44358 FORMAT "%8.5" ECU_ADDRESS 0xD0000B00 /end MEASUREMENT
/begin MEASUREMENT kdlrhki_w "" UWORD fak_q0p00015259 1 100 0.00 9.999847 FORMAT "%8.6" ECU_ADDRESS 0xD0000ADC /end MEASUREMENT
/begin MEASUREMENT lamka_w "" UWORD fak_uw_b16 1 100 0.00 15.99976 FORMAT "%8.5" ECU_ADDRESS 0xD0000AA0 /end MEASUREMENT
/begin MEASUREMENT lasonhk_w "" UWORD fak_uw_b2 1 100 0.00 1.999969 FORMAT "%8.6" ECU_ADDRESS 0xD0000ADE /end MEASUREMENT
/begin MEASUREMENT mivmxi_w "" UWORD rel_uw_b100 1 100 0.00 99.99847 FORMAT "%8.5" ECU_ADDRESS 0xD0000B16 /end MEASUREMENT
/begin MEASUREMENT mivmxp_w "" SWORD rel_sw_b100 1 100 -100.0000 99.99695 FORMAT "%8.4" ECU_ADDRESS 0xD0000B18 /end MEASUREMENT
/begin MEASUREMENT mivmx_w "" UWORD rel_uw_b100 1 100 0.00 99.99847 FORMAT "%8.5" ECU_ADDRESS 0xD0000B1E /end MEASUREMENT
/begin MEASUREMENT nmotzwstt "" UBYTE nmot_ub_q40 1 100 0.00 10200. FORMAT "%5.0" ECU_ADDRESS 0xD0000F0E /end MEASUREMENT
/begin MEASUREMENT osctvdkt_w "" UWORD m_q0p1_mg 1 100 0.00 6553.500 FORMAT "%8.3" ECU_ADDRESS 0xD0000B02 /end MEASUREMENT
/begin MEASUREMENT ovlzes "" UBYTE dez 1 100 0.00 255.0 FORMAT "%5.1" ECU_ADDRESS 0xD0000EEE /end MEASUREMENT
/begin MEASUREMENT rldkthb "" UBYTE rel_ub_q0p75 1 100 0.00 191.3 FORMAT "%5.1" ECU_ADDRESS 0xD0000EE9 /end MEASUREMENT
/begin MEASUREMENT s1p56lsf_w "" SWORD fak_sw_b1 1 100 -1.000000 0.9999695 FORMAT "%8.6" ECU_ADDRESS 0xD0000AB2 /end MEASUREMENT
/begin MEASUREMENT szouttem_w "" UWORD t_q0p001 1 100 0.00 65.53500 FORMAT "%8.5" ECU_ADDRESS 0xD0000B20 /end MEASUREMENT
/begin MEASUREMENT szout_w "" UWORD t_q0p001 1 100 0.00 65.53500 FORMAT "%8.5" ECU_ADDRESS 0xD0000B22 /end MEASUREMENT
/begin MEASUREMENT tkivhkm_w "" UWORD temp_q0p0234_o273 1 100 -273.1500 1262.827 FORMAT "%8.3" ECU_ADDRESS 0xD0000B04 /end MEASUREMENT
/begin MEASUREMENT tmzwstt "" UBYTE temp_q1_om40 1 100 -40.00 215.0 FORMAT "%5.1" ECU_ADDRESS 0xD0000F0F /end MEASUREMENT
/begin MEASUREMENT TWCC_BalCat1B1_I.bEngOffMark "" UBYTE B_TRUE 1 100 0.00 1.00000000000 BIT_MASK 0x1 FORMAT "%13.11" ECU_ADDRESS 0xD0001780 /end MEASUREMENT
/begin MEASUREMENT TWCC_BalCat1B1_I.bEngOffO2 "" UBYTE B_TRUE 1 100 0.00 1.00000000000 BIT_MASK 0x2 FORMAT "%13.11" ECU_ADDRESS 0xD0001780 /end MEASUREMENT
/begin MEASUREMENT TWCC_BalCat1B1_I.bLeanPurg "" UBYTE B_TRUE 1 100 0.00 1.00000000000 BIT_MASK 0x4 FORMAT "%13.11" ECU_ADDRESS 0xD0001780 /end MEASUREMENT
/begin MEASUREMENT TWCC_BalCat1B1_I.bLeanSt "" UBYTE B_TRUE 1 100 0.00 1.00000000000 BIT_MASK 0x1 FORMAT "%13.11" ECU_ADDRESS 0xD0001781 /end MEASUREMENT
/begin MEASUREMENT TWCC_BalCat1B1_I.bO2Max "" UBYTE B_TRUE 1 100 0.00 1.00000000000 BIT_MASK 0x8 FORMAT "%13.11" ECU_ADDRESS 0xD0001780 /end MEASUREMENT
/begin MEASUREMENT TWCC_BalCat1B1_I.bO2MinThres "" UBYTE B_TRUE 1 100 0.00 1.00000000000 BIT_MASK 0x10 FORMAT "%13.11" ECU_ADDRESS 0xD0001780 /end MEASUREMENT
/begin MEASUREMENT TWCC_BalCat1B1_I.bRichReq "" UBYTE B_TRUE 1 100 0.00 1.00000000000 BIT_MASK 0x1 FORMAT "%13.11" ECU_ADDRESS 0xD0001782 /end MEASUREMENT
/begin MEASUREMENT TWCC_BalCat1B1_I.bRichSt "" UBYTE B_TRUE 1 100 0.00 1.00000000000 BIT_MASK 0x1 FORMAT "%13.11" ECU_ADDRESS 0xD0001783 /end MEASUREMENT
/begin MEASUREMENT TWCC_BalCat1B1_I.bRstSensRich "" UBYTE B_TRUE 1 100 0.00 1.00000000000 BIT_MASK 0x20 FORMAT "%13.11" ECU_ADDRESS 0xD0001780 /end MEASUREMENT
/begin MEASUREMENT TWCC_BalCat1B1_I.bSensLean "" UBYTE B_TRUE 1 100 0.00 1.00000000000 BIT_MASK 0x40 FORMAT "%13.11" ECU_ADDRESS 0xD0001780 /end MEASUREMENT
/begin MEASUREMENT TWCC_BalCat1B1_I.mO2 "" UWORD m_q0p1_mg 1 100 0.00 6553.500 FORMAT "%8.3" ECU_ADDRESS 0xD0001784 /end MEASUREMENT
/begin MEASUREMENT TWCC_BalCat1B1_I.mO2Max "" UWORD m_q0p1_mg 1 100 0.00 6553.500 FORMAT "%8.3" ECU_ADDRESS 0xD0001786 /end MEASUREMENT
/begin MEASUREMENT TWCC_BalCat1B1_I.O2_IKL.memory "" ULONG m_q0p1_mg 1 100 0.00 429496729.500 FORMAT "%13.3" ECU_ADDRESS 0xD0001788 /end MEASUREMENT
/begin MEASUREMENT TWCC_BalCat1B1_I.SensLeanER_I.buffer "" UBYTE B_TRUE 1 100 0.00 1.00000000000 BIT_MASK 0x1 FORMAT "%13.11" ECU_ADDRESS 0xD000178C /end MEASUREMENT
/begin MEASUREMENT TWCC_BalCat1B1_I.SensLeanER_I.oldSignal "" UBYTE B_TRUE 1 100 0.00 1.00000000000 BIT_MASK 0x1 FORMAT "%13.11" ECU_ADDRESS 0xD000178D /end MEASUREMENT
/begin MEASUREMENT TWCC_bClrCtlPriB1 "" UBYTE B_TRUE 1 100 0.00 1.00000000000 BIT_MASK 0x4 FORMAT "%13.11" ECU_ADDRESS 0xD0000074 /end MEASUREMENT
/begin MEASUREMENT TWCC_bCtlLimMaxPriB1 "" UBYTE B_TRUE 1 100 0.00 1.00000000000 BIT_MASK 0x80 FORMAT "%13.11" ECU_ADDRESS 0xD000008C /end MEASUREMENT
/begin MEASUREMENT TWCC_bCtlLimMinPriB1 "" UBYTE B_TRUE 1 100 0.00 1.00000000000 BIT_MASK 0x8 FORMAT "%13.11" ECU_ADDRESS 0xD0000060 /end MEASUREMENT
/begin MEASUREMENT TWCC_bDebEngOnPurg "" UBYTE B_TRUE 1 100 0.00 1.00000000000 BIT_MASK 0x4 FORMAT "%13.11" ECU_ADDRESS 0xD000004B /end MEASUREMENT
/begin MEASUREMENT TWCC_bEnaLeanPurgB1 "" UBYTE B_TRUE 1 100 0.00 1.00000000000 BIT_MASK 0x10 FORMAT "%13.11" ECU_ADDRESS 0xD000004B /end MEASUREMENT
/begin MEASUREMENT TWCC_bEnaRichPurgB1 "" UBYTE B_TRUE 1 100 0.00 1.00000000000 BIT_MASK 0x40 FORMAT "%13.11" ECU_ADDRESS 0xD0000078 /end MEASUREMENT
/begin MEASUREMENT TWCC_bEnaTrimB1 "" UBYTE B_TRUE 1 100 0.00 1.00000000000 BIT_MASK 0x10 FORMAT "%13.11" ECU_ADDRESS 0xD000004C /end MEASUREMENT
/begin MEASUREMENT TWCC_bEngOffPurg "" UBYTE B_TRUE 1 100 0.00 1.00000000000 BIT_MASK 0x2 FORMAT "%13.11" ECU_ADDRESS 0xD000004B /end MEASUREMENT
/begin MEASUREMENT TWCC_bErrDebTrimB1 "" UBYTE B_TRUE 1 100 0.00 1.00000000000 BIT_MASK 0x4 FORMAT "%13.11" ECU_ADDRESS 0xD000004D /end MEASUREMENT
/begin MEASUREMENT TWCC_bFrzFrmPresTrimB1 "" UBYTE B_TRUE 1 100 0.00 1.00000000000 BIT_MASK 0x20 FORMAT "%13.11" ECU_ADDRESS 0xD000004D /end MEASUREMENT
/begin MEASUREMENT TWCC_bHldTrimB1 "" UBYTE B_TRUE 1 100 0.00 1.00000000000 BIT_MASK 0x40 FORMAT "%13.11" ECU_ADDRESS 0xD000004C /end MEASUREMENT
/begin MEASUREMENT TWCC_bIBalPriB1 "" UBYTE B_TRUE 1 100 0.00 1.00000000000 BIT_MASK 0x8 FORMAT "%13.11" ECU_ADDRESS 0xD0000050 /end MEASUREMENT
/begin MEASUREMENT TWCC_bICoPriB1 "" UBYTE B_TRUE 1 100 0.00 1.00000000000 BIT_MASK 0x4 FORMAT "%13.11" ECU_ADDRESS 0xD0000050 /end MEASUREMENT
/begin MEASUREMENT TWCC_bIGlbBalPri "" UBYTE B_TRUE 1 100 0.00 1.00000000000 BIT_MASK 0x80 FORMAT "%13.11" ECU_ADDRESS 0xD000004E /end MEASUREMENT
/begin MEASUREMENT TWCC_bIGlbCPPri "" UBYTE B_TRUE 1 100 0.00 1.00000000000 BIT_MASK 0x40 FORMAT "%13.11" ECU_ADDRESS 0xD000004E /end MEASUREMENT
/begin MEASUREMENT TWCC_bIGlbLckErrPri "" UBYTE B_TRUE 1 100 0.00 1.00000000000 BIT_MASK 0x1 FORMAT "%13.11" ECU_ADDRESS 0xD000004F /end MEASUREMENT
/begin MEASUREMENT TWCC_bIGlbPri "" UBYTE B_TRUE 1 100 0.00 1.00000000000 BIT_MASK 0x2 FORMAT "%13.11" ECU_ADDRESS 0xD000004F /end MEASUREMENT
/begin MEASUREMENT TWCC_bIH2DLaPriB1 "" UBYTE B_TRUE 1 100 0.00 1.00000000000 BIT_MASK 0x1 FORMAT "%13.11" ECU_ADDRESS 0xD000004E /end MEASUREMENT
/begin MEASUREMENT TWCC_bIH2LckPriB1 "" UBYTE B_TRUE 1 100 0.00 1.00000000000 BIT_MASK 0x2 FORMAT "%13.11" ECU_ADDRESS 0xD000004E /end MEASUREMENT
/begin MEASUREMENT TWCC_bILckErrPriB1 "" UBYTE B_TRUE 1 100 0.00 1.00000000000 BIT_MASK 0x40 FORMAT "%13.11" ECU_ADDRESS 0xD0000095 /end MEASUREMENT
/begin MEASUREMENT TWCC_bIPriB1 "" UBYTE B_TRUE 1 100 0.00 1.00000000000 BIT_MASK 0x4 FORMAT "%13.11" ECU_ADDRESS 0xD0000057 /end MEASUREMENT
/begin MEASUREMENT TWCC_bISysPriB1 "" UBYTE B_TRUE 1 100 0.00 1.00000000000 BIT_MASK 0x20 FORMAT "%13.11" ECU_ADDRESS 0xD0000050 /end MEASUREMENT
/begin MEASUREMENT TWCC_bITempPriB1 "" UBYTE B_TRUE 1 100 0.00 1.00000000000 BIT_MASK 0x10 FORMAT "%13.11" ECU_ADDRESS 0xD0000050 /end MEASUREMENT
/begin MEASUREMENT TWCC_bLamAvrgTrimB1 "" UBYTE B_TRUE 1 100 0.00 1.00000000000 BIT_MASK 0x20 FORMAT "%13.11" ECU_ADDRESS 0xD000004C /end MEASUREMENT
/begin MEASUREMENT TWCC_bLamCtlTrimB1 "" UBYTE B_TRUE 1 100 0.00 1.00000000000 BIT_MASK 0x1 FORMAT "%13.11" ECU_ADDRESS 0xD000004D /end MEASUREMENT
/begin MEASUREMENT TWCC_bLamJmpTrimB1 "" UBYTE B_TRUE 1 100 0.00 1.00000000000 BIT_MASK 0x80 FORMAT "%13.11" ECU_ADDRESS 0xD000004C /end MEASUREMENT
/begin MEASUREMENT TWCC_bLeanInCat1PurgB1 "" UBYTE B_TRUE 1 100 0.00 1.00000000000 BIT_MASK 0x1 FORMAT "%13.11" ECU_ADDRESS 0xD000004C /end MEASUREMENT
/begin MEASUREMENT TWCC_bLeanPurgB1 "" UBYTE B_TRUE 1 100 0.00 1.00000000000 BIT_MASK 0x8 FORMAT "%13.11" ECU_ADDRESS 0xD000004B /end MEASUREMENT
/begin MEASUREMENT TWCC_bLeanStCat1PurgB1 "" UBYTE B_TRUE 1 100 0.00 1.00000000000 BIT_MASK 0x80 FORMAT "%13.11" ECU_ADDRESS 0xD000004B /end MEASUREMENT
/begin MEASUREMENT TWCC_bLimpCoPriB1 "" UBYTE B_TRUE 1 100 0.00 1.00000000000 BIT_MASK 0x4 FORMAT "%13.11" ECU_ADDRESS 0xD000004F /end MEASUREMENT
/begin MEASUREMENT TWCC_bLimpPriB1 "" UBYTE B_TRUE 1 100 0.00 1.00000000000 BIT_MASK 0x1 FORMAT "%13.11" ECU_ADDRESS 0xD000005C /end MEASUREMENT
/begin MEASUREMENT TWCC_bMaxErrTrimB1 "" UBYTE B_TRUE 1 100 0.00 1.00000000000 BIT_MASK 0x8 FORMAT "%13.11" ECU_ADDRESS 0xD000004D /end MEASUREMENT
/begin MEASUREMENT TWCC_bMinErrTrimB1 "" UBYTE B_TRUE 1 100 0.00 1.00000000000 BIT_MASK 0x10 FORMAT "%13.11" ECU_ADDRESS 0xD000004D /end MEASUREMENT
/begin MEASUREMENT TWCC_bNoErrTrimB1 "" UBYTE B_TRUE 1 100 0.00 1.00000000000 BIT_MASK 0x80 FORMAT "%13.11" ECU_ADDRESS 0xD000004D /end MEASUREMENT
/begin MEASUREMENT TWCC_bPBalPriB1 "" UBYTE B_TRUE 1 100 0.00 1.00000000000 BIT_MASK 0x40 FORMAT "%13.11" ECU_ADDRESS 0xD000004F /end MEASUREMENT
/begin MEASUREMENT TWCC_bPCoBalPriB1 "" UBYTE B_TRUE 1 100 0.00 1.00000000000 BIT_MASK 0x8 FORMAT "%13.11" ECU_ADDRESS 0xD000004F /end MEASUREMENT
/begin MEASUREMENT TWCC_bPCoPriB1 "" UBYTE B_TRUE 1 100 0.00 1.00000000000 BIT_MASK 0x10 FORMAT "%13.11" ECU_ADDRESS 0xD000004F /end MEASUREMENT
/begin MEASUREMENT TWCC_bPDynTempPriB1 "" UBYTE B_TRUE 1 100 0.00 1.00000000000 BIT_MASK 0x1 FORMAT "%13.11" ECU_ADDRESS 0xD0000050 /end MEASUREMENT
/begin MEASUREMENT TWCC_bPGlbBalPri "" UBYTE B_TRUE 1 100 0.00 1.00000000000 BIT_MASK 0x10 FORMAT "%13.11" ECU_ADDRESS 0xD000004E /end MEASUREMENT
/begin MEASUREMENT TWCC_bPGlbLckDiaPri "" UBYTE B_TRUE 1 100 0.00 1.00000000000 BIT_MASK 0x8 FORMAT "%13.11" ECU_ADDRESS 0xD000004E /end MEASUREMENT
/begin MEASUREMENT TWCC_bPGlbLckErrPri "" UBYTE B_TRUE 1 100 0.00 1.00000000000 BIT_MASK 0x4 FORMAT "%13.11" ECU_ADDRESS 0xD000004E /end MEASUREMENT
/begin MEASUREMENT TWCC_bPGlbPri "" UBYTE B_TRUE 1 100 0.00 1.00000000000 BIT_MASK 0x20 FORMAT "%13.11" ECU_ADDRESS 0xD000004E /end MEASUREMENT
/begin MEASUREMENT TWCC_bPLckErrPriB1 "" UBYTE B_TRUE 1 100 0.00 1.00000000000 BIT_MASK 0x80 FORMAT "%13.11" ECU_ADDRESS 0xD000006D /end MEASUREMENT
/begin MEASUREMENT TWCC_bPPriB1 "" UBYTE B_TRUE 1 100 0.00 1.00000000000 BIT_MASK 0x40 FORMAT "%13.11" ECU_ADDRESS 0xD000005D /end MEASUREMENT
/begin MEASUREMENT TWCC_bPSysPriB1 "" UBYTE B_TRUE 1 100 0.00 1.00000000000 BIT_MASK 0x2 FORMAT "%13.11" ECU_ADDRESS 0xD0000050 /end MEASUREMENT
/begin MEASUREMENT TWCC_bPTempPriB1 "" UBYTE B_TRUE 1 100 0.00 1.00000000000 BIT_MASK 0x80 FORMAT "%13.11" ECU_ADDRESS 0xD000004F /end MEASUREMENT
/begin MEASUREMENT TWCC_bRichInCat1PurgB1 "" UBYTE B_TRUE 1 100 0.00 1.00000000000 BIT_MASK 0x4 FORMAT "%13.11" ECU_ADDRESS 0xD000004C /end MEASUREMENT
/begin MEASUREMENT TWCC_bRichReqCat1PurgB1 "" UBYTE B_TRUE 1 100 0.00 1.00000000000 BIT_MASK 0x20 FORMAT "%13.11" ECU_ADDRESS 0xD000004B /end MEASUREMENT
/begin MEASUREMENT TWCC_bRichReqPurgB1 "" UBYTE B_TRUE 1 100 0.00 1.00000000000 BIT_MASK 0x40 FORMAT "%13.11" ECU_ADDRESS 0xD000004B /end MEASUREMENT
/begin MEASUREMENT TWCC_bRichStCat1PurgB1 "" UBYTE B_TRUE 1 100 0.00 1.00000000000 BIT_MASK 0x2 FORMAT "%13.11" ECU_ADDRESS 0xD000004C /end MEASUREMENT
/begin MEASUREMENT TWCC_bRstCatPurgB1 "" UBYTE B_TRUE 1 100 0.00 1.00000000000 BIT_MASK 0x8 FORMAT "%13.11" ECU_ADDRESS 0xD000004C /end MEASUREMENT
/begin MEASUREMENT TWCC_bRstPurgB1 "" UBYTE B_TRUE 1 100 0.00 1.00000000000 BIT_MASK 0x80 FORMAT "%13.11" ECU_ADDRESS 0xD0000099 /end MEASUREMENT
/begin MEASUREMENT TWCC_bSimContTrimB1 "" UBYTE B_TRUE 1 100 0.00 1.00000000000 BIT_MASK 0x40 FORMAT "%13.11" ECU_ADDRESS 0xD000004D /end MEASUREMENT
/begin MEASUREMENT TWCC_bStabTrimB1 "" UBYTE B_TRUE 1 100 0.00 1.00000000000 BIT_MASK 0x2 FORMAT "%13.11" ECU_ADDRESS 0xD000004D /end MEASUREMENT
/begin MEASUREMENT TWCC_dmEnaTrimB1 "" SWORD m_q0p1 1 100 -3276.800 3276.700 FORMAT "%8.3" ECU_ADDRESS 0xD0000AA4 /end MEASUREMENT
/begin MEASUREMENT TWCC_dmO2Cat1PurgB1 "" SWORD m_q0p1_mgs 1 100 -3276.800 3276.700 FORMAT "%8.3" ECU_ADDRESS 0xD0000A98 /end MEASUREMENT
/begin MEASUREMENT TWCC_dtPMsO2BalPriB1 "" SWORD m_q0p1_mg 1 100 -3276.800 3276.700 FORMAT "%8.3" ECU_ADDRESS 0xD0000AB4 /end MEASUREMENT
/begin MEASUREMENT TWCC_EnaDynTrimB1IK_I.memory "" ULONG m_q1p526Em6_g 1 100 0.00 6553.59999847 FORMAT "%13.8" ECU_ADDRESS 0xD0001790 /end MEASUREMENT
/begin MEASUREMENT TWCC_EngOffPurgER_I.buffer "" UBYTE B_TRUE 1 100 0.00 1.00000000000 BIT_MASK 0x1 FORMAT "%13.11" ECU_ADDRESS 0xD0001776 /end MEASUREMENT
/begin MEASUREMENT TWCC_EngOffPurgER_I.oldSignal "" UBYTE B_TRUE 1 100 0.00 1.00000000000 BIT_MASK 0x1 FORMAT "%13.11" ECU_ADDRESS 0xD0001777 /end MEASUREMENT
/begin MEASUREMENT TWCC_facCtlLowTrimB1 "" SWORD fak_sw_b1 1 100 -1.000000 0.9999695 FORMAT "%8.6" ECU_ADDRESS 0xD0000AA6 /end MEASUREMENT
/begin MEASUREMENT TWCC_facCtlTrimB1 "" SWORD fak_sw_b1 1 100 -1.000000 0.9999695 FORMAT "%8.6" ECU_ADDRESS 0xD0000AA8 /end MEASUREMENT
/begin MEASUREMENT TWCC_facIGnCtlPriB1 "" UWORD fak_q0p00015259 1 100 0.00 9.999847 FORMAT "%8.6" ECU_ADDRESS 0xD0003622 /end MEASUREMENT
/begin MEASUREMENT TWCC_facOSCGlbB1 "" UBYTE fak_q0p0078 1 100 0.00 1.992 FORMAT "%5.3" ECU_ADDRESS 0xD0000ED1 /end MEASUREMENT
/begin MEASUREMENT TWCC_facOSCPriB1 "" UWORD fak_uw_b2 1 100 0.00 1.999969 FORMAT "%8.6" ECU_ADDRESS 0xD0000AE2 /end MEASUREMENT
/begin MEASUREMENT TWCC_facPGnCtlPriB1 "" UBYTE fak_ub_b4 1 100 0.00 3.984 FORMAT "%5.3" ECU_ADDRESS 0xD0000ED5 /end MEASUREMENT
/begin MEASUREMENT TWCC_FuelCutOffPurgB1TOFFV_I.outbit "" UBYTE B_TRUE 1 100 0.00 1.00000000000 BIT_MASK 0x1 FORMAT "%13.11" ECU_ADDRESS 0xD0001778 /end MEASUREMENT
/begin MEASUREMENT TWCC_FuelCutOffPurgB1TOFFV_I.time "" UWORD t_q0p02 1 100 0.00 1310.700 FORMAT "%8.3" ECU_ADDRESS 0xD000177A /end MEASUREMENT
/begin MEASUREMENT TWCC_IBalPriB1IK_I.memory "" ULONG m_q1p695Em6 1 100 0.00 7281.77777608 FORMAT "%13.8" ECU_ADDRESS 0xD00017F0 /end MEASUREMENT
/begin MEASUREMENT TWCC_IDLaH2PriB1LT_I.memory "" SLONG fak_q4p6566Em11 1 100 -0.100000000000 0.0999999999534 FORMAT "%14.12" ECU_ADDRESS 0xD00017F4 /end MEASUREMENT
/begin MEASUREMENT TWCC_ILamSwtH2PriB1EF_I.buffer "" UBYTE B_TRUE 1 100 0.00 1.00000000000 BIT_MASK 0x1 FORMAT "%13.11" ECU_ADDRESS 0xD00017F8 /end MEASUREMENT
/begin MEASUREMENT TWCC_ILamSwtH2PriB1EF_I.oldSignal "" UBYTE B_TRUE 1 100 0.00 1.00000000000 BIT_MASK 0x1 FORMAT "%13.11" ECU_ADDRESS 0xD00017F9 /end MEASUREMENT
/begin MEASUREMENT TWCC_ILamSwtH2PriB1T_I.timeCounter "" UBYTE t_q1 1 100 0.00 255.0 FORMAT "%5.1" ECU_ADDRESS 0xD00017FA /end MEASUREMENT
/begin MEASUREMENT TWCC_ILdGradPriLT_I.memory "" SLONG rel_q3p576Em7 1 100 -768.000000000 767.999999642 FORMAT "%13.9" ECU_ADDRESS 0xD00017FC /end MEASUREMENT
/begin MEASUREMENT TWCC_ILdGradPriTOFFV_I.outbit "" UBYTE B_TRUE 1 100 0.00 1.00000000000 BIT_MASK 0x1 FORMAT "%13.11" ECU_ADDRESS 0xD0001800 /end MEASUREMENT
/begin MEASUREMENT TWCC_ILdGradPriTOFFV_I.time "" UBYTE t_q0p1 1 100 0.00 25.50 FORMAT "%5.2" ECU_ADDRESS 0xD0001801 /end MEASUREMENT
/begin MEASUREMENT TWCC_INLdPriTOFFV_I.outbit "" UBYTE B_TRUE 1 100 0.00 1.00000000000 BIT_MASK 0x1 FORMAT "%13.11" ECU_ADDRESS 0xD0001802 /end MEASUREMENT
/begin MEASUREMENT TWCC_INLdPriTOFFV_I.time "" UBYTE t_q0p1 1 100 0.00 25.50 FORMAT "%5.2" ECU_ADDRESS 0xD0001803 /end MEASUREMENT
/begin MEASUREMENT TWCC_IOSCRlsH2PriB1IK_I.memory "" ULONG m_q3p0518Em7_mgO2 1 100 0.00 1310.71999969 FORMAT "%13.8" ECU_ADDRESS 0xD0001804 /end MEASUREMENT
/begin MEASUREMENT TWCC_LamAvrgB1ERNM_I.oldSignal "" UBYTE B_TRUE 1 100 0.00 1.00000000000 BIT_MASK 0x1 FORMAT "%13.11" ECU_ADDRESS 0xD0001794 /end MEASUREMENT
/begin MEASUREMENT TWCC_LamAvrgTrimB1_I.bLamAvrgOkTrim "" UBYTE B_TRUE 1 100 0.00 1.00000000000 BIT_MASK 0x1 FORMAT "%13.11" ECU_ADDRESS 0xD0001798 /end MEASUREMENT
/begin MEASUREMENT TWCC_LamAvrgTrimB1_I.mExhSum "" SLONG m_uw_b6553p5 1 100 -214748364.800 214748364.700 FORMAT "%13.3" ECU_ADDRESS 0xD000179C /end MEASUREMENT
/begin MEASUREMENT TWCC_LamAvrgTrimB1_I.mLamSum "" SLONG fak_q3p0518Em6 1 100 -6553.60000000 6553.59999695 FORMAT "%13.8" ECU_ADDRESS 0xD00017A0 /end MEASUREMENT
/begin MEASUREMENT TWCC_LamAvrgTrimB1_I.LamJmpCTR_I.counter "" UBYTE dez 1 100 0.00 255.0 FORMAT "%5.1" ECU_ADDRESS 0xD00017A4 /end MEASUREMENT
/begin MEASUREMENT TWCC_mHldTrimB1IK_I.memory "" ULONG m_q1p526Em6_g 1 100 0.00 6553.59999847 FORMAT "%13.8" ECU_ADDRESS 0xD00017B4 /end MEASUREMENT
/begin MEASUREMENT TWCC_mIBalPThresPriB1 "" UWORD m_uw_b7281 1 100 0.00 7281.667 FORMAT "%8.3" ECU_ADDRESS 0xD0000AE4 /end MEASUREMENT
/begin MEASUREMENT TWCC_mIBalThresPriB1 "" UWORD m_uw_b7281 1 100 0.00 7281.667 FORMAT "%8.3" ECU_ADDRESS 0xD0000AE6 /end MEASUREMENT
/begin MEASUREMENT TWCC_mO2EngOffCat1PurgB1 "" UWORD m_q0p1_mg 1 100 0.00 6553.500 FORMAT "%8.3" ECU_ADDRESS 0xAFE80148 /end MEASUREMENT
/begin MEASUREMENT TWCC_mO2StCat1PurgB1 "" UWORD m_q0p1_mg 1 100 0.00 6553.500 FORMAT "%8.3" ECU_ADDRESS 0xD0003624 /end MEASUREMENT
/begin MEASUREMENT TWCC_mO2StPurgB1 "" UWORD m_q0p1_mg 1 100 0.00 6553.500 FORMAT "%8.3" ECU_ADDRESS 0xD0003626 /end MEASUREMENT
/begin MEASUREMENT TWCC_mOSCCat1PurgB1 "" UWORD m_q0p1_mg 1 100 0.00 6553.500 FORMAT "%8.3" ECU_ADDRESS 0xD0000A9A /end MEASUREMENT
/begin MEASUREMENT TWCC_mPBalThresPriB1 "" UWORD m_uw_b7281 1 100 0.00 7281.667 FORMAT "%8.3" ECU_ADDRESS 0xD0000AE8 /end MEASUREMENT
/begin MEASUREMENT TWCC_nEngSimContTrimB1 "" UWORD nmot_q0p25 1 100 0.00 16383.75 FORMAT "%8.2" ECU_ADDRESS 0xD0000AAA /end MEASUREMENT
/begin MEASUREMENT TWCC_PBalPriB1IK_I.memory "" ULONG m_q1p695Em6 1 100 0.00 7281.77777608 FORMAT "%13.8" ECU_ADDRESS 0xD0001808 /end MEASUREMENT
/begin MEASUREMENT TWCC_PCoUsPriB1HDR_I.hysterese "" UBYTE B_TRUE 1 100 0.00 1.00000000000 BIT_MASK 0x1 FORMAT "%13.11" ECU_ADDRESS 0xD000180C /end MEASUREMENT
/begin MEASUREMENT TWCC_PCoUsPriB1LT_I.memory "" UWORD rel_q2p929Em3 1 100 0.00 191.9971 FORMAT "%8.4" ECU_ADDRESS 0xD000180E /end MEASUREMENT
/begin MEASUREMENT TWCC_PCoUsPriB1TOFFV_I.outbit "" UBYTE B_TRUE 1 100 0.00 1.00000000000 BIT_MASK 0x1 FORMAT "%13.11" ECU_ADDRESS 0xD0001810 /end MEASUREMENT
/begin MEASUREMENT TWCC_PCoUsPriB1TOFFV_I.time "" UBYTE t_q0p1 1 100 0.00 25.50 FORMAT "%5.2" ECU_ADDRESS 0xD0001811 /end MEASUREMENT
/begin MEASUREMENT TWCC_PhSyncB1_I.rActPer "" UWORD fak_uw_b2 1 100 0.00 1.999969 FORMAT "%8.6" ECU_ADDRESS 0xD00017CC /end MEASUREMENT
/begin MEASUREMENT TWCC_PhSyncB1_I.rPhAvrg "" SWORD fak_sw_b1 1 100 -1.000000 0.9999695 FORMAT "%8.6" ECU_ADDRESS 0xD00017CE /end MEASUREMENT
/begin MEASUREMENT TWCC_PhSyncB1_I.rPrevPer "" UWORD fak_uw_b2 1 100 0.00 1.999969 FORMAT "%8.6" ECU_ADDRESS 0xD00017D0 /end MEASUREMENT
/begin MEASUREMENT TWCC_PhSyncB1_I.sm "" UBYTE OneToOne 1 100 0.00 2.000 FORMAT "%5.3" ECU_ADDRESS 0xD00017D2 /end MEASUREMENT
/begin MEASUREMENT TWCC_PID15B "" SBYTE fak_q0p0078 1 100 -1.000 0.9922 FORMAT "%5.3" ECU_ADDRESS 0xD0003BE7 /end MEASUREMENT
/begin MEASUREMENT TWCC_PLam1DrctPriB1TOFFV_I.outbit "" UBYTE B_TRUE 1 100 0.00 1.00000000000 BIT_MASK 0x1 FORMAT "%13.11" ECU_ADDRESS 0xD0001812 /end MEASUREMENT
/begin MEASUREMENT TWCC_PLam1DrctPriB1TOFFV_I.time "" UBYTE t_q0p1 1 100 0.00 25.50 FORMAT "%5.2" ECU_ADDRESS 0xD0001813 /end MEASUREMENT
/begin MEASUREMENT TWCC_PLam1ErrPriB1TOFFV_I.outbit "" UBYTE B_TRUE 1 100 0.00 1.00000000000 BIT_MASK 0x1 FORMAT "%13.11" ECU_ADDRESS 0xD0001814 /end MEASUREMENT
/begin MEASUREMENT TWCC_PLam1ErrPriB1TOFFV_I.time "" UBYTE t_q0p1 1 100 0.00 25.50 FORMAT "%5.2" ECU_ADDRESS 0xD0001815 /end MEASUREMENT
/begin MEASUREMENT TWCC_PLam1PriB1ER_I.buffer "" UBYTE B_TRUE 1 100 0.00 1.00000000000 BIT_MASK 0x1 FORMAT "%13.11" ECU_ADDRESS 0xD0001816 /end MEASUREMENT
/begin MEASUREMENT TWCC_PLam1PriB1ER_I.oldSignal "" UBYTE B_TRUE 1 100 0.00 1.00000000000 BIT_MASK 0x1 FORMAT "%13.11" ECU_ADDRESS 0xD0001817 /end MEASUREMENT
/begin MEASUREMENT TWCC_PMsO2BalPriB1IK_I.memory "" SLONG m_q1p5259Em6_mg 1 100 -3276.80000000 3276.79999847 FORMAT "%13.8" ECU_ADDRESS 0xD00017C8 /end MEASUREMENT
/begin MEASUREMENT TWCC_PriCtlB1TOFV_I.outbit "" UBYTE B_TRUE 1 100 0.00 1.00000000000 BIT_MASK 0x1 FORMAT "%13.11" ECU_ADDRESS 0xD00017A8 /end MEASUREMENT
/begin MEASUREMENT TWCC_PriCtlB1TOFV_I.time "" UWORD t_q0p1 1 100 0.00 6553.500 FORMAT "%8.3" ECU_ADDRESS 0xD00017AA /end MEASUREMENT
/begin MEASUREMENT TWCC_PriCtlB1TONV_I.outbit "" UBYTE B_TRUE 1 100 0.00 1.00000000000 BIT_MASK 0x1 FORMAT "%13.11" ECU_ADDRESS 0xD00017AC /end MEASUREMENT
/begin MEASUREMENT TWCC_PriCtlB1TONV_I.time "" UWORD t_q0p1 1 100 0.00 6553.500 FORMAT "%8.3" ECU_ADDRESS 0xD00017AE /end MEASUREMENT
/begin MEASUREMENT TWCC_rCtlErrBalPriB1 "" SWORD fak_sw_b1 1 100 -1.000000 0.9999695 FORMAT "%8.6" ECU_ADDRESS 0xD0000AB6 /end MEASUREMENT
/begin MEASUREMENT TWCC_rCtlErrPriB1 "" SWORD fak_sw_b1 1 100 -1.000000 0.9999695 FORMAT "%8.6" ECU_ADDRESS 0xD00035A8 /end MEASUREMENT
/begin MEASUREMENT TWCC_rCtlErrPriB1DH_I.hysterese "" UBYTE B_TRUE 1 100 0.00 1.00000000000 BIT_MASK 0x1 FORMAT "%13.11" ECU_ADDRESS 0xD00017DC /end MEASUREMENT
/begin MEASUREMENT TWCC_rCtlErrPriB1EBNM_I.oldSignal "" UBYTE B_TRUE 1 100 0.00 1.00000000000 BIT_MASK 0x1 FORMAT "%13.11" ECU_ADDRESS 0xD00017DD /end MEASUREMENT
/begin MEASUREMENT TWCC_rCtlPriB1 "" SWORD fak_sw_b1 1 100 -1.000000 0.9999695 FORMAT "%8.6" ECU_ADDRESS 0xD00035AA /end MEASUREMENT
/begin MEASUREMENT TWCC_rDeltaLamTrimB1 "" SWORD fak_sw_b1 1 100 -1.000000 0.9999695 FORMAT "%8.6" ECU_ADDRESS 0xD00035AC /end MEASUREMENT
/begin MEASUREMENT TWCC_rDifLamCtlTrimB1 "" SWORD fak_sw_b1 1 100 -1.000000 0.9999695 FORMAT "%8.6" ECU_ADDRESS 0xD0000AAC /end MEASUREMENT
/begin MEASUREMENT TWCC_rDynSetPIniPriB1 "" SWORD fak_sw_b1 1 100 -1.000000 0.9999695 FORMAT "%8.6" ECU_ADDRESS 0xD0000AB8 /end MEASUREMENT
/begin MEASUREMENT TWCC_rDynSetPPriB1 "" SWORD fak_sw_b1 1 100 -1.000000 0.9999695 FORMAT "%8.6" ECU_ADDRESS 0xD00035AE /end MEASUREMENT
/begin MEASUREMENT TWCC_rDynSetPPriB1LT_I.memory "" SLONG fak_q4p6566Em10 1 100 -1.000000000000000 0.999999999534339 FORMAT "%17.15" ECU_ADDRESS 0xD00017E0 /end MEASUREMENT
/begin MEASUREMENT TWCC_rICtlErrFltPriB1 "" SWORD fak_sw_b1 1 100 -1.000000 0.9999695 FORMAT "%8.6" ECU_ADDRESS 0xD0000ABA /end MEASUREMENT
/begin MEASUREMENT TWCC_rICtlErrPriB1 "" SWORD fak_sw_b1 1 100 -1.000000 0.9999695 FORMAT "%8.6" ECU_ADDRESS 0xD0000ABC /end MEASUREMENT
/begin MEASUREMENT TWCC_rICtlIntPriB1 "" SLONG fak_sl_b1 1 100 -1.00000000000 0.999999999534 FORMAT "%13.11" ECU_ADDRESS 0xAFE80018 /end MEASUREMENT
/begin MEASUREMENT TWCC_rICtlPriB1 "" SWORD fak_sw_b1 1 100 -1.000000 0.9999695 FORMAT "%8.6" ECU_ADDRESS 0xD00035B0 /end MEASUREMENT
/begin MEASUREMENT TWCC_rICtlPriB1_I.memory_l "" SLONG fak_sl_b1 1 100 -1.00000000000 0.999999999534 FORMAT "%13.11" ECU_ADDRESS 0xD00017E4 /end MEASUREMENT
/begin MEASUREMENT TWCC_rIFlCPPri "" UWORD fak_uw_b1 1 100 0.00 0.9999847 FORMAT "%9.7" ECU_ADDRESS 0xD0000AEC /end MEASUREMENT
/begin MEASUREMENT TWCC_rLamActFltPriB1LT_I.memory "" ULONG fak_q4p6566Em10 1 100 0.00 1.999999999534339 FORMAT "%17.15" ECU_ADDRESS 0xD00017E8 /end MEASUREMENT
/begin MEASUREMENT TWCC_rLamActPriB1 "" UWORD fak_uw_b2 1 100 0.00 1.999969 FORMAT "%8.6" ECU_ADDRESS 0xD0000ABE /end MEASUREMENT
/begin MEASUREMENT TWCC_rLamAvrgTrimB1 "" SWORD fak_sw_b1 1 100 -1.000000 0.9999695 FORMAT "%8.6" ECU_ADDRESS 0xD0000AAE /end MEASUREMENT
/begin MEASUREMENT TWCC_rLamCat1PurgB1 "" UWORD fak_uw_b16 1 100 0.00 15.99976 FORMAT "%8.5" ECU_ADDRESS 0xD0000A9C /end MEASUREMENT
/begin MEASUREMENT TWCC_rLamCtlOldTrimB1 "" SWORD fak_sw_b1 1 100 -1.000000 0.9999695 FORMAT "%8.6" ECU_ADDRESS 0xD0000AB0 /end MEASUREMENT
/begin MEASUREMENT TWCC_rLamCtlTrimB1 "" SWORD fak_sw_b1 1 100 -1.000000 0.9999695 FORMAT "%8.6" ECU_ADDRESS 0xAFE8014A /end MEASUREMENT
/begin MEASUREMENT TWCC_rLamSetPMapPriB1 "" UWORD fak_uw_b2 1 100 0.00 1.999969 FORMAT "%8.6" ECU_ADDRESS 0xD0000AC0 /end MEASUREMENT
/begin MEASUREMENT TWCC_rLamSetPPriB1 "" UWORD fak_uw_b2 1 100 0.00 1.999969 FORMAT "%8.6" ECU_ADDRESS 0xD0000AC2 /end MEASUREMENT
/begin MEASUREMENT TWCC_rLamSetPPurgB1 "" UWORD fak_uw_b16 1 100 0.00 15.99976 FORMAT "%8.5" ECU_ADDRESS 0xD0003628 /end MEASUREMENT
/begin MEASUREMENT TWCC_rLdSimContTrimB1 "" UBYTE fak_ub_b100 1 100 0.00 100.0 FORMAT "%5.1" ECU_ADDRESS 0xD0000ED2 /end MEASUREMENT
/begin MEASUREMENT TWCC_RmpLamSetPPurgB1ITL_I.memory "" ULONG dez 1 100 0.00 4294967295.00 FORMAT "%13.2" ECU_ADDRESS 0xD000177C /end MEASUREMENT
/begin MEASUREMENT TWCC_rPCtlErrFltPriB1 "" SWORD fak_sw_b1 1 100 -1.000000 0.9999695 FORMAT "%8.6" ECU_ADDRESS 0xD0000AC4 /end MEASUREMENT
/begin MEASUREMENT TWCC_rPCtlErrPriB1 "" SWORD fak_sw_b1 1 100 -1.000000 0.9999695 FORMAT "%8.6" ECU_ADDRESS 0xD0000AC6 /end MEASUREMENT
/begin MEASUREMENT TWCC_rPCtlPriB1 "" SWORD fak_sw_b1 1 100 -1.000000 0.9999695 FORMAT "%8.6" ECU_ADDRESS 0xD00035B2 /end MEASUREMENT
/begin MEASUREMENT TWCC_rPMsO2BalPriB1 "" SWORD fak_sw_b1 1 100 -1.000000 0.9999695 FORMAT "%8.6" ECU_ADDRESS 0xD0000AC8 /end MEASUREMENT
/begin MEASUREMENT TWCC_rSetPUsGlbB1 "" SWORD fak_q3p0518Em5 1 100 -1.000000 0.9999695 FORMAT "%8.6" ECU_ADDRESS 0xD00035B4 /end MEASUREMENT
/begin MEASUREMENT TWCC_StabTrimB1CTR_I.counter "" UBYTE dez 1 100 0.00 255.0 FORMAT "%5.1" ECU_ADDRESS 0xD00017B0 /end MEASUREMENT
/begin MEASUREMENT TWCC_tiDynSetPPriB1 "" UWORD t_q0p05 1 100 0.00 3276.750 FORMAT "%8.3" ECU_ADDRESS 0xD0000ACA /end MEASUREMENT
/begin MEASUREMENT TWCC_tIMinPriB1 "" SWORD Temp_Cels 1 100 -3549.940 3003.560 FORMAT "%8.3" ECU_ADDRESS 0xD0000AEE /end MEASUREMENT
/begin MEASUREMENT TWCC_tiRichTOutPurgB1 "" UWORD t_q0p02 1 100 0.00 1310.700 FORMAT "%8.3" ECU_ADDRESS 0xD0000A9E /end MEASUREMENT
/begin MEASUREMENT TWCC_tPMinPriB1 "" SWORD Temp_Cels 1 100 -3549.940 3003.560 FORMAT "%8.3" ECU_ADDRESS 0xD0000AF0 /end MEASUREMENT
/begin MEASUREMENT TWCC_tSimContTrimB1 "" UBYTE temp_ub_q1_o40 1 100 -40.00 215.0 FORMAT "%5.1" ECU_ADDRESS 0xD0000ED3 /end MEASUREMENT
/begin MEASUREMENT TWCC_uSetPPriB1 "" UBYTE spg_q0p00488 1 100 0.00 1.245 FORMAT "%5.3" ECU_ADDRESS 0xD0003CBD /end MEASUREMENT
/begin MEASUREMENT TWCD_bActvB1 "" UBYTE B_TRUE 1 100 0.00 1.00000000000 BIT_MASK 0x2 FORMAT "%13.11" ECU_ADDRESS 0xD0000069 /end MEASUREMENT
/begin MEASUREMENT TWCD_bAmpOnlyB1 "" UBYTE B_TRUE 1 100 0.00 1.00000000000 BIT_MASK 0x80 FORMAT "%13.11" ECU_ADDRESS 0xD0000050 /end MEASUREMENT
/begin MEASUREMENT TWCD_bCalcFinB1 "" UBYTE B_TRUE 1 100 0.00 1.00000000000 BIT_MASK 0x10 FORMAT "%13.11" ECU_ADDRESS 0xD0000059 /end MEASUREMENT
/begin MEASUREMENT TWCD_bDSMPrmsB1 "" UBYTE B_TRUE 1 100 0.00 1.00000000000 BIT_MASK 0x2 FORMAT "%13.11" ECU_ADDRESS 0xD0000051 /end MEASUREMENT
/begin MEASUREMENT TWCD_bEnaAmpB1 "" UBYTE B_TRUE 1 100 0.00 1.00000000000 BIT_MASK 0x40 FORMAT "%13.11" ECU_ADDRESS 0xD000005B /end MEASUREMENT
/begin MEASUREMENT TWCD_bErrB1 "" UBYTE B_TRUE 1 100 0.00 1.00000000000 BIT_MASK 0x8 FORMAT "%13.11" ECU_ADDRESS 0xD0000052 /end MEASUREMENT
/begin MEASUREMENT TWCD_bErrSusB1 "" UBYTE B_TRUE 1 100 0.00 1.00000000000 BIT_MASK 0x80 FORMAT "%13.11" ECU_ADDRESS 0xD0000065 /end MEASUREMENT
/begin MEASUREMENT TWCD_bErrSusIntB1 "" UBYTE B_TRUE 1 100 0.00 1.00000000000 BIT_MASK 0x2 FORMAT "%13.11" ECU_ADDRESS 0xD000009E /end MEASUREMENT
/begin MEASUREMENT TWCD_bFinAmpCompB1 "" UBYTE B_TRUE 1 100 0.00 1.00000000000 BIT_MASK 0x20 FORMAT "%13.11" ECU_ADDRESS 0xD000006B /end MEASUREMENT
/begin MEASUREMENT TWCD_bHealB1 "" UBYTE B_TRUE 1 100 0.00 1.00000000000 BIT_MASK 0x10 FORMAT "%13.11" ECU_ADDRESS 0xD0000052 /end MEASUREMENT
/begin MEASUREMENT TWCD_bHealIntB1 "" UBYTE B_TRUE 1 100 0.00 1.00000000000 BIT_MASK 0x8 FORMAT "%13.11" ECU_ADDRESS 0xD0000084 /end MEASUREMENT
/begin MEASUREMENT TWCD_bIniAmpCompB1 "" UBYTE B_TRUE 1 100 0.00 1.00000000000 BIT_MASK 0x40 FORMAT "%13.11" ECU_ADDRESS 0xD0000050 /end MEASUREMENT
/begin MEASUREMENT TWCD_bLamCtrlReqB1 "" UBYTE B_TRUE 1 100 0.00 1.00000000000 BIT_MASK 0x20 FORMAT "%13.11" ECU_ADDRESS 0xD0000080 /end MEASUREMENT
/begin MEASUREMENT TWCD_bLckdPID41 "" UBYTE B_TRUE 1 100 0.00 1.00000000000 BIT_MASK 0x4 FORMAT "%13.11" ECU_ADDRESS 0xD0000088 /end MEASUREMENT
/begin MEASUREMENT TWCD_bStopDesLamB1 "" UBYTE B_TRUE 1 100 0.00 1.00000000000 BIT_MASK 0x20 FORMAT "%13.11" ECU_ADDRESS 0xD0000051 /end MEASUREMENT
/begin MEASUREMENT TWCD_bStopDSMB1 "" UBYTE B_TRUE 1 100 0.00 1.00000000000 BIT_MASK 0x2 FORMAT "%13.11" ECU_ADDRESS 0xD0000053 /end MEASUREMENT
/begin MEASUREMENT TWCD_bStopEngStrtTemp "" UBYTE B_TRUE 1 100 0.00 1.00000000000 BIT_MASK 0x1 FORMAT "%13.11" ECU_ADDRESS 0xD000007E /end MEASUREMENT
/begin MEASUREMENT TWCD_bStopLamB1 "" UBYTE B_TRUE 1 100 0.00 1.00000000000 BIT_MASK 0x40 FORMAT "%13.11" ECU_ADDRESS 0xD0000051 /end MEASUREMENT
/begin MEASUREMENT TWCD_bStopLamCtrlB1 "" UBYTE B_TRUE 1 100 0.00 1.00000000000 BIT_MASK 0x8 FORMAT "%13.11" ECU_ADDRESS 0xD0000051 /end MEASUREMENT
/begin MEASUREMENT TWCD_bStopLdCng "" UBYTE B_TRUE 1 100 0.00 1.00000000000 BIT_MASK 0x1 FORMAT "%13.11" ECU_ADDRESS 0xD0000052 /end MEASUREMENT
/begin MEASUREMENT TWCD_bStopLdCngRaw "" UBYTE B_TRUE 1 100 0.00 1.00000000000 BIT_MASK 0x80 FORMAT "%13.11" ECU_ADDRESS 0xD0000051 /end MEASUREMENT
/begin MEASUREMENT TWCD_bStopNLd "" UBYTE B_TRUE 1 100 0.00 1.00000000000 BIT_MASK 0x1 FORMAT "%13.11" ECU_ADDRESS 0xD0000055 /end MEASUREMENT
/begin MEASUREMENT TWCD_bStopPhyB1 "" UBYTE B_TRUE 1 100 0.00 1.00000000000 BIT_MASK 0x40 FORMAT "%13.11" ECU_ADDRESS 0xD0000088 /end MEASUREMENT
/begin MEASUREMENT TWCD_bStopS2B1 "" UBYTE B_TRUE 1 100 0.00 1.00000000000 BIT_MASK 0x10 FORMAT "%13.11" ECU_ADDRESS 0xD0000051 /end MEASUREMENT
/begin MEASUREMENT TWCD_bStopScav "" UBYTE B_TRUE 1 100 0.00 1.00000000000 BIT_MASK 0x4 FORMAT "%13.11" ECU_ADDRESS 0xD0000051 /end MEASUREMENT
/begin MEASUREMENT TWCD_bStopTempB1 "" UBYTE B_TRUE 1 100 0.00 1.00000000000 BIT_MASK 0x4 FORMAT "%13.11" ECU_ADDRESS 0xD000006D /end MEASUREMENT
/begin MEASUREMENT TWCD_bTstReq "" UBYTE B_TRUE 1 100 0.00 1.00000000000 BIT_MASK 0x20 FORMAT "%13.11" ECU_ADDRESS 0xD0000066 /end MEASUREMENT
/begin MEASUREMENT TWCD_bVldnFinB1 "" UBYTE B_TRUE 1 100 0.00 1.00000000000 BIT_MASK 0x4 FORMAT "%13.11" ECU_ADDRESS 0xD0000052 /end MEASUREMENT
/begin MEASUREMENT TWCD_dmCatLdB1 "" SWORD mgrad_sw_b28p44 1 100 -28.44444 28.44358 FORMAT "%8.5" ECU_ADDRESS 0xD0000AF2 /end MEASUREMENT
/begin MEASUREMENT TWCD_dmCatLdRichB1 "" SWORD mgrad_sw_b28p44 1 100 -28.44444 28.44358 FORMAT "%8.5" ECU_ADDRESS 0xD00035B6 /end MEASUREMENT
/begin MEASUREMENT TWCD_dmExhIntB1 "" UWORD m_uw_b6553p5 1 100 0.00 6553.500 FORMAT "%8.3" ECU_ADDRESS 0xD0000AF4 /end MEASUREMENT
/begin MEASUREMENT TWCD_facAmplLamCtrl "" UBYTE fak_ub_b8 1 100 0.00 7.969 FORMAT "%5.3" ECU_ADDRESS 0xD0003CBE /end MEASUREMENT
/begin MEASUREMENT TWCD_facCatAgeAmpCompB1 "" UBYTE fak_ub_b1 1 100 0.00 0.9961 ECU_ADDRESS 0xAFE801B0 /end MEASUREMENT
/begin MEASUREMENT TWCD_facCorAmpB1 "" UBYTE fak_ub_b2 1 100 0.00 1.992188 FORMAT "%8.6" ECU_ADDRESS 0xD0000ED9 /end MEASUREMENT
/begin MEASUREMENT TWCD_facCorS1DynB1 "" UBYTE fak_ub_b1 1 100 0.00 0.9961 ECU_ADDRESS 0xD0000EDA /end MEASUREMENT
/begin MEASUREMENT TWCD_facOSCInc "" UWORD m_q0p1_mg 1 100 0.00 6553.500 FORMAT "%8.3" ECU_ADDRESS 0xD000362A /end MEASUREMENT
/begin MEASUREMENT TWCD_frqCatO2LdB1 "" SWORD freq_sw_b512 1 100 -512.0000 511.9844 FORMAT "%8.4" ECU_ADDRESS 0xD00035B8 /end MEASUREMENT
/begin MEASUREMENT TWCD_rAmpCompB1 "" UWORD fak_uw_b16 1 100 0.00 15.99976 FORMAT "%8.5" ECU_ADDRESS 0xD000362C /end MEASUREMENT
/begin MEASUREMENT TWCD_rAmpCompIntB1 "" UBYTE fak_ub_b1 1 100 0.00 0.9961 ECU_ADDRESS 0xD0003CBF /end MEASUREMENT
/begin MEASUREMENT TWCD_rAmpCompRawB1 "" UBYTE fak_ub_b1 1 100 0.00 0.9961 ECU_ADDRESS 0xD0000EDB /end MEASUREMENT
/begin MEASUREMENT TWCD_rAmpDifB1 "" UBYTE fak_ub_b1 1 100 0.00 0.9961 ECU_ADDRESS 0xD0003CC0 /end MEASUREMENT
/begin MEASUREMENT TWCD_rAmpIntglB1 "" UWORD t50msxs_uw_b819p2 1 100 0.00 819.1875 FORMAT "%8.4" ECU_ADDRESS 0xD000362E /end MEASUREMENT
/begin MEASUREMENT TWCD_rAmpMdlCorB1 "" UBYTE fak_ub_b1 1 100 0.00 0.9961 ECU_ADDRESS 0xD0000EDC /end MEASUREMENT
/begin MEASUREMENT TWCD_rAmpNrmB1 "" UBYTE fak_ub_b1 1 100 0.00 0.9961 ECU_ADDRESS 0xD0003CC1 /end MEASUREMENT
/begin MEASUREMENT TWCD_rAmpNrmMdlB1 "" UBYTE fak_ub_b1 1 100 0.00 0.9961 ECU_ADDRESS 0xD0003CC2 /end MEASUREMENT
/begin MEASUREMENT TWCD_rCatLdIntglB1 "" SBYTE fak_sb_b1 1 100 -1.000 0.9922 FORMAT "%5.3" ECU_ADDRESS 0xD0003BE8 /end MEASUREMENT
/begin MEASUREMENT TWCD_rDiagRsltB1 "" UWORD fak_uw_b16 1 100 0.00 15.99976 FORMAT "%8.5" ECU_ADDRESS 0xD0003630 /end MEASUREMENT
/begin MEASUREMENT TWCD_rDiagThreshB1 "" UWORD fak_uw_b16 1 100 0.00 15.99976 FORMAT "%8.5" ECU_ADDRESS 0xD0000B0A /end MEASUREMENT
/begin MEASUREMENT TWCD_rLdCng "" UBYTE rel_ub_q0p75 1 100 0.00 191.3 FORMAT "%5.1" ECU_ADDRESS 0xD0003CC3 /end MEASUREMENT
/begin MEASUREMENT TWCD_rLdGrdt "" SBYTE rel_sb_q0p75 1 100 -96.00 95.25 FORMAT "%5.2" ECU_ADDRESS 0xD0000EE7 /end MEASUREMENT
/begin MEASUREMENT TWCD_stDiagB1 "" UBYTE dez 1 100 0.00 255.0 FORMAT "%5.1" ECU_ADDRESS 0xD0000EEA /end MEASUREMENT
/begin MEASUREMENT TWCD_tAvrgCatB1 "" UWORD temp_q0p0234_o273 1 100 -273.1500 1262.827 FORMAT "%8.3" ECU_ADDRESS 0xD0003632 /end MEASUREMENT
/begin MEASUREMENT TWCD_tGrdtB1 "" UWORD temp_q0p0234 1 100 0.00 1535.977 FORMAT "%8.3" ECU_ADDRESS 0xD0000B06 /end MEASUREMENT
/begin MEASUREMENT TWCD_tiDiagB1 "" UWORD t_q0p05 1 100 0.00 3276.750 FORMAT "%8.3" ECU_ADDRESS 0xD0003634 /end MEASUREMENT
/begin MEASUREMENT TWCD_tiStopLdCng "" UBYTE t_q0p05 1 100 0.00 12.75 FORMAT "%5.2" ECU_ADDRESS 0xD0000EE8 /end MEASUREMENT
/begin MEASUREMENT TWCD_tiStopTempB1 "" UWORD t_q0p2 1 100 0.00 13107.00 FORMAT "%8.2" ECU_ADDRESS 0xD0000B08 /end MEASUREMENT
/begin MEASUREMENT TWCD_trqResv "" UWORD rel_uw_b100 1 100 0.00 99.99847 FORMAT "%8.5" ECU_ADDRESS 0xD0003636 /end MEASUREMENT
/begin MEASUREMENT TWCD_uDifMeanB1 "" SBYTE spg_q0p00977 1 100 -1.250 1.240 FORMAT "%5.3" ECU_ADDRESS 0xD0000EDD /end MEASUREMENT
/begin MEASUREMENT TWCD_uS2MdlB1 "" UBYTE spg_q0p00488 1 100 0.00 1.245 FORMAT "%5.3" ECU_ADDRESS 0xD0003CC4 /end MEASUREMENT
/begin MEASUREMENT TWCD_uS2MdlMeanB1 "" UBYTE spg_q0p00488 1 100 0.00 1.245 FORMAT "%5.3" ECU_ADDRESS 0xD0000EDE /end MEASUREMENT
/begin MEASUREMENT TWCD_uS2MeanB1 "" UBYTE spg_q0p00488 1 100 0.00 1.245 FORMAT "%5.3" ECU_ADDRESS 0xD0003CC5 /end MEASUREMENT
/begin MEASUREMENT tyzwwlnm_w "" UWORD temp_q0p0234_o273 1 100 -273.1500 1262.827 FORMAT "%8.3" ECU_ADDRESS 0xD0000B26 /end MEASUREMENT
/begin MEASUREMENT ushdktp "" UBYTE spg_ub_q0p0052 1 100 0.00 1.330 FORMAT "%5.3" ECU_ADDRESS 0xD0000EE6 /end MEASUREMENT
/begin MEASUREMENT usrhk "" UBYTE spg_ub_q0p0052_o0p2 1 100 -0.2000 1.130 FORMAT "%5.3" ECU_ADDRESS 0xD0000ED8 /end MEASUREMENT
/begin MEASUREMENT usrhk_w "" UWORD spg_uw_q0p00488_o1 1 100 -1.000000 318.9951 FORMAT "%8.4" ECU_ADDRESS 0xD0000AE0 /end MEASUREMENT
/begin MEASUREMENT VehMot_rAccPedFlt "" SWORD Prc 1 100 -400.0000 399.9878 FORMAT "%8.4" ECU_ADDRESS 0xD00035C4 /end MEASUREMENT
/begin MEASUREMENT VehMot_rTrqDfftl "" SWORD TransR 1 100 -327.6800 327.6700 FORMAT "%8.4" ECU_ADDRESS 0xD00035C6 /end MEASUREMENT
/begin MEASUREMENT VehMot_stLimDfftl "" UBYTE dez 1 100 0.00 255.0 FORMAT "%5.1" ECU_ADDRESS 0xD0003CC9 /end MEASUREMENT
/begin MEASUREMENT VehMot_stPrpAccPed "" UBYTE dez 1 100 0.00 255.0 FORMAT "%5.1" ECU_ADDRESS 0xD0003CCA /end MEASUREMENT
/begin MEASUREMENT VehMot_stStabIntv "" UBYTE dez 1 100 0.00 255.0 FORMAT "%5.1" ECU_ADDRESS 0xD0003CCD /end MEASUREMENT
/begin MEASUREMENT VehMot_trqPrtDfftl "" SLONG TrqPrpHigh 1 100 -50000.0000000 50000.0000000 FORMAT "%13.7" ECU_ADDRESS 0xD0002314 /end MEASUREMENT
/begin MEASUREMENT VehV_a "" SWORD Acc 1 100 -32.76800 32.76700 FORMAT "%8.5" ECU_ADDRESS 0xD00035C8 /end MEASUREMENT
/begin MEASUREMENT VehV_aRawUnFlt_mp "" SWORD Acc 1 100 -32.76800 32.76700 FORMAT "%8.5" ECU_ADDRESS 0xD00053AE /end MEASUREMENT
/begin MEASUREMENT VehV_ctPeriodOld_mp "" ULONG OneToOne 1 100 0.00 4294967295.00 FORMAT "%13.2" ECU_ADDRESS 0xD000527C /end MEASUREMENT
/begin MEASUREMENT VehV_ctPeriod_mp "" ULONG OneToOne 1 100 0.00 4294967295.00 FORMAT "%13.2" ECU_ADDRESS 0xD0005280 /end MEASUREMENT
/begin MEASUREMENT VehV_facTireAxlCorr "" ULONG PerKm 1 100 0.00 4294967295.00 FORMAT "%13.2" ECU_ADDRESS 0xD0002348 /end MEASUREMENT
/begin MEASUREMENT VehV_stTopSpdLim "" SWORD OneToOne 1 100 -32768.00 32767.00 FORMAT "%8.2" ECU_ADDRESS 0xD00035CA /end MEASUREMENT
/begin MEASUREMENT VehV_tiDiff_mp "" SLONG Prc_q0p01_COMPU 1 100 -21474836.4800 21474836.4700 FORMAT "%13.4" ARRAY_SIZE 4 ECU_ADDRESS 0xD0005284 /end MEASUREMENT
/begin MEASUREMENT VehV_tiPerAvrg "" SLONG Time_PwmHigh 1 100 -107374182.400 107374182.350 FORMAT "%13.3" ECU_ADDRESS 0xD0002318 /end MEASUREMENT
/begin MEASUREMENT VehV_tiPerAvrgOld_mp "" SLONG Time_PwmHigh 1 100 -107374182.400 107374182.350 FORMAT "%13.3" ECU_ADDRESS 0xD0005294 /end MEASUREMENT
/begin MEASUREMENT VehV_tiPeriodOld_mp "" ULONG Time_ms 1 100 0.00 42949672950.0 FORMAT "%13.1" ECU_ADDRESS 0xD0005298 /end MEASUREMENT
/begin MEASUREMENT VehV_tiPeriod_mp "" ULONG Time_ms 1 100 0.00 42949672950.0 FORMAT "%13.1" ECU_ADDRESS 0xD000529C /end MEASUREMENT
/begin MEASUREMENT VehV_v "" SWORD Vel 1 100 -327.6800 327.6700 FORMAT "%8.4" ECU_ADDRESS 0xD00035CC /end MEASUREMENT
/begin MEASUREMENT VehV_vFltOld_mp "" SWORD Vel 1 100 -327.6800 327.6700 FORMAT "%8.4" ECU_ADDRESS 0xD00053B0 /end MEASUREMENT
/begin MEASUREMENT VehV_vFlt_mp "" SWORD Vel 1 100 -327.6800 327.6700 FORMAT "%8.4" ECU_ADDRESS 0xD00053B2 /end MEASUREMENT
/begin MEASUREMENT VehV_vRawOld_mp "" SWORD Vel 1 100 -327.6800 327.6700 FORMAT "%8.4" ECU_ADDRESS 0xD00053AC /end MEASUREMENT
/begin MEASUREMENT VehV_vSens "" SWORD Vel 1 100 -327.6800 327.6700 FORMAT "%8.4" ECU_ADDRESS 0xD00035CE /end MEASUREMENT
/begin MEASUREMENT VehV_vUnFlt_mp "" SWORD Vel 1 100 -327.6800 327.6700 FORMAT "%8.4" ECU_ADDRESS 0xD00053B4 /end MEASUREMENT
/begin MEASUREMENT vfzg "" UBYTE vfzg_ub_q1p25 1 100 0.00 318.8 FORMAT "%5.1" ECU_ADDRESS 0xD0000EEB /end MEASUREMENT
/begin MEASUREMENT vfzg_w "" UWORD vfzg_uw_b512 1 100 0.00 511.9922 FORMAT "%8.4" ECU_ADDRESS 0xD0000B10 /end MEASUREMENT
/begin MEASUREMENT vfzroh_w "" UWORD vfzg_uw_b512 1 100 0.00 511.9922 FORMAT "%8.4" ECU_ADDRESS 0xD0000B12 /end MEASUREMENT
/begin MEASUREMENT vivmx_w "" UWORD vfzg_uw_q0p00781 1 100 0.00 511.9922 FORMAT "%8.4" ECU_ADDRESS 0xD0000B1A /end MEASUREMENT
/begin MEASUREMENT VMSI_trqMin "" SLONG TrqPrpHigh 1 100 -50000.0000000 50000.0000000 FORMAT "%13.7" ECU_ADDRESS 0xD0002310 /end MEASUREMENT
/begin MEASUREMENT vsvmx_w "" UWORD vfzg_uw_q0p00781 1 100 0.00 511.9922 FORMAT "%8.4" ECU_ADDRESS 0xD0000B1C /end MEASUREMENT
/begin MEASUREMENT zwbas "" SBYTE kw_q0p75 1 100 -96.00 95.25 FORMAT "%5.2" ECU_ADDRESS 0xD0000EEF /end MEASUREMENT
/begin MEASUREMENT zwbasar "" SBYTE kw_q0p75 1 100 -96.00 95.25 FORMAT "%5.2" ARRAY_SIZE 2 ECU_ADDRESS 0xD0000EF0 /end MEASUREMENT
/begin MEASUREMENT zwbasokr "" SBYTE kw_q0p75 1 100 -96.00 95.25 FORMAT "%5.2" ECU_ADDRESS 0xD0000EF2 /end MEASUREMENT
/begin MEASUREMENT zwcalcar "" SBYTE kw_q0p75 1 100 -96.00 95.25 FORMAT "%5.2" ARRAY_SIZE 3 ECU_ADDRESS 0xD0000F03 /end MEASUREMENT
/begin MEASUREMENT zwcalcarcp "" UBYTE dez 1 100 0.00 255.0 FORMAT "%5.1" ARRAY_SIZE 3 ECU_ADDRESS 0xD0000F06 /end MEASUREMENT
/begin MEASUREMENT zwgru "" SBYTE kw_q0p75 1 100 -96.00 95.25 FORMAT "%5.2" ECU_ADDRESS 0xD0000EF3 /end MEASUREMENT
/begin MEASUREMENT zwgruhom "" SBYTE kw_q0p75 1 100 -96.00 95.25 FORMAT "%5.2" ECU_ADDRESS 0xD0000EF7 /end MEASUREMENT
/begin MEASUREMENT zwist "" SBYTE kw_q0p75 1 100 -96.00 95.25 FORMAT "%5.2" ECU_ADDRESS 0xD0000F09 /end MEASUREMENT
/begin MEASUREMENT zwkfzw "" SBYTE kw_q0p75 1 100 -96.00 95.25 FORMAT "%5.2" ECU_ADDRESS 0xD0000EF8 /end MEASUREMENT
/begin MEASUREMENT zwkrafld "" UBYTE dez 1 100 0.00 255.0 FORMAT "%5.1" ECU_ADDRESS 0xD0000F0A /end MEASUREMENT
/begin MEASUREMENT zwmn "" SBYTE kw_q0p75 1 100 -96.00 95.25 FORMAT "%5.2" ECU_ADDRESS 0xD0000EFF /end MEASUREMENT
/begin MEASUREMENT zwmnhom "" SBYTE kw_q0p75 1 100 -96.00 95.25 FORMAT "%5.2" ECU_ADDRESS 0xD0000F00 /end MEASUREMENT
/begin MEASUREMENT zwmnhomst "" SBYTE kw_q0p75 1 100 -96.00 95.25 FORMAT "%5.2" ECU_ADDRESS 0xD0000F01 /end MEASUREMENT
/begin MEASUREMENT zwout "" SBYTE kw_q0p75 1 100 -96.00 95.25 FORMAT "%5.2" ECU_ADDRESS 0xD0000F0B /end MEASUREMENT
/begin MEASUREMENT zwoutcpl "" UBYTE dez 1 100 0.00 255.0 FORMAT "%5.1" ECU_ADDRESS 0xD0000F0C /end MEASUREMENT
/begin MEASUREMENT zwspae "" SBYTE kw_q0p75 1 100 -96.00 95.25 FORMAT "%5.2" ECU_ADDRESS 0xD0000EFC /end MEASUREMENT
/begin MEASUREMENT zwspaebvg "" SBYTE kw_q0p75 1 100 -96.00 95.25 FORMAT "%5.2" ECU_ADDRESS 0xD0000F02 /end MEASUREMENT
/begin MEASUREMENT zwstt "" SBYTE zw_sb_q0p75 1 100 -96.00 95.25 FORMAT "%5.2" ECU_ADDRESS 0xD0000F10 /end MEASUREMENT
/begin MEASUREMENT zwzyl1 "" SBYTE kw_q0p75 1 100 -96.00 95.25 FORMAT "%5.2" ECU_ADDRESS 0xD0000F0D /end MEASUREMENT
/begin MEASUREMENT zzylzuear "" UBYTE dez 1 100 0.00 255.0 FORMAT "%5.1" ARRAY_SIZE 2 ECU_ADDRESS 0xD0000EF4 /end MEASUREMENT
/begin FUNCTION TWCC_CatPurge "1.13.0"
 /begin DEF_CHARACTERISTIC TWCC_BalCat1B1_I.facOSCPurge_C TWCC_BalCat1B1_I.facOSCState_C TWCC_BalCat1B1_I.mO2DisThresPurge_C TWCC_BalCat1B1_I.mO2EngOff_CUR TWCC_facCorO2Purg_C TWCC_mO2MinThresCat1Purg_C TWCC_OSCCat1B1_I.facOSCKNBB_C TWCC_OSCCat1B1_I.facOSCK_C TWCC_rLamSetPPurg_MAP TWCC_rMinThresEngResPurg_C TWCC_stEngStTiPurg_C TWCC_stPurg2_CW TWCC_stPurg_CW TWCC_tiDebEngOnKSPurg_C TWCC_tiDebEngOnPurg_C TWCC_tiRichTOutPurg_C TWCC_tiRmpLambdaSetPPurg_C TWCC_tMinThresPurg_C TWCC_uThresLeanCat1Purg_C TWCC_uThresRichCat1Purg_C /end DEF_CHARACTERISTIC
 /begin IN_MEASUREMENT B_bevab B_engrot B_kh B_khakt B_stend B_stendz B_tengsr Epm_nEngLRes ExhMod_dmExhCat1B1 ExhMod_mO2StrCat1B1 ExhMod_tCat1B1 HEGO_bS2B1Vld HEGO_uS2B1 lamsbrs_w lason_w SyC_stSub tengslst tengsq1_w tlrs_w tnst_w /end IN_MEASUREMENT
 /begin OUT_MEASUREMENT B_lamka B_lrka B_lrkat lamka_w TWCC_bEnaRichPurgB1 TWCC_bRstPurgB1 TWCC_mO2StCat1PurgB1 TWCC_mO2StPurgB1 TWCC_rLamSetPPurgB1 /end OUT_MEASUREMENT
 /begin LOC_MEASUREMENT B_stz_ER.buffer B_stz_ER.oldSignal B_st_EF.buffer B_st_EF.oldSignal B_st_FF.status TWCC_BalCat1B1_I.bEngOffMark TWCC_BalCat1B1_I.bEngOffO2 TWCC_BalCat1B1_I.bLeanPurg TWCC_BalCat1B1_I.bLeanSt TWCC_BalCat1B1_I.bO2Max TWCC_BalCat1B1_I.bO2MinThres TWCC_BalCat1B1_I.bRichReq TWCC_BalCat1B1_I.bRichSt TWCC_BalCat1B1_I.bRstSensRich TWCC_BalCat1B1_I.bSensLean TWCC_BalCat1B1_I.mO2 TWCC_BalCat1B1_I.mO2Max TWCC_BalCat1B1_I.O2_IKL.memory TWCC_BalCat1B1_I.SensLeanER_I.buffer TWCC_BalCat1B1_I.SensLeanER_I.oldSignal TWCC_bDebEngOnPurg TWCC_bEnaLeanPurgB1 TWCC_bEngOffPurg TWCC_bLeanInCat1PurgB1 TWCC_bLeanPurgB1 TWCC_bLeanStCat1PurgB1 TWCC_bRichInCat1PurgB1 TWCC_bRichReqCat1PurgB1 TWCC_bRichReqPurgB1 TWCC_bRichStCat1PurgB1 TWCC_bRstCatPurgB1 TWCC_dmO2Cat1PurgB1 TWCC_EngOffPurgER_I.buffer TWCC_EngOffPurgER_I.oldSignal TWCC_FuelCutOffPurgB1TOFFV_I.outbit TWCC_FuelCutOffPurgB1TOFFV_I.time TWCC_mO2EngOffCat1PurgB1 TWCC_mOSCCat1PurgB1 TWCC_rLamCat1PurgB1 TWCC_RmpLamSetPPurgB1ITL_I.memory TWCC_tiRichTOutPurgB1 /end LOC_MEASUREMENT
 FUNCTION_VERSION "1.13.0" /end FUNCTION
/begin FUNCTION TWCC_GlbSet "1.2.0" /begin DEF_CHARACTERISTIC TWCC_rSetPUsGlb_CUR /end DEF_CHARACTERISTIC /begin IN_MEASUREMENT fcoschk SyC_stSub /end IN_MEASUREMENT /begin OUT_MEASUREMENT dlaskat_w TWCC_rSetPUsGlbB1 /end OUT_MEASUREMENT /begin LOC_MEASUREMENT TWCC_facOSCGlbB1 /end LOC_MEASUREMENT FUNCTION_VERSION "1.2.0" /end FUNCTION
/begin FUNCTION TWCC_OBDFuelTrim "1.1.1"
 /begin DEF_CHARACTERISTIC TWCC_numLamJmpTrim_C TWCC_dLoadTrim_C TWCC_dmMaxTrim_C TWCC_dmMinTrim_C TWCC_facCtlLowTrim_C TWCC_facCtlTrim_C TWCC_facDeltaLamTrim_C TWCC_HldTrim_C TWCC_mEnaDynTrim_C TWCC_mEnaMaxTrim_C TWCC_mEnaMinTrim_C TWCC_numErrDebTrim_C TWCC_numStabTrim_C TWCC_rLamMaxErrTrim_C TWCC_rLamMaxTrim_C TWCC_rLamMinErrTrim_C TWCC_rLamMinTrim_C TWCC_rLamTrim_C TWCC_stOBDFuelTrim_CW TWCC_tCatMaxTrim_C TWCC_tCatMinTrim_C TWCC_tiEnaTrim_C TWCC_tiPriOffTrim_C TWCC_tiPriOnTrim_C TWCC_tMotMinTrim_C /end DEF_CHARACTERISTIC
 /begin IN_MEASUREMENT B_kh B_lasostc B_lr B_lrnd B_lrsetp B_lrsp B_sa drlas_w msabnhk_w SyC_stSub tkihkm_w tmot TWCC_bEnaRichPurgB1 TWCC_bIPriB1 TWCC_bPPriB1 TWCC_rCtlErrPriB1 TWCC_rCtlPriB1 TWCC_rICtlPriB1 /end IN_MEASUREMENT
 /begin OUT_MEASUREMENT s1p56lsf_w TWCC_rDeltaLamTrimB1 TWCC_rLamCtlTrimB1 /end OUT_MEASUREMENT
 /begin LOC_MEASUREMENT TWCC_bEnaTrimB1 TWCC_bErrDebTrimB1 TWCC_bFrzFrmPresTrimB1 TWCC_bHldTrimB1 TWCC_bLamAvrgTrimB1 TWCC_bLamCtlTrimB1 TWCC_bLamJmpTrimB1 TWCC_bMaxErrTrimB1 TWCC_bMinErrTrimB1 TWCC_bNoErrTrimB1 TWCC_bSimContTrimB1 TWCC_bStabTrimB1 TWCC_dmEnaTrimB1 TWCC_EnaDynTrimB1IK_I.memory TWCC_facCtlLowTrimB1 TWCC_facCtlTrimB1 TWCC_LamAvrgB1ERNM_I.oldSignal TWCC_LamAvrgTrimB1_I.bLamAvrgOkTrim TWCC_LamAvrgTrimB1_I.mExhSum TWCC_LamAvrgTrimB1_I.mLamSum TWCC_LamAvrgTrimB1_I.LamJmpCTR_I.counter TWCC_mHldTrimB1IK_I.memory TWCC_nEngSimContTrimB1 TWCC_PriCtlB1TOFV_I.outbit TWCC_PriCtlB1TOFV_I.time TWCC_PriCtlB1TONV_I.outbit TWCC_PriCtlB1TONV_I.time TWCC_rDifLamCtlTrimB1 TWCC_rLamAvrgTrimB1 TWCC_rLamCtlOldTrimB1 TWCC_rLdSimContTrimB1 TWCC_StabTrimB1CTR_I.counter TWCC_tSimContTrimB1 /end LOC_MEASUREMENT
 FUNCTION_VERSION "1.1.1" /end FUNCTION
/begin FUNCTION TWCC_PriCont "1.12.0"
 /begin DEF_CHARACTERISTIC LRHIMN LRHIMX TWCC_facFltActPTPri_C TWCC_facIGnCtlPriB1_CUR TWCC_facILamLinPri_CUR TWCC_facIOSCAbsPriB1_CUR TWCC_facIOSCPriB1_CUR TWCC_facPGnCtlPriB1_CUR TWCC_facPLamLinPri_CUR TWCC_facPOSCAbsPriB1_CUR TWCC_facPOSCPriB1_CUR TWCC_rDynSetPIniPri_CUR TWCC_rICtlInitPriB1_C TWCC_rILamMaxPri_C TWCC_rILamMinPri_C TWCC_rInvLamLinPri_CUR TWCC_rLamCtlMaxPri_C TWCC_rLamCtlMinPri_C TWCC_rLamLinPri_CUR TWCC_rPBalDLaPri_MAP TWCC_rPBalHysDLaPri_C TWCC_stPriCont_CW TWCC_tiDynSetPPri_CUR TWCC_tiLpActPri_CUR TWCC_uSetPPriB1_MAP /end DEF_CHARACTERISTIC
 /begin IN_MEASUREMENT B_lr B_spvkea Epm_nEngLRes fcoschk HEGO_bS2B1Vld HEGO_uS2B1 msabnhk_w msabvhk_w oschkm_w rl SyC_stSub TWCC_bEnaRichPurgB1 TWCC_bIPriB1 TWCC_bPPriB1 TWCC_rDeltaLamTrimB1 TWCC_rSetPUsGlbB1 /end IN_MEASUREMENT
 /begin OUT_MEASUREMENT B_clhker dlahc_w dlahi_w dlahkab_w dlahp_w dlashk_w dlastrm_w dlatrmc_w dlatrmi_w kdlrhki_w lasonhk_w TWCC_bClrCtlPriB1 TWCC_bCtlLimMaxPriB1 TWCC_bCtlLimMinPriB1 TWCC_facIGnCtlPriB1 TWCC_rCtlErrPriB1 TWCC_rCtlPriB1 TWCC_rDynSetPPriB1 TWCC_rICtlPriB1 TWCC_rPCtlPriB1 TWCC_uSetPPriB1 usrhk usrhk_w /end OUT_MEASUREMENT
 /begin LOC_MEASUREMENT BFlSign_EB.buffer BFlSign_EB.oldSignal fcoscxk fcoscxk_EB.buffer fcoscxk_EB.oldSignal TWCC_dtPMsO2BalPriB1 TWCC_facPGnCtlPriB1 TWCC_PhSyncB1_I.rActPer TWCC_PhSyncB1_I.rPhAvrg TWCC_PhSyncB1_I.rPrevPer TWCC_PhSyncB1_I.sm TWCC_PMsO2BalPriB1IK_I.memory TWCC_rCtlErrBalPriB1 TWCC_rCtlErrPriB1DH_I.hysterese TWCC_rCtlErrPriB1EBNM_I.oldSignal TWCC_rDynSetPIniPriB1 TWCC_rDynSetPPriB1LT_I.memory TWCC_rICtlErrFltPriB1 TWCC_rICtlErrPriB1 TWCC_rICtlIntPriB1 TWCC_rICtlPriB1_I.memory_l TWCC_rLamActFltPriB1LT_I.memory TWCC_rLamActPriB1 TWCC_rLamSetPMapPriB1 TWCC_rLamSetPPriB1 TWCC_rPCtlErrFltPriB1 TWCC_rPCtlErrPriB1 TWCC_rPMsO2BalPriB1 TWCC_tiDynSetPPriB1 /end LOC_MEASUREMENT
 FUNCTION_VERSION "1.12.0" /end FUNCTION
/begin FUNCTION TWCC_PriEna "1.10.0"
 /begin DEF_CHARACTERISTIC TWCC_drIDLaH2Pri_C TWCC_facIOSCRlsH2Pri_C TWCC_facOSCPri_GCUR TWCC_mIBalPPri_CUR TWCC_mIBalPri_CUR TWCC_mIOscRlsH2Pri_C TWCC_mPBalPri_CUR TWCC_nIMaxPri_C TWCC_nIMinPri_C TWCC_rIDecLdPri_C TWCC_rIDLaH2Pri_C TWCC_rIFlCPPri_C TWCC_rIIncLdPri_C TWCC_rILdMaxPri_CUR TWCC_rILdMinPri_CUR TWCC_rPCoUsPri_C TWCC_stPriEna_CW TWCC_tIEngPri_C TWCC_tiIDebFlCutPri_C TWCC_tiIDebIdlSpdPri_C TWCC_tiIDebLdGradPri_C TWCC_tiIDebNLdPri_C TWCC_tiILamGradH2Pri_C TWCC_tiILamSwtH2Pri_C TWCC_tiILckDecelPri_C TWCC_tiILpLdGradPri_C TWCC_tIMaxPri_C TWCC_tIMinPri_CUR TWCC_tIMinTstReqPri_C TWCC_tiPDebCoUsPri_C TWCC_tiPDebLam1DrctPri_C TWCC_tiPDebLam1ErrPri_C TWCC_tiPLpCoUsPri_C TWCC_tPMaxPri_C TWCC_tPMinPri_CUR TWCC_tPMinTstReqPri_C /end DEF_CHARACTERISTIC
 /begin REF_CHARACTERISTIC CWLREBMD /end REF_CHARACTERISTIC
 /begin IN_MEASUREMENT B_dtes B_lasostc B_ll B_lrnd B_lrseta B_mdarv B_sa drlas_w Epm_nEngLRes ExhMod_dmExhS2B1 ExhMod_ratO2StrCat1B1 ExhMod_tCat1B1 HEGO_bS2B1Vld nsa_w rkg_w rkte_w rl SyC_stSub tmot TWCC_bEnaRichPurgB1 TWCC_bTstReqPri TWCC_rCtlErrPriB1 /end IN_MEASUREMENT
 /begin OUT_MEASUREMENT B_lrhk B_lrhkp TWCC_bILckErrPriB1 TWCC_bIPriB1 TWCC_bLimpPriB1 TWCC_bPLckErrPriB1 TWCC_bPPriB1 /end OUT_MEASUREMENT
 /begin LOC_MEASUREMENT TWCC_bIBalPriB1 TWCC_bICoPriB1 TWCC_bIGlbBalPri TWCC_bIGlbCPPri TWCC_bIGlbLckErrPri TWCC_bIGlbPri TWCC_bIH2DLaPriB1 TWCC_bIH2LckPriB1 TWCC_bISysPriB1 TWCC_bITempPriB1 TWCC_bLimpCoPriB1 TWCC_bPBalPriB1 TWCC_bPCoBalPriB1 TWCC_bPCoPriB1 TWCC_bPDynTempPriB1 TWCC_bPGlbBalPri TWCC_bPGlbLckDiaPri TWCC_bPGlbLckErrPri TWCC_bPGlbPri TWCC_bPSysPriB1 TWCC_bPTempPriB1 TWCC_facOSCPriB1 TWCC_IBalPriB1IK_I.memory TWCC_IDLaH2PriB1LT_I.memory TWCC_ILamSwtH2PriB1EF_I.buffer TWCC_ILamSwtH2PriB1EF_I.oldSignal TWCC_ILamSwtH2PriB1T_I.timeCounter TWCC_ILdGradPriLT_I.memory TWCC_ILdGradPriTOFFV_I.outbit TWCC_ILdGradPriTOFFV_I.time TWCC_INLdPriTOFFV_I.outbit TWCC_INLdPriTOFFV_I.time TWCC_IOSCRlsH2PriB1IK_I.memory TWCC_mIBalPThresPriB1 TWCC_mIBalThresPriB1 TWCC_mPBalThresPriB1 TWCC_PBalPriB1IK_I.memory TWCC_PCoUsPriB1HDR_I.hysterese TWCC_PCoUsPriB1LT_I.memory TWCC_PCoUsPriB1TOFFV_I.outbit TWCC_PCoUsPriB1TOFFV_I.time TWCC_PLam1DrctPriB1TOFFV_I.outbit TWCC_PLam1DrctPriB1TOFFV_I.time TWCC_PLam1ErrPriB1TOFFV_I.outbit TWCC_PLam1ErrPriB1TOFFV_I.time TWCC_PLam1PriB1ER_I.buffer TWCC_PLam1PriB1ER_I.oldSignal TWCC_rIFlCPPri TWCC_tIMinPriB1 TWCC_tPMinPriB1 /end LOC_MEASUREMENT
 FUNCTION_VERSION "1.10.0" /end FUNCTION
/begin FUNCTION TWCC_TstCom "1.5.0" /begin IN_MEASUREMENT SyC_stSub TWCC_uSetPPriB1 /end IN_MEASUREMENT /begin OUT_MEASUREMENT TWCC_PID15B /end OUT_MEASUREMENT FUNCTION_VERSION "1.5.0" /end FUNCTION
/begin FUNCTION TWCD_AmpComp "1.2.0"
 /begin DEF_CHARACTERISTIC TWCD_AmpCompAppl_CW TWCD_AmpComp_CW TWCD_dmCatLdOfs_C TWCD_facAmpComp_C TWCD_facAmplLamCtrlTstReq_C TWCD_facAmplLamCtrl_C TWCD_facAmp_C TWCD_facCatAgeIni_C TWCD_facCatLdRich_C TWCD_facCorAmp_CUR TWCD_facCorAmp_MAP TWCD_facCorS1Dyn_CUR TWCD_facMaxLamCtrl_C TWCD_facOSCInc_MAP TWCD_mCatStrMdl_C TWCD_rAmpAbsHys_C TWCD_rAmpMin_C TWCD_rAmpRelHys_C TWCD_rCatLdMinTstReq_C TWCD_rCatLdMin_C TWCD_tiDiagTstReq_C TWCD_tiDiag_C TWCD_tiDlyBal_C TWCD_tiFltAmp_C TWCD_tiFltCatLdB1_CUR TWCD_tiFltLamCtrl_C TWCD_tiFltMeanVltg_C TWCD_tiFltVltgDif_C TWCD_tiGasMixBefCat_C TWCD_tiIniInteg_C TWCD_trqResv_C TWCD_uS2MdlFac_C TWCD_uS2MdlMean_C /end DEF_CHARACTERISTIC
 /begin IN_MEASUREMENT B_cdkat B_fakat B_pwf fr_w HEGOD_tiDeltaFltPerB1 HEGO_uS2B1 msabvhk_w SyC_stSub tkihkm_w TWCD_bEnaAmpB1 TWCD_bLamCtrlReqB1 TWCD_bTstReq /end IN_MEASUREMENT
 /begin OUT_MEASUREMENT ahkat ahkatn ahktki_w ahktnk akatbn avkatf B_dktakt B_dktt dkatakt_w dmrdkt_w falrdkt fdktav_w katbf katbfi_w katbfs katbshd_w osctvdkt_w tkivhkm_w TWCD_bActvB1 TWCD_bFinAmpCompB1 TWCD_dmCatLdRichB1 TWCD_facAmplLamCtrl TWCD_facCatAgeAmpCompB1 TWCD_facOSCInc TWCD_frqCatO2LdB1 TWCD_rAmpCompB1 TWCD_rAmpCompIntB1 TWCD_rAmpDifB1 TWCD_rAmpIntglB1 TWCD_rAmpNrmB1 TWCD_rAmpNrmMdlB1 TWCD_rCatLdIntglB1 TWCD_tAvrgCatB1 TWCD_tiDiagB1 TWCD_trqResv TWCD_uS2MdlB1 TWCD_uS2MeanB1 ushdktp /end OUT_MEASUREMENT
 /begin LOC_MEASUREMENT KATBFML_LT.memory TWCD_bAmpOnlyB1 TWCD_bIniAmpCompB1 TWCD_dmCatLdB1 TWCD_dmExhIntB1 TWCD_facCorAmpB1 TWCD_facCorS1DynB1 TWCD_rAmpCompRawB1 TWCD_rAmpMdlCorB1 TWCD_uDifMeanB1 TWCD_uS2MdlMeanB1 /end LOC_MEASUREMENT
 FUNCTION_VERSION "1.2.0" /end FUNCTION
/begin FUNCTION TWCD_AmpCompEna "1.2.0"
 /begin DEF_CHARACTERISTIC TWCD_frqCatO2LdMaxTstReq_C TWCD_frqCatO2LdMax_CUR TWCD_nEngMax_C TWCD_nEngMin_C TWCD_nEngTstReqMax_C TWCD_nEngTstReqMin_C TWCD_rCatLdIntglMax_C TWCD_rLdChgMaxTstReq_C TWCD_rLdChgMax_C TWCD_rLdMax_CUR TWCD_rLdMin_CUR TWCD_rLdTstReqMax_C TWCD_rLdTstReqMin_C TWCD_stAmpEna_CW TWCD_tEngStrtMin_C TWCD_tiDebLdCng_C TWCD_tiFltEngLd_C TWCD_tiFltTemp_C TWCD_tiStopDeb_C TWCD_tiStopLdCng_CUR TWCD_tiStopTempGrdt_CUR TWCD_tMax_C TWCD_tMin_C TWCD_tTstReqMin_C /end DEF_CHARACTERISTIC
 /begin IN_MEASUREMENT B_cdkat B_fa B_fakat B_frmax B_frmin B_lasostc B_lr B_lrka B_ukg Epm_nEngLRes HEGO_bS2B1HtgSuffRi HEGO_bS2B1Vld ml_w rl SyC_stSub tmst TWCC_bPPriB1 TWCD_bCalcFinB1 TWCD_frqCatO2LdB1 TWCD_rCatLdIntglB1 TWCD_tAvrgCatB1 /end IN_MEASUREMENT
 /begin OUT_MEASUREMENT B_dktlk B_dktlp B_dktnr B_dktsb B_dktsp B_dktst B_dkttk B_fakatv B_tmsdkt rldkthb TWCD_bEnaAmpB1 TWCD_bLamCtrlReqB1 TWCD_bLckdPID41 TWCD_bStopDSMB1 TWCD_bStopEngStrtTemp TWCD_bStopNLd TWCD_bStopPhyB1 TWCD_bStopTempB1 TWCD_bTstReq TWCD_rLdCng /end OUT_MEASUREMENT
 /begin LOC_MEASUREMENT TWCD_bDSMPrmsB1 TWCD_bStopDesLamB1 TWCD_bStopLamB1 TWCD_bStopLamCtrlB1 TWCD_bStopLdCng TWCD_bStopLdCngRaw TWCD_bStopS2B1 TWCD_bStopScav TWCD_rLdGrdt TWCD_tGrdtB1 TWCD_tiStopLdCng TWCD_tiStopTempB1 /end LOC_MEASUREMENT
 FUNCTION_VERSION "1.2.0" /end FUNCTION
/begin FUNCTION TWCD_DSMCfg "1.3.0" FUNCTION_VERSION "1.3.0" /end FUNCTION
/begin FUNCTION TWCD_Eval "1.3.0" /begin DEF_CHARACTERISTIC TWCD_rOSCThresB1_C TWCD_rOSCThresTstReqB1_C /end DEF_CHARACTERISTIC
 /begin IN_MEASUREMENT B_cdkat B_fakat SyC_stSub TWCD_bFinAmpCompB1 TWCD_bFinOSCMeasScndB1 TWCD_bLckdPID41 TWCD_rAmpCompB1 /end IN_MEASUREMENT
 /begin OUT_MEASUREMENT B_dktcfin B_vekat B_vekati B_zdkti dktval_w TWCD_bCalcFinB1 TWCD_bErrSusB1 TWCD_bErrSusIntB1 TWCD_bHealIntB1 TWCD_rDiagRsltB1 /end OUT_MEASUREMENT
 /begin LOC_MEASUREMENT TWCD_bErrB1 TWCD_bHealB1 TWCD_bVldnFinB1 TWCD_rDiagThreshB1 TWCD_stDiagB1 /end LOC_MEASUREMENT
 FUNCTION_VERSION "1.3.0" /end FUNCTION
/begin FUNCTION UAcc "29.0.0" FUNCTION_VERSION "29.0.0" /end FUNCTION
/begin FUNCTION UAccAppl "37.0.0" FUNCTION_VERSION "37.0.0" /end FUNCTION
/begin FUNCTION Uart "1.6.0" FUNCTION_VERSION "1.6.0" /end FUNCTION
/begin FUNCTION VehV2MED "3.0.0" /begin DEF_CHARACTERISTIC VFZMN /end DEF_CHARACTERISTIC /begin IN_MEASUREMENT VehV_a VehV_v VehV_vSens /end IN_MEASUREMENT /begin OUT_MEASUREMENT bfzgl_w B_vnull vfzg vfzg_w vfzroh_w /end OUT_MEASUREMENT FUNCTION_VERSION "3.0.0" /end FUNCTION
/begin FUNCTION VehV_DD "2.1.0"
 /begin DEF_CHARACTERISTIC VehV_ctDvtMax_C VehV_ctDvtMin_C VehV_facTireAxlCorrMax_C VehV_facTireAxlCorrMin_C VehV_numSegSens_C VehV_rAxl_C VehV_rThresWhlErr_C VehV_swtSig_C VehV_tiPerMax_C VehV_vWhlErrMax_C VehV_vWhlErrMin_C /end DEF_CHARACTERISTIC
 /begin IN_MEASUREMENT Com_vVeh GlbDa_lWhlCirc /end IN_MEASUREMENT
 /begin OUT_MEASUREMENT VehV_facTireAxlCorr VehV_tiPerAvrg VehV_vSens /end OUT_MEASUREMENT
 /begin LOC_MEASUREMENT VehV_ctPeriodOld_mp VehV_ctPeriod_mp VehV_tiDiff_mp VehV_tiPerAvrgOld_mp VehV_tiPeriodOld_mp VehV_tiPeriod_mp VehV_vRawOld_mp /end LOC_MEASUREMENT
 FUNCTION_VERSION "2.1.0" /end FUNCTION
/begin FUNCTION VehV_VD "2.2.0"
 /begin DEF_CHARACTERISTIC VehV_nThresPla_C VehV_swtCANSensErrEna_C VehV_swtTrqSel_C VehV_tiAPT1_C VehV_tiDebMonPla_C VehV_tiVPT1_C VehV_tiVRawPT1_C VehV_trqThresPla_C VehV_vDfl_C VehV_vLowThres_C VehV_vMaxFix_C VehV_vMax_C VehV_vMin_C VehV_vThresPla_C /end DEF_CHARACTERISTIC
 /begin IN_MEASUREMENT ActMod_trqInr Clth_st Com_stVehSpdSensErr Epm_nEng Gbx_numGear PthSet_trqInrSet /end IN_MEASUREMENT
 /begin OUT_MEASUREMENT VehV_a VehV_stTopSpdLim VehV_v /end OUT_MEASUREMENT
 /begin LOC_MEASUREMENT VehV_aRawUnFlt_mp VehV_vFltOld_mp VehV_vFlt_mp VehV_vUnFlt_mp /end LOC_MEASUREMENT
 FUNCTION_VERSION "2.2.0" /end FUNCTION
/begin FUNCTION VMAXMD "3.0.0" /begin DEF_CHARACTERISTIC KIVMXG KPVMXG TVMXPRG VFZGMX /end DEF_CHARACTERISTIC /begin IN_MEASUREMENT bfzgl_w dmllri_w gangi mifab_w mimin_w vfzg_w /end IN_MEASUREMENT /begin OUT_MEASUREMENT B_vmax mivmx_w /end OUT_MEASUREMENT /begin LOC_MEASUREMENT dvsi_w mivmxi_w mivmxp_w vivmx_w vsvmx_w /end LOC_MEASUREMENT FUNCTION_VERSION "3.0.0" /end FUNCTION
/begin FUNCTION VMDAdapt_Adapt "3.0.0" /begin DEF_CHARACTERISTIC CoVeh_trqAcs_C VehMot_rTrqDfftl_C /end DEF_CHARACTERISTIC /begin IN_MEASUREMENT APP_r /end IN_MEASUREMENT
 /begin OUT_MEASUREMENT CoVeh_trqAcs VehMot_rAccPedFlt VehMot_rTrqDfftl VehMot_stLimDfftl VehMot_stPrpAccPed VehMot_stStabIntv VehMot_trqPrtDfftl VMSI_trqMin /end OUT_MEASUREMENT
 FUNCTION_VERSION "3.0.0" /end FUNCTION
/begin FUNCTION ZUESZ "9.0.0" /begin DEF_CHARACTERISTIC KFFSZNM KFSZT SNM08ZUUB SUB08ZUUB /end DEF_CHARACTERISTIC /begin REF_CHARACTERISTIC STM08__UB /end REF_CHARACTERISTIC /begin IN_MEASUREMENT esst_stm08__ub nmot tmot ubsq /end IN_MEASUREMENT /begin OUT_MEASUREMENT B_ff fubaanz szout_w /end OUT_MEASUREMENT /begin LOC_MEASUREMENT ftsztl szouttem_w /end LOC_MEASUREMENT FUNCTION_VERSION "9.0.0" /end FUNCTION
/begin FUNCTION ZWBAS "1.3.0" /begin DEF_CHARACTERISTIC CWIGC ZWAPPL ZWBASFST /end DEF_CHARACTERISTIC /begin IN_MEASUREMENT B_stendmd dwkrz dzwks dzwwl wkrdyv zwgruhom zwstt zzylzue /end IN_MEASUREMENT /begin OUT_MEASUREMENT ovlzes zwbas zwbasar zwbasokr zwgru zzylzuear /end OUT_MEASUREMENT FUNCTION_VERSION "1.3.0" /end FUNCTION
/begin FUNCTION ZWGRU "6.0.0" /begin DEF_CHARACTERISTIC KFDZWKG KFZW NMZWGRUSYN SNMXZUUW SRLXZUUW /end DEF_CHARACTERISTIC /begin IN_MEASUREMENT dzwol lambas nmot nmot_w rl_w /end IN_MEASUREMENT /begin OUT_MEASUREMENT B_zwgrusyn zwgruhom zwkfzw /end OUT_MEASUREMENT /begin LOC_MEASUREMENT dzwkg /end LOC_MEASUREMENT FUNCTION_VERSION "6.0.0" /end FUNCTION
/begin FUNCTION ZWKS "3.0.0" /begin DEF_CHARACTERISTIC FKSFHO KFFWK KFWK KSZWE /end DEF_CHARACTERISTIC /begin REF_CHARACTERISTIC SNM24ZUUB SRL16ZUUB /end REF_CHARACTERISTIC /begin IN_MEASUREMENT esst_snm24zuub esst_srl16zuub fho nmot rl tans tmot /end IN_MEASUREMENT /begin OUT_MEASUREMENT dzwks /end OUT_MEASUREMENT FUNCTION_VERSION "3.0.0" /end FUNCTION
/begin FUNCTION ZWMINBG "1.3.0" /begin IN_MEASUREMENT B_zwappl flambts zwbas zwspaebts zwspaebvg /end IN_MEASUREMENT /begin OUT_MEASUREMENT zwspae /end OUT_MEASUREMENT FUNCTION_VERSION "1.3.0" /end FUNCTION
/begin FUNCTION ZWMINBVG "2.1.0"
 /begin DEF_CHARACTERISTIC DFZWMNST KFDZMNST KFZWMN KFZWMNKHLL KFZWMNLB KLDZWMNLAM KLDZWMNTM /end DEF_CHARACTERISTIC
 /begin REF_CHARACTERISTIC SNM16ZUUW SRL12ZUUW STM08__UB /end REF_CHARACTERISTIC
 /begin IN_MEASUREMENT B_kh B_ll B_munst B_stendzw esst_snm16zuuw esst_srl12zuuw esst_stm08__ub lambas nmot nmot_w rl rl_w tmot tmst zwstt /end IN_MEASUREMENT
 /begin OUT_MEASUREMENT B_zwmnst zwmnhom zwmnhomst zwspaebvg /end OUT_MEASUREMENT
 /begin LOC_MEASUREMENT dzwmnlam dzwmntm fzwmn_w zwmn /end LOC_MEASUREMENT
 FUNCTION_VERSION "2.1.0" /end FUNCTION
/begin FUNCTION ZWOUT "1.6.0"
 /begin IN_MEASUREMENT B_nozwe B_sa B_stendzw B_zwappl nmot redist zwbasar zwsol zwspae zzylzue zzylzuear /end IN_MEASUREMENT
 /begin OUT_MEASUREMENT B_zwspae zwcalcar zwcalcarcp zwist zwkrafld zwout zwoutcpl zwzyl1 /end OUT_MEASUREMENT
 FUNCTION_VERSION "1.6.0" /end FUNCTION
/begin FUNCTION ZWSTT "1.8.0" /begin DEF_CHARACTERISTIC DZWSTFHO DZWSTTA KFZWSTTM /end DEF_CHARACTERISTIC /begin IN_MEASUREMENT B_stendzw fho nmot_w tans tmst /end IN_MEASUREMENT /begin OUT_MEASUREMENT zwstt /end OUT_MEASUREMENT /begin LOC_MEASUREMENT nmotzwstt tmzwstt /end LOC_MEASUREMENT FUNCTION_VERSION "1.8.0" /end FUNCTION
/begin FUNCTION ZWWL "3.2.0" /begin DEF_CHARACTERISTIC CWZWWLE FZWWLRLN KFZWWLNMOT KFZWWLRL /end DEF_CHARACTERISTIC /begin IN_MEASUREMENT nmot rl taev_w tansk_w tavdk_w tmot /end IN_MEASUREMENT /begin OUT_MEASUREMENT dzwwl /end OUT_MEASUREMENT /begin LOC_MEASUREMENT tyzwwlnm_w /end LOC_MEASUREMENT FUNCTION_VERSION "3.2.0" /end FUNCTION
/begin COMPU_METHOD Acc "" RAT_FUNC "%6.5" "m/s^2" COEFFS 0 1000 0 0 0 1 /end COMPU_METHOD
/begin COMPU_METHOD bfzg_sw_q4p239Em4 "" RAT_FUNC "%10.7" "m/s^2" COEFFS 0 1 0 0 0 0.0004239 /end COMPU_METHOD
/begin COMPU_METHOD B_TRUE "" TAB_VERB "%6.3" "" COMPU_TAB_REF B_TRUE /end COMPU_METHOD
/begin COMPU_VTAB B_TRUE "" TAB_VERB 2 0 "----" 1 "TRUE" /end COMPU_VTAB
/begin COMPU_METHOD dez "" RAT_FUNC "%6.2" "" COEFFS 0 1 0 0 0 1 /end COMPU_METHOD
/begin COMPU_METHOD EngN "" RAT_FUNC "%6.3" "rpm" COEFFS 0 2 0 0 0 1 /end COMPU_METHOD
/begin COMPU_METHOD Fact0002 "" RAT_FUNC "%6.5" "-" COEFFS 0 5000 0 0 0 1 /end COMPU_METHOD
/begin COMPU_METHOD fak_q0p00015259 "" RAT_FUNC "%6.5" "" COEFFS 0 32768 0 0 0 5 /end COMPU_METHOD
/begin COMPU_METHOD fak_q0p0078 "" RAT_FUNC "%6.4" "-" COEFFS 0 128 0 0 0 1 /end COMPU_METHOD
/begin COMPU_METHOD fak_q0p1 "" RAT_FUNC "%6.3" "-" COEFFS 0 1 0 0 0 0.1 /end COMPU_METHOD
/begin COMPU_METHOD fak_q3p0518Em5 "" RAT_FUNC "%7.6" "" COEFFS 0 32768 0 0 0 1 /end COMPU_METHOD
/begin COMPU_METHOD fak_q3p0518Em6 "" RAT_FUNC "%8.7" "" COEFFS 0 65536 0 0 0 0.2 /end COMPU_METHOD
/begin COMPU_METHOD fak_q4p6566Em10 "" RAT_FUNC "%18.17" "" COEFFS 0 2147483648 0 0 0 1 /end COMPU_METHOD
/begin COMPU_METHOD fak_q4p6566Em11 "" RAT_FUNC "%13.12" "-" COEFFS 0 214748364.8 0 0 0 0.01 /end COMPU_METHOD
/begin COMPU_METHOD fak_q4p657Em10 "" RAT_FUNC "%12.11" "" COEFFS 0 4294970000 0 0 0 2 /end COMPU_METHOD
/begin COMPU_METHOD fak_sb_b1 "" RAT_FUNC "%6.4" "-" COEFFS 0 256 0 0 0 2 /end COMPU_METHOD
/begin COMPU_METHOD fak_sl_b1 "" RAT_FUNC "%12.11" "-" COEFFS 0 4294967296 0 0 0 2 /end COMPU_METHOD
/begin COMPU_METHOD fak_sw_b1 "" RAT_FUNC "%7.6" "-" COEFFS 0 65536 0 0 0 2 /end COMPU_METHOD
/begin COMPU_METHOD fak_ub_b1 "" RAT_FUNC "%6.4" "-" COEFFS 0 256 0 0 0 1 /end COMPU_METHOD
/begin COMPU_METHOD fak_ub_b100 "" RAT_FUNC "%6.3" "" COEFFS 0 255 0 0 0 100 /end COMPU_METHOD
/begin COMPU_METHOD fak_ub_b2 "" RAT_FUNC "%8.5" "-" COEFFS 0 256 0 0 0 2 /end COMPU_METHOD
/begin COMPU_METHOD fak_ub_b4 "" RAT_FUNC "%6.4" "-" COEFFS 0 256 0 0 0 4 /end COMPU_METHOD
/begin COMPU_METHOD fak_ub_b8 "" RAT_FUNC "%6.4" "-" COEFFS 0 256 0 0 0 8 /end COMPU_METHOD
/begin COMPU_METHOD fak_uw_b1 "" RAT_FUNC "%7.6" "-" COEFFS 0 65536 0 0 0 1 /end COMPU_METHOD
/begin COMPU_METHOD fak_uw_b16 "" RAT_FUNC "%6.5" "-" COEFFS 0 65536 0 0 0 16 /end COMPU_METHOD
/begin COMPU_METHOD fak_uw_b2 "" RAT_FUNC "%7.6" "-" COEFFS 0 65536 0 0 0 2 /end COMPU_METHOD
/begin COMPU_METHOD freq_sw_b512 "" RAT_FUNC "%6.4" "1/s" COEFFS 0 65536 0 0 0 1024 /end COMPU_METHOD
/begin COMPU_METHOD kw_q0p75 "" RAT_FUNC "%6.3" "Grad KW" COEFFS 0 4 0 0 0 3 /end COMPU_METHOD
/begin COMPU_METHOD mgrad_sw_b28p44 "" RAT_FUNC "%6.5" "g/s" COEFFS 0 230.4 0 0 0 0.2 /end COMPU_METHOD
/begin COMPU_METHOD mgrad_ub_b221p35 "" RAT_FUNC "%6.2" "mg/s" COEFFS 0 230.4 0 0 0 200 /end COMPU_METHOD
/begin COMPU_METHOD m_q0p02_mgO2 "" RAT_FUNC "%6.4" "mgO2" COEFFS 0 50 0 0 0 1 /end COMPU_METHOD
/begin COMPU_METHOD m_q0p1 "" RAT_FUNC "%6.3" "kg/h" COEFFS 0 10 0 0 0 1 /end COMPU_METHOD
/begin COMPU_METHOD m_q0p1_g "" RAT_FUNC "%6.3" "g" COEFFS 0 10 0 0 0 1 /end COMPU_METHOD
/begin COMPU_METHOD m_q0p1_mg "" RAT_FUNC "%6.3" "mg" COEFFS 0 1 0 0 0 0.1 /end COMPU_METHOD
/begin COMPU_METHOD m_q0p1_mgs "" RAT_FUNC "%6.3" "mg/s" COEFFS 0 1 0 0 0 0.1 /end COMPU_METHOD
/begin COMPU_METHOD m_q1p5259Em6_mg "" RAT_FUNC "%8.7" "mg" COEFFS 0 655360 0 0 0 1 /end COMPU_METHOD
/begin COMPU_METHOD m_q1p526Em6_g "" RAT_FUNC "%8.7" "g" COEFFS 0 655360 0 0 0 1 /end COMPU_METHOD
/begin COMPU_METHOD m_q1p695Em6 "" RAT_FUNC "%8.7" "g" COEFFS 0 589824 0 0 0 1 /end COMPU_METHOD
/begin COMPU_METHOD m_q3p0518Em7_mgO2 "" RAT_FUNC "%9.8" "mgO2" COEFFS 0 3276800 0 0 0 1 /end COMPU_METHOD
/begin COMPU_METHOD m_ub_b221p35 "" RAT_FUNC "%6.2" "mg" COEFFS 0 230.4 0 0 0 200 /end COMPU_METHOD
/begin COMPU_METHOD m_uw_b6553p5 "" RAT_FUNC "%6.3" "kg/h" COEFFS 0 1 0 0 0 0.1 /end COMPU_METHOD
/begin COMPU_METHOD m_uw_b7281 "" RAT_FUNC "%6.3" "g" COEFFS 0 9 0 0 0 1 /end COMPU_METHOD
/begin COMPU_METHOD nmot_q0p25 "" RAT_FUNC "%6.3" "1/min" COEFFS 0 4 0 0 0 1 /end COMPU_METHOD
/begin COMPU_METHOD nmot_q40 "" RAT_FUNC "%6.1" "1/min" COEFFS 0 1 0 0 0 40 /end COMPU_METHOD
/begin COMPU_METHOD nmot_ub_q40 "" RAT_FUNC "%6.1" "1/min" COEFFS 0 1 0 0 0 40 /end COMPU_METHOD
/begin COMPU_METHOD nmot_uw_q0p25 "" RAT_FUNC "%6.3" "1/min" COEFFS 0 1 0 0 0 0.25 /end COMPU_METHOD
/begin COMPU_METHOD OneToOne "" RAT_FUNC "%6.2" "-" COEFFS 0 1 0 0 0 1 /end COMPU_METHOD
/begin COMPU_METHOD PerKm "" RAT_FUNC "%6.2" "l/km" COEFFS 0 1 0 0 0 1 /end COMPU_METHOD
/begin COMPU_METHOD Prc "" RAT_FUNC "%6.4" "%" COEFFS 0 81.92 0 0 0 1 /end COMPU_METHOD
/begin COMPU_METHOD Prc_q0p01_COMPU "" RAT_FUNC "%6.4" "%" COEFFS 0 100 0 0 0 1 /end COMPU_METHOD
/begin COMPU_METHOD q11p1_mg_DIV_V_s "" RAT_FUNC "%6.1" "mg/(V*s)" COEFFS 0 9 0 0 0 100 /end COMPU_METHOD
/begin COMPU_METHOD rel_q0p007629 "" RAT_FUNC "%10.6" "%/(km/h)/s" COEFFS 0 65536 0 0 0 500 /end COMPU_METHOD
/begin COMPU_METHOD rel_q0p0234 "" RAT_FUNC "%6.4" "%" COEFFS 0 128 0 0 0 3 /end COMPU_METHOD
/begin COMPU_METHOD rel_q0p02344 "" RAT_FUNC "%6.4" "%" COEFFS 0 32 0 0 0 0.75 /end COMPU_METHOD
/begin COMPU_METHOD rel_q0p75 "" RAT_FUNC "%6.3" "%" COEFFS 0 4 0 0 0 3 /end COMPU_METHOD
/begin COMPU_METHOD rel_q2p929Em3 "" RAT_FUNC "%6.4" "%" COEFFS 0 1024 0 0 0 3 /end COMPU_METHOD
/begin COMPU_METHOD rel_q3p576Em7 "" RAT_FUNC "%9.8" "%" COEFFS 0 8388608 0 0 0 3 /end COMPU_METHOD
/begin COMPU_METHOD rel_sb_q0p75 "" RAT_FUNC "%6.3" "%" COEFFS 0 1 0 0 0 0.75 /end COMPU_METHOD
/begin COMPU_METHOD rel_sw_b100 "" RAT_FUNC "%6.4" "%" COEFFS 0 32768 0 0 0 100 /end COMPU_METHOD
/begin COMPU_METHOD rel_ub_q0p391 "" RAT_FUNC "%6.3" "%/km/h" COEFFS 0 1 0 0 0 0.391 /end COMPU_METHOD
/begin COMPU_METHOD rel_ub_q0p75 "" RAT_FUNC "%6.3" "%" COEFFS 0 1 0 0 0 0.75 /end COMPU_METHOD
/begin COMPU_METHOD rel_uw_b100 "" RAT_FUNC "%6.4" "%" COEFFS 0 65536 0 0 0 100 /end COMPU_METHOD
/begin COMPU_METHOD spg_q0p00488 "" RAT_FUNC "%6.4" "V" COEFFS 0 1024 0 0 0 5 /end COMPU_METHOD
/begin COMPU_METHOD spg_q0p00977 "" RAT_FUNC "%6.4" "V" COEFFS 0 256 0 0 0 2.5 /end COMPU_METHOD
/begin COMPU_METHOD spg_q0p1 "" RAT_FUNC "%6.3" "V" COEFFS 0 1 0 0 0 0.1 /end COMPU_METHOD
/begin COMPU_METHOD spg_ub_q0p0052 "" RAT_FUNC "%6.4" "V" COEFFS 0 255 0 0 0 1.33 /end COMPU_METHOD
/begin COMPU_METHOD spg_ub_q0p0052_o0p2 "" RAT_FUNC "%6.3" "V" COEFFS 0 255 51 0 0 1.33 /end COMPU_METHOD
/begin COMPU_METHOD spg_uw_q0p00488_o1 "" RAT_FUNC "%6.3" "V" COEFFS 0 1024 1024 0 0 5 /end COMPU_METHOD
/begin COMPU_METHOD t20msxs_ub_q0p02 "" RAT_FUNC "%6.4" "s" COEFFS 0 50 0 0 0 1 /end COMPU_METHOD
/begin COMPU_METHOD t50msxs_uw_b819p2 "" RAT_FUNC "%6.4" "s" COEFFS 0 1 0 0 0 0.0125 /end COMPU_METHOD
/begin COMPU_METHOD Temp_Cels "" RAT_FUNC "%6.1" "deg C" COEFFS 0 10 2731.4 0 0 1 /end COMPU_METHOD
/begin COMPU_METHOD temp_q0p0234 "" RAT_FUNC "%6.4" "K" COEFFS 0 256 0 0 0 6 /end COMPU_METHOD
/begin COMPU_METHOD temp_q0p0234_o273 "" RAT_FUNC "%6.1" "Grad C" COEFFS 0 1 273.15 0 0 0.0234375 /end COMPU_METHOD
/begin COMPU_METHOD temp_q0p0234_om273 "" RAT_FUNC "%6.1" "Grad C" COEFFS 0 640 174816 0 0 15 /end COMPU_METHOD
/begin COMPU_METHOD temp_q0p75_om48 "" RAT_FUNC "%6.2" "Grad C" COEFFS 0 4 192 0 0 3 /end COMPU_METHOD
/begin COMPU_METHOD temp_q1_om40 "" RAT_FUNC "%6.2" "Grad C" COEFFS 0 1 40 0 0 1 /end COMPU_METHOD
/begin COMPU_METHOD temp_ub_q0p75_o48 "" RAT_FUNC "%6.2" "Grad C" COEFFS 0 1 48 0 0 0.75 /end COMPU_METHOD
/begin COMPU_METHOD temp_ub_q1_o40 "" RAT_FUNC "%6.2" "Grad C" COEFFS 0 1 40 0 0 1 /end COMPU_METHOD
/begin COMPU_METHOD TimeDelay_s "" RAT_FUNC "%12.4" "s" COEFFS 0 0 1 0 0.00023283064365387 0 /end COMPU_METHOD
/begin COMPU_METHOD Time_ms "" RAT_FUNC "%6.1" "ms" COEFFS 0 0.1 0 0 0 1 /end COMPU_METHOD
/begin COMPU_METHOD Time_PwmHigh "" RAT_FUNC "%6.4" "us" COEFFS 0 20 0 0 0 1 /end COMPU_METHOD
/begin COMPU_METHOD TransR "" RAT_FUNC "%6.4" "-" COEFFS 0 100 0 0 0 1 /end COMPU_METHOD
/begin COMPU_METHOD Trq "" RAT_FUNC "%6.3" "Nm" COEFFS 0 10 0 0 0 1 /end COMPU_METHOD
/begin COMPU_METHOD TrqPrpHigh "" RAT_FUNC "%6.3" "Nm" COEFFS 0 10 0 0 0 1 /end COMPU_METHOD
/begin COMPU_METHOD TRQRESV_CONST_SY_Compu "" TAB_VERB "%6.3" "" COMPU_TAB_REF TRQRESV_CONST_SY_Compu /end COMPU_METHOD
/begin COMPU_VTAB TRQRESV_CONST_SY_Compu "" TAB_VERB 2 0 "0" 1 "1" /end COMPU_VTAB
/begin COMPU_METHOD TRQRESV_CP_SY_Compu "" TAB_VERB "%6.3" "" COMPU_TAB_REF TRQRESV_CP_SY_Compu /end COMPU_METHOD
/begin COMPU_VTAB TRQRESV_CP_SY_Compu "" TAB_VERB 2 0 "no torque reserve for purge control available" 1 "torque reserve for purge control available" /end COMPU_VTAB
/begin COMPU_METHOD TRQRESV_ETAREQ_SY_Compu "" TAB_VERB "%6.3" "" COMPU_TAB_REF TRQRESV_ETAREQ_SY_Compu /end COMPU_METHOD
/begin COMPU_VTAB TRQRESV_ETAREQ_SY_Compu "" TAB_VERB 2 0 "0" 1 "1" /end COMPU_VTAB
/begin COMPU_METHOD TRQRESV_EXL_SY_Compu "" TAB_VERB "%6.3" "" COMPU_TAB_REF TRQRESV_EXL_SY_Compu /end COMPU_METHOD
/begin COMPU_VTAB TRQRESV_EXL_SY_Compu "" TAB_VERB 3 0 "no_excl_t_reserve" 1 "basic" 2 "standard" /end COMPU_VTAB
/begin COMPU_METHOD TRQRNG_EXL_SY_Compu "" TAB_VERB "%6.3" "" COMPU_TAB_REF TRQRNG_EXL_SY_Compu /end COMPU_METHOD
/begin COMPU_VTAB TRQRNG_EXL_SY_Compu "" TAB_VERB 2 0 "False" 1 "True" /end COMPU_VTAB
/begin COMPU_METHOD TrqToNSqr "" RAT_FUNC "%10.9" "-" COEFFS 0 10000000 0 0 0 1 /end COMPU_METHOD
/begin COMPU_METHOD TRQ_MONLIM_CNT_SY_Compu "" TAB_VERB "%6.3" "" COMPU_TAB_REF TRQ_MONLIM_CNT_SY_Compu /end COMPU_METHOD
/begin COMPU_VTAB TRQ_MONLIM_CNT_SY_Compu "" TAB_VERB 2 0 "False" 1 "True" /end COMPU_VTAB
/begin COMPU_METHOD TRQ_MONLIM_DIAG_SY_Compu "" TAB_VERB "%6.3" "" COMPU_TAB_REF TRQ_MONLIM_DIAG_SY_Compu /end COMPU_METHOD
/begin COMPU_VTAB TRQ_MONLIM_DIAG_SY_Compu "" TAB_VERB 2 0 "False" 1 "True" /end COMPU_VTAB
/begin COMPU_METHOD TRQ_WOTRAINTV_SY_Compu "" TAB_VERB "%6.3" "" COMPU_TAB_REF TRQ_WOTRAINTV_SY_Compu /end COMPU_METHOD
/begin COMPU_VTAB TRQ_WOTRAINTV_SY_Compu "" TAB_VERB 2 0 "0" 1 "1" /end COMPU_VTAB
/begin COMPU_METHOD TS_CTTMON_SY_Compu "" TAB_VERB "%6.3" "" COMPU_TAB_REF TS_CTTMON_SY_Compu /end COMPU_METHOD
/begin COMPU_VTAB TS_CTTMON_SY_Compu "" TAB_VERB 3 0 "CTTMON_OFF" 1 "CTTMON_AIRMASS" 2 "CTTMON_TEMP" /end COMPU_VTAB
/begin COMPU_METHOD TS_HPPMPPRT_SY_Compu "" TAB_VERB "%6.3" "" COMPU_TAB_REF TS_HPPMPPRT_SY_Compu /end COMPU_METHOD
/begin COMPU_VTAB TS_HPPMPPRT_SY_Compu "" TAB_VERB 2 0 "FALSE" 1 "TRUE" /end COMPU_VTAB
/begin COMPU_METHOD TS_INTRCLRCO_SY_Compu "" TAB_VERB "%6.3" "" COMPU_TAB_REF TS_INTRCLRCO_SY_Compu /end COMPU_METHOD
/begin COMPU_VTAB TS_INTRCLRCO_SY_Compu "" TAB_VERB 2 0 "FALSE" 1 "TRUE" /end COMPU_VTAB
/begin COMPU_METHOD TS_LOTEMPRADCO_SY_Compu "" TAB_VERB "%6.3" "" COMPU_TAB_REF TS_LOTEMPRADCO_SY_Compu /end COMPU_METHOD
/begin COMPU_VTAB TS_LOTEMPRADCO_SY_Compu "" TAB_VERB 2 0 "FALSE" 1 "TRUE" /end COMPU_VTAB
/begin COMPU_METHOD TS_LTCCIRMON_SY_Compu "" TAB_VERB "%6.3" "" COMPU_TAB_REF TS_LTCCIRMON_SY_Compu /end COMPU_METHOD
/begin COMPU_VTAB TS_LTCCIRMON_SY_Compu "" TAB_VERB 3 0 "NOTAVL" 1 "ACTHYB" 2 "ACTDS" /end COMPU_VTAB
/begin COMPU_METHOD TWCCBALUP_SY_Compu "" TAB_VERB "%6.3" "" COMPU_TAB_REF TWCCBALUP_SY_Compu /end COMPU_METHOD
/begin COMPU_VTAB TWCCBALUP_SY_Compu "" TAB_VERB 2 0 "not included" 1 "included" /end COMPU_VTAB
/begin COMPU_METHOD TWCCMODLNBAL_SY_Compu "" TAB_VERB "%6.3" "" COMPU_TAB_REF TWCCMODLNBAL_SY_Compu /end COMPU_METHOD
/begin COMPU_VTAB TWCCMODLNBAL_SY_Compu "" TAB_VERB 2 0 "not included" 1 "included" /end COMPU_VTAB
/begin COMPU_METHOD TWCCModlnBal_SY_Compu "" TAB_VERB "%6.3" "" COMPU_TAB_REF TWCCModlnBal_SY_Compu /end COMPU_METHOD
/begin COMPU_VTAB TWCCModlnBal_SY_Compu "" TAB_VERB 2 0 "not included" 1 "included" /end COMPU_VTAB
/begin COMPU_METHOD TWCCOBDFUELTRIM_SY_Compu "" TAB_VERB "%6.3" "" COMPU_TAB_REF TWCCOBDFUELTRIM_SY_Compu /end COMPU_METHOD
/begin COMPU_VTAB TWCCOBDFUELTRIM_SY_Compu "" TAB_VERB 2 0 "False" 1 "True" /end COMPU_VTAB
/begin COMPU_METHOD TWCCPRIB1_SY_Compu "" TAB_VERB "%6.3" "" COMPU_TAB_REF TWCCPRIB1_SY_Compu /end COMPU_METHOD
/begin COMPU_VTAB TWCCPRIB1_SY_Compu "" TAB_VERB 4 0 "not included" 3 "control value sensor 3 bank 1" 1 "control value sensor 1 bank 1" 2 "control value sensor 2 bank 1" /end COMPU_VTAB
/begin COMPU_METHOD TWCCPRIB2_SY_Compu "" TAB_VERB "%6.3" "" COMPU_TAB_REF TWCCPRIB2_SY_Compu /end COMPU_METHOD
/begin COMPU_VTAB TWCCPRIB2_SY_Compu "" TAB_VERB 4 0 "not included" 1 "control value sensor 1 bank 1" 2 "control value sensor 2 bank 1" 3 "control value sensor 3 bank 1" /end COMPU_VTAB
/begin COMPU_METHOD TWCCPRINF_SY_Compu "" TAB_VERB "%6.3" "" COMPU_TAB_REF TWCCPRINF_SY_Compu /end COMPU_METHOD
/begin COMPU_VTAB TWCCPRINF_SY_Compu "" TAB_VERB 2 0 "not included" 1 "included" /end COMPU_VTAB
/begin COMPU_METHOD TWCCPriNF_SY_Compu "" TAB_VERB "%6.3" "" COMPU_TAB_REF TWCCPriNF_SY_Compu /end COMPU_METHOD
/begin COMPU_VTAB TWCCPriNF_SY_Compu "" TAB_VERB 2 0 "not included" 1 "included" /end COMPU_VTAB
/begin COMPU_METHOD TWCCSCNDB1_SY_Compu "" TAB_VERB "%6.3" "" COMPU_TAB_REF TWCCSCNDB1_SY_Compu /end COMPU_METHOD
/begin COMPU_VTAB TWCCSCNDB1_SY_Compu "" TAB_VERB 4 0 "not included" 1 "control value sensor 1 bank 1" 2 "control value sensor 2 bank 1" 3 "control value sensor 3 bank 1" /end COMPU_VTAB
/begin COMPU_METHOD TWCCSCNDB2_SY_Compu "" TAB_VERB "%6.3" "" COMPU_TAB_REF TWCCSCNDB2_SY_Compu /end COMPU_METHOD
/begin COMPU_VTAB TWCCSCNDB2_SY_Compu "" TAB_VERB 4 0 "not included" 1 "control value sensor 1 bank 1" 2 "control value sensor 2 bank 1" 3 "control value sensor 3 bank 1" /end COMPU_VTAB
/begin COMPU_METHOD TWCDCATHEATGREQ_SY_Compu "" TAB_VERB "%6.3" "" COMPU_TAB_REF TWCDCATHEATGREQ_SY_Compu /end COMPU_METHOD
/begin COMPU_VTAB TWCDCATHEATGREQ_SY_Compu "" TAB_VERB 2 0 "False" 1 "True" /end COMPU_VTAB
/begin COMPU_METHOD TWCDEWMA_SY_Compu "" TAB_VERB "%6.3" "" COMPU_TAB_REF TWCDEWMA_SY_Compu /end COMPU_METHOD
/begin COMPU_VTAB TWCDEWMA_SY_Compu "" TAB_VERB 2 0 "FALSE" 1 "TRUE" /end COMPU_VTAB
/begin COMPU_METHOD TWCDMODCMPPRIB1_SY_Compu "" TAB_VERB "%6.3" "" COMPU_TAB_REF TWCDMODCMPPRIB1_SY_Compu /end COMPU_METHOD
/begin COMPU_VTAB TWCDMODCMPPRIB1_SY_Compu "" TAB_VERB 2 0 "False" 1 "True" /end COMPU_VTAB
/begin COMPU_METHOD TWCDMODCMPPRIB2_SY_Compu "" TAB_VERB "%6.3" "" COMPU_TAB_REF TWCDMODCMPPRIB2_SY_Compu /end COMPU_METHOD
/begin COMPU_VTAB TWCDMODCMPPRIB2_SY_Compu "" TAB_VERB 2 0 "False" 1 "True" /end COMPU_VTAB
/begin COMPU_METHOD TWCDMODCMPSCNDB1_SY_Compu "" TAB_VERB "%6.3" "" COMPU_TAB_REF TWCDMODCMPSCNDB1_SY_Compu /end COMPU_METHOD
/begin COMPU_VTAB TWCDMODCMPSCNDB1_SY_Compu "" TAB_VERB 2 0 "False" 1 "True" /end COMPU_VTAB
/begin COMPU_METHOD TWCDMODCMPSCNDB2_SY_Compu "" TAB_VERB "%6.3" "" COMPU_TAB_REF TWCDMODCMPSCNDB2_SY_Compu /end COMPU_METHOD
/begin COMPU_VTAB TWCDMODCMPSCNDB2_SY_Compu "" TAB_VERB 2 0 "False" 1 "True" /end COMPU_VTAB
/begin COMPU_METHOD TWCDOSCPAPRIB1_SY_Compu "" TAB_VERB "%6.3" "" COMPU_TAB_REF TWCDOSCPAPRIB1_SY_Compu /end COMPU_METHOD
/begin COMPU_VTAB TWCDOSCPAPRIB1_SY_Compu "" TAB_VERB 2 0 "False" 1 "True" /end COMPU_VTAB
/begin COMPU_METHOD TWCDOSCPAPRIB2_SY_Compu "" TAB_VERB "%6.3" "" COMPU_TAB_REF TWCDOSCPAPRIB2_SY_Compu /end COMPU_METHOD
/begin COMPU_VTAB TWCDOSCPAPRIB2_SY_Compu "" TAB_VERB 2 0 "False" 1 "True" /end COMPU_VTAB
/begin COMPU_METHOD TWCDOSCPASCNDB1_SY_Compu "" TAB_VERB "%6.3" "" COMPU_TAB_REF TWCDOSCPASCNDB1_SY_Compu /end COMPU_METHOD
/begin COMPU_VTAB TWCDOSCPASCNDB1_SY_Compu "" TAB_VERB 2 0 "False" 1 "True" /end COMPU_VTAB
/begin COMPU_METHOD TWCDOSCPASCNDB2_SY_Compu "" TAB_VERB "%6.3" "" COMPU_TAB_REF TWCDOSCPASCNDB2_SY_Compu /end COMPU_METHOD
/begin COMPU_VTAB TWCDOSCPASCNDB2_SY_Compu "" TAB_VERB 2 0 "False" 1 "True" /end COMPU_VTAB
/begin COMPU_METHOD TWCDOSCPATST_SY_Compu "" TAB_VERB "%6.3" "" COMPU_TAB_REF TWCDOSCPATST_SY_Compu /end COMPU_METHOD
/begin COMPU_VTAB TWCDOSCPATST_SY_Compu "" TAB_VERB 2 0 "False" 1 "True" /end COMPU_VTAB
/begin COMPU_METHOD TWCDOSCPRIB1_SY_Compu "" TAB_VERB "%6.3" "" COMPU_TAB_REF TWCDOSCPRIB1_SY_Compu /end COMPU_METHOD
/begin COMPU_VTAB TWCDOSCPRIB1_SY_Compu "" TAB_VERB 2 0 "False" 1 "True" /end COMPU_VTAB
/begin COMPU_METHOD TWCDOSCPRIB2_SY_Compu "" TAB_VERB "%6.3" "" COMPU_TAB_REF TWCDOSCPRIB2_SY_Compu /end COMPU_METHOD
/begin COMPU_VTAB TWCDOSCPRIB2_SY_Compu "" TAB_VERB 2 0 "False" 1 "True" /end COMPU_VTAB
/begin COMPU_METHOD TWCDOSCSCNDB1_SY_Compu "" TAB_VERB "%6.3" "" COMPU_TAB_REF TWCDOSCSCNDB1_SY_Compu /end COMPU_METHOD
/begin COMPU_VTAB TWCDOSCSCNDB1_SY_Compu "" TAB_VERB 2 0 "False" 1 "True" /end COMPU_VTAB
/begin COMPU_METHOD TWCDOSCSCNDB2_SY_Compu "" TAB_VERB "%6.3" "" COMPU_TAB_REF TWCDOSCSCNDB2_SY_Compu /end COMPU_METHOD
/begin COMPU_VTAB TWCDOSCSCNDB2_SY_Compu "" TAB_VERB 2 0 "False" 1 "True" /end COMPU_VTAB
/begin COMPU_METHOD TWCDPATST_SY_Compu "" TAB_VERB "%6.3" "" COMPU_TAB_REF TWCDPATST_SY_Compu /end COMPU_METHOD
/begin COMPU_VTAB TWCDPATST_SY_Compu "" TAB_VERB 2 0 "not active" 1 "active" /end COMPU_VTAB
/begin COMPU_METHOD TWCDRSCPATST_SY_Compu "" TAB_VERB "%6.3" "" COMPU_TAB_REF TWCDRSCPATST_SY_Compu /end COMPU_METHOD
/begin COMPU_VTAB TWCDRSCPATST_SY_Compu "" TAB_VERB 2 0 "False" 1 "True" /end COMPU_VTAB
/begin COMPU_METHOD TWCDRSCPRIB1_SY_Compu "" TAB_VERB "%6.3" "" COMPU_TAB_REF TWCDRSCPRIB1_SY_Compu /end COMPU_METHOD
/begin COMPU_VTAB TWCDRSCPRIB1_SY_Compu "" TAB_VERB 2 0 "False" 1 "True" /end COMPU_VTAB
/begin COMPU_METHOD TWCDRSCPRIB2_SY_Compu "" TAB_VERB "%6.3" "" COMPU_TAB_REF TWCDRSCPRIB2_SY_Compu /end COMPU_METHOD
/begin COMPU_VTAB TWCDRSCPRIB2_SY_Compu "" TAB_VERB 2 0 "False" 1 "True" /end COMPU_VTAB
/begin COMPU_METHOD TWCDRSCSCNDB1_SY_Compu "" TAB_VERB "%6.3" "" COMPU_TAB_REF TWCDRSCSCNDB1_SY_Compu /end COMPU_METHOD
/begin COMPU_VTAB TWCDRSCSCNDB1_SY_Compu "" TAB_VERB 2 0 "False" 1 "True" /end COMPU_VTAB
/begin COMPU_METHOD TWCDRSCSCNDB2_SY_Compu "" TAB_VERB "%6.3" "" COMPU_TAB_REF TWCDRSCSCNDB2_SY_Compu /end COMPU_METHOD
/begin COMPU_VTAB TWCDRSCSCNDB2_SY_Compu "" TAB_VERB 2 0 "False" 1 "True" /end COMPU_VTAB
/begin COMPU_METHOD TWCDRSCTHRDB1_SY_Compu "" TAB_VERB "%6.3" "" COMPU_TAB_REF TWCDRSCTHRDB1_SY_Compu /end COMPU_METHOD
/begin COMPU_VTAB TWCDRSCTHRDB1_SY_Compu "" TAB_VERB 2 0 "False" 1 "True" /end COMPU_VTAB
/begin COMPU_METHOD TWCDRSCTHRDB2_SY_Compu "" TAB_VERB "%6.3" "" COMPU_TAB_REF TWCDRSCTHRDB2_SY_Compu /end COMPU_METHOD
/begin COMPU_VTAB TWCDRSCTHRDB2_SY_Compu "" TAB_VERB 2 0 "False" 1 "True" /end COMPU_VTAB
/begin COMPU_METHOD TWCD_STRATIUMPRSIMN_SC_Compu "" TAB_VERB "%6.3" "" COMPU_TAB_REF TWCD_STRATIUMPRSIMN_SC_Compu /end COMPU_METHOD
/begin COMPU_VTAB TWCD_STRATIUMPRSIMN_SC_Compu "" TAB_VERB 2 0 "False" 1 "True" /end COMPU_VTAB
/begin COMPU_METHOD TWC_NmngCnvtn_SC_Compu "" TAB_VERB "%6.3" "" COMPU_TAB_REF TWC_NmngCnvtn_SC_Compu /end COMPU_METHOD
/begin COMPU_VTAB TWC_NmngCnvtn_SC_Compu "" TAB_VERB 4 0 "0" 1 "1" 2 "2" 3 "3" /end COMPU_VTAB
/begin COMPU_METHOD TWC_VAR_SY_Compu "" TAB_VERB "%6.3" "" COMPU_TAB_REF TWC_VAR_SY_Compu /end COMPU_METHOD
/begin COMPU_VTAB TWC_VAR_SY_Compu "" TAB_VERB 32 1 "DAI" 3 "VWW" 5 "AUD" 22 "FOR" 147 "HYU" 999 "ALL" 214 "AVT" 9 "FIA" 21 "GMU" 159 "HON" 160 "MAZ" 123 "MIT" 20 "NIS" 14 "PSA" 4 "POR" 15 "REN" 248 "SUZ" 308 "TAT" 72 "TOY" 6 "OPE" 19 "VOL" 55 "ROL" 18 "SAB" 69 "FER" 51 "SEA" 204 "VVW" 17 "ALF" 289 "AMG" 11 "BMW" 183 "CU" 385 "UAES" 243 "DMC" /end COMPU_VTAB
/begin COMPU_METHOD t_q0p001 "" RAT_FUNC "%6.5" "s" COEFFS 0 1000 0 0 0 1 /end COMPU_METHOD
/begin COMPU_METHOD t_q0p001_ms "" RAT_FUNC "%6.5" "ms" COEFFS 0 1 0 0 0 0.001 /end COMPU_METHOD
/begin COMPU_METHOD t_q0p01 "" RAT_FUNC "%6.4" "" COEFFS 0 100 0 0 0 1 /end COMPU_METHOD
/begin COMPU_METHOD t_q0p02 "" RAT_FUNC "%6.4" "s" COEFFS 0 100 0 0 0 2 /end COMPU_METHOD
/begin COMPU_METHOD t_q0p05 "" RAT_FUNC "%6.4" "s" COEFFS 0 100 0 0 0 5 /end COMPU_METHOD
/begin COMPU_METHOD t_q0p1 "" RAT_FUNC "%6.3" "s" COEFFS 0 10 0 0 0 1 /end COMPU_METHOD
/begin COMPU_METHOD t_q0p2 "" RAT_FUNC "%6.3" "s" COEFFS 0 10 0 0 0 2 /end COMPU_METHOD
/begin COMPU_METHOD t_q1 "" RAT_FUNC "%6.2" "s" COEFFS 0 1 0 0 0 1 /end COMPU_METHOD
/begin COMPU_METHOD UART_SY_Compu "" TAB_VERB "%6.3" "" COMPU_TAB_REF UART_SY_Compu /end COMPU_METHOD
/begin COMPU_VTAB UART_SY_Compu "" TAB_VERB 2 0 "UART not used" 1 "UART used" /end COMPU_VTAB
/begin COMPU_METHOD UBFAILSRC_SY_Compu "" TAB_VERB "%6.3" "" COMPU_TAB_REF UBFAILSRC_SY_Compu /end COMPU_METHOD
/begin COMPU_VTAB UBFAILSRC_SY_Compu "" TAB_VERB 2 0 "NONE" 1 "PWRSPLYCHIP" /end COMPU_VTAB
/begin COMPU_METHOD UEGO_S1B1_SY_Compu "" TAB_VERB "%6.3" "" COMPU_TAB_REF UEGO_S1B1_SY_Compu /end COMPU_METHOD
/begin COMPU_VTAB UEGO_S1B1_SY_Compu "" TAB_VERB 2 0 "False" 1 "True" /end COMPU_VTAB
/begin COMPU_METHOD VARCOD_SY_Compu "" TAB_VERB "%6.3" "" COMPU_TAB_REF VARCOD_SY_Compu /end COMPU_METHOD
/begin COMPU_VTAB VARCOD_SY_Compu "" TAB_VERB 4 0 "VARCOD_NO" 2 "VARCOD_SHORT" 1 "VARCOD_LONG" 3 "VARCOD_CONCERN" /end COMPU_VTAB
/begin COMPU_METHOD VehMass "" RAT_FUNC "%6.3" "kg" COEFFS 0 10 0 0 0 1 /end COMPU_METHOD
/begin COMPU_METHOD VEHM_VAR_SY_Compu "" TAB_VERB "%6.3" "" COMPU_TAB_REF VEHM_VAR_SY_Compu /end COMPU_METHOD
/begin COMPU_VTAB VEHM_VAR_SY_Compu "" TAB_VERB 36 1 "DAI" 3 "VWW" 5 "AUD" 22 "FOR" 147 "HYU" 999 "ALL" 214 "AVT" 9 "FIA" 21 "GMU" 159 "HON" 160 "MAZ" 123 "MIT" 20 "NIS" 14 "PSA" 4 "POR" 15 "REN" 248 "SUZ" 308 "TAT" 72 "TOY" 6 "OPE" 19 "VOL" 55 "ROL" 18 "SAB" 69 "FER" 51 "SEA" 204 "VVW" 17 "ALF" 289 "AMG" 11 "BMW" 183 "CU" 385 "UAES" 310 "DHS" 243 "DMC" 828 "RBCD" 54 "JAG" 190 "LRG" /end COMPU_VTAB
/begin COMPU_METHOD VEHVBR3_SY_Compu "" TAB_VERB "%6.3" "" COMPU_TAB_REF VEHVBR3_SY_Compu /end COMPU_METHOD
/begin COMPU_VTAB VEHVBR3_SY_Compu "" TAB_VERB 2 0 "FALSE" 1 "TRUE" /end COMPU_VTAB
/begin COMPU_METHOD VEHVPWMOUT_SC_Compu "" TAB_VERB "%6.3" "" COMPU_TAB_REF VEHVPWMOUT_SC_Compu /end COMPU_METHOD
/begin COMPU_VTAB VEHVPWMOUT_SC_Compu "" TAB_VERB 2 0 "False" 1 "True" /end COMPU_VTAB
/begin COMPU_METHOD VEHVSRC_SY_Compu "" TAB_VERB "%6.3" "" COMPU_TAB_REF VEHVSRC_SY_Compu /end COMPU_METHOD
/begin COMPU_VTAB VEHVSRC_SY_Compu "" TAB_VERB 3 0 "0" 1 "1" 2 "2" /end COMPU_VTAB
/begin COMPU_METHOD VEHV_FCOPLAUS_SY_Compu "" TAB_VERB "%6.3" "" COMPU_TAB_REF VEHV_FCOPLAUS_SY_Compu /end COMPU_METHOD
/begin COMPU_VTAB VEHV_FCOPLAUS_SY_Compu "" TAB_VERB 2 0 "False" 1 "True" /end COMPU_VTAB
/begin COMPU_METHOD VEHV_NUMTTHWHL_SY_Compu "" RAT_FUNC "%6.2" "" COEFFS 0 1 0 0 0 1 /end COMPU_METHOD
/begin COMPU_METHOD VEHV_OBDPLAUS_SY_Compu "" TAB_VERB "%6.3" "" COMPU_TAB_REF VEHV_OBDPLAUS_SY_Compu /end COMPU_METHOD
/begin COMPU_VTAB VEHV_OBDPLAUS_SY_Compu "" TAB_VERB 2 0 "False" 1 "True" /end COMPU_VTAB
/begin COMPU_METHOD VEHV_PHYSRNGCHK_SY_Compu "" TAB_VERB "%6.3" "" COMPU_TAB_REF VEHV_PHYSRNGCHK_SY_Compu /end COMPU_METHOD
/begin COMPU_VTAB VEHV_PHYSRNGCHK_SY_Compu "" TAB_VERB 2 0 "False" 1 "True" /end COMPU_VTAB
/begin COMPU_METHOD VEHV_PWMCFG_SC_Compu "" TAB_VERB "%6.3" "" COMPU_TAB_REF VEHV_PWMCFG_SC_Compu /end COMPU_METHOD
/begin COMPU_VTAB VEHV_PWMCFG_SC_Compu "" TAB_VERB 2 0 "False" 1 "True" /end COMPU_VTAB
/begin COMPU_METHOD Vel "" RAT_FUNC "%6.4" "km/h" COEFFS 0 100 0 0 0 1 /end COMPU_METHOD
/begin COMPU_METHOD Vel_SI "" RAT_FUNC "%6.4" "m/s" COEFFS 0 360 0 0 0 1 /end COMPU_METHOD
/begin COMPU_METHOD VERSSTOPMISFGDETNBYINJ_SY_Compu "" TAB_VERB "%6.3" "" COMPU_TAB_REF VERSSTOPMISFGDETNBYINJ_SY_Compu /end COMPU_METHOD
/begin COMPU_VTAB VERSSTOPMISFGDETNBYINJ_SY_Compu "" TAB_VERB 2 0 "0" 1 "1" /end COMPU_VTAB
/begin COMPU_METHOD vfzg_sw_q0p00781 "" RAT_FUNC "%6.4" "km/h" COEFFS 0 1 0 0 0 0.0078125 /end COMPU_METHOD
/begin COMPU_METHOD vfzg_ub_q1p25 "" RAT_FUNC "%6.2" "km/h" COEFFS 0 1 0 0 0 1.25 /end COMPU_METHOD
/begin COMPU_METHOD vfzg_uw_b512 "" RAT_FUNC "%6.4" "km/h" COEFFS 0 65536 0 0 0 512 /end COMPU_METHOD
/begin COMPU_METHOD vfzg_uw_q0p00781 "" RAT_FUNC "%6.4" "km/h" COEFFS 0 1 0 0 0 0.0078125 /end COMPU_METHOD
/begin COMPU_METHOD VLVI_SY_Compu "" TAB_VERB "%6.3" "" COMPU_TAB_REF VLVI_SY_Compu /end COMPU_METHOD
/begin COMPU_VTAB VLVI_SY_Compu "" TAB_VERB 3 0 "VLVI_NONE" 1 "VLVI_2POINT" 2 "VLVI_CONT" /end COMPU_VTAB
/begin COMPU_METHOD VMD_LEADPTHCALCENA_SY_Compu "" TAB_VERB "%6.3" "" COMPU_TAB_REF VMD_LEADPTHCALCENA_SY_Compu /end COMPU_METHOD
/begin COMPU_VTAB VMD_LEADPTHCALCENA_SY_Compu "" TAB_VERB 2 0 "FALSE" 1 "TRUE" /end COMPU_VTAB
/begin COMPU_METHOD Vol "" RAT_FUNC "%6.4" "l" COEFFS 0 100 0 0 0 1 /end COMPU_METHOD
/begin COMPU_METHOD Volt_q0p002_COMPU "" RAT_FUNC "%6.4" "V" COEFFS 0 500 0 0 0 1 /end COMPU_METHOD
/begin COMPU_METHOD VS_SY_Compu "" TAB_VERB "%6.3" "" COMPU_TAB_REF VS_SY_Compu /end COMPU_METHOD
/begin COMPU_VTAB VS_SY_Compu "" TAB_VERB 2 0 "False" 1 "True" /end COMPU_VTAB
/begin COMPU_METHOD WAHTEL_SWTHWORCAN_SY_Compu "" TAB_VERB "%6.3" "" COMPU_TAB_REF WAHTEL_SWTHWORCAN_SY_Compu /end COMPU_METHOD
/begin COMPU_VTAB WAHTEL_SWTHWORCAN_SY_Compu "" TAB_VERB 3 0 "HW" 1 "CAN" 2 "HW and CAN" /end COMPU_VTAB
/begin COMPU_METHOD WAHTFL_SY_Compu "" TAB_VERB "%6.3" "" COMPU_TAB_REF WAHTFL_SY_Compu /end COMPU_METHOD
/begin COMPU_VTAB WAHTFL_SY_Compu "" TAB_VERB 2 0 "FALSE" 1 "TRUE" /end COMPU_VTAB
/begin COMPU_METHOD WAHT_SY_Compu "" TAB_VERB "%6.3" "" COMPU_TAB_REF WAHT_SY_Compu /end COMPU_METHOD
/begin COMPU_VTAB WAHT_SY_Compu "" TAB_VERB 2 1 "TRUE" 0 "FALSE" /end COMPU_VTAB
/begin COMPU_METHOD WAPMP_SY_Compu "" TAB_VERB "%6.3" "" COMPU_TAB_REF WAPMP_SY_Compu /end COMPU_METHOD
/begin COMPU_VTAB WAPMP_SY_Compu "" TAB_VERB 2 0 "False" 1 "True" /end COMPU_VTAB
/begin COMPU_METHOD WNTR_SY_Compu "" TAB_VERB "%6.3" "" COMPU_TAB_REF WNTR_SY_Compu /end COMPU_METHOD
/begin COMPU_VTAB WNTR_SY_Compu "" TAB_VERB 2 0 "False" 1 "True" /end COMPU_VTAB
/begin COMPU_METHOD XCP_SY_Compu "" TAB_VERB "%6.3" "" COMPU_TAB_REF XCP_SY_Compu /end COMPU_METHOD
/begin COMPU_VTAB XCP_SY_Compu "" TAB_VERB 2 0 "No XCP" 1 "XCP" /end COMPU_VTAB
/begin COMPU_METHOD XDI_SC_Compu "" TAB_VERB "%6.3" "" COMPU_TAB_REF XDI_SC_Compu /end COMPU_METHOD
/begin COMPU_VTAB XDI_SC_Compu "" TAB_VERB 2 0 "False" 1 "True" /end COMPU_VTAB
/begin COMPU_METHOD zk100msxs_ub_b25p5 "" RAT_FUNC "%6.3" "s" COEFFS 0 0 256 0 10 0 /end COMPU_METHOD
/begin COMPU_METHOD zk10msxs_uw_b655p36 "" RAT_FUNC "%6.2" "s" COEFFS 0 0 65536 0 100 0 /end COMPU_METHOD
/begin COMPU_METHOD zk1sxs_uw_b65535 "" RAT_FUNC "%6.0" "s" COEFFS 0 0 65535 0 1 0 /end COMPU_METHOD
/begin COMPU_METHOD zk200msxs_uw_b13107p2 "" RAT_FUNC "%6.0" "s" COEFFS 0 0 65536 0 5 0 /end COMPU_METHOD
/begin COMPU_METHOD zk20msxs_uw_b1310p72 "" RAT_FUNC "%6.1" "s" COEFFS 0 0 65536 0 50 0 /end COMPU_METHOD
/begin COMPU_METHOD zk50msxs_ub_b12p8 "" RAT_FUNC "%6.3" "s" COEFFS 0 0 256 0 20 0 /end COMPU_METHOD
/begin COMPU_METHOD zk50msxs_uw_b3276p8 "" RAT_FUNC "%6.1" "s" COEFFS 0 0 65536 0 20 0 /end COMPU_METHOD
/begin COMPU_METHOD zw_sb_q0p75 "" RAT_FUNC "%6.3" "Grad KW" COEFFS 0 255 0 0 0 191.25 /end COMPU_METHOD
/begin RECORD_LAYOUT GkfWS8 FNC_VALUES 1 SBYTE COLUMN_DIR DIRECT /end RECORD_LAYOUT
/begin RECORD_LAYOUT GkfWSb FNC_VALUES 1 SBYTE COLUMN_DIR DIRECT /end RECORD_LAYOUT
/begin RECORD_LAYOUT GkfWU16 FNC_VALUES 1 UWORD COLUMN_DIR DIRECT /end RECORD_LAYOUT
/begin RECORD_LAYOUT GkfWU8 FNC_VALUES 1 UBYTE COLUMN_DIR DIRECT /end RECORD_LAYOUT
/begin RECORD_LAYOUT GklWS16 FNC_VALUES 1 SWORD COLUMN_DIR DIRECT /end RECORD_LAYOUT
/begin RECORD_LAYOUT GklWS8 FNC_VALUES 1 SBYTE COLUMN_DIR DIRECT /end RECORD_LAYOUT
/begin RECORD_LAYOUT GklWU16 FNC_VALUES 1 UWORD COLUMN_DIR DIRECT /end RECORD_LAYOUT
/begin RECORD_LAYOUT KfAxU8AyU8SstxS16SstyS16WS16 NO_AXIS_PTS_X 1 SWORD NO_AXIS_PTS_Y 2 SWORD AXIS_PTS_X 3 SWORD INDEX_INCR DIRECT AXIS_PTS_Y 4 SWORD INDEX_INCR DIRECT FNC_VALUES 5 SWORD COLUMN_DIR DIRECT /end RECORD_LAYOUT
/begin RECORD_LAYOUT KfAxU8AyU8SstxU16SstyU16WS16 NO_AXIS_PTS_X 1 UWORD NO_AXIS_PTS_Y 2 UWORD AXIS_PTS_X 3 UWORD INDEX_INCR DIRECT AXIS_PTS_Y 4 UWORD INDEX_INCR DIRECT FNC_VALUES 5 SWORD COLUMN_DIR DIRECT /end RECORD_LAYOUT
/begin RECORD_LAYOUT KfAxU8AyU8SstxU16SstyU16WU16 NO_AXIS_PTS_X 1 UWORD NO_AXIS_PTS_Y 2 UWORD AXIS_PTS_X 3 UWORD INDEX_INCR DIRECT AXIS_PTS_Y 4 UWORD INDEX_INCR DIRECT FNC_VALUES 5 UWORD COLUMN_DIR DIRECT /end RECORD_LAYOUT
/begin RECORD_LAYOUT KfAxU8AyU8SstxU8SstyU8WS8 NO_AXIS_PTS_X 1 UBYTE NO_AXIS_PTS_Y 2 UBYTE AXIS_PTS_X 3 UBYTE INDEX_INCR DIRECT AXIS_PTS_Y 4 UBYTE INDEX_INCR DIRECT FNC_VALUES 5 SBYTE COLUMN_DIR DIRECT /end RECORD_LAYOUT
/begin RECORD_LAYOUT KfAxU8AyU8SstxU8SstyU8WU8 NO_AXIS_PTS_X 1 UBYTE NO_AXIS_PTS_Y 2 UBYTE AXIS_PTS_X 3 UBYTE INDEX_INCR DIRECT AXIS_PTS_Y 4 UBYTE INDEX_INCR DIRECT FNC_VALUES 5 UBYTE COLUMN_DIR DIRECT /end RECORD_LAYOUT
/begin RECORD_LAYOUT KfAxUbAyUbSstxUbSstyUbWSb NO_AXIS_PTS_X 1 UBYTE NO_AXIS_PTS_Y 2 UBYTE AXIS_PTS_X 3 UBYTE INDEX_INCR DIRECT AXIS_PTS_Y 4 UBYTE INDEX_INCR DIRECT FNC_VALUES 5 SBYTE COLUMN_DIR DIRECT /end RECORD_LAYOUT
/begin RECORD_LAYOUT KlAUbSstUbWUb NO_AXIS_PTS_X 1 UBYTE AXIS_PTS_X 2 UBYTE INDEX_INCR DIRECT FNC_VALUES 3 UBYTE COLUMN_DIR DIRECT /end RECORD_LAYOUT
/begin RECORD_LAYOUT KlAxU8SstxS16WS16 NO_AXIS_PTS_X 1 SWORD AXIS_PTS_X 2 SWORD INDEX_INCR DIRECT FNC_VALUES 3 SWORD COLUMN_DIR DIRECT /end RECORD_LAYOUT
/begin RECORD_LAYOUT KlAxU8SstxU16WS16 NO_AXIS_PTS_X 1 UWORD AXIS_PTS_X 2 UWORD INDEX_INCR DIRECT FNC_VALUES 3 SWORD COLUMN_DIR DIRECT /end RECORD_LAYOUT
/begin RECORD_LAYOUT KlAxU8SstxU16WU16 NO_AXIS_PTS_X 1 UWORD AXIS_PTS_X 2 UWORD INDEX_INCR DIRECT FNC_VALUES 3 UWORD COLUMN_DIR DIRECT /end RECORD_LAYOUT
/begin RECORD_LAYOUT KlAxU8SstxU16WU8 NO_AXIS_PTS_X 1 UWORD AXIS_PTS_X 2 UWORD INDEX_INCR DIRECT FNC_VALUES 3 UBYTE COLUMN_DIR DIRECT /end RECORD_LAYOUT
/begin RECORD_LAYOUT KlAxU8SstxU8WS8 NO_AXIS_PTS_X 1 UBYTE AXIS_PTS_X 2 UBYTE INDEX_INCR DIRECT FNC_VALUES 3 SBYTE COLUMN_DIR DIRECT /end RECORD_LAYOUT
/begin RECORD_LAYOUT KlAxU8SstxU8WU16 NO_AXIS_PTS_X 1 UBYTE AXIS_PTS_X 2 UBYTE INDEX_INCR DIRECT FNC_VALUES 3 UWORD COLUMN_DIR DIRECT /end RECORD_LAYOUT
/begin RECORD_LAYOUT KlAxU8SstxU8WU8 NO_AXIS_PTS_X 1 UBYTE AXIS_PTS_X 2 UBYTE INDEX_INCR DIRECT FNC_VALUES 3 UBYTE COLUMN_DIR DIRECT /end RECORD_LAYOUT
/begin RECORD_LAYOUT KwSb FNC_VALUES 1 SBYTE COLUMN_DIR DIRECT /end RECORD_LAYOUT
/begin RECORD_LAYOUT KwWS16 FNC_VALUES 1 SWORD COLUMN_DIR DIRECT /end RECORD_LAYOUT
/begin RECORD_LAYOUT KwWS8 FNC_VALUES 1 SBYTE COLUMN_DIR DIRECT /end RECORD_LAYOUT
/begin RECORD_LAYOUT KwWU16 FNC_VALUES 1 UWORD COLUMN_DIR DIRECT /end RECORD_LAYOUT
/begin RECORD_LAYOUT KwWU8 FNC_VALUES 1 UBYTE COLUMN_DIR DIRECT /end RECORD_LAYOUT
/begin RECORD_LAYOUT SstAU8SstU16 NO_AXIS_PTS_X 1 UWORD AXIS_PTS_X 2 UWORD INDEX_INCR DIRECT /end RECORD_LAYOUT
/begin RECORD_LAYOUT SstAU8SstU8 NO_AXIS_PTS_X 1 UBYTE AXIS_PTS_X 2 UBYTE INDEX_INCR DIRECT /end RECORD_LAYOUT
/begin RECORD_LAYOUT SstAUbSstUb NO_AXIS_PTS_X 1 UBYTE AXIS_PTS_X 2 UBYTE INDEX_INCR DIRECT /end RECORD_LAYOUT
/begin RECORD_LAYOUT SstAUwSstUw NO_AXIS_PTS_X 1 UWORD AXIS_PTS_X 2 UWORD INDEX_INCR DIRECT /end RECORD_LAYOUT
/begin RECORD_LAYOUT Val_Ws16 FNC_VALUES 1 SWORD COLUMN_DIR DIRECT /end RECORD_LAYOUT
/begin RECORD_LAYOUT Val_Ws32 FNC_VALUES 1 SLONG COLUMN_DIR DIRECT /end RECORD_LAYOUT
/begin RECORD_LAYOUT Val_Wu32 FNC_VALUES 1 ULONG COLUMN_DIR DIRECT /end RECORD_LAYOUT
/begin RECORD_LAYOUT Val_Wu8 FNC_VALUES 1 UBYTE COLUMN_DIR DIRECT /end RECORD_LAYOUT
/end MODULE
/end PROJECT
