ASAP2_VERSION 1 4
/begin PROJECT M17955S3CC411_110Y0320 "M17955S3CC411_110Y0320"
/begin HEADER "" VERSION "M17955S3CC411_110Y0320" PROJECT_NO M17955S3CC411_110Y0320 /end HEADER
/begin MODULE DIM ""
/begin MOD_COMMON "" BYTE_ORDER MSB_LAST ALIGNMENT_BYTE 1 ALIGNMENT_WORD 2 ALIGNMENT_LONG 4 ALIGNMENT_FLOAT32_IEEE 4 /end MOD_COMMON
/begin CHARACTERISTIC BPHUTEB "" CURVE 0x8004A58C KlAxU8SstxS8WU8 255.0 dez 0.00 255.0 FORMAT "%5.1"
 /begin AXIS_DESCR STD_AXIS fteadvir fak_q0p5 4 -64.00 63.50 FORMAT "%5.2" DEPOSIT ABSOLUTE /end AXIS_DESCR
/end CHARACTERISTIC
/begin CHARACTERISTIC B_komd_c "" VALUE 0x8004A228 KwWU1 1.000 default 0.00 1.000 FORMAT "%5.3" /end CHARACTERISTIC
/begin CHARACTERISTIC B_ubpvg_C "" VALUE 0x8004A229 KwWU1 1.000 default 0.00 1.000 FORMAT "%5.3" /end CHARACTERISTIC
/begin CHARACTERISTIC Com_pIntMnf_C "" VALUE 0x8004A2E8 KwUw 65535.00 Pres_hPa 0.00 65535.00 FORMAT "%8.2" /end CHARACTERISTIC
/begin CHARACTERISTIC Com_stPIntMnf_C "" VALUE 0x8004A2EA KwUb 255.0 OneToOne 0.00 255.0 FORMAT "%5.1" /end CHARACTERISTIC
/begin CHARACTERISTIC CoVeh_stAlt_C "" VALUE 0x8004A22A KwWU8 255.0 OneToOne 0.00 255.0 FORMAT "%5.1" /end CHARACTERISTIC
/begin CHARACTERISTIC CoVeh_trqMaxAC_C "" VALUE 0x8004A22C KwWS16 6553.500 Trq -3276.800 3276.700 FORMAT "%8.3" /end CHARACTERISTIC
/begin CHARACTERISTIC CoVeh_trqPrpLimErr_C "" VALUE 0x8004A230 KwWS32 100000.000000 TrqPrpHigh -50000.0000000 50000.0000000 FORMAT "%13.7" /end CHARACTERISTIC
/begin CHARACTERISTIC CWFPC "" VALUE 0x8004A4C8 KwWU8 255.0 dez 0.00 255.0 FORMAT "%5.1" /end CHARACTERISTIC
/begin CHARACTERISTIC CWFPCES "" VALUE 0x8004A4C9 KwWU8 255.0 dez 0.00 255.0 FORMAT "%5.1" /end CHARACTERISTIC
/begin CHARACTERISTIC CWFPCPHU "" VALUE 0x8004A596 KwWU8 255.0 dez 0.00 255.0 FORMAT "%5.1" /end CHARACTERISTIC
/begin CHARACTERISTIC CWFPCTVTEV "" VALUE 0x8004A37A KwWU8 255.0 dez 0.00 255.0 FORMAT "%5.1" /end CHARACTERISTIC
/begin CHARACTERISTIC CWMIDMD "" VALUE 0x80049FD8 KwUb 2.000 dez 0.00 2.000 FORMAT "%5.3" /end CHARACTERISTIC
/begin CHARACTERISTIC CWSTADAP "" VALUE 0x8004A000 KwWU8 255.0 dez 0.00 255.0 FORMAT "%5.1" /end CHARACTERISTIC
/begin CHARACTERISTIC CWTEINI "" VALUE 0x8004A5EE KwWU8 255.0 dez 0.00 255.0 FORMAT "%5.1" /end CHARACTERISTIC
/begin CHARACTERISTIC dmrkh_C "" VALUE 0x8004A234 KwWU16 99.99847 rel_uw_b100 0.00 99.99847 FORMAT "%8.5" /end CHARACTERISTIC
/begin CHARACTERISTIC DNLLRESW "" VALUE 0x8004A2EC KwWS16 16383.75 nmot_sw_q0p25 -8192.000 8191.750 FORMAT "%8.3" /end CHARACTERISTIC
/begin CHARACTERISTIC DSTEMIN "" VALUE 0x8004A560 KwWU16 0.9999390 fak_uw_b2 0.00003051758 0.9999695 FORMAT "%9.7" /end CHARACTERISTIC
/begin CHARACTERISTIC FBTEFKA "" CURVE 0x8004A2EE KlAxU8SstxU8WU8 0.9961 fak_ub_b1 0.00 0.9961 /begin AXIS_DESCR STD_AXIS fkaste fak_ub_b0p5 5 0.00 0.4980 DEPOSIT ABSOLUTE /end AXIS_DESCR /end CHARACTERISTIC
/begin CHARACTERISTIC FBTEFKAX "" CURVE 0x8004A2F9 KlAxU8SstxU8WU8 0.9961 fak_ub_b1 0.00 0.9961
 /begin AXIS_DESCR STD_AXIS fkastexm fak_ub_b0p5 5 0.00 0.4980 DEPOSIT ABSOLUTE /end AXIS_DESCR
/end CHARACTERISTIC
/begin CHARACTERISTIC FGWRKA "" CURVE 0x8004A5EF KlAxU8SstxU8WU8 15.94 fak_ub_b16 0.00 15.94 FORMAT "%5.2"
 /begin AXIS_DESCR STD_AXIS fkakordl fak_ub_b4 10 0.00 3.984 FORMAT "%5.3" DEPOSIT ABSOLUTE /end AXIS_DESCR
/end CHARACTERISTIC
/begin CHARACTERISTIC FGWRMSMX "" VALUE 0x8004A4E4 KwWU8 0.4375 fak_ub_b16 1.063 1.500 FORMAT "%5.3" /end CHARACTERISTIC
/begin AXIS_PTS FHO04ESUB "" 0x80049E52 fho SstAUbSstUb 3.984 fak_ub_b4 4 0.00 3.984 FORMAT "%5.3" DEPOSIT ABSOLUTE /end AXIS_PTS
/begin CHARACTERISTIC FKAKORBAO "" VALUE 0x8004A4DC KwWU16 1.999969 fak_uw_b2 0.00 1.999969 FORMAT "%8.6" /end CHARACTERISTIC
/begin CHARACTERISTIC FKAKORBAV "" VALUE 0x8004A4DE KwWU16 1.999969 fak_uw_b2 0.00 1.999969 FORMAT "%8.6" /end CHARACTERISTIC
/begin CHARACTERISTIC FKAKORBMN "" VALUE 0x8004A598 KwWU16 1.999969 fak_uw_b2 0.00 1.999969 FORMAT "%8.6" /end CHARACTERISTIC
/begin CHARACTERISTIC FKAKORBMX "" VALUE 0x8004A59A KwWU16 1.999969 fak_uw_b2 0.00 1.999969 FORMAT "%8.6" /end CHARACTERISTIC
/begin CHARACTERISTIC FKAPROG "" CURVE 0x8004A604 KlAxU8SstxU8WU8 7.969 fak_ub_b8 0.00 7.969 FORMAT "%5.3"
 /begin AXIS_DESCR STD_AXIS fkastes fak_ub_b0p5 5 0.00 0.4980 DEPOSIT ABSOLUTE /end AXIS_DESCR
/end CHARACTERISTIC
/begin CHARACTERISTIC FKASTINX "" CURVE 0x8004A60F KlAxU8SstxU8WU8 0.4980 fak_ub_b0p5 0.00 0.4980
 /begin AXIS_DESCR STD_AXIS imsteini m_ub_q0p0444 5 0.00 11.32 FORMAT "%5.2" DEPOSIT ABSOLUTE /end AXIS_DESCR
/end CHARACTERISTIC
/begin CHARACTERISTIC FKATEB "" CURVE 0x8004A61A KlAxU8SstxU8WU8 0.9961 fak_ub_b1 0.00 0.9961
 /begin AXIS_DESCR STD_AXIS qtetemin fak_ub_b4 4 0.00 3.984 FORMAT "%5.3" DEPOSIT ABSOLUTE /end AXIS_DESCR
/end CHARACTERISTIC
/begin CHARACTERISTIC FKATEIBGMN "" VALUE 0x8004A59C KwWS8 3.984 fak_sb_b2 -2.000 1.984 FORMAT "%5.3" /end CHARACTERISTIC
/begin CHARACTERISTIC FKATEINPMN "" VALUE 0x8004A59D KwWS8 1.992 fak_sb_b1 -1.000 0.9922 FORMAT "%5.3" /end CHARACTERISTIC
/begin CHARACTERISTIC FKATEINPMX "" VALUE 0x8004A59E KwWS8 3.984 fak_sb_b2 -2.000 1.984 FORMAT "%5.3" /end CHARACTERISTIC
/begin CHARACTERISTIC FRKTEMN "" VALUE 0x8004A562 KwWS16 1.999969 fak_sw_b1 -1.000000 0.9999695 FORMAT "%8.6" /end CHARACTERISTIC
/begin CHARACTERISTIC FRKTEMX "" VALUE 0x8004A564 KwWS16 1.999969 fak_sw_b1 -1.000000 0.9999695 FORMAT "%8.6" /end CHARACTERISTIC
/begin CHARACTERISTIC FSRFKAS "" VALUE 0x8004A623 KwWU8 22.00 fak_ub_b64 10.00 32.00 FORMAT "%5.2" /end CHARACTERISTIC
/begin CHARACTERISTIC FSTAIFRES "" VALUE 0x8004A001 KwWU8 16.26 fak_ub_q0p064 0.00 16.26 FORMAT "%5.2" /end CHARACTERISTIC
/begin CHARACTERISTIC FTEADMAX "" VALUE 0x8004A304 KwWS8 127.5 fak_sb_b64 -64.00 63.50 FORMAT "%5.2" /end CHARACTERISTIC
/begin CHARACTERISTIC FTEADMINH "" VALUE 0x8004A305 KwWS8 127.5 fak_sb_b64 -64.00 63.50 FORMAT "%5.2" /end CHARACTERISTIC
/begin CHARACTERISTIC FTEADNPMN "" VALUE 0x8004A5A0 KwWS16 127.9980 fak_sw_b64 -64.00000 63.99805 FORMAT "%8.5" /end CHARACTERISTIC
/begin CHARACTERISTIC FTEADNPMX "" VALUE 0x8004A5A2 KwWS16 127.9980 fak_sw_b64 -64.00000 63.99805 FORMAT "%8.5" /end CHARACTERISTIC
/begin CHARACTERISTIC FTEADRPL "" VALUE 0x8004A4CA KwWS8 127.5 fak_sb_b64 -64.00 63.50 FORMAT "%5.2" /end CHARACTERISTIC
/begin CHARACTERISTIC FTEADSPH "" VALUE 0x8004A4CB KwWS8 127.5 fak_sb_b64 -64.00 63.50 FORMAT "%5.2" /end CHARACTERISTIC
/begin CHARACTERISTIC FTVTEVTANS "" CURVE 0x8004A37B KlAxU8SstxU8WU8 1.992188 fak_ub_b2 0.00 1.992188 FORMAT "%8.6"
 /begin AXIS_DESCR STD_AXIS tansloc temp_ub_q0p75_o48 4 -48.00 143.3 FORMAT "%5.1" DEPOSIT ABSOLUTE /end AXIS_DESCR
/end CHARACTERISTIC
/begin CHARACTERISTIC FVERMN "" CURVE 0x8004A566 KlAxU8SstxU8WU8 0.9922 fak_ub_b1 0.003906 0.9961
 /begin AXIS_DESCR STD_AXIS nmot nmot_ub_q40 6 0.00 10200. FORMAT "%5.0" DEPOSIT ABSOLUTE /end AXIS_DESCR
/end CHARACTERISTIC
/begin CHARACTERISTIC FVERZDYN "" CURVE 0x8004A574 GklWU16 0.003906190 t_q5p96046Em8_min 0.00 0.003906190 FORMAT "%11.9"
 /begin AXIS_DESCR COM_AXIS qmsdyn fak_ub_b16 5 0.00 15.94 FORMAT "%5.2" AXIS_PTS_REF SQM05TEUB /end AXIS_DESCR
/end CHARACTERISTIC
/begin CHARACTERISTIC FVRMDYN "" CURVE 0x8004A57E GklWU8 7.938 fak_ub_b8 0.03125 7.969 FORMAT "%5.3"
 /begin AXIS_DESCR COM_AXIS qmsdyn fak_ub_b16 5 0.00 15.94 FORMAT "%5.2" AXIS_PTS_REF SQM05TEUB /end AXIS_DESCR
/end CHARACTERISTIC
/begin CHARACTERISTIC IMSDTEVA "" VALUE 0x8004A236 KwWU8 11.32 m_ub_q0p0444 0.00 11.32 FORMAT "%5.2" /end CHARACTERISTIC
/begin CHARACTERISTIC IMSTEFVMN "" VALUE 0x8004A5A4 KwWU16 2909.754 m_ub_q0p0444 0.00 2909.754 FORMAT "%8.3" /end CHARACTERISTIC
/begin CHARACTERISTIC KFADASTEP "" MAP 0x8004A002 KfAxU8AyU8SstxS16SstyU8WS16 63.99902 fak_q0p0009766 -32.00000 31.99902 FORMAT "%8.5"
 /begin AXIS_DESCR STD_AXIS qdnmot_w fak_q0p015625 6 -512.0000 511.9844 FORMAT "%8.4" DEPOSIT ABSOLUTE /end AXIS_DESCR
 /begin AXIS_DESCR STD_AXIS tststadap temp_ub_q0p75_o48 7 -48.00 143.3 FORMAT "%5.1" DEPOSIT ABSOLUTE /end AXIS_DESCR
/end CHARACTERISTIC
/begin CHARACTERISTIC KFDMSTES "" MAP 0x8004A4E6 KfAxU8AyU8SstxU16SstyU16WU16 26214.07 mgrad_q0p400001 0.00 26214.07 FORMAT "%8.2"
 /begin AXIS_DESCR STD_AXIS mstesoll_w m_uw_b25p6 5 0.00 25.59961 FORMAT "%8.5" DEPOSIT ABSOLUTE /end AXIS_DESCR
 /begin AXIS_DESCR STD_AXIS mksbg m_ub_b25p6 6 0.00 25.50000 FORMAT "%8.5" DEPOSIT ABSOLUTE /end AXIS_DESCR
/end CHARACTERISTIC
/begin CHARACTERISTIC KFDNBNSKH "" MAP 0x8004A06C KfAxU8AyU8SstxU16SstyU16WS16 1020.000 nmot_q4 -512.0000 508.0000 FORMAT "%8.4"
 /begin AXIS_DESCR STD_AXIS nmot_w nmot_uw_q0p25 8 0.00 16383.75 FORMAT "%8.2" DEPOSIT ABSOLUTE /end AXIS_DESCR
 /begin AXIS_DESCR STD_AXIS tststadap temp_ub_q0p75_o48 7 -48.00000 143.2500 FORMAT "%8.4" DEPOSIT ABSOLUTE /end AXIS_DESCR
/end CHARACTERISTIC
/begin CHARACTERISTIC KFDNBURNS "" MAP 0x8004A0FE KfAxU8AyU8SstxU16SstyU16WS16 1020.000 nmot_q4 -512.0000 508.0000 FORMAT "%8.4"
 /begin AXIS_DESCR STD_AXIS nmot_w nmot_uw_q0p25 8 0.00 16383.75 FORMAT "%8.2" DEPOSIT ABSOLUTE /end AXIS_DESCR
 /begin AXIS_DESCR STD_AXIS tststadap temp_ub_q0p75_o48 7 -48.00000 143.2500 FORMAT "%8.4" DEPOSIT ABSOLUTE /end AXIS_DESCR
/end CHARACTERISTIC
/begin CHARACTERISTIC KFFKASX "" MAP 0x8004A624 GkfWU8 0.4980 fak_ub_b0p5 0.00 0.4980
 /begin AXIS_DESCR COM_AXIS mksbg m_ub_b25p6 5 0.00 25.50 FORMAT "%5.2" AXIS_PTS_REF SMK05TEUB /end AXIS_DESCR
 /begin AXIS_DESCR COM_AXIS tans temp_ub_q0p75_o48 4 -48.00 143.3 FORMAT "%5.1" AXIS_PTS_REF STA04TEUB /end AXIS_DESCR
/end CHARACTERISTIC
/begin CHARACTERISTIC KFFTEAD "" MAP 0x8004A306 KfAxU8AyU8SstxU8SstyU8WU8 79.69 perio_q0p3125 0.00 79.69 FORMAT "%5.2"
 /begin AXIS_DESCR STD_AXIS mksbg m_ub_b25p6 5 0.00 25.50 FORMAT "%5.2" DEPOSIT ABSOLUTE /end AXIS_DESCR
 /begin AXIS_DESCR STD_AXIS imsteini m_ub_q0p0444 3 0.00 11.32 FORMAT "%5.2" DEPOSIT ABSOLUTE /end AXIS_DESCR
/end CHARACTERISTIC
/begin CHARACTERISTIC KFFTEVFX "" MAP 0x8004A638 KfAxU8AyU8SstxU8SstyU8WU8 0.9961 fak_ub_b1 0.00 0.9961
 /begin AXIS_DESCR STD_AXIS nmot nmot_ub_q40 4 0.00 10200. FORMAT "%5.0" DEPOSIT ABSOLUTE /end AXIS_DESCR
 /begin AXIS_DESCR STD_AXIS pndkpu fak_ub_b2 4 0.00 1.992188 FORMAT "%8.6" DEPOSIT ABSOLUTE /end AXIS_DESCR
/end CHARACTERISTIC
/begin CHARACTERISTIC KFKASNH "" MAP 0x8004A652 GkfWU8 0.4980 fak_ub_b0p5 0.00 0.4980
 /begin AXIS_DESCR COM_AXIS nmot nmot_ub_q40 4 0.00 10200. FORMAT "%5.0" AXIS_PTS_REF SNM04TEUB /end AXIS_DESCR
 /begin AXIS_DESCR COM_AXIS misol_w rel_uw_b100 4 0.00 99.99847 FORMAT "%8.5" AXIS_PTS_REF SMI04TEUW /end AXIS_DESCR
/end CHARACTERISTIC
/begin CHARACTERISTIC KFKORMTMOD "" MAP 0x8004A320 KfAxU8AyU8SstxU8SstyU16WU16 1.999969 fak_uw_b2 0.00 1.999969 FORMAT "%8.6"
 /begin AXIS_DESCR STD_AXIS mksbg m_ub_b25p6 4 0.00 25.50 FORMAT "%5.2" DEPOSIT ABSOLUTE /end AXIS_DESCR
 /begin AXIS_DESCR STD_AXIS fkakormt_w fak_uw_b2 8 0.00 1.999969 FORMAT "%8.6" DEPOSIT ABSOLUTE /end AXIS_DESCR
/end CHARACTERISTIC
/begin CHARACTERISTIC KFNSTAMX "" MAP 0x8004A190 KfAxU8AyU8SstxU16SstyU16WU16 16383.75 nmot_uw_q0p25 0.00 16383.75 FORMAT "%8.2"
 /begin AXIS_DESCR STD_AXIS nstat nmot_ub_q10 4 0.00 2550.000 FORMAT "%8.3" DEPOSIT ABSOLUTE /end AXIS_DESCR
 /begin AXIS_DESCR STD_AXIS fho fak_ub_b4 4 0.00 3.984375 FORMAT "%8.6" DEPOSIT ABSOLUTE /end AXIS_DESCR
/end CHARACTERISTIC
/begin CHARACTERISTIC KFTEINI "" MAP 0x8004A662 KfAxU8AyU8SstxS16SstyU8WU16 6553.500 t_q0p1 0.00 6553.500 FORMAT "%8.3"
 /begin AXIS_DESCR STD_AXIS fteadf fak_sb_b64 6 -64.00000 63.50000 FORMAT "%8.5" DEPOSIT ABSOLUTE /end AXIS_DESCR
 /begin AXIS_DESCR STD_AXIS teini temp_ub_q0p75_o48 6 -48.00 143.3 FORMAT "%5.1" DEPOSIT ABSOLUTE /end AXIS_DESCR
/end CHARACTERISTIC
/begin CHARACTERISTIC KFTEKAH "" MAP 0x8004A6BE GkfWU8 0.9961 fak_ub_b1 0.00 0.9961
 /begin AXIS_DESCR COM_AXIS nmot nmot_ub_q40 4 0.00 10200. FORMAT "%5.0" AXIS_PTS_REF SNM04TEUB /end AXIS_DESCR
 /begin AXIS_DESCR COM_AXIS misol_w rel_uw_b100 4 0.00 99.99847 FORMAT "%8.5" AXIS_PTS_REF SMI04TEUW /end AXIS_DESCR
/end CHARACTERISTIC
/begin CHARACTERISTIC KFTETPU "" MAP 0x8004A5A6 KfAxU8AyU8SstxU8SstyU8WU8 1.992 fak_q0p0078 0.00 1.992 FORMAT "%5.3"
 /begin AXIS_DESCR STD_AXIS tumg temp_ub_q0p75_o48 3 -48.00 143.3 FORMAT "%5.1" DEPOSIT ABSOLUTE /end AXIS_DESCR
 /begin AXIS_DESCR STD_AXIS pu p_ub_q5 3 0.00 1275. FORMAT "%5.0" DEPOSIT ABSOLUTE /end AXIS_DESCR
/end CHARACTERISTIC
/begin CHARACTERISTIC KFTEVP "" MAP 0x8004A384 KfAxU8AyU8SstxU8SstyU8WU8 127.0 t500usxms_ub_q0p5 0.5000 127.5 FORMAT "%5.1"
 /begin AXIS_DESCR STD_AXIS nmot nmot_ub_q40 5 0.00 10200. FORMAT "%5.0" DEPOSIT ABSOLUTE /end AXIS_DESCR
 /begin AXIS_DESCR STD_AXIS tatesoll rel_ub_b99p6 9 0.00 99.61 FORMAT "%5.2" DEPOSIT ABSOLUTE /end AXIS_DESCR
/end CHARACTERISTIC
/begin CHARACTERISTIC KFTVPHTEV "" MAP 0x8004A3C2 KfAxU8AyU8SstxU16SstyU16WU16 655.3500 t_q0p01_ms 0.00 655.3500 FORMAT "%8.4"
 /begin AXIS_DESCR STD_AXIS ubsq spg_q0p1 4 0.00 25.50000 FORMAT "%8.5" DEPOSIT ABSOLUTE /end AXIS_DESCR
 /begin AXIS_DESCR STD_AXIS phtev_w p_q0p0195 6 0.00 1279.980 FORMAT "%8.3" DEPOSIT ABSOLUTE /end AXIS_DESCR
/end CHARACTERISTIC
/begin CHARACTERISTIC KFWTVTEV "" MAP 0x8004A40A KfAxU8AyU8SstxU16SstyU16WU16 655.3500 t_q0p01_ms 0.00 655.3500 FORMAT "%8.4"
 /begin AXIS_DESCR STD_AXIS ubsq spg_q0p1 6 0.00 25.50000 FORMAT "%8.5" DEPOSIT ABSOLUTE /end AXIS_DESCR
 /begin AXIS_DESCR STD_AXIS pndkpu fak_ub_b2 5 0.00 1.992188 FORMAT "%8.6" DEPOSIT ABSOLUTE /end AXIS_DESCR
/end CHARACTERISTIC
/begin CHARACTERISTIC KLADAPSRES "" CURVE 0x8004A1C4 KlAxU8SstxU8WU8 1.992188 fak_ub_b2 0.00 1.992188 FORMAT "%8.6"
 /begin AXIS_DESCR STD_AXIS tststadap temp_ub_q0p75_o48 7 -48.00 143.3 FORMAT "%5.1" DEPOSIT ABSOLUTE /end AXIS_DESCR
/end CHARACTERISTIC
/begin CHARACTERISTIC KLAFTE "" CURVE 0x8004A48E KlAxU8SstxU16WU16 1.999969 fak_uw_b2 0.00 1.999969 FORMAT "%8.6"
 /begin AXIS_DESCR STD_AXIS phtevpu_w fak_uw_b2 14 0.00 1.999969 FORMAT "%8.6" DEPOSIT ABSOLUTE /end AXIS_DESCR
/end CHARACTERISTIC
/begin CHARACTERISTIC KLDNFHO "" CURVE 0x8004A1D3 KlAxU8SstxU8WU8 1.992188 fak_ub_b2 0.00 1.992188 FORMAT "%8.6"
 /begin AXIS_DESCR STD_AXIS fho fak_ub_b4 4 0.00 3.984 FORMAT "%5.3" DEPOSIT ABSOLUTE /end AXIS_DESCR
/end CHARACTERISTIC
/begin CHARACTERISTIC KLFDMSTES "" CURVE 0x8004A53C KlAxU8SstxU16WS16 3.999878 fak_sw_b4 0.00 3.999878 FORMAT "%8.6"
 /begin AXIS_DESCR STD_AXIS msteo_w m_uw_b25p6 4 0.00 25.59961 FORMAT "%8.5" DEPOSIT ABSOLUTE /end AXIS_DESCR
/end CHARACTERISTIC
/begin CHARACTERISTIC KLIMSTEFV "" CURVE 0x8004A5B8 KlAxU8SstxU16WU8 1.992188 fak_ub_b2 0.00 1.992188 FORMAT "%8.6"
 /begin AXIS_DESCR STD_AXIS imstefv_w m_ub_q0p0444 8 0.00 2909.754 FORMAT "%8.3" DEPOSIT ABSOLUTE /end AXIS_DESCR
/end CHARACTERISTIC
/begin CHARACTERISTIC KLKSTAAINI "" CURVE 0x8004A1DC KlAxU8SstxU8WU8 1.992188 fak_ub_b2 0.00 1.992188 FORMAT "%8.6"
 /begin AXIS_DESCR STD_AXIS tststadap temp_ub_q0p75_o48 4 -48.00 143.3 FORMAT "%5.1" DEPOSIT ABSOLUTE /end AXIS_DESCR
/end CHARACTERISTIC
/begin CHARACTERISTIC KLKSTAMN "" CURVE 0x8004A1E5 KlAxU8SstxU8WU8 1.992188 fak_ub_b2 0.00 1.992188 FORMAT "%8.6"
 /begin AXIS_DESCR STD_AXIS tmstsst temp_ub_q0p75_o48 5 -48.00 143.3 FORMAT "%5.1" DEPOSIT ABSOLUTE /end AXIS_DESCR
/end CHARACTERISTIC
/begin CHARACTERISTIC KLKSTAMX "" CURVE 0x8004A1F0 KlAxU8SstxU8WU8 1.992188 fak_ub_b2 0.00 1.992188 FORMAT "%8.6"
 /begin AXIS_DESCR STD_AXIS tmstsst temp_ub_q0p75_o48 5 -48.00 143.3 FORMAT "%5.1" DEPOSIT ABSOLUTE /end AXIS_DESCR
/end CHARACTERISTIC
/begin CHARACTERISTIC KLSSTTMST "" CURVE 0x8004A1FB KlAxU8SstxU8WU8 191.3 temp_ub_q0p75_o48 -48.00 143.3 FORMAT "%5.1"
 /begin AXIS_DESCR STD_AXIS sststadap dez 7 0.00 255.0 FORMAT "%5.1" DEPOSIT ABSOLUTE /end AXIS_DESCR
/end CHARACTERISTIC
/begin CHARACTERISTIC KLTEINIFHO "" CURVE 0x8004A6CE KlAxU8SstxU8WU16 6553.500 t_q0p1 0.00 6553.500 FORMAT "%8.3"
 /begin AXIS_DESCR STD_AXIS fho fak_ub_b4 5 0.00 3.984 FORMAT "%5.3" DEPOSIT ABSOLUTE /end AXIS_DESCR
/end CHARACTERISTIC
/begin CHARACTERISTIC KLTEMSZ "" CURVE 0x8004A5D2 KlAxU8SstxU16WU8 1.992 fak_q0p0078 0.00 1.992 FORMAT "%5.3"
 /begin AXIS_DESCR STD_AXIS coumsnte_w t_q0p1 3 0.00 6553.500 FORMAT "%8.3" DEPOSIT ABSOLUTE /end AXIS_DESCR
/end CHARACTERISTIC
/begin CHARACTERISTIC KLWSTADAP "" CURVE 0x8004A20A KlAxU8SstxS8WU8 0.996093750 fak_sb_b0p5 0.00 0.996093750 FORMAT "%11.9"
 /begin AXIS_DESCR STD_AXIS dssttmst temp_sb_q0p75 5 -96.00 95.25 FORMAT "%5.2" DEPOSIT ABSOLUTE /end AXIS_DESCR
/end CHARACTERISTIC
/begin CHARACTERISTIC KLZKMSTES "" CURVE 0x8004A54E KlAxU8SstxU16WU16 1310.680 t_q0p02 0.02000000 1310.700 FORMAT "%8.3"
 /begin AXIS_DESCR STD_AXIS msteo_w m_uw_b25p6 4 0.00 25.59961 FORMAT "%8.5" DEPOSIT ABSOLUTE /end AXIS_DESCR
/end CHARACTERISTIC
/begin CHARACTERISTIC KSTATMSTI "" VALUE 0x8004A216 KwWU8 1.992188 fak_ub_b2 0.00 1.992188 FORMAT "%8.6" /end CHARACTERISTIC
/begin CHARACTERISTIC KSTTOPMN "" VALUE 0x8004A218 KwWU16 393210.0 t6minxmin_q6 0.00 393210.0 FORMAT "%8.1" /end CHARACTERISTIC
/begin CHARACTERISTIC KTEVANMK "" CURVE 0x8004A5E2 GklWU8 0.0121593164 perio_ub_b0p012207 0.00 0.0121593164 FORMAT "%12.10"
 /begin AXIS_DESCR COM_AXIS mksbg m_ub_b25p6 5 0.00 25.50 FORMAT "%5.2" AXIS_PTS_REF SMK05TEUB /end AXIS_DESCR
/end CHARACTERISTIC
/begin CHARACTERISTIC LAMTEMN "" VALUE 0x8004A4E0 KwWU16 15.99976 fak_uw_b16 0.00 15.99976 FORMAT "%8.5" /end CHARACTERISTIC
/begin CHARACTERISTIC LAMTEMX "" VALUE 0x8004A4E2 KwWU16 15.99976 fak_uw_b16 0.00 15.99976 FORMAT "%8.5" /end CHARACTERISTIC
/begin CHARACTERISTIC LINCAUSW "" VALUE 0x8004A21A KwWU8 1.992188 fak_ub_b2 0.00 1.992188 FORMAT "%8.6" /end CHARACTERISTIC
/begin CHARACTERISTIC MDNORM "" VALUE 0x8004A6E2 KwWU8 2550. md_ub_q10 0.00 2550. FORMAT "%5.0" /end CHARACTERISTIC
/begin CHARACTERISTIC mdwan_w_C "" VALUE 0x8004A238 KwWS16 199.9969 rel_sw_b100 -100.0000 99.99695 FORMAT "%8.4" /end CHARACTERISTIC
/begin CHARACTERISTIC MSDKLMMN "" VALUE 0x8004A5E7 KwWU8 9.000 m_q0p1 3.000 12.00 FORMAT "%5.2" /end CHARACTERISTIC
/begin CHARACTERISTIC MSNTEVO "" VALUE 0x8004A460 KwWU16 25.59961 m_uw_b25p6 0.00 25.59961 FORMAT "%8.5" /end CHARACTERISTIC
/begin CHARACTERISTIC MSTEFTEAD "" VALUE 0x8004A376 KwWU16 25.59961 m_uw_b25p6 0.00 25.59961 FORMAT "%8.5" /end CHARACTERISTIC
/begin CHARACTERISTIC NSTAK "" VALUE 0x8004A21C KwWU16 16383.75 nmot_uw_q0p25 0.00 16383.75 FORMAT "%8.2" /end CHARACTERISTIC
/begin CHARACTERISTIC NVERZMN "" VALUE 0x8004A584 KwWU16 16383.75 nmot_uw_q0p25 0.00 16383.75 FORMAT "%8.2" /end CHARACTERISTIC
/begin CHARACTERISTIC QDNBURNOK "" VALUE 0x8004A21E KwWS8 3.984 fak_q0p015625 -2.000 1.984 FORMAT "%5.3" /end CHARACTERISTIC
/begin CHARACTERISTIC RngMod_stAdap_C "" VALUE 0x8004A6E3 KwWU8 255.0 OneToOne 0.00 255.0 FORMAT "%5.1" /end CHARACTERISTIC
/begin AXIS_PTS SGA08MDUB "" 0x80049E57 gangi SstAUbSstUb 255.0 dez 8 0.00 255.0 FORMAT "%5.1" DEPOSIT ABSOLUTE /end AXIS_PTS
/begin CHARACTERISTIC Signals_Mode1Pid_CA "" VAL_BLK 0x8004BE54 ValA_Wu8 255.0 OneToOne 0.00 255.0 FORMAT "%5.1" READ_ONLY NUMBER 36 /end CHARACTERISTIC
/begin CHARACTERISTIC Signals_Mode1SigNum_CA "" VAL_BLK 0x8004BE78 ValA_Wu16 59.0000000000 Signals_IntSigNumVerb 0.00 59.0000000000 FORMAT "%13.10" READ_ONLY NUMBER 36 /end CHARACTERISTIC
/begin CHARACTERISTIC Signals_stSrv01SuppPid_CA "" VAL_BLK 0x8004BEC0 ValA_Wu16 90.0000000000 Signals_PidVerbSupp 0.00 90.0000000000 FORMAT "%13.10" NUMBER 36 /end CHARACTERISTIC
/begin AXIS_PTS SIM06ESUW "" 0x80049E60 imlatm_w SstAUwSstUw 23.30133 m_uw_b23p3 6 0.00 23.30133 FORMAT "%8.5" DEPOSIT ABSOLUTE /end AXIS_PTS
/begin AXIS_PTS SKS06ESUB "" 0x80049E6E kstaa SstAUbSstUb 1.992188 fak_ub_b2 6 0.00 1.992188 FORMAT "%8.6" DEPOSIT ABSOLUTE /end AXIS_PTS
/begin AXIS_PTS SMI04LLUB "" 0x80049E76 mifa_w SstAUwSstUw 99.99847 rel_uw_b100 4 0.00 99.99847 FORMAT "%8.5" DEPOSIT ABSOLUTE /end AXIS_PTS
/begin AXIS_PTS SMI04TEUW "" 0x80049E80 misol_w SstAUwSstUw 99.99847 rel_uw_b100 4 0.00 99.99847 FORMAT "%8.5" DEPOSIT ABSOLUTE /end AXIS_PTS
/begin AXIS_PTS SMI08DMUB "" 0x80049FD9 midmd SstAUbSstUb 99.61 rel_ub_b99p6 8 0.00 99.61 FORMAT "%5.2" DEPOSIT ABSOLUTE /end AXIS_PTS
/begin AXIS_PTS SMK05TEUB "" 0x8004A5E8 mksbg SstAU8SstU8 25.50 m_ub_b25p6 5 0.00 25.50 FORMAT "%5.2" DEPOSIT ABSOLUTE /end AXIS_PTS
/begin AXIS_PTS SML05LKUB "" 0x80049E8A ml SstAU8SstU8 1020. m_q4_kg_DIV_h 5 0.00 1020. FORMAT "%5.0" DEPOSIT ABSOLUTE /end AXIS_PTS
/begin AXIS_PTS SML08LHUB "" 0x80049E90 ml SstAU8SstU8 1020. m_q4_kg_DIV_h 8 0.00 1020. FORMAT "%5.0" DEPOSIT ABSOLUTE /end AXIS_PTS
/begin AXIS_PTS SNG06LLSB "" 0x80049E99 ngfil SstAU8SstS8 25500. nmotg_sb_q100 6 -12800. 12700. FORMAT "%5.0" DEPOSIT ABSOLUTE /end AXIS_PTS
/begin AXIS_PTS SNM04TEUB "" 0x80049EA0 nmot SstAU8SstU8 10200. nmot_ub_q40 4 0.00 10200. FORMAT "%5.0" DEPOSIT ABSOLUTE /end AXIS_PTS
/begin AXIS_PTS SNM06LLUW "" 0x80049EA6 nmot_w SstAUwSstUw 16383.75 nmot_uw_q0p25 6 0.00 16383.75 FORMAT "%8.2" DEPOSIT ABSOLUTE /end AXIS_PTS
/begin AXIS_PTS SNM07ESUB "" 0x80049EB4 nmot SstAUbSstUb 10200. nmot_ub_q40 7 0.00 10200. FORMAT "%5.0" DEPOSIT ABSOLUTE /end AXIS_PTS
/begin AXIS_PTS SNM08DMUB "" 0x80049FE2 nmot SstAUbSstUb 10200. nmot_ub_q40 8 0.00 10200. FORMAT "%5.0" DEPOSIT ABSOLUTE /end AXIS_PTS
/begin AXIS_PTS SNM08LHUB "" 0x80049EBC nmot SstAUbSstUb 10200. nmot_ub_q40 8 0.00 10200. FORMAT "%5.0" DEPOSIT ABSOLUTE /end AXIS_PTS
/begin AXIS_PTS SNM09DM1UB "" 0x80049FEB nmot SstAUbSstUb 10200. nmot_ub_q40 9 0.00 10200. FORMAT "%5.0" DEPOSIT ABSOLUTE /end AXIS_PTS
/begin AXIS_PTS SNM09DM2UB "" 0x80049FF5 nmot SstAUbSstUb 10200. nmot_ub_q40 9 0.00 10200. FORMAT "%5.0" DEPOSIT ABSOLUTE /end AXIS_PTS
/begin AXIS_PTS SNM16OPUW "" 0x80049EC6 nmot_w SstAU8SstU16 16383.75 nmot_uw_q0p25 16 0.00 16383.75 FORMAT "%8.2" DEPOSIT ABSOLUTE /end AXIS_PTS
/begin AXIS_PTS SNM16ZUUW "" 0x80049EE8 nmot_w SstAUwSstUw 16383.75 nmot_uw_q0p25 16 0.00 16383.75 FORMAT "%8.2" DEPOSIT ABSOLUTE /end AXIS_PTS
/begin AXIS_PTS SNM24ZUUB "" 0x80049F0A nmot SstAU8SstU8 10200. nmot_ub_q40 24 0.00 10200. FORMAT "%5.0" DEPOSIT ABSOLUTE /end AXIS_PTS
/begin AXIS_PTS SQM05TEUB "" 0x8004A586 qmsdyn SstAU8SstU8 15.94 fak_ub_b16 5 0.00 15.94 FORMAT "%5.2" DEPOSIT ABSOLUTE /end AXIS_PTS
/begin AXIS_PTS SRL11OPUW "" 0x80049F24 rl_w SstAU8SstU16 1535.977 rel_q0p0234 11 0.00 1535.977 FORMAT "%8.3" DEPOSIT ABSOLUTE /end AXIS_PTS
/begin AXIS_PTS SRL12ZUUW "" 0x80049F3C rl_w SstAUwSstUw 1535.977 rel_q0p0234 12 0.00 1535.977 FORMAT "%8.3" DEPOSIT ABSOLUTE /end AXIS_PTS
/begin AXIS_PTS SRL16ZUUB "" 0x80049F56 rl SstAU8SstU8 191.3 rel_q0p75 16 0.00 191.3 FORMAT "%5.1" DEPOSIT ABSOLUTE /end AXIS_PTS
/begin AXIS_PTS SRP06ESUB "" 0x80049F67 rlp SstAUbSstUb 191.3 rel_ub_q0p75 6 0.00 191.3 FORMAT "%5.1" DEPOSIT ABSOLUTE /end AXIS_PTS
/begin AXIS_PTS STA04LLUB "" 0x80049F6E tans SstAUwSstUw 49151. temp_ub_q0p75_o48 4 -48.00 49103. FORMAT "%5.0" DEPOSIT ABSOLUTE /end AXIS_PTS
/begin AXIS_PTS STA04TEUB "" 0x80049F78 tans SstAUbSstUb 191.3 temp_ub_q0p75_o48 4 -48.00 143.3 FORMAT "%5.1" DEPOSIT ABSOLUTE /end AXIS_PTS
/begin AXIS_PTS STA06ESUB "" 0x80049F7D tans SstAUbSstUb 191.3 temp_ub_q0p75_o48 6 -48.00 143.3 FORMAT "%5.1" DEPOSIT ABSOLUTE /end AXIS_PTS
/begin AXIS_PTS STM04SAUB "" 0x80049F84 tmot SstAUbSstUb 191.3 temp_ub_q0p75_o48 4 -48.00 143.3 FORMAT "%5.1" DEPOSIT ABSOLUTE /end AXIS_PTS
/begin AXIS_PTS STM06LLUB "" 0x80049F89 tmot SstAU8SstU8 191.3 temp_ub_q0p75_o48 6 -48.00 143.3 FORMAT "%5.1" DEPOSIT ABSOLUTE /end AXIS_PTS
/begin AXIS_PTS STM08__UB "" 0x80049F90 tmot SstAUbSstUb 191.3 temp_ub_q0p75_o48 8 -48.00 143.3 FORMAT "%5.1" DEPOSIT ABSOLUTE /end AXIS_PTS
/begin AXIS_PTS STM09ESUB "" 0x80049F99 tmot SstAUbSstUb 191.3 temp_ub_q0p75_o48 9 -48.00 143.3 FORMAT "%5.1" DEPOSIT ABSOLUTE /end AXIS_PTS
/begin AXIS_PTS STM10TMUB "" 0x80049FA3 tmst SstAUbSstUb 191.3 temp_ub_q0p75_o48 10 -48.00 143.3 FORMAT "%5.1" DEPOSIT ABSOLUTE /end AXIS_PTS
/begin AXIS_PTS STM12ESUB "" 0x80049FAE tmot SstAUbSstUb 191.3 temp_ub_q0p75_o48 12 -48.00 143.3 FORMAT "%5.1" DEPOSIT ABSOLUTE /end AXIS_PTS
/begin AXIS_PTS STMS06LLUB "" 0x80049FBB tmst SstAUbSstUb 191.3 temp_ub_q0p75_o48 6 -48.00 143.3 FORMAT "%5.1" DEPOSIT ABSOLUTE /end AXIS_PTS
/begin AXIS_PTS STS08ESUB "" 0x80049FC2 tmst SstAUbSstUb 191.3 temp_ub_q0p75_o48 8 -48.00 143.3 FORMAT "%5.1" DEPOSIT ABSOLUTE /end AXIS_PTS
/begin AXIS_PTS STS12ESUB "" 0x80049FCB tmst SstAUbSstUb 191.3 temp_ub_q0p75_o48 12 -48.00 143.3 FORMAT "%5.1" DEPOSIT ABSOLUTE /end AXIS_PTS
/begin CHARACTERISTIC SWADP_10ms "" VALUE 0x8004A23A KwWU8 255.0 dez 0.00 255.0 FORMAT "%5.1" /end CHARACTERISTIC
/begin CHARACTERISTIC SWADP_20ms "" VALUE 0x8004A23B KwWU8 255.0 dez 0.00 255.0 FORMAT "%5.1" /end CHARACTERISTIC
/begin CHARACTERISTIC SyC_stTest_C "" VALUE 0x8004BF08 Val_Wu8 255.0 OneToOne 0.00 255.0 FORMAT "%5.1" /end CHARACTERISTIC
/begin CHARACTERISTIC SyC_swtTestEna_C "" VALUE 0x8004BF09 Val_Wu8 255.0 OneToOne 0.00 255.0 FORMAT "%5.1" /end CHARACTERISTIC
/begin CHARACTERISTIC SyC_tiPostDrvMax_C "" VALUE 0x8004BF0A Val_Wu16 3997.000 SyC_Time_100ms 3.000000 4000.000 FORMAT "%8.3" /end CHARACTERISTIC
/begin CHARACTERISTIC SyC_tiPostDrvMin_C "" VALUE 0x8004BF0C Val_Wu16 59.80000 SyC_Time_100ms 0.2000000 60.00000 FORMAT "%8.5" /end CHARACTERISTIC
/begin CHARACTERISTIC SyC_tiPostDrvResv_C "" VALUE 0x8004BF0E Val_Wu16 6553.500 SyC_Time_100ms 0.00 6553.500 FORMAT "%8.3" /end CHARACTERISTIC
/begin CHARACTERISTIC SyC_tiPreDrvMax_C "" VALUE 0x8004BF10 Val_Wu16 65534.00 Time_sec_q1_COMPU 1.000000 65535.00 FORMAT "%8.2" /end CHARACTERISTIC
/begin CHARACTERISTIC SyC_tiPreDrvResv_C "" VALUE 0x8004BF12 Val_Wu8 255.0 Time_sec_q1_COMPU 0.00 255.0 FORMAT "%5.1" /end CHARACTERISTIC
/begin CHARACTERISTIC S_ko_C "" VALUE 0x8004A23C KwWU1 1.000 default 0.00 1.000 FORMAT "%5.3" /end CHARACTERISTIC
/begin CHARACTERISTIC T15_tiDebHiLo_C "" VALUE 0x80041F88 Val_Ws16 100.0000 TimeDeb 0.00 100.0000 FORMAT "%8.4" /end CHARACTERISTIC
/begin CHARACTERISTIC T15_tiDebLoHi_C "" VALUE 0x80041F8A Val_Ws16 100.0000 TimeDeb 0.00 100.0000 FORMAT "%8.4" /end CHARACTERISTIC
/begin CHARACTERISTIC TATEGMX "" VALUE 0x8004A462 KwWU16 99.99847 rel_uw_b100 0.00 99.99847 FORMAT "%8.5" /end CHARACTERISTIC
/begin CHARACTERISTIC TATELL "" VALUE 0x8004A4CC KwWU8 191.3 temp_ub_q0p75_o48 -48.00 143.3 FORMAT "%5.1" /end CHARACTERISTIC
/begin CHARACTERISTIC TATEMSN "" CURVE 0x8004A464 KlAxU8SstxU16WU16 99.99847 rel_uw_b100 0.00 99.99847 FORMAT "%8.5"
 /begin AXIS_DESCR STD_AXIS msntesol_w m_uw_b25p6 10 0.00 25.59961 FORMAT "%8.5" DEPOSIT ABSOLUTE /end AXIS_DESCR
/end CHARACTERISTIC
/begin CHARACTERISTIC TDTEZAM "" VALUE 0x8004A23E KwWU16 6553.500 t100msxs_uw_b6553p5 0.00 6553.500 FORMAT "%8.3" /end CHARACTERISTIC
/begin CHARACTERISTIC TFKAKORFV "" VALUE 0x8004A5DE KwWU8 10.00 t_q0p1 5.000 15.00 FORMAT "%5.2" /end CHARACTERISTIC
/begin CHARACTERISTIC TFTEINI "" VALUE 0x8004A6DE KwWU16 6553.500 t_q0p1 0.00 6553.500 FORMAT "%8.3" /end CHARACTERISTIC
/begin CHARACTERISTIC THS2ME_stConf_CW "" VALUE 0x8004ABF6 KwWU8 255.0 dez 0.00 255.0 FORMAT "%5.1" /end CHARACTERISTIC
/begin CHARACTERISTIC TMLIM "" VALUE 0x8004A21F KwWU8 191.3 temp_ub_q0p75_o48 -48.00 143.3 FORMAT "%5.1" /end CHARACTERISTIC
/begin CHARACTERISTIC TMOTSELDMD "" VALUE 0x80049FFF KwUb 1.000 dez 0.00 1.000 FORMAT "%5.3" /end CHARACTERISTIC
/begin CHARACTERISTIC TMSTTE "" VALUE 0x8004A4CD KwWU8 191.3 temp_ub_q0p75_o48 -48.00 143.3 FORMAT "%5.1" /end CHARACTERISTIC
/begin CHARACTERISTIC TMTE "" VALUE 0x8004A4CE KwWU8 191.3 temp_ub_q0p75_o48 -48.00 143.3 FORMAT "%5.1" /end CHARACTERISTIC
/begin CHARACTERISTIC TQTEAB "" VALUE 0x8004A6E0 KwWU8 81.60 t_q0p32000082 0.00 81.60 FORMAT "%5.2" /end CHARACTERISTIC
/begin CHARACTERISTIC TQTEXMAB "" VALUE 0x8004A6E1 KwWU8 81.60 t_q0p32000082 0.00 81.60 FORMAT "%5.2" /end CHARACTERISTIC
/begin CHARACTERISTIC TSDa_tRadOutSubs_C "" VALUE 0x80041F8C Val_Ws16 6553.500 Temp_Cels -3549.940 3003.560 FORMAT "%8.3" /end CHARACTERISTIC
/begin CHARACTERISTIC TTEATMTPA "" VALUE 0x8004A4D0 KwWU16 6553.500 t_q0p1 0.00 6553.500 FORMAT "%8.3" /end CHARACTERISTIC
/begin CHARACTERISTIC TTEAUS "" VALUE 0x8004A4D2 KwWU16 6553.500 t_q0p1 0.00 6553.500 FORMAT "%8.3" /end CHARACTERISTIC
/begin CHARACTERISTIC TVACVOL "" CURVE 0x8004A240 KlAxU8SstxU16WS16 6553.500 fak_q0p1 -3276.800 3276.700 FORMAT "%8.3"
 /begin AXIS_DESCR STD_AXIS wtacvol_w Volt 20 0.00 13107.00 FORMAT "%8.2" DEPOSIT ABSOLUTE /end AXIS_DESCR
/end CHARACTERISTIC
/begin CHARACTERISTIC TVATEH "" VALUE 0x8004A4D4 KwWU8 25.50 t_q0p1 0.00 25.50 FORMAT "%5.2" /end CHARACTERISTIC
/begin CHARACTERISTIC TVATEL "" VALUE 0x8004A4D5 KwWU8 25.50 t_q0p1 0.00 25.50 FORMAT "%5.2" /end CHARACTERISTIC
/begin CHARACTERISTIC TVERDELI "" CURVE 0x8004A292 KlAxU8SstxU16WS16 6553.500 Temp_Cels -3549.940 3003.560 FORMAT "%8.3"
 /begin AXIS_DESCR STD_AXIS wtverd_w Volt 20 0.00 13107.00 FORMAT "%8.2" DEPOSIT ABSOLUTE /end AXIS_DESCR
/end CHARACTERISTIC
/begin CHARACTERISTIC TVEVLOCTE "" VALUE 0x8004A4D6 KwWU8 5.100 t_q0p02 0.00 5.100 FORMAT "%5.3" /end CHARACTERISTIC
/begin CHARACTERISTIC TVTEB "" VALUE 0x8004A4D7 KwWU8 25.50 t_q0p1 0.00 25.50 FORMAT "%5.2" /end CHARACTERISTIC
/begin CHARACTERISTIC UBTEMN "" VALUE 0x8004A4D8 KwWU16 25.59961 spg_q0p00039 0.00 25.59961 FORMAT "%8.5" /end CHARACTERISTIC
/begin CHARACTERISTIC UBTEMX "" VALUE 0x8004A4DA KwWU16 25.59961 spg_q0p00039 0.00 25.59961 FORMAT "%8.5" /end CHARACTERISTIC
/begin CHARACTERISTIC VF2ME_CWVF2ME_C "" VALUE 0x8004ABF7 KwWU8 255.0 dez 0.00 255.0 FORMAT "%5.1" /end CHARACTERISTIC
/begin CHARACTERISTIC VF2ME_THRESBKOE_C "" VALUE 0x8004ABF8 KwWS16 6553.500 Trq -3276.800 3276.700 FORMAT "%8.3" /end CHARACTERISTIC
/begin CHARACTERISTIC VF2ME_UPOTPWM_C "" VALUE 0x8004ABFA KwWU8 4.980 spg_ub_b5 0.00 4.980 FORMAT "%5.3" /end CHARACTERISTIC
/begin CHARACTERISTIC WNWREO "" VALUE 0x8004A2E4 KwWS16 511.9922 kw_q0p0078 -256.0000 255.9922 FORMAT "%8.4" /end CHARACTERISTIC
/begin CHARACTERISTIC ZBURNABR "" VALUE 0x8004A220 KwWU8 255.0 dez 0.00 255.0 FORMAT "%5.1" /end CHARACTERISTIC
/begin CHARACTERISTIC ZKFKATEIFV "" VALUE 0x8004A5DF KwWU8 25.4996 zk100msxs_ub_b25p5 0.100392 25.6000 FORMAT "%7.4" /end CHARACTERISTIC
/begin CHARACTERISTIC ZKFTEAD "" VALUE 0x8004A378 KwWU16 6553.4999985 zk100msxs_uw_b6553p6 0.10000152590 6553.6000000 FORMAT "%12.7" /end CHARACTERISTIC
/begin CHARACTERISTIC ZKFTEADVA "" VALUE 0x8004A5E0 KwWU8 25.4996 zk100msxs_ub_b25p5 0.100392 25.6000 FORMAT "%7.4" /end CHARACTERISTIC
/begin CHARACTERISTIC ZKFTEADVNA "" VALUE 0x8004A5E1 KwWU8 25.4996 zk100msxs_ub_b25p5 0.100392 25.6000 FORMAT "%7.4" /end CHARACTERISTIC
/begin CHARACTERISTIC ZSYAUSWINC "" VALUE 0x8004A221 KwWU8 255.0 dez 0.00 255.0 FORMAT "%5.1" /end CHARACTERISTIC
/begin CHARACTERISTIC ZSYNAUSW "" VALUE 0x8004A222 KwWU8 255.0 dez 0.00 255.0 FORMAT "%5.1" /end CHARACTERISTIC
/begin CHARACTERISTIC ZSYNCHECKN "" VALUE 0x8004A223 KwWU8 255.0 dez 0.00 255.0 FORMAT "%5.1" /end CHARACTERISTIC
/begin CHARACTERISTIC ZSYNDEL "" VALUE 0x8004A224 KwWU8 255.0 dez 0.00 255.0 FORMAT "%5.1" /end CHARACTERISTIC
/begin MEASUREMENT ACCI_aGbxSet "" SWORD Acc 1 100 -32.76800 32.76700 FORMAT "%8.5" ECU_ADDRESS 0xD0003422 /end MEASUREMENT
/begin MEASUREMENT ACCI_aSetBrkDem "" SWORD Acc 1 100 -32.76800 32.76700 FORMAT "%8.5" ECU_ADDRESS 0xD0003424 /end MEASUREMENT
/begin MEASUREMENT ACCI_aTolNgv "" SWORD Acc 1 100 -32.76800 32.76700 FORMAT "%8.5" ECU_ADDRESS 0xD0003426 /end MEASUREMENT
/begin MEASUREMENT ACCI_bACCStp "" UBYTE OneToOne 1 100 0.00 1.000 BIT_MASK 0x1 FORMAT "%5.3" ECU_ADDRESS 0xD0003BE9 /end MEASUREMENT
/begin MEASUREMENT ACCI_bCorCodTSK "" UBYTE OneToOne 1 100 0.00 1.000 BIT_MASK 0x1 FORMAT "%5.3" ECU_ADDRESS 0xD0003BEA /end MEASUREMENT
/begin MEASUREMENT ACCI_bTSK "" UBYTE OneToOne 1 100 0.00 1.000 BIT_MASK 0x1 FORMAT "%5.3" ECU_ADDRESS 0xD0003BEB /end MEASUREMENT
/begin MEASUREMENT ACCI_mVehHi "" SWORD ACCIMass 1 100 -32768.00 32767.00 FORMAT "%8.2" ECU_ADDRESS 0xD0003428 /end MEASUREMENT
/begin MEASUREMENT ACCI_rSlpRoad "" SWORD Prc 1 100 -400.0000 399.9878 FORMAT "%8.4" ECU_ADDRESS 0xD000342A /end MEASUREMENT
/begin MEASUREMENT ACCI_stActESP "" UBYTE OneToOne 1 100 0.00 1.000 BIT_MASK 0x1 FORMAT "%5.3" ECU_ADDRESS 0xD0003BEC /end MEASUREMENT
/begin MEASUREMENT ACCI_stCrCtl "" UBYTE OneToOne 1 100 0.00 255.0 FORMAT "%5.1" ECU_ADDRESS 0xD0003BED /end MEASUREMENT
/begin MEASUREMENT ACCI_stDrvTrnCoShOff "" ULONG OneToOne 1 100 0.00 4294967295.00 FORMAT "%13.2" ECU_ADDRESS 0xD000231C /end MEASUREMENT
/begin MEASUREMENT ACCI_stGearInfoMT1 "" UBYTE OneToOne 1 100 0.00 255.0 FORMAT "%5.1" ECU_ADDRESS 0xD0003BEE /end MEASUREMENT
/begin MEASUREMENT ACCI_stLmp "" UBYTE OneToOne 1 100 0.00 1.000 BIT_MASK 0x1 FORMAT "%5.3" ECU_ADDRESS 0xD0003BEF /end MEASUREMENT
/begin MEASUREMENT ACCI_stMVeh "" UBYTE OneToOne 1 100 0.00 255.0 FORMAT "%5.1" ECU_ADDRESS 0xD0003BF0 /end MEASUREMENT
/begin MEASUREMENT ACCI_stNLim "" UBYTE OneToOne 1 100 0.00 255.0 FORMAT "%5.1" ECU_ADDRESS 0xD0003BF1 /end MEASUREMENT
/begin MEASUREMENT ACCI_stRSlpRoad "" UBYTE OneToOne 1 100 0.00 255.0 FORMAT "%5.1" ECU_ADDRESS 0xD0003BF2 /end MEASUREMENT
/begin MEASUREMENT AccPed_rAPP "" SWORD Prc 1 100 -400.0000 399.9878 FORMAT "%8.4" ECU_ADDRESS 0xD0003442 /end MEASUREMENT
/begin MEASUREMENT ACCtl_tAcVolR "" SWORD fak_q0p1 1 100 -3276.800 3276.700 FORMAT "%8.3" ECU_ADDRESS 0xD000342C /end MEASUREMENT
/begin MEASUREMENT ActMod_trqCrS "" SWORD md_q0p1 1 100 -3276.800 3276.700 FORMAT "%8.3" ECU_ADDRESS 0xD0003444 /end MEASUREMENT
/begin MEASUREMENT ActMod_trqCrSWoTraIntv "" SWORD md_q0p1 1 100 -3276.800 3276.700 FORMAT "%8.3" ECU_ADDRESS 0xD0003446 /end MEASUREMENT
/begin MEASUREMENT ActMod_trqInr "" SWORD md_q0p1 1 100 -3276.800 3276.700 FORMAT "%8.3" ECU_ADDRESS 0xD0003448 /end MEASUREMENT
/begin MEASUREMENT AC_tEvapT "" SWORD Temp_Cels 1 100 -3549.940 3003.560 FORMAT "%8.3" ECU_ADDRESS 0xD000342E /end MEASUREMENT
/begin MEASUREMENT adapdec_w "" SWORD fak_q0p0009766 1 100 -32.00000 31.99902 FORMAT "%8.5" ECU_ADDRESS 0xD0000A28 /end MEASUREMENT
/begin MEASUREMENT adapinc_w "" SWORD fak_q0p0009766 1 100 -32.00000 31.99902 FORMAT "%8.5" ECU_ADDRESS 0xD0000A2A /end MEASUREMENT
/begin MEASUREMENT adastepc_w "" SWORD fak_q0p0009766 1 100 -32.00000 31.99902 FORMAT "%8.5" ECU_ADDRESS 0xD0000A2C /end MEASUREMENT
/begin MEASUREMENT adasteps "" SBYTE fak_sb_b2 1 100 -2.000 1.984 FORMAT "%5.3" ECU_ADDRESS 0xD0000EA2 /end MEASUREMENT
/begin MEASUREMENT adastep_w "" SWORD fak_q0p0009766 1 100 -32.00000 31.99902 FORMAT "%8.5" ECU_ADDRESS 0xD0000A2E /end MEASUREMENT
/begin MEASUREMENT AFCtl_stFltFul "" UBYTE OneToOne 1 100 0.00 255.0 FORMAT "%5.1" ECU_ADDRESS 0xD0003BF5 /end MEASUREMENT
/begin MEASUREMENT Airbg_bFrmRx "" UBYTE OneToOne 1 100 0.00 1.000 FORMAT "%5.3" ECU_ADDRESS 0xD0003C05 /end MEASUREMENT
/begin MEASUREMENT AirC_bNIdlDem "" UBYTE OneToOne 1 100 0.00 1.000 BIT_MASK 0x8 FORMAT "%5.3" ECU_ADDRESS 0xD000008A /end MEASUREMENT
/begin MEASUREMENT AirC_stCmpr "" UBYTE OneToOne 1 100 0.00 255.0 FORMAT "%5.1" ECU_ADDRESS 0xD0003BFB /end MEASUREMENT
/begin MEASUREMENT AirC_stCmprAct "" UBYTE OneToOne 1 100 0.00 255.0 FORMAT "%5.1" ECU_ADDRESS 0xD0003BFC /end MEASUREMENT
/begin MEASUREMENT AirC_stCmprOffCode "" UBYTE OneToOne 1 100 0.00 255.0 FORMAT "%5.1" ECU_ADDRESS 0xD0003BFD /end MEASUREMENT
/begin MEASUREMENT AirC_stCmprRedTrq "" UBYTE OneToOne 1 100 0.00 255.0 FORMAT "%5.1" ECU_ADDRESS 0xD0003BFE /end MEASUREMENT
/begin MEASUREMENT AirC_trqDes "" SWORD Trq 1 100 -3276.800 3276.700 FORMAT "%8.3" ECU_ADDRESS 0xD0003450 /end MEASUREMENT
/begin MEASUREMENT AirSys_pCACDsNrm "" SWORD p_q1 1 100 -32768.00 32767.00 FORMAT "%8.2" ECU_ADDRESS 0xD0003454 /end MEASUREMENT
/begin MEASUREMENT Air_pCACDs "" SWORD Pres_hPa 1 100 -32768.00 32767.00 FORMAT "%8.2" ECU_ADDRESS 0xD000345A /end MEASUREMENT
/begin MEASUREMENT Air_tCACDs "" SWORD Temp_Cels 1 100 -3549.940 3003.560 FORMAT "%8.3" ECU_ADDRESS 0xD000345C /end MEASUREMENT
/begin MEASUREMENT AltIO_trqDes "" SWORD Trq 1 100 -3276.800 3276.700 FORMAT "%8.3" ECU_ADDRESS 0xD0003466 /end MEASUREMENT
/begin MEASUREMENT AltIO_uAltDes "" SWORD Volt_Batt 1 100 -655360.0 655340.0 FORMAT "%8.1" ECU_ADDRESS 0xD0003468 /end MEASUREMENT
/begin MEASUREMENT APP_rUnFltShtrp "" SWORD Prc 1 100 -400.0000 399.9878 FORMAT "%8.4" ECU_ADDRESS 0xD000343C /end MEASUREMENT
/begin MEASUREMENT arqttev_w "" SWORD rel_q0p01 1 100 -327.6800 327.6700 FORMAT "%8.4" ECU_ADDRESS 0xD0000B28 /end MEASUREMENT
/begin MEASUREMENT BasSvrAppl_stFCodPresent "" UWORD OneToOne 1 100 0.00 65535.00 FORMAT "%8.2" ECU_ADDRESS 0xD00035D0 /end MEASUREMENT
/begin MEASUREMENT BasSvrAppl_swtCodAC "" UBYTE OneToOne 1 100 0.00 255.0 FORMAT "%5.1" ECU_ADDRESS 0xD0003C0B /end MEASUREMENT
/begin MEASUREMENT BasSvrAppl_swtCodAirb "" UBYTE OneToOne 1 100 0.00 255.0 FORMAT "%5.1" ECU_ADDRESS 0xD0003C0C /end MEASUREMENT
/begin MEASUREMENT BasSvrAppl_swtCodPark "" UBYTE OneToOne 1 100 0.00 255.0 FORMAT "%5.1" ECU_ADDRESS 0xD0003C0D /end MEASUREMENT
/begin MEASUREMENT BasSvrAppl_swtFCodAC "" UBYTE OneToOne 1 100 0.00 255.0 FORMAT "%5.1" ECU_ADDRESS 0xD0003C0E /end MEASUREMENT
/begin MEASUREMENT BasSvrAppl_swtFCodAlt "" UBYTE OneToOne 1 100 0.00 255.0 FORMAT "%5.1" ECU_ADDRESS 0xD0003C10 /end MEASUREMENT
/begin MEASUREMENT BasSvrAppl_swtFCodESP "" UBYTE OneToOne 1 100 0.00 255.0 FORMAT "%5.1" ECU_ADDRESS 0xD0003C11 /end MEASUREMENT
/begin MEASUREMENT BasSvrAppl_swtFCodSLmpCtl "" UBYTE OneToOne 1 100 0.00 255.0 FORMAT "%5.1" ECU_ADDRESS 0xD0003C12 /end MEASUREMENT
/begin MEASUREMENT BasSvrAppl_swtLCodAC "" UBYTE OneToOne 1 100 0.00 255.0 FORMAT "%5.1" ECU_ADDRESS 0xD0003C14 /end MEASUREMENT
/begin MEASUREMENT BasSvrAppl_swtLCodPrePost "" UBYTE OneToOne 1 100 0.00 255.0 FORMAT "%5.1" ECU_ADDRESS 0xD0003C15 /end MEASUREMENT
/begin MEASUREMENT BasSvrAppl_swtLCodVehType "" UBYTE OneToOne 1 100 0.00 255.0 FORMAT "%5.1" ECU_ADDRESS 0xD0003C16 /end MEASUREMENT
/begin MEASUREMENT BrkP_p "" SWORD Pres_hPa 1 100 -32768.00 32767.00 FORMAT "%8.2" ECU_ADDRESS 0xD0003476 /end MEASUREMENT
/begin MEASUREMENT Brk_bLoPres "" UBYTE OneToOne 1 100 0.00 255.0 BIT_MASK 0x1 FORMAT "%5.1" ECU_ADDRESS 0xD0003CCF /end MEASUREMENT
/begin MEASUREMENT Brk_stExt "" UBYTE OneToOne 1 100 0.00 255.0 FORMAT "%5.1" ECU_ADDRESS 0xD0003C18 /end MEASUREMENT
/begin MEASUREMENT BusDiag_bNoMon "" UBYTE B_TRUE 1 100 0.00 1.00000000000 BIT_MASK 0x20 FORMAT "%13.11" ECU_ADDRESS 0xD0000053 /end MEASUREMENT
/begin MEASUREMENT BusDiag_bTDiagStrt "" UBYTE B_TRUE 1 100 0.00 1.00000000000 BIT_MASK 0x4 FORMAT "%13.11" ECU_ADDRESS 0xD000005A /end MEASUREMENT
/begin MEASUREMENT B_acres "" UBYTE B_TRUE 1 100 0.00 1.00000000000 BIT_MASK 0x40 FORMAT "%13.11" ECU_ADDRESS 0xD0000073 /end MEASUREMENT
/begin MEASUREMENT B_ad "" UBYTE B_TRUE 1 100 0.00 1.00000000000 BIT_MASK 0x8 FORMAT "%13.11" ECU_ADDRESS 0xD000006B /end MEASUREMENT
/begin MEASUREMENT B_adapend "" UBYTE B_TRUE 1 100 0.00 1.00000000000 BIT_MASK 0x2 FORMAT "%13.11" ECU_ADDRESS 0xD0000049 /end MEASUREMENT
/begin MEASUREMENT B_adshs "" UWORD B_TRUE 1 100 0.00 1.00000000000 BIT_MASK 0x1 FORMAT "%13.11" ECU_ADDRESS 0xD0000B58 /end MEASUREMENT
/begin MEASUREMENT B_aofmsdea "" UWORD B_TRUE 1 100 0.00 1.00000000000 BIT_MASK 0x1 FORMAT "%13.11" ECU_ADDRESS 0xD0000B58 /end MEASUREMENT
/begin MEASUREMENT B_apdkti2 "" UWORD B_TRUE 1 100 0.00 1.00000000000 BIT_MASK 0x1 FORMAT "%13.11" ECU_ADDRESS 0xD0000B58 /end MEASUREMENT
/begin MEASUREMENT B_asc_reg "" UWORD B_TRUE 1 100 0.00 1.00000000000 BIT_MASK 0x1 FORMAT "%13.11" ECU_ADDRESS 0xD0000B58 /end MEASUREMENT
/begin MEASUREMENT B_asr "" UWORD B_TRUE 1 100 0.00 1.00000000000 BIT_MASK 0x1 FORMAT "%13.11" ECU_ADDRESS 0xD0000B58 /end MEASUREMENT
/begin MEASUREMENT B_ate "" UWORD B_TRUE 1 100 0.00 1.00000000000 BIT_MASK 0x1 FORMAT "%13.11" ECU_ADDRESS 0xD0000B58 /end MEASUREMENT
/begin MEASUREMENT B_ausw "" UBYTE B_TRUE 1 100 0.00 1.00000000000 BIT_MASK 0x8 FORMAT "%13.11" ECU_ADDRESS 0xD0000049 /end MEASUREMENT
/begin MEASUREMENT B_badburn "" UBYTE B_TRUE 1 100 0.00 1.00000000000 BIT_MASK 0x4 FORMAT "%13.11" ECU_ADDRESS 0xD0000049 /end MEASUREMENT
/begin MEASUREMENT B_clradbbo "" UWORD B_TRUE 1 100 0.00 1.00000000000 BIT_MASK 0x1 FORMAT "%13.11" ECU_ADDRESS 0xD0000B58 /end MEASUREMENT
/begin MEASUREMENT B_clradfof "" UBYTE B_TRUE 1 100 0.00 1.00000000000 BIT_MASK 0x40 FORMAT "%13.11" ECU_ADDRESS 0xD0000096 /end MEASUREMENT
/begin MEASUREMENT B_clreepr "" UBYTE B_TRUE 1 100 0.00 1.00000000000 BIT_MASK 0x10 FORMAT "%13.11" ECU_ADDRESS 0xD000008F /end MEASUREMENT
/begin MEASUREMENT B_dfonrst "" UWORD B_TRUE 1 100 0.00 1.00000000000 BIT_MASK 0x2000 FORMAT "%13.11" ECU_ADDRESS 0xD00036C4 /end MEASUREMENT
/begin MEASUREMENT B_dkpu "" UBYTE B_TRUE 1 100 0.00 1.00000000000 BIT_MASK 0x8 FORMAT "%13.11" ECU_ADDRESS 0xD0000067 /end MEASUREMENT
/begin MEASUREMENT B_dksbeg "" UBYTE B_TRUE 1 100 0.00 1.00000000000 BIT_MASK 0x2 FORMAT "%13.11" ECU_ADDRESS 0xD0000055 /end MEASUREMENT
/begin MEASUREMENT B_dkvsf "" UWORD B_TRUE 1 100 0.00 1.00000000000 BIT_MASK 0x1 FORMAT "%13.11" ECU_ADDRESS 0xD0000B58 /end MEASUREMENT
/begin MEASUREMENT B_drlmx "" UWORD B_TRUE 1 100 0.00 1.00000000000 BIT_MASK 0x1 FORMAT "%13.11" ECU_ADDRESS 0xD0000B58 /end MEASUREMENT
/begin MEASUREMENT B_dteaam "" UWORD B_TRUE 1 100 0.00 1.00000000000 BIT_MASK 0x1 FORMAT "%13.11" ECU_ADDRESS 0xD0000B58 /end MEASUREMENT
/begin MEASUREMENT B_dteabu "" UWORD B_TRUE 1 100 0.00 1.00000000000 BIT_MASK 0x1 FORMAT "%13.11" ECU_ADDRESS 0xD0000B58 /end MEASUREMENT
/begin MEASUREMENT B_dteenf "" UBYTE B_TRUE 1 100 0.00 1.00000000000 BIT_MASK 0x1 FORMAT "%13.11" ECU_ADDRESS 0xD0000082 /end MEASUREMENT
/begin MEASUREMENT B_dtefrr "" UWORD B_TRUE 1 100 0.00 1.00000000000 BIT_MASK 0x1 FORMAT "%13.11" ECU_ADDRESS 0xD0000B58 /end MEASUREMENT
/begin MEASUREMENT B_dtemsfr "" UBYTE B_TRUE 1 100 0.00 1.00000000000 BIT_MASK 0x20 FORMAT "%13.11" ECU_ADDRESS 0xD000007F /end MEASUREMENT
/begin MEASUREMENT B_dtephm "" UBYTE B_TRUE 1 100 0.00 1.00000000000 BIT_MASK 0x8 FORMAT "%13.11" ECU_ADDRESS 0xD0000061 /end MEASUREMENT
/begin MEASUREMENT B_dternm "" UWORD B_TRUE 1 100 0.00 1.00000000000 BIT_MASK 0x1 FORMAT "%13.11" ECU_ADDRESS 0xD0000B58 /end MEASUREMENT
/begin MEASUREMENT B_dtes "" UWORD B_TRUE 1 100 0.00 1.00000000000 BIT_MASK 0x1 FORMAT "%13.11" ECU_ADDRESS 0xD0000B58 /end MEASUREMENT
/begin MEASUREMENT B_dtest "" UWORD B_TRUE 1 100 0.00 1.00000000000 BIT_MASK 0x1 FORMAT "%13.11" ECU_ADDRESS 0xD0000B58 /end MEASUREMENT
/begin MEASUREMENT B_dtmbh "" UBYTE B_TRUE 1 100 0.00 1.00000000000 BIT_MASK 0x80 FORMAT "%13.11" ECU_ADDRESS 0xD0000097 /end MEASUREMENT
/begin MEASUREMENT B_edss "" UBYTE B_TRUE 1 100 0.00 1.00000000000 BIT_MASK 0x80 FORMAT "%13.11" ECU_ADDRESS 0xD0000089 /end MEASUREMENT
/begin MEASUREMENT B_ells "" UBYTE B_TRUE 1 100 0.00 1.00000000000 BIT_MASK 0x2 FORMAT "%13.11" ECU_ADDRESS 0xD0000088 /end MEASUREMENT
/begin MEASUREMENT B_engrestr "" UBYTE B_TRUE 1 100 0.00 1.00000000000 BIT_MASK 0x8 FORMAT "%13.11" ECU_ADDRESS 0xD0000093 /end MEASUREMENT
/begin MEASUREMENT B_etavdk "" UWORD B_TRUE 1 100 0.00 1.00000000000 BIT_MASK 0x1 FORMAT "%13.11" ECU_ADDRESS 0xD0000B58 /end MEASUREMENT
/begin MEASUREMENT B_evabeep "" UWORD B_TRUE 1 100 0.00 1.00000000000 BIT_MASK 0x1 FORMAT "%13.11" ECU_ADDRESS 0xD0000B58 /end MEASUREMENT
/begin MEASUREMENT B_evdmtbc "" UWORD B_TRUE 1 100 0.00 1.00000000000 BIT_MASK 0x1 FORMAT "%13.11" ECU_ADDRESS 0xD0000B58 /end MEASUREMENT
/begin MEASUREMENT B_evdmtec "" UWORD B_TRUE 1 100 0.00 1.00000000000 BIT_MASK 0x1 FORMAT "%13.11" ECU_ADDRESS 0xD0000B58 /end MEASUREMENT
/begin MEASUREMENT B_evdmtmo "" UWORD B_TRUE 1 100 0.00 1.00000000000 BIT_MASK 0x1 FORMAT "%13.11" ECU_ADDRESS 0xD0000B58 /end MEASUREMENT
/begin MEASUREMENT B_evdmtoc "" UWORD B_TRUE 1 100 0.00 1.00000000000 BIT_MASK 0x1 FORMAT "%13.11" ECU_ADDRESS 0xD0000B58 /end MEASUREMENT
/begin MEASUREMENT B_fa "" UWORD B_TRUE 1 100 0.00 1.00000000000 BIT_MASK 0x2 FORMAT "%13.11" ECU_ADDRESS 0xD00036B8 /end MEASUREMENT
/begin MEASUREMENT B_faagr "" UWORD B_TRUE 1 100 0.00 1.00000000000 BIT_MASK 0x80 FORMAT "%13.11" ECU_ADDRESS 0xD00036B8 /end MEASUREMENT
/begin MEASUREMENT B_faam "" UWORD B_TRUE 1 100 0.00 1.00000000000 BIT_MASK 0x100 FORMAT "%13.11" ECU_ADDRESS 0xD00036B8 /end MEASUREMENT
/begin MEASUREMENT B_faan "" UBYTE B_TRUE 1 100 0.00 1.00000000000 BIT_MASK 0x20 FORMAT "%13.11" ECU_ADDRESS 0xD0000057 /end MEASUREMENT
/begin MEASUREMENT B_faatm "" UWORD B_TRUE 1 100 0.00 1.00000000000 BIT_MASK 0x800 FORMAT "%13.11" ECU_ADDRESS 0xD00036B8 /end MEASUREMENT
/begin MEASUREMENT B_fadss "" UWORD B_TRUE 1 100 0.00 1.00000000000 BIT_MASK 0x8 FORMAT "%13.11" ECU_ADDRESS 0xD00036BA /end MEASUREMENT
/begin MEASUREMENT B_fadylsu "" UWORD B_TRUE 1 100 0.00 1.00000000000 BIT_MASK 0x20 FORMAT "%13.11" ECU_ADDRESS 0xD00036BA /end MEASUREMENT
/begin MEASUREMENT B_fafonrm "" UBYTE B_TRUE 1 100 0.00 1.00000000000 BIT_MASK 0x40 FORMAT "%13.11" ECU_ADDRESS 0xD000007D /end MEASUREMENT
/begin MEASUREMENT B_fagals "" UWORD B_TRUE 1 100 0.00 1.00000000000 BIT_MASK 0x400 FORMAT "%13.11" ECU_ADDRESS 0xD00036BA /end MEASUREMENT
/begin MEASUREMENT B_fahsh "" UWORD B_TRUE 1 100 0.00 1.00000000000 BIT_MASK 0x2000 FORMAT "%13.11" ECU_ADDRESS 0xD00036BA /end MEASUREMENT
/begin MEASUREMENT B_fahsv "" UWORD B_TRUE 1 100 0.00 1.00000000000 BIT_MASK 0x4000 FORMAT "%13.11" ECU_ADDRESS 0xD00036BA /end MEASUREMENT
/begin MEASUREMENT B_faiumpr "" UWORD B_TRUE 1 100 0.00 1.00000000000 BIT_MASK 0x8000 FORMAT "%13.11" ECU_ADDRESS 0xD00036BA /end MEASUREMENT
/begin MEASUREMENT B_fakat "" UWORD B_TRUE 1 100 0.00 1.00000000000 BIT_MASK 0x1 FORMAT "%13.11" ECU_ADDRESS 0xD00036BC /end MEASUREMENT
/begin MEASUREMENT B_fakath "" UWORD B_TRUE 1 100 0.00 1.00000000000 BIT_MASK 0x800 FORMAT "%13.11" ECU_ADDRESS 0xD00036C4 /end MEASUREMENT
/begin MEASUREMENT B_fakth "" UWORD B_TRUE 1 100 0.00 1.00000000000 BIT_MASK 0x100 FORMAT "%13.11" ECU_ADDRESS 0xD00036BC /end MEASUREMENT
/begin MEASUREMENT B_fakvs "" UWORD B_TRUE 1 100 0.00 1.00000000000 BIT_MASK 0x400 FORMAT "%13.11" ECU_ADDRESS 0xD00036BC /end MEASUREMENT
/begin MEASUREMENT B_falr "" UWORD B_TRUE 1 100 0.00 1.00000000000 BIT_MASK 0x1 FORMAT "%13.11" ECU_ADDRESS 0xD0000B58 /end MEASUREMENT
/begin MEASUREMENT B_falra "" UWORD B_TRUE 1 100 0.00 1.00000000000 BIT_MASK 0x2000 FORMAT "%13.11" ECU_ADDRESS 0xD00036BC /end MEASUREMENT
/begin MEASUREMENT B_falrhk "" UWORD B_TRUE 1 100 0.00 1.00000000000 BIT_MASK 0x200 FORMAT "%13.11" ECU_ADDRESS 0xD00036C4 /end MEASUREMENT
/begin MEASUREMENT B_falrsfk "" UWORD B_TRUE 1 100 0.00 1.00000000000 BIT_MASK 0x8000 FORMAT "%13.11" ECU_ADDRESS 0xD00036BC /end MEASUREMENT
/begin MEASUREMENT B_falrshk "" UWORD B_TRUE 1 100 0.00 1.00000000000 BIT_MASK 0x1 FORMAT "%13.11" ECU_ADDRESS 0xD00036BE /end MEASUREMENT
/begin MEASUREMENT B_falsh "" UWORD B_TRUE 1 100 0.00 1.00000000000 BIT_MASK 0x40 FORMAT "%13.11" ECU_ADDRESS 0xD00036BE /end MEASUREMENT
/begin MEASUREMENT B_falzsr "" UWORD B_TRUE 1 100 0.00 1.00000000000 BIT_MASK 0x1000 FORMAT "%13.11" ECU_ADDRESS 0xD00036BE /end MEASUREMENT
/begin MEASUREMENT B_fanwrad "" UWORD B_TRUE 1 100 0.00 1.00000000000 BIT_MASK 0x2 FORMAT "%13.11" ECU_ADDRESS 0xD00036C4 /end MEASUREMENT
/begin MEASUREMENT B_fanwse "" UWORD B_TRUE 1 100 0.00 1.00000000000 BIT_MASK 0x20 FORMAT "%13.11" ECU_ADDRESS 0xD00036C0 /end MEASUREMENT
/begin MEASUREMENT B_fapllsu "" UWORD B_TRUE 1 100 0.00 1.00000000000 BIT_MASK 0x100 FORMAT "%13.11" ECU_ADDRESS 0xD00036C0 /end MEASUREMENT
/begin MEASUREMENT B_fasf "" UWORD B_TRUE 1 100 0.00 1.00000000000 BIT_MASK 0x1000 FORMAT "%13.11" ECU_ADDRESS 0xD00036C0 /end MEASUREMENT
/begin MEASUREMENT B_fash "" UWORD B_TRUE 1 100 0.00 1.00000000000 BIT_MASK 0x4000 FORMAT "%13.11" ECU_ADDRESS 0xD00036C0 /end MEASUREMENT
/begin MEASUREMENT B_fatp "" UWORD B_TRUE 1 100 0.00 1.00000000000 BIT_MASK 0x100 FORMAT "%13.11" ECU_ADDRESS 0xD00036C2 /end MEASUREMENT
/begin MEASUREMENT B_fatv "" UWORD B_TRUE 1 100 0.00 1.00000000000 BIT_MASK 0x400 FORMAT "%13.11" ECU_ADDRESS 0xD00036C2 /end MEASUREMENT
/begin MEASUREMENT B_fcotr "" UBYTE B_TRUE 1 100 0.00 1.00000000000 BIT_MASK 0x2 FORMAT "%13.11" ECU_ADDRESS 0xD0000093 /end MEASUREMENT
/begin MEASUREMENT B_fgr "" UBYTE B_TRUE 1 100 0.00 1.00000000000 BIT_MASK 0x4 FORMAT "%13.11" ECU_ADDRESS 0xD0000059 /end MEASUREMENT
/begin MEASUREMENT B_fhz "" UBYTE B_TRUE 1 100 0.00 1.00000000000 BIT_MASK 0x2 FORMAT "%13.11" ECU_ADDRESS 0xD000008B /end MEASUREMENT
/begin MEASUREMENT B_fkateifv "" UBYTE B_TRUE 1 100 0.00 1.00000000000 BIT_MASK 0x80 FORMAT "%13.11" ECU_ADDRESS 0xD000004A /end MEASUREMENT
/begin MEASUREMENT B_fklanf "" UWORD B_TRUE 1 100 0.00 1.00000000000 BIT_MASK 0x1 FORMAT "%13.11" ECU_ADDRESS 0xD0000B58 /end MEASUREMENT
/begin MEASUREMENT B_fkmsmn "" UWORD B_TRUE 1 100 0.00 1.00000000000 BIT_MASK 0x1 FORMAT "%13.11" ECU_ADDRESS 0xD0000B58 /end MEASUREMENT
/begin MEASUREMENT B_fkmsmx "" UWORD B_TRUE 1 100 0.00 1.00000000000 BIT_MASK 0x1 FORMAT "%13.11" ECU_ADDRESS 0xD0000B58 /end MEASUREMENT
/begin MEASUREMENT B_fkpvmn "" UWORD B_TRUE 1 100 0.00 1.00000000000 BIT_MASK 0x1 FORMAT "%13.11" ECU_ADDRESS 0xD0000B58 /end MEASUREMENT
/begin MEASUREMENT B_fkpvmx "" UWORD B_TRUE 1 100 0.00 1.00000000000 BIT_MASK 0x1 FORMAT "%13.11" ECU_ADDRESS 0xD0000B58 /end MEASUREMENT
/begin MEASUREMENT B_fofkhseg "" UWORD B_TRUE 1 100 0.00 1.00000000000 BIT_MASK 0x1 FORMAT "%13.11" ECU_ADDRESS 0xD0000B58 /end MEASUREMENT
/begin MEASUREMENT B_fofrun0 "" UWORD B_TRUE 1 100 0.00 1.00000000000 BIT_MASK 0x1 FORMAT "%13.11" ECU_ADDRESS 0xD0000B58 /end MEASUREMENT
/begin MEASUREMENT B_fproab "" UWORD B_TRUE 1 100 0.00 1.00000000000 BIT_MASK 0x1 FORMAT "%13.11" ECU_ADDRESS 0xD0000B58 /end MEASUREMENT
/begin MEASUREMENT B_frmeing "" UWORD B_TRUE 1 100 0.00 1.00000000000 BIT_MASK 0x1 FORMAT "%13.11" ECU_ADDRESS 0xD0000B42 /end MEASUREMENT
/begin MEASUREMENT B_frmfrz "" UWORD B_TRUE 1 100 0.00 1.00000000000 BIT_MASK 0x1 FORMAT "%13.11" ECU_ADDRESS 0xD0000B42 /end MEASUREMENT
/begin MEASUREMENT B_fs "" UBYTE B_TRUE 1 100 0.00 1.00000000000 BIT_MASK 0x80 FORMAT "%13.11" ECU_ADDRESS 0xD0000057 /end MEASUREMENT
/begin MEASUREMENT B_fteadber "" UBYTE B_TRUE 1 100 0.00 1.00000000000 BIT_MASK 0x4 FORMAT "%13.11" ECU_ADDRESS 0xD000005D /end MEASUREMENT
/begin MEASUREMENT B_fteadh "" UBYTE B_TRUE 1 100 0.00 1.00000000000 BIT_MASK 0x20 FORMAT "%13.11" ECU_ADDRESS 0xD0000059 /end MEASUREMENT
/begin MEASUREMENT B_fushk "" UWORD B_TRUE 1 100 0.00 1.00000000000 BIT_MASK 0x1 FORMAT "%13.11" ECU_ADDRESS 0xD0000B58 /end MEASUREMENT
/begin MEASUREMENT B_fvgte "" UBYTE B_TRUE 1 100 0.00 1.00000000000 BIT_MASK 0x8 FORMAT "%13.11" ECU_ADDRESS 0xD000006F /end MEASUREMENT
/begin MEASUREMENT B_gerte "" UBYTE B_TRUE 1 100 0.00 1.00000000000 BIT_MASK 0x2 FORMAT "%13.11" ECU_ADDRESS 0xD000004A /end MEASUREMENT
/begin MEASUREMENT B_globd "" UWORD B_TRUE 1 100 0.00 1.00000000000 BIT_MASK 0x1 FORMAT "%13.11" ECU_ADDRESS 0xD0000B58 /end MEASUREMENT
/begin MEASUREMENT B_gsaf "" UWORD B_TRUE 1 100 0.00 1.00000000000 BIT_MASK 0x1 FORMAT "%13.11" ECU_ADDRESS 0xD0000B58 /end MEASUREMENT
/begin MEASUREMENT B_hlsumx "" UWORD B_TRUE 1 100 0.00 1.00000000000 BIT_MASK 0x1 FORMAT "%13.11" ECU_ADDRESS 0xD0000B58 /end MEASUREMENT
/begin MEASUREMENT B_hos "" UWORD B_TRUE 1 100 0.00 1.00000000000 BIT_MASK 0x1 FORMAT "%13.11" ECU_ADDRESS 0xD0000B58 /end MEASUREMENT
/begin MEASUREMENT B_hrlsunp "" UWORD B_TRUE 1 100 0.00 1.00000000000 BIT_MASK 0x1 FORMAT "%13.11" ECU_ADDRESS 0xD0000B58 /end MEASUREMENT
/begin MEASUREMENT B_iclsabg "" UWORD B_TRUE 1 100 0.00 1.00000000000 BIT_MASK 0x1 FORMAT "%13.11" ECU_ADDRESS 0xD0000B58 /end MEASUREMENT
/begin MEASUREMENT B_imstemin "" UBYTE B_TRUE 1 100 0.00 1.00000000000 BIT_MASK 0x1 FORMAT "%13.11" ECU_ADDRESS 0xD000004B /end MEASUREMENT
/begin MEASUREMENT B_incmxres "" UBYTE B_TRUE 1 100 0.00 1.00000000000 BIT_MASK 0x2 FORMAT "%13.11" ECU_ADDRESS 0xD000008A /end MEASUREMENT
/begin MEASUREMENT B_kl15 "" UBYTE B_TRUE 1 100 0.00 1.00000000000 BIT_MASK 0x2 FORMAT "%13.11" ECU_ADDRESS 0xD000005C /end MEASUREMENT
/begin MEASUREMENT B_klimex "" UBYTE B_TRUE 1 100 0.00 1.00000000000 BIT_MASK 0x1 FORMAT "%13.11" ECU_ADDRESS 0xD0000ECA /end MEASUREMENT
/begin MEASUREMENT B_klobd "" UWORD B_TRUE 1 100 0.00 1.00000000000 BIT_MASK 0x1 FORMAT "%13.11" ECU_ADDRESS 0xD0000B58 /end MEASUREMENT
/begin MEASUREMENT B_koe "" UBYTE B_TRUE 1 100 0.00 1.00000000000 BIT_MASK 0x4 FORMAT "%13.11" ECU_ADDRESS 0xD0000ECA /end MEASUREMENT
/begin MEASUREMENT B_komd "" UBYTE B_TRUE 1 100 0.00 1.00000000000 BIT_MASK 0x80 FORMAT "%13.11" ECU_ADDRESS 0xD0000080 /end MEASUREMENT
/begin MEASUREMENT B_kstaue "" UBYTE B_TRUE 1 100 0.00 1.00000000000 BIT_MASK 0x80 FORMAT "%13.11" ECU_ADDRESS 0xD0000049 /end MEASUREMENT
/begin MEASUREMENT B_lamrb "" UBYTE B_TRUE 1 100 0.00 1.00000000000 BIT_MASK 0x4 FORMAT "%13.11" ECU_ADDRESS 0xD0000084 /end MEASUREMENT
/begin MEASUREMENT B_lf1 "" UBYTE B_TRUE 1 100 0.00 1.00000000000 BIT_MASK 0x1 FORMAT "%13.11" ECU_ADDRESS 0xD0000F19 /end MEASUREMENT
/begin MEASUREMENT B_lf1res "" UBYTE B_TRUE 1 100 0.00 1.00000000000 BIT_MASK 0x2 FORMAT "%13.11" ECU_ADDRESS 0xD0000F19 /end MEASUREMENT
/begin MEASUREMENT B_lf2 "" UBYTE B_TRUE 1 100 0.00 1.00000000000 BIT_MASK 0x4 FORMAT "%13.11" ECU_ADDRESS 0xD0000F19 /end MEASUREMENT
/begin MEASUREMENT B_lf2res "" UBYTE B_TRUE 1 100 0.00 1.00000000000 BIT_MASK 0x8 FORMAT "%13.11" ECU_ADDRESS 0xD0000F19 /end MEASUREMENT
/begin MEASUREMENT B_llde "" UBYTE B_TRUE 1 100 0.00 1.00000000000 BIT_MASK 0x4 FORMAT "%13.11" ECU_ADDRESS 0xD0000083 /end MEASUREMENT
/begin MEASUREMENT B_load1 "" UBYTE B_TRUE 1 100 0.00 1.00000000000 BIT_MASK 0x10 FORMAT "%13.11" ECU_ADDRESS 0xD0000F19 /end MEASUREMENT
/begin MEASUREMENT B_load2 "" UBYTE B_TRUE 1 100 0.00 1.00000000000 BIT_MASK 0x20 FORMAT "%13.11" ECU_ADDRESS 0xD0000F19 /end MEASUREMENT
/begin MEASUREMENT B_load3 "" UBYTE B_TRUE 1 100 0.00 1.00000000000 BIT_MASK 0x40 FORMAT "%13.11" ECU_ADDRESS 0xD0000F19 /end MEASUREMENT
/begin MEASUREMENT B_lrndia "" UWORD B_TRUE 1 100 0.00 1.00000000000 BIT_MASK 0x2000 FORMAT "%13.11" ECU_ADDRESS 0xD00036C2 /end MEASUREMENT
/begin MEASUREMENT B_lrndiaur "" UWORD B_TRUE 1 100 0.00 1.00000000000 BIT_MASK 0x4000 FORMAT "%13.11" ECU_ADDRESS 0xD00036C2 /end MEASUREMENT
/begin MEASUREMENT B_lrnws "" UBYTE B_TRUE 1 100 0.00 1.00000000000 BIT_MASK 0x40 FORMAT "%13.11" ECU_ADDRESS 0xD0000064 /end MEASUREMENT
/begin MEASUREMENT B_lrs "" UBYTE B_TRUE 1 100 0.00 1.00000000000 BIT_MASK 0x10 FORMAT "%13.11" ECU_ADDRESS 0xD0000096 /end MEASUREMENT
/begin MEASUREMENT B_lsuabgl "" UWORD B_TRUE 1 100 0.00 1.00000000000 BIT_MASK 0x1 FORMAT "%13.11" ECU_ADDRESS 0xD0000B58 /end MEASUREMENT
/begin MEASUREMENT B_lsuoffs "" UWORD B_TRUE 1 100 0.00 1.00000000000 BIT_MASK 0x1 FORMAT "%13.11" ECU_ADDRESS 0xD0000B58 /end MEASUREMENT
/begin MEASUREMENT B_lteab "" UBYTE B_TRUE 1 100 0.00 1.00000000000 BIT_MASK 0x80 FORMAT "%13.11" ECU_ADDRESS 0xD000009B /end MEASUREMENT
/begin MEASUREMENT B_luft "" UWORD B_TRUE 1 100 0.00 1.00000000000 BIT_MASK 0x1 FORMAT "%13.11" ECU_ADDRESS 0xD0000B58 /end MEASUREMENT
/begin MEASUREMENT B_mdeeub "" UBYTE B_TRUE 1 100 0.00 1.00000000000 BIT_MASK 0x20 FORMAT "%13.11" ECU_ADDRESS 0xD000006A /end MEASUREMENT
/begin MEASUREMENT B_mdmin "" UBYTE B_TRUE 1 100 0.00 1.00000000000 BIT_MASK 0x40 FORMAT "%13.11" ECU_ADDRESS 0xD000009C /end MEASUREMENT
/begin MEASUREMENT B_minflsu "" UWORD B_TRUE 1 100 0.00 1.00000000000 BIT_MASK 0x1 FORMAT "%13.11" ECU_ADDRESS 0xD0000B58 /end MEASUREMENT
/begin MEASUREMENT B_msr "" UWORD B_TRUE 1 100 0.00 1.00000000000 BIT_MASK 0x1 FORMAT "%13.11" ECU_ADDRESS 0xD0000B58 /end MEASUREMENT
/begin MEASUREMENT B_mstefg "" UBYTE B_TRUE 1 100 0.00 1.00000000000 BIT_MASK 0x20 FORMAT "%13.11" ECU_ADDRESS 0xD000005C /end MEASUREMENT
/begin MEASUREMENT B_nac "" UBYTE B_TRUE 1 100 0.00 1.00000000000 BIT_MASK 0x8 FORMAT "%13.11" ECU_ADDRESS 0xD0000ECA /end MEASUREMENT
/begin MEASUREMENT B_nachl "" UBYTE B_TRUE 1 100 0.00 1.00000000000 BIT_MASK 0x40 FORMAT "%13.11" ECU_ADDRESS 0xD000006C /end MEASUREMENT
/begin MEASUREMENT B_nachlauf "" UBYTE B_TRUE 1 100 0.00 1.00000000000 BIT_MASK 0x10 FORMAT "%13.11" ECU_ADDRESS 0xD0000071 /end MEASUREMENT
/begin MEASUREMENT B_ngsawe "" UBYTE B_TRUE 1 100 0.00 1.00000000000 BIT_MASK 0x2 FORMAT "%13.11" ECU_ADDRESS 0xD000006C /end MEASUREMENT
/begin MEASUREMENT B_nlel "" UBYTE B_TRUE 1 100 0.00 1.00000000000 BIT_MASK 0x2 FORMAT "%13.11" ECU_ADDRESS 0xD0000ECA /end MEASUREMENT
/begin MEASUREMENT B_nlh "" UWORD B_TRUE 1 100 0.00 1.00000000000 BIT_MASK 0x1 FORMAT "%13.11" ECU_ADDRESS 0xD0000B58 /end MEASUREMENT
/begin MEASUREMENT B_nmaxext "" UBYTE B_TRUE 1 100 0.00 1.00000000000 BIT_MASK 0x2 FORMAT "%13.11" ECU_ADDRESS 0xD0000083 /end MEASUREMENT
/begin MEASUREMENT B_nodec "" UBYTE B_TRUE 1 100 0.00 1.00000000000 BIT_MASK 0x20 FORMAT "%13.11" ECU_ADDRESS 0xD0000049 /end MEASUREMENT
/begin MEASUREMENT B_noinc "" UBYTE B_TRUE 1 100 0.00 1.00000000000 BIT_MASK 0x40 FORMAT "%13.11" ECU_ADDRESS 0xD0000049 /end MEASUREMENT
/begin MEASUREMENT B_norm "" UBYTE B_TRUE 1 100 0.00 1.00000000000 BIT_MASK 0x10 FORMAT "%13.11" ECU_ADDRESS 0xD000005D /end MEASUREMENT
/begin MEASUREMENT B_nsoltcu "" UBYTE B_TRUE 1 100 0.00 1.00000000000 BIT_MASK 0x80 FORMAT "%13.11" ECU_ADDRESS 0xD000007D /end MEASUREMENT
/begin MEASUREMENT B_plra "" UWORD B_TRUE 1 100 0.00 1.00000000000 BIT_MASK 0x1 FORMAT "%13.11" ECU_ADDRESS 0xD0000B58 /end MEASUREMENT
/begin MEASUREMENT B_pusab "" UWORD B_TRUE 1 100 0.00 1.00000000000 BIT_MASK 0x1 FORMAT "%13.11" ECU_ADDRESS 0xD0000B58 /end MEASUREMENT
/begin MEASUREMENT B_rbte "" UBYTE B_TRUE 1 100 0.00 1.00000000000 BIT_MASK 0x1 FORMAT "%13.11" ECU_ADDRESS 0xD000009C /end MEASUREMENT
/begin MEASUREMENT B_ricalf "" UWORD B_TRUE 1 100 0.00 1.00000000000 BIT_MASK 0x1 FORMAT "%13.11" ECU_ADDRESS 0xD0000B58 /end MEASUREMENT
/begin MEASUREMENT B_rinabg "" UWORD B_TRUE 1 100 0.00 1.00000000000 BIT_MASK 0x1 FORMAT "%13.11" ECU_ADDRESS 0xD0000B58 /end MEASUREMENT
/begin MEASUREMENT B_rkteb "" UBYTE B_TRUE 1 100 0.00 1.00000000000 BIT_MASK 0x2 FORMAT "%13.11" ECU_ADDRESS 0xD0000068 /end MEASUREMENT
/begin MEASUREMENT B_rlperno "" UWORD B_TRUE 1 100 0.00 1.00000000000 BIT_MASK 0x1 FORMAT "%13.11" ECU_ADDRESS 0xD0000B58 /end MEASUREMENT
/begin MEASUREMENT B_rluoffs "" UWORD B_TRUE 1 100 0.00 1.00000000000 BIT_MASK 0x1 FORMAT "%13.11" ECU_ADDRESS 0xD0000B58 /end MEASUREMENT
/begin MEASUREMENT B_rqttev "" UBYTE B_TRUE 1 100 0.00 1.00000000000 BIT_MASK 0x1 FORMAT "%13.11" ECU_ADDRESS 0xD000007F /end MEASUREMENT
/begin MEASUREMENT B_savfgr "" UBYTE B_TRUE 1 100 0.00 1.00000000000 BIT_MASK 0x20 FORMAT "%13.11" ECU_ADDRESS 0xD000005D /end MEASUREMENT
/begin MEASUREMENT B_savmd "" UBYTE B_TRUE 1 100 0.00 1.00000000000 BIT_MASK 0x2 FORMAT "%13.11" ECU_ADDRESS 0xD000008C /end MEASUREMENT
/begin MEASUREMENT B_savmsr "" UBYTE B_TRUE 1 100 0.00 1.00000000000 BIT_MASK 0x80 FORMAT "%13.11" ECU_ADDRESS 0xD0000067 /end MEASUREMENT
/begin MEASUREMENT B_sbblsu "" UWORD B_TRUE 1 100 0.00 1.00000000000 BIT_MASK 0x1 FORMAT "%13.11" ECU_ADDRESS 0xD0000B58 /end MEASUREMENT
/begin MEASUREMENT B_sch "" UWORD B_TRUE 1 100 0.00 1.00000000000 BIT_MASK 0x1 FORMAT "%13.11" ECU_ADDRESS 0xD0000B58 /end MEASUREMENT
/begin MEASUREMENT B_sgs "" UBYTE B_TRUE 1 100 0.00 1.00000000000 BIT_MASK 0x4 FORMAT "%13.11" ECU_ADDRESS 0xD0000055 /end MEASUREMENT
/begin MEASUREMENT B_sgsred "" UBYTE B_TRUE 1 100 0.00 1.00000000000 BIT_MASK 0x4 FORMAT "%13.11" ECU_ADDRESS 0xD0000092 /end MEASUREMENT
/begin MEASUREMENT B_skh "" UWORD B_TRUE 1 100 0.00 1.00000000000 BIT_MASK 0x1 FORMAT "%13.11" ECU_ADDRESS 0xD0000B58 /end MEASUREMENT
/begin MEASUREMENT B_sl "" UBYTE B_TRUE 1 100 0.00 1.00000000000 BIT_MASK 0x4 FORMAT "%13.11" ECU_ADDRESS 0xD000005C /end MEASUREMENT
/begin MEASUREMENT B_slperno "" UWORD B_TRUE 1 100 0.00 1.00000000000 BIT_MASK 0x1 FORMAT "%13.11" ECU_ADDRESS 0xD0000B58 /end MEASUREMENT
/begin MEASUREMENT B_spabgl "" UWORD B_TRUE 1 100 0.00 1.00000000000 BIT_MASK 0x1 FORMAT "%13.11" ECU_ADDRESS 0xD0000B58 /end MEASUREMENT
/begin MEASUREMENT B_spdtevh "" UBYTE B_TRUE 1 100 0.00 1.00000000000 BIT_MASK 0x8 FORMAT "%13.11" ECU_ADDRESS 0xD0000078 /end MEASUREMENT
/begin MEASUREMENT B_spf3k "" UWORD B_TRUE 1 100 0.00 1.00000000000 BIT_MASK 0x1 FORMAT "%13.11" ECU_ADDRESS 0xD0000B58 /end MEASUREMENT
/begin MEASUREMENT B_staa "" UBYTE B_TRUE 1 100 0.00 1.00000000000 BIT_MASK 0x10 FORMAT "%13.11" ECU_ADDRESS 0xD000009B /end MEASUREMENT
/begin MEASUREMENT B_stadapon "" UBYTE B_TRUE 1 100 0.00 1.00000000000 BIT_MASK 0x80 FORMAT "%13.11" ECU_ADDRESS 0xD0000048 /end MEASUREMENT
/begin MEASUREMENT B_stano "" UBYTE B_TRUE 1 100 0.00 1.00000000000 BIT_MASK 0x1 FORMAT "%13.11" ECU_ADDRESS 0xD0000049 /end MEASUREMENT
/begin MEASUREMENT B_sttakt "" UWORD B_TRUE 1 100 0.00 1.00000000000 BIT_MASK 0x1 FORMAT "%13.11" ECU_ADDRESS 0xD0000B58 /end MEASUREMENT
/begin MEASUREMENT B_tahrmx "" UWORD B_TRUE 1 100 0.00 1.00000000000 BIT_MASK 0x1 FORMAT "%13.11" ECU_ADDRESS 0xD0000B58 /end MEASUREMENT
/begin MEASUREMENT B_talval "" UBYTE B_TRUE 1 100 0.00 1.00000000000 BIT_MASK 0x80 FORMAT "%13.11" ECU_ADDRESS 0xD0000068 /end MEASUREMENT
/begin MEASUREMENT B_tansh "" UBYTE B_TRUE 1 100 0.00 1.00000000000 BIT_MASK 0x20 FORMAT "%13.11" ECU_ADDRESS 0xD000007D /end MEASUREMENT
/begin MEASUREMENT B_tatewi "" UBYTE B_TRUE 1 100 0.00 1.00000000000 BIT_MASK 0x2 FORMAT "%13.11" ECU_ADDRESS 0xD0000080 /end MEASUREMENT
/begin MEASUREMENT B_te "" UBYTE B_TRUE 1 100 0.00 1.00000000000 BIT_MASK 0x10 FORMAT "%13.11" ECU_ADDRESS 0xD000005A /end MEASUREMENT
/begin MEASUREMENT B_teakt "" UBYTE B_TRUE 1 100 0.00 1.00000000000 BIT_MASK 0x8 FORMAT "%13.11" ECU_ADDRESS 0xD0000059 /end MEASUREMENT
/begin MEASUREMENT B_tef "" UBYTE B_TRUE 1 100 0.00 1.00000000000 BIT_MASK 0x4 FORMAT "%13.11" ECU_ADDRESS 0xD000005B /end MEASUREMENT
/begin MEASUREMENT B_tei "" UBYTE B_TRUE 1 100 0.00 1.00000000000 BIT_MASK 0x10 FORMAT "%13.11" ECU_ADDRESS 0xD000005B /end MEASUREMENT
/begin MEASUREMENT B_ten "" UBYTE B_TRUE 1 100 0.00 1.00000000000 BIT_MASK 0x80 FORMAT "%13.11" ECU_ADDRESS 0xD000007F /end MEASUREMENT
/begin MEASUREMENT B_tevior "" UWORD B_TRUE 1 100 0.00 1.00000000000 BIT_MASK 0x1 FORMAT "%13.11" ECU_ADDRESS 0xD0000B58 /end MEASUREMENT
/begin MEASUREMENT B_trsah "" UWORD B_TRUE 1 100 0.00 1.00000000000 BIT_MASK 0x1 FORMAT "%13.11" ECU_ADDRESS 0xD0000B58 /end MEASUREMENT
/begin MEASUREMENT B_tvateh "" UBYTE B_TRUE 1 100 0.00 1.00000000000 BIT_MASK 0x4 FORMAT "%13.11" ECU_ADDRESS 0xD000004A /end MEASUREMENT
/begin MEASUREMENT B_tvatel "" UBYTE B_TRUE 1 100 0.00 1.00000000000 BIT_MASK 0x40 FORMAT "%13.11" ECU_ADDRESS 0xD000004A /end MEASUREMENT
/begin MEASUREMENT B_ubpvg "" UBYTE B_TRUE 1 100 0.00 1.00000000000 BIT_MASK 0x40 FORMAT "%13.11" ECU_ADDRESS 0xD0000054 /end MEASUREMENT
/begin MEASUREMENT B_uhsig "" UWORD B_TRUE 1 100 0.00 1.00000000000 BIT_MASK 0x1 FORMAT "%13.11" ECU_ADDRESS 0xD0000B58 /end MEASUREMENT
/begin MEASUREMENT B_vl "" UWORD B_TRUE 1 100 0.00 1.00000000000 BIT_MASK 0x1 FORMAT "%13.11" ECU_ADDRESS 0xD0000B58 /end MEASUREMENT
/begin MEASUREMENT B_wakeup "" UBYTE B_TRUE 1 100 0.00 1.00000000000 BIT_MASK 0x8 FORMAT "%13.11" ECU_ADDRESS 0xD000009C /end MEASUREMENT
/begin MEASUREMENT B_zhhrlsu "" UWORD B_TRUE 1 100 0.00 1.00000000000 BIT_MASK 0x1 FORMAT "%13.11" ECU_ADDRESS 0xD0000B58 /end MEASUREMENT
/begin MEASUREMENT CoEOM_stOpModeAct "" ULONG OneToOne 1 100 0.00 4294967295.00 FORMAT "%13.2" ECU_ADDRESS 0xD0002320 /end MEASUREMENT
/begin MEASUREMENT CoESS_stRcpt "" UBYTE OneToOne 1 100 0.00 255.0 FORMAT "%5.1" ECU_ADDRESS 0xD0003C23 /end MEASUREMENT
/begin MEASUREMENT CoETS_bIntvActvDesNoTra "" UBYTE OneToOne 1 100 0.00 255.0 BIT_MASK 0x1 FORMAT "%5.1" ECU_ADDRESS 0xD0003CD0 /end MEASUREMENT
/begin MEASUREMENT CoETS_trqInrActDrv "" SWORD Trq 1 100 -3276.800 3276.700 FORMAT "%8.3" ECU_ADDRESS 0xD000348C /end MEASUREMENT
/begin MEASUREMENT CoME_stIdlSpdInc "" UBYTE OneToOne 1 100 0.00 255.0 FORMAT "%5.1" ECU_ADDRESS 0xD0003C27 /end MEASUREMENT
/begin MEASUREMENT CoME_tiOffStrtAC "" SWORD Time_s 1 100 -327.6800 327.6700 FORMAT "%8.4" ECU_ADDRESS 0xD000349E /end MEASUREMENT
/begin MEASUREMENT Com_pIntMnf "" UWORD Pres_hPa 1 100 0.00 65535.00 FORMAT "%8.2" ECU_ADDRESS 0xD00035D4 /end MEASUREMENT
/begin MEASUREMENT Com_rAltLoadBEM "" SWORD Prc 1 100 -400.0000 399.9878 FORMAT "%8.4" ECU_ADDRESS 0xD00034B2 /end MEASUREMENT
/begin MEASUREMENT Com_rClthPos "" SWORD Prc 1 100 -400.0000 399.9878 FORMAT "%8.4" ECU_ADDRESS 0xD00034B4 /end MEASUREMENT
/begin MEASUREMENT Com_stAC "" UBYTE OneToOne 1 100 0.00 255.0 FORMAT "%5.1" ECU_ADDRESS 0xD0000B58 /end MEASUREMENT
/begin MEASUREMENT Com_stAirBg "" UWORD OneToOne 1 100 0.00 65535.00 FORMAT "%8.2" ECU_ADDRESS 0xD00035D6 /end MEASUREMENT
/begin MEASUREMENT Com_stAltLoadBEM "" UBYTE OneToOne 1 100 0.00 255.0 FORMAT "%5.1" ECU_ADDRESS 0xD0003C30 /end MEASUREMENT
/begin MEASUREMENT Com_stBrk "" UWORD OneToOne 1 100 0.00 65535.00 FORMAT "%8.2" ECU_ADDRESS 0xD00035D8 /end MEASUREMENT
/begin MEASUREMENT Com_stClth "" UBYTE OneToOne 1 100 0.00 255.0 FORMAT "%5.1" ECU_ADDRESS 0xD0003C32 /end MEASUREMENT
/begin MEASUREMENT Com_stClthErr "" UBYTE OneToOne 1 100 0.00 255.0 FORMAT "%5.1" ECU_ADDRESS 0xD0003C33 /end MEASUREMENT
/begin MEASUREMENT Com_stClthModlRng "" UBYTE OneToOne 1 100 0.00 255.0 FORMAT "%5.1" ECU_ADDRESS 0xD0003C34 /end MEASUREMENT
/begin MEASUREMENT Com_stCrCtl "" UBYTE OneToOne 1 100 0.00 255.0 FORMAT "%5.1" ECU_ADDRESS 0xD0003C35 /end MEASUREMENT
/begin MEASUREMENT Com_stCrshIntsty "" UBYTE OneToOne 1 100 0.00 255.0 FORMAT "%5.1" ECU_ADDRESS 0xD0003C36 /end MEASUREMENT
/begin MEASUREMENT Com_stPIntMnf "" UBYTE OneToOne 1 100 0.00 255.0 FORMAT "%5.1" ECU_ADDRESS 0xD0003C37 /end MEASUREMENT
/begin MEASUREMENT Com_stVehSpdSensErr "" UBYTE B_TRUE 1 100 0.00 1.00000000000 BIT_MASK 0x2 FORMAT "%13.11" ECU_ADDRESS 0xD000008F /end MEASUREMENT
/begin MEASUREMENT Com_vVeh "" SWORD Vel 1 100 -327.6800 327.6700 FORMAT "%8.4" ECU_ADDRESS 0xD00034B8 /end MEASUREMENT
/begin MEASUREMENT Conv_trqLd "" SWORD Trq 1 100 -3276.800 3276.700 FORMAT "%8.3" ECU_ADDRESS 0xD00034BA /end MEASUREMENT
/begin MEASUREMENT CoPOM_bChZero "" UBYTE OneToOne 1 100 0.00 255.0 BIT_MASK 0x1 FORMAT "%5.1" ECU_ADDRESS 0xD0003C28 /end MEASUREMENT
/begin MEASUREMENT CoPOM_bEffOk "" UBYTE OneToOne 1 100 0.00 255.0 BIT_MASK 0x1 FORMAT "%5.1" ECU_ADDRESS 0xD0003C29 /end MEASUREMENT
/begin MEASUREMENT CoPOM_bHybP1 "" UBYTE OneToOne 1 100 0.00 255.0 BIT_MASK 0x1 FORMAT "%5.1" ECU_ADDRESS 0xD0003C2A /end MEASUREMENT
/begin MEASUREMENT CoPOM_bTrqIntvOk "" UBYTE OneToOne 1 100 0.00 255.0 BIT_MASK 0x1 FORMAT "%5.1" ECU_ADDRESS 0xD0003C2B /end MEASUREMENT
/begin MEASUREMENT coumsnte_w "" UWORD t_q0p1 1 100 0.00 6553.500 FORMAT "%8.3" ECU_ADDRESS 0xD0000A74 /end MEASUREMENT
/begin MEASUREMENT CoVeh_rClgDes "" SWORD Prc 1 100 -400.0000 399.9878 FORMAT "%8.4" ECU_ADDRESS 0xD00034AA /end MEASUREMENT
/begin MEASUREMENT CoVeh_stAlt "" UBYTE OneToOne 1 100 0.00 255.0 FORMAT "%5.1" ECU_ADDRESS 0xD0000F12 /end MEASUREMENT
/begin MEASUREMENT CoVeh_stWaHt "" UBYTE OneToOne 1 100 0.00 255.0 FORMAT "%5.1" ECU_ADDRESS 0xD0003C2E /end MEASUREMENT
/begin MEASUREMENT CoVeh_tClntDes "" SWORD Temp_Cels 1 100 -3549.940 3003.560 FORMAT "%8.3" ECU_ADDRESS 0xD00034AC /end MEASUREMENT
/begin MEASUREMENT CoVeh_trqMaxAC "" SWORD Trq 1 100 -3276.800 3276.700 FORMAT "%8.3" ECU_ADDRESS 0xD00034B0 /end MEASUREMENT
/begin MEASUREMENT CoVeh_trqPrpLimErr "" SLONG TrqPrpHigh 1 100 -50000.0000000 50000.0000000 FORMAT "%13.7" ECU_ADDRESS 0xD00024AC /end MEASUREMENT
/begin MEASUREMENT CoVMD_stDiffDesTrq "" UBYTE OneToOne 1 100 0.00 255.0 FORMAT "%5.1" ECU_ADDRESS 0xD0003C2C /end MEASUREMENT
/begin MEASUREMENT CoVMD_swtCCSel "" UBYTE OneToOne 1 100 0.00 255.0 FORMAT "%5.1" ECU_ADDRESS 0xD0003C2D /end MEASUREMENT
/begin MEASUREMENT CrCtl_numSymbol "" UBYTE OneToOne 1 100 0.00 255.0 FORMAT "%5.1" ECU_ADDRESS 0xD0003C39 /end MEASUREMENT
/begin MEASUREMENT CrCtl_numTxt "" UBYTE OneToOne 1 100 0.00 255.0 FORMAT "%5.1" ECU_ADDRESS 0xD0003C3A /end MEASUREMENT
/begin MEASUREMENT CrCtl_st "" UBYTE OneToOne 1 100 0.00 255.0 FORMAT "%5.1" ECU_ADDRESS 0xD0003C3B /end MEASUREMENT
/begin MEASUREMENT CrCtl_stCrCtlConf "" UBYTE OneToOne 1 100 0.00 255.0 FORMAT "%5.1" ECU_ADDRESS 0xD0003C3C /end MEASUREMENT
/begin MEASUREMENT CrCtl_stDia "" UBYTE OneToOne 1 100 0.00 255.0 FORMAT "%5.1" ECU_ADDRESS 0xD0003C3D /end MEASUREMENT
/begin MEASUREMENT CrCtl_stDsplHighLine "" UBYTE OneToOne 1 100 0.00 1.000 BIT_MASK 0x1 FORMAT "%5.3" ECU_ADDRESS 0xD0003C3E /end MEASUREMENT
/begin MEASUREMENT CrCtl_stNoDspl "" UBYTE OneToOne 1 100 0.00 1.000 BIT_MASK 0x1 FORMAT "%5.3" ECU_ADDRESS 0xD0003C3F /end MEASUREMENT
/begin MEASUREMENT CrCtl_vDes "" SWORD Vel 1 100 -327.6800 327.6700 FORMAT "%8.4" ECU_ADDRESS 0xD00034BC /end MEASUREMENT
/begin MEASUREMENT CrCtl_vDesDspl "" SWORD Vel 1 100 -327.6800 327.6700 FORMAT "%8.4" ECU_ADDRESS 0xD00034BE /end MEASUREMENT
/begin MEASUREMENT CrC_stPan "" UWORD OneToOne 1 100 0.00 65535.00 FORMAT "%8.2" ECU_ADDRESS 0xD00035DA /end MEASUREMENT
/begin MEASUREMENT CrC_stSixPos "" UBYTE OneToOne 1 100 0.00 255.0 FORMAT "%5.1" ECU_ADDRESS 0xD0003C38 /end MEASUREMENT
/begin MEASUREMENT CtT_stCtTMonActv "" UBYTE OneToOne 1 100 0.00 255.0 BIT_MASK 0x1 FORMAT "%5.1" ECU_ADDRESS 0xD0003C40 /end MEASUREMENT
/begin MEASUREMENT CtT_stIntegEnbl "" UBYTE OneToOne 1 100 0.00 255.0 BIT_MASK 0x1 FORMAT "%5.1" ECU_ADDRESS 0xD0003C41 /end MEASUREMENT
/begin MEASUREMENT CtT_stThmDiagBrk "" UBYTE OneToOne 1 100 0.00 255.0 BIT_MASK 0x1 FORMAT "%5.1" ECU_ADDRESS 0xD0003C42 /end MEASUREMENT
/begin MEASUREMENT dfkaster "" SBYTE fak_sb_b16 1 100 -16.00 15.88 FORMAT "%5.2" ECU_ADDRESS 0xD0000EBF /end MEASUREMENT
/begin MEASUREMENT dfkastes_w "" SWORD perio_q4p76836Em5 1 100 -1.562496 1.562448 FORMAT "%8.6" ECU_ADDRESS 0xD0000A7E /end MEASUREMENT
/begin MEASUREMENT dfkasteub "" SBYTE fak_sb_b16 1 100 -16.00 15.88 FORMAT "%5.2" ECU_ADDRESS 0xD0000EC0 /end MEASUREMENT
/begin MEASUREMENT DiffIO_rTrqDfftl "" SWORD TransR 1 100 -327.6800 327.6700 FORMAT "%8.4" ECU_ADDRESS 0xD00034C0 /end MEASUREMENT
/begin MEASUREMENT DiffIO_stCfg "" UBYTE OneToOne 1 100 0.00 255.0 FORMAT "%5.1" ECU_ADDRESS 0xD0003C44 /end MEASUREMENT
/begin MEASUREMENT DiffIO_trqPrtDfftl "" SLONG TrqPrpHigh 1 100 -214748364.800 214748364.700 FORMAT "%13.3" ECU_ADDRESS 0xD00022E8 /end MEASUREMENT
/begin MEASUREMENT dkstaamn_w "" SWORD fak_q0p0009766 1 100 -32.00000 31.99902 FORMAT "%8.5" ECU_ADDRESS 0xD0000A30 /end MEASUREMENT
/begin MEASUREMENT dkstaamx_w "" SWORD fak_q0p0009766 1 100 -32.00000 31.99902 FORMAT "%8.5" ECU_ADDRESS 0xD0000A32 /end MEASUREMENT
/begin MEASUREMENT dkstaa_w "" SWORD fak_q0p0009766 1 100 -32.00000 31.99902 FORMAT "%8.5" ECU_ADDRESS 0xD0000A34 /end MEASUREMENT
/begin MEASUREMENT dmrkhmn_w "" UWORD rel_uw_b100 1 100 0.00 99.99847 FORMAT "%8.5" ECU_ADDRESS 0xD0000B2A /end MEASUREMENT
/begin MEASUREMENT dmrkh_w "" UWORD rel_uw_b100 1 100 0.00 99.99847 FORMAT "%8.5" ECU_ADDRESS 0xD0000B2C /end MEASUREMENT
/begin MEASUREMENT dmrlf "" UBYTE rel_ub_b99p6 1 100 0.00 99.61 FORMAT "%5.2" ECU_ADDRESS 0xD0000EC9 /end MEASUREMENT
/begin MEASUREMENT dmrllr_w "" UWORD rel_uw_b100 1 100 0.00 99.99847 FORMAT "%8.5" ECU_ADDRESS 0xD0000A24 /end MEASUREMENT
/begin MEASUREMENT dmrmx_w "" UWORD rel_uw_b100 1 100 0.00 99.99847 FORMAT "%8.5" ECU_ADDRESS 0xD0000B2E /end MEASUREMENT
/begin MEASUREMENT dmsnte_w "" SWORD m_q0p1 1 100 -3276.800 3276.700 FORMAT "%8.3" ECU_ADDRESS 0xD0000B58 /end MEASUREMENT
/begin MEASUREMENT dmstes_w "" SWORD m_q0p002441_kg_DIV_h_s 1 100 -80.00000 79.99756 FORMAT "%8.5" ECU_ADDRESS 0xD0000A60 /end MEASUREMENT
/begin MEASUREMENT dnburns_w "" SWORD nmot_sw_q0p25 1 100 -8192.000 8191.750 FORMAT "%8.3" ECU_ADDRESS 0xD0000A36 /end MEASUREMENT
/begin MEASUREMENT DrvPrgSwt_bSprt "" UBYTE OneToOne 1 100 0.00 1.000 BIT_MASK 0x1 FORMAT "%5.3" ECU_ADDRESS 0xD0003C45 /end MEASUREMENT
/begin MEASUREMENT DrvPrgSwt_bWntrActv "" UBYTE OneToOne 1 100 0.00 1.000 BIT_MASK 0x1 FORMAT "%5.3" ECU_ADDRESS 0xD0003C46 /end MEASUREMENT
/begin MEASUREMENT DrvPrgSwt_numCurrCAN "" UBYTE OneToOne 1 100 0.00 255.0 FORMAT "%5.1" ECU_ADDRESS 0xD0003C47 /end MEASUREMENT
/begin MEASUREMENT DrvPrgSwt_st "" UBYTE OneToOne 1 100 0.00 255.0 FORMAT "%5.1" ECU_ADDRESS 0xD0003C48 /end MEASUREMENT
/begin MEASUREMENT dssttmst "" SBYTE temp_sb_q0p75 1 100 -96.00 95.25 FORMAT "%5.2" ECU_ADDRESS 0xD0000EA3 /end MEASUREMENT
/begin MEASUREMENT dzwspae "" SBYTE zw_sb_q0p75 1 100 -96.00 95.25 FORMAT "%5.2" ECU_ADDRESS 0xD0000ECD /end MEASUREMENT
/begin MEASUREMENT ECl_bRedTrq "" UBYTE OneToOne 1 100 0.00 255.0 BIT_MASK 0x1 FORMAT "%5.1" ECU_ADDRESS 0xD0003C49 /end MEASUREMENT
/begin MEASUREMENT EEM_pwrAltDes "" SWORD Pwr 1 100 -308831.1 308821.7 FORMAT "%8.1" ECU_ADDRESS 0xD00034C2 /end MEASUREMENT
/begin MEASUREMENT EngDa_pwrEngHi "" UWORD Pwr_kW 1 100 0.00 655.3500 FORMAT "%8.4" ECU_ADDRESS 0xD00035DE /end MEASUREMENT
/begin MEASUREMENT EngDa_tStrt "" SWORD Temp_Cels 1 100 -3549.940 3003.560 FORMAT "%8.3" ECU_ADDRESS 0xD00034DC /end MEASUREMENT
/begin MEASUREMENT EngDem_nMax "" SWORD EngN 1 100 -16384.00 16383.50 FORMAT "%8.2" ECU_ADDRESS 0xD00034DE /end MEASUREMENT
/begin MEASUREMENT EngDem_stErr "" UBYTE OneToOne 1 100 0.00 255.0 FORMAT "%5.1" ECU_ADDRESS 0xD0003C4A /end MEASUREMENT
/begin MEASUREMENT EngPrt_stTempPrtShftUp "" UBYTE OneToOne 1 100 0.00 255.0 BIT_MASK 0x1 FORMAT "%5.1" ECU_ADDRESS 0xD0003C4C /end MEASUREMENT
/begin MEASUREMENT EngPrt_trqLimWoIncLd "" SWORD Trq 1 100 -3276.800 3276.700 FORMAT "%8.3" ECU_ADDRESS 0xD00034E0 /end MEASUREMENT
/begin MEASUREMENT EnvP_facCor "" SWORD Fact 1 100 -4.000000 3.999878 FORMAT "%8.6" ECU_ADDRESS 0xD00034E6 /end MEASUREMENT
/begin MEASUREMENT ErrLmp_stSVS "" UBYTE OneToOne 1 100 0.00 255.0 FORMAT "%5.1" ECU_ADDRESS 0xD0003C60 /end MEASUREMENT
/begin MEASUREMENT esst_fho04esub "" ULONG dez 1 100 0.00 4294967295.00 FORMAT "%13.2" ECU_ADDRESS 0xD00024B0 /end MEASUREMENT
/begin MEASUREMENT esst_sga08mdub "" ULONG dez 1 100 0.00 4294967295.00 FORMAT "%13.2" ECU_ADDRESS 0xD00024B4 /end MEASUREMENT
/begin MEASUREMENT esst_sim06esuw "" ULONG dez 1 100 0.00 4294967295.00 FORMAT "%13.2" ECU_ADDRESS 0xD00024B8 /end MEASUREMENT
/begin MEASUREMENT esst_sks06esub "" ULONG dez 1 100 0.00 4294967295.00 FORMAT "%13.2" ECU_ADDRESS 0xD00024BC /end MEASUREMENT
/begin MEASUREMENT esst_smi04llub "" ULONG dez 1 100 0.00 4294967295.00 FORMAT "%13.2" ECU_ADDRESS 0xD00024C0 /end MEASUREMENT
/begin MEASUREMENT esst_smi04teuw "" ULONG dez 1 100 0.00 4294967295.00 FORMAT "%13.2" ECU_ADDRESS 0xD00024C4 /end MEASUREMENT
/begin MEASUREMENT esst_smi08dmub "" ULONG dez 1 100 0.00 4294967295.00 FORMAT "%13.2" ECU_ADDRESS 0xD0002448 /end MEASUREMENT
/begin MEASUREMENT esst_smk05teub "" ULONG dez 1 100 0.00 4294967295.00 FORMAT "%13.2" ECU_ADDRESS 0xD000247C /end MEASUREMENT
/begin MEASUREMENT esst_sml05lkub "" ULONG dez 1 100 0.00 4294967295.00 FORMAT "%13.2" ECU_ADDRESS 0xD00024C8 /end MEASUREMENT
/begin MEASUREMENT esst_sml08lhub "" ULONG dez 1 100 0.00 4294967295.00 FORMAT "%13.2" ECU_ADDRESS 0xD00024CC /end MEASUREMENT
/begin MEASUREMENT esst_snm04teub "" ULONG dez 1 100 0.00 4294967295.00 FORMAT "%13.2" ECU_ADDRESS 0xD00024D4 /end MEASUREMENT
/begin MEASUREMENT esst_snm06lluw "" ULONG dez 1 100 0.00 4294967295.00 FORMAT "%13.2" ECU_ADDRESS 0xD00024D8 /end MEASUREMENT
/begin MEASUREMENT esst_snm07esub "" ULONG dez 1 100 0.00 4294967295.00 FORMAT "%13.2" ECU_ADDRESS 0xD00024DC /end MEASUREMENT
/begin MEASUREMENT esst_snm08dmub "" ULONG dez 1 100 0.00 4294967295.00 FORMAT "%13.2" ECU_ADDRESS 0xD000244C /end MEASUREMENT
/begin MEASUREMENT esst_snm08lhub "" ULONG dez 1 100 0.00 4294967295.00 FORMAT "%13.2" ECU_ADDRESS 0xD00024E0 /end MEASUREMENT
/begin MEASUREMENT esst_snm09dm1ub "" ULONG dez 1 100 0.00 4294967295.00 FORMAT "%13.2" ECU_ADDRESS 0xD0002450 /end MEASUREMENT
/begin MEASUREMENT esst_snm09dm2ub "" ULONG dez 1 100 0.00 4294967295.00 FORMAT "%13.2" ECU_ADDRESS 0xD0002454 /end MEASUREMENT
/begin MEASUREMENT esst_snm16zuuw "" ULONG dez 1 100 0.00 4294967295.00 FORMAT "%13.2" ECU_ADDRESS 0xD00024E8 /end MEASUREMENT
/begin MEASUREMENT esst_snm24zuub "" ULONG dez 1 100 0.00 4294967295.00 FORMAT "%13.2" ECU_ADDRESS 0xD00024EC /end MEASUREMENT
/begin MEASUREMENT esst_srl11opuw "" ULONG dez 1 100 0.00 4294967295.00 FORMAT "%13.2" ECU_ADDRESS 0xD00024F0 /end MEASUREMENT
/begin MEASUREMENT esst_srl12zuuw "" ULONG dez 1 100 0.00 4294967295.00 FORMAT "%13.2" ECU_ADDRESS 0xD00024F4 /end MEASUREMENT
/begin MEASUREMENT esst_srl16zuub "" ULONG dez 1 100 0.00 4294967295.00 FORMAT "%13.2" ECU_ADDRESS 0xD00024F8 /end MEASUREMENT
/begin MEASUREMENT esst_srp06esub "" ULONG dez 1 100 0.00 4294967295.00 FORMAT "%13.2" ECU_ADDRESS 0xD00024FC /end MEASUREMENT
/begin MEASUREMENT esst_sta04llub "" ULONG dez 1 100 0.00 4294967295.00 FORMAT "%13.2" ECU_ADDRESS 0xD0002500 /end MEASUREMENT
/begin MEASUREMENT esst_sta04teub "" ULONG dez 1 100 0.00 4294967295.00 FORMAT "%13.2" ECU_ADDRESS 0xD0002504 /end MEASUREMENT
/begin MEASUREMENT esst_sta06esub "" ULONG dez 1 100 0.00 4294967295.00 FORMAT "%13.2" ECU_ADDRESS 0xD0002508 /end MEASUREMENT
/begin MEASUREMENT esst_stm04saub "" ULONG dez 1 100 0.00 4294967295.00 FORMAT "%13.2" ECU_ADDRESS 0xD000250C /end MEASUREMENT
/begin MEASUREMENT esst_stm08__ub "" ULONG dez 1 100 0.00 4294967295.00 FORMAT "%13.2" ECU_ADDRESS 0xD0002514 /end MEASUREMENT
/begin MEASUREMENT esst_stm09esub "" ULONG dez 1 100 0.00 4294967295.00 FORMAT "%13.2" ECU_ADDRESS 0xD0002518 /end MEASUREMENT
/begin MEASUREMENT esst_stm10tmub "" ULONG dez 1 100 0.00 4294967295.00 FORMAT "%13.2" ECU_ADDRESS 0xD000251C /end MEASUREMENT
/begin MEASUREMENT esst_stm12esub "" ULONG dez 1 100 0.00 4294967295.00 FORMAT "%13.2" ECU_ADDRESS 0xD0002520 /end MEASUREMENT
/begin MEASUREMENT esst_stms06llub "" ULONG dez 1 100 0.00 4294967295.00 FORMAT "%13.2" ECU_ADDRESS 0xD0002524 /end MEASUREMENT
/begin MEASUREMENT esst_sts08esub "" ULONG dez 1 100 0.00 4294967295.00 FORMAT "%13.2" ECU_ADDRESS 0xD0002528 /end MEASUREMENT
/begin MEASUREMENT esst_sts12esub "" ULONG dez 1 100 0.00 4294967295.00 FORMAT "%13.2" ECU_ADDRESS 0xD000252C /end MEASUREMENT
/begin MEASUREMENT etakh "" UBYTE rel_ub_b127p5 1 100 0.00 127.5 FORMAT "%5.1" ECU_ADDRESS 0xD0000ECE /end MEASUREMENT
/begin MEASUREMENT etazwmn "" UBYTE rel_ub_b127p5 1 100 0.00 127.5 FORMAT "%5.1" ECU_ADDRESS 0xD0000ECF /end MEASUREMENT
/begin MEASUREMENT etazwmn_w "" UWORD fak_uw_b2 1 100 0.00 1.999969 FORMAT "%8.6" ECU_ADDRESS 0xD0000A90 /end MEASUREMENT
/begin MEASUREMENT evtmod "" UBYTE temp_q0p75_om48 1 100 -48.00 143.3 FORMAT "%5.1" ECU_ADDRESS 0xD0000F13 /end MEASUREMENT
/begin MEASUREMENT fafte_w "" UWORD fak_uw_b2 1 100 0.00 1.999969 FORMAT "%8.6" ECU_ADDRESS 0xD0000A4C /end MEASUREMENT
/begin MEASUREMENT Fan1_r "" SWORD Prc 1 100 -400.0000 399.9878 FORMAT "%8.4" ECU_ADDRESS 0xD000352A /end MEASUREMENT
/begin MEASUREMENT FanCtl_bARActv "" UBYTE OneToOne 1 100 0.00 255.0 BIT_MASK 0x1 FORMAT "%5.1" ECU_ADDRESS 0xD0003C62 /end MEASUREMENT
/begin MEASUREMENT FanCtl_stHotLmp "" UBYTE dez 1 100 0.00 255.0 FORMAT "%5.1" ECU_ADDRESS 0xD0003C64 /end MEASUREMENT
/begin MEASUREMENT FanCtl_stOk "" UBYTE dez 1 100 0.00 255.0 BIT_MASK 0x1 FORMAT "%5.1" ECU_ADDRESS 0xD0003C65 /end MEASUREMENT
/begin MEASUREMENT FanCtl_tiAR "" SWORD TimeEngOn 1 100 -32768.00 32767.00 FORMAT "%8.2" ECU_ADDRESS 0xD000352C /end MEASUREMENT
/begin MEASUREMENT Fan_bFan3Ena "" UBYTE OneToOne 1 100 0.00 255.0 FORMAT "%5.1" ECU_ADDRESS 0xD0003C66 /end MEASUREMENT
/begin MEASUREMENT Fan_rPs "" SWORD DtyCyc 1 100 -327.6800 327.6700 FORMAT "%8.4" ECU_ADDRESS 0xD0003530 /end MEASUREMENT
/begin MEASUREMENT Fan_rRelClg "" SWORD Prc 1 100 -400.0000 399.9878 FORMAT "%8.4" ECU_ADDRESS 0xD0003532 /end MEASUREMENT
/begin MEASUREMENT Fan_st "" UBYTE OneToOne 1 100 0.00 255.0 FORMAT "%5.1" ARRAY_SIZE 2 ECU_ADDRESS 0xD0003C69 /end MEASUREMENT
/begin MEASUREMENT Fan_stShutOff "" UBYTE OneToOne 1 100 0.00 255.0 FORMAT "%5.1" ECU_ADDRESS 0xD0003C68 /end MEASUREMENT
/begin MEASUREMENT fgwrte "" UBYTE fak_ub_b16 1 100 0.00 15.94 FORMAT "%5.2" ECU_ADDRESS 0xD0000EC5 /end MEASUREMENT
/begin MEASUREMENT fkakordl "" UBYTE fak_ub_b4 1 100 0.00 3.984 FORMAT "%5.3" ECU_ADDRESS 0xD0000EC1 /end MEASUREMENT
/begin MEASUREMENT fkakormt_w "" UWORD fak_uw_b2 1 100 0.00 1.999969 FORMAT "%8.6" ECU_ADDRESS 0xD0000A5C /end MEASUREMENT
/begin MEASUREMENT fkakormx_w "" UWORD fak_uw_b4 1 100 0.00 3.999939 FORMAT "%8.6" ECU_ADDRESS 0xD0000A5E /end MEASUREMENT
/begin MEASUREMENT fkaste "" UBYTE fak_ub_b0p5 1 100 0.00 0.4980 ECU_ADDRESS 0xD0000EC6 /end MEASUREMENT
/begin MEASUREMENT fkastes "" UBYTE fak_ub_b0p5 1 100 0.00 0.4980 ECU_ADDRESS 0xD0000EC2 /end MEASUREMENT
/begin MEASUREMENT fkastes_w "" UWORD fak_uw_b0p5 1 100 0.00 0.4999924 FORMAT "%9.7" ECU_ADDRESS 0xD0000A80 /end MEASUREMENT
/begin MEASUREMENT fkastexm "" UBYTE fak_ub_b0p5 1 100 0.00 0.4980 ECU_ADDRESS 0xD0000EAE /end MEASUREMENT
/begin MEASUREMENT fkastexm_w "" UWORD fak_uw_b0p5 1 100 0.00 0.4999924 FORMAT "%9.7" ECU_ADDRESS 0xD0000A8A /end MEASUREMENT
/begin MEASUREMENT fkastexu "" UBYTE fak_ub_b0p5 1 100 0.00 0.4980 ECU_ADDRESS 0xD0000EC3 /end MEASUREMENT
/begin MEASUREMENT fkastex_w "" UWORD fak_uw_b0p5 1 100 0.00 0.4999924 FORMAT "%9.7" ECU_ADDRESS 0xD0000A82 /end MEASUREMENT
/begin MEASUREMENT fkastold_w "" UWORD fak_uw_b0p5 1 100 0.00 0.4999924 FORMAT "%9.7" ECU_ADDRESS 0xD0000A84 /end MEASUREMENT
/begin MEASUREMENT fkatei "" SBYTE fak_sb_b1 1 100 -1.000 0.9922 FORMAT "%5.3" ECU_ADDRESS 0xD0000EC7 /end MEASUREMENT
/begin MEASUREMENT fkateif "" SBYTE fak_sb_b1 1 100 -1.000 0.9922 FORMAT "%5.3" ECU_ADDRESS 0xD0000EB8 /end MEASUREMENT
/begin MEASUREMENT fkateifv "" SBYTE fak_sb_b2 1 100 -2.000 1.984 FORMAT "%5.3" ECU_ADDRESS 0xD0000EB9 /end MEASUREMENT
/begin MEASUREMENT fkateiims "" SBYTE fak_sb_b1 1 100 -1.000 0.9922 FORMAT "%5.3" ECU_ADDRESS 0xD0000EBA /end MEASUREMENT
/begin MEASUREMENT flambts "" UBYTE fak_ub_b1 1 100 0.00 0.9961 ECU_ADDRESS 0xD0000F14 /end MEASUREMENT
/begin MEASUREMENT FlSys_volFlConsDspl "" SWORD vol_q1_ul 1 100 -32768.00 32767.00 FORMAT "%8.2" ECU_ADDRESS 0xD0003538 /end MEASUREMENT
/begin MEASUREMENT frdter_w "" UWORD fak_uw_b2 1 100 0.00 1.999969 FORMAT "%8.6" ECU_ADDRESS 0xD0000B42 /end MEASUREMENT
/begin MEASUREMENT fteadf "" SBYTE fak_sb_b64 1 100 -64.00 63.50 FORMAT "%5.2" ECU_ADDRESS 0xD0000EB0 /end MEASUREMENT
/begin MEASUREMENT fteadvir "" SBYTE fak_q0p5 1 100 -64.00 63.50 FORMAT "%5.2" ECU_ADDRESS 0xD0000EBB /end MEASUREMENT
/begin MEASUREMENT ftead_w "" SWORD fak_sw_b64 1 100 -64.00000 63.99805 FORMAT "%8.5" ECU_ADDRESS 0xD0000A3C /end MEASUREMENT
/begin MEASUREMENT ftefsoll_w "" UWORD fak_uw_b0p5 1 100 0.00 0.4999924 FORMAT "%9.7" ECU_ADDRESS 0xD0000A8C /end MEASUREMENT
/begin MEASUREMENT ftevflox_w "" UWORD fak_uw_b1 1 100 0.00 0.9999847 FORMAT "%9.7" ECU_ADDRESS 0xD0000A8E /end MEASUREMENT
/begin MEASUREMENT ftevflxm_w "" UWORD fak_uw_b1 1 100 0.00 0.9999847 FORMAT "%9.7" ECU_ADDRESS 0xD0000A86 /end MEASUREMENT
/begin MEASUREMENT ftho_w "" UWORD fak_uw_b2 1 100 0.00 1.999969 FORMAT "%8.6" ECU_ADDRESS 0xD0000A50 /end MEASUREMENT
/begin MEASUREMENT ftrq2mi_w "" UWORD fak_q2p384Em4_pc_DIV_Nm 1 100 0.00 15.62476 FORMAT "%8.5" ECU_ADDRESS 0xD0000A92 /end MEASUREMENT
/begin MEASUREMENT FuelT_t "" SWORD Temp_Cels 1 100 -3549.940 3003.560 FORMAT "%8.3" ECU_ADDRESS 0xD000353A /end MEASUREMENT
/begin MEASUREMENT fwnwe "" UBYTE fak_ub_b1 1 100 0.00 0.9961 ECU_ADDRESS 0xD0000B42 /end MEASUREMENT
/begin MEASUREMENT fwnwvs_w "" UWORD fak_uw_b2 1 100 0.00 1.999969 FORMAT "%8.6" ECU_ADDRESS 0xD0000B58 /end MEASUREMENT
/begin MEASUREMENT gangauti "" UBYTE OneToOne 1 100 0.00 255.0 FORMAT "%5.1" ECU_ADDRESS 0xD0000B58 /end MEASUREMENT
/begin MEASUREMENT Gbx_numGear "" SBYTE OneToOne 1 100 -128.0 127.0 FORMAT "%5.1" ECU_ADDRESS 0xD0003BE6 /end MEASUREMENT
/begin MEASUREMENT Gbx_rTrqTra "" SWORD TransR 1 100 -327.6800 327.6700 FORMAT "%8.4" ECU_ADDRESS 0xD000353C /end MEASUREMENT
/begin MEASUREMENT Gbx_stNPos "" UBYTE OneToOne 1 100 0.00 1.000 BIT_MASK 0x1 FORMAT "%5.3" ECU_ADDRESS 0xD0003CD1 /end MEASUREMENT
/begin MEASUREMENT Gbx_stPNPos "" UBYTE OneToOne 1 100 0.00 255.0 FORMAT "%5.1" ECU_ADDRESS 0xD0003C6B /end MEASUREMENT
/begin MEASUREMENT GlbDa_stVehicleHalt "" UBYTE OneToOne 1 100 0.00 1.000 BIT_MASK 0x1 FORMAT "%5.3" ECU_ADDRESS 0xD0003C6D /end MEASUREMENT
/begin MEASUREMENT HEGOD_bS2B1InhbRiEval "" UBYTE B_TRUE 1 100 0.00 1.00000000000 BIT_MASK 0x80 FORMAT "%13.11" ECU_ADDRESS 0xD0000081 /end MEASUREMENT
/begin MEASUREMENT HEGOD_bS2B1ReqRcn "" UBYTE B_TRUE 1 100 0.00 1.00000000000 BIT_MASK 0x80 FORMAT "%13.11" ECU_ADDRESS 0xD000007A /end MEASUREMENT
/begin MEASUREMENT HEGOD_tiDeltaFltPerB1 "" UWORD t_q0p01 1 100 0.00 655.3500 FORMAT "%8.4" ECU_ADDRESS 0xD00035E8 /end MEASUREMENT
/begin MEASUREMENT HEGO_bS2B1HtgSuffRi "" UBYTE B_TRUE 1 100 0.00 1.00000000000 BIT_MASK 0x40 FORMAT "%13.11" ECU_ADDRESS 0xD0000094 /end MEASUREMENT
/begin MEASUREMENT HEGO_bS2B1Vld "" UBYTE B_TRUE 1 100 0.00 1.00000000000 BIT_MASK 0x10 FORMAT "%13.11" ECU_ADDRESS 0xD000007F /end MEASUREMENT
/begin MEASUREMENT HEGO_uS2B1 "" UBYTE spg_q0p00488 1 100 0.00 1.245 FORMAT "%5.3" ECU_ADDRESS 0xD0003C71 /end MEASUREMENT
/begin MEASUREMENT HEGO_uS2B1Extd "" UWORD spg_q0p00488 1 100 0.00 319.9951 FORMAT "%8.4" ECU_ADDRESS 0xD00035FA /end MEASUREMENT
/begin MEASUREMENT HLSDem_bShrtTrpSpdRmp "" UBYTE OneToOne 1 100 0.00 1.000 BIT_MASK 0x10 FORMAT "%5.3" ECU_ADDRESS 0xD0000064 /end MEASUREMENT
/begin MEASUREMENT HLSDem_nSetPLo "" SWORD nmot_sw_q0p5 1 100 -16384.00 16383.50 FORMAT "%8.2" ECU_ADDRESS 0xD000355E /end MEASUREMENT
/begin MEASUREMENT imstefv_w "" UWORD m_ub_q0p0444 1 100 0.00 2909.754 FORMAT "%8.3" ECU_ADDRESS 0xD0000A76 /end MEASUREMENT
/begin MEASUREMENT imsteini "" UBYTE m_ub_q0p0444 1 100 0.00 11.32 FORMAT "%5.2" ECU_ADDRESS 0xD0000EC8 /end MEASUREMENT
/begin MEASUREMENT InjCrv_stInjCharActVal "" UBYTE OneToOne 1 100 0.00 255.0 FORMAT "%5.1" ARRAY_SIZE 3 ECU_ADDRESS 0xD0003C87 /end MEASUREMENT
/begin MEASUREMENT InjCtl_qSetUnBal "" SWORD InjMass 1 100 -327.6800 327.6700 FORMAT "%8.4" ECU_ADDRESS 0xD0003562 /end MEASUREMENT
/begin MEASUREMENT kintftead "" UBYTE perio_q0p3125 1 100 0.00 79.69 FORMAT "%5.2" ECU_ADDRESS 0xD0000EAF /end MEASUREMENT
/begin MEASUREMENT kormtmod_w "" UWORD fak_uw_b2 1 100 0.00 1.999969 FORMAT "%8.6" ECU_ADDRESS 0xD0000A3A /end MEASUREMENT
/begin MEASUREMENT kstaa "" UBYTE fak_ub_b2 1 100 0.00 1.992188 FORMAT "%8.6" ECU_ADDRESS 0xD0000EAC /end MEASUREMENT
/begin MEASUREMENT kstaold "" UBYTE fak_ub_b2 1 100 0.00 1.992188 FORMAT "%8.6" ECU_ADDRESS 0xD0000EA4 /end MEASUREMENT
/begin MEASUREMENT kstaoldon "" UBYTE fak_ub_b2 1 100 0.00 1.992188 FORMAT "%8.6" ECU_ADDRESS 0xD0000EA5 /end MEASUREMENT
/begin MEASUREMENT kstatmst "" UBYTE fak_ub_b2 1 100 0.00 1.992188 FORMAT "%8.6" ARRAY_SIZE 7 ECU_ADDRESS 0xAFE801A8 /end MEASUREMENT
/begin MEASUREMENT ktevanst "" UBYTE perio_ub_b0p012207 1 100 0.00 0.0121593164 FORMAT "%12.10" ECU_ADDRESS 0xD0000EBC /end MEASUREMENT
/begin MEASUREMENT lamelsh_w "" UWORD fak_uw_b16 1 100 0.00 15.99976 FORMAT "%8.5" ECU_ADDRESS 0xD0000B30 /end MEASUREMENT
/begin MEASUREMENT lamesok_w "" UWORD fak_q0p000244 1 100 0.00 15.99976 FORMAT "%8.5" ECU_ADDRESS 0xD0000B32 /end MEASUREMENT
/begin MEASUREMENT lamsbgm_w "" UWORD fak_uw_b16 1 100 0.00 15.99976 FORMAT "%8.5" ECU_ADDRESS 0xD0000A78 /end MEASUREMENT
/begin MEASUREMENT lbz "" UBYTE rel_ub_b99p6 1 100 0.00 99.61 FORMAT "%5.2" ECU_ADDRESS 0xD0000F15 /end MEASUREMENT
/begin MEASUREMENT LIGov_nDiff "" SWORD nmot_q0p5 1 100 -16384.00 16383.50 FORMAT "%8.2" ECU_ADDRESS 0xD0003564 /end MEASUREMENT
/begin MEASUREMENT LLim_stMaxActvLvlECU "" UBYTE OneToOne 1 100 0.00 255.0 FORMAT "%5.1" ECU_ADDRESS 0xD0003C8B /end MEASUREMENT
/begin MEASUREMENT mdgen_w "" UWORD rel_uw_b100 1 100 0.00 99.99847 FORMAT "%8.5" ECU_ADDRESS 0xD0000B34 /end MEASUREMENT
/begin MEASUREMENT mdkocan "" UBYTE rel_ub_b100 1 100 0.00 99.61 FORMAT "%5.2" ECU_ADDRESS 0xD0000F16 /end MEASUREMENT
/begin MEASUREMENT mdwan_w "" SWORD rel_sw_b100 1 100 -100.0000 99.99695 FORMAT "%8.4" ECU_ADDRESS 0xD0000B36 /end MEASUREMENT
/begin MEASUREMENT miasrs_w "" UWORD rel_uw_b100 1 100 0.00 99.99847 FORMAT "%8.5" ECU_ADDRESS 0xD0000B38 /end MEASUREMENT
/begin MEASUREMENT miautget_w "" UWORD rel_uw_b100 1 100 0.00 99.99847 FORMAT "%8.5" ECU_ADDRESS 0xD0000A94 /end MEASUREMENT
/begin MEASUREMENT midmd "" UBYTE rel_ub_b99p6 1 100 0.00 99.61 FORMAT "%5.2" ECU_ADDRESS 0xD0000E9F /end MEASUREMENT
/begin MEASUREMENT midmd_w "" UWORD rel_uw_b100 1 100 0.00 99.99847 FORMAT "%8.5" ECU_ADDRESS 0xD0000A26 /end MEASUREMENT
/begin MEASUREMENT mifab_w "" UWORD rel_uw_b100 1 100 0.00 99.99847 FORMAT "%8.5" ECU_ADDRESS 0xD0000A96 /end MEASUREMENT
/begin MEASUREMENT mifafu_w "" UWORD rel_uw_b100 1 100 0.00 99.99847 FORMAT "%8.5" ECU_ADDRESS 0xD0000B3A /end MEASUREMENT
/begin MEASUREMENT migs_w "" UWORD rel_uw_b100 1 100 0.00 99.99847 FORMAT "%8.5" ECU_ADDRESS 0xD0000B3C /end MEASUREMENT
/begin MEASUREMENT mimsr_w "" UWORD rel_uw_b100 1 100 0.00 99.99847 FORMAT "%8.5" ECU_ADDRESS 0xD0000B58 /end MEASUREMENT
/begin MEASUREMENT mistt "" UBYTE rel_ub_b99p6 1 100 0.00 99.61 FORMAT "%5.2" ECU_ADDRESS 0xD0000ED0 /end MEASUREMENT
/begin MEASUREMENT mksbg "" UBYTE m_ub_b25p6 1 100 0.00 25.50 FORMAT "%5.2" ECU_ADDRESS 0xD0000EBD /end MEASUREMENT
/begin MEASUREMENT msndks_w "" UWORD m_q0p1 1 100 0.00 6553.500 FORMAT "%8.3" ECU_ADDRESS 0xD0000B3E /end MEASUREMENT
/begin MEASUREMENT msntesol_w "" UWORD m_uw_b25p6 1 100 0.00 25.59961 FORMAT "%8.5" ECU_ADDRESS 0xD0000A5A /end MEASUREMENT
/begin MEASUREMENT msntes_w "" UWORD m_uw_b25p6 1 100 0.00 25.59961 FORMAT "%8.5" ECU_ADDRESS 0xD0000A66 /end MEASUREMENT
/begin MEASUREMENT msntetev_w "" UWORD m_uw_b25p6 1 100 0.00 25.59961 FORMAT "%8.5" ECU_ADDRESS 0xD0000A44 /end MEASUREMENT
/begin MEASUREMENT msntevo_w "" UWORD m_uw_b25p6 1 100 0.00 25.59961 FORMAT "%8.5" ECU_ADDRESS 0xD0000A46 /end MEASUREMENT
/begin MEASUREMENT mssgin_w "" UWORD m_uw_b6553p5 1 100 0.00 6553.500 FORMAT "%8.3" ECU_ADDRESS 0xD0000A7A /end MEASUREMENT
/begin MEASUREMENT mssgout_w "" UWORD m_uw_b6553p5 1 100 0.00 6553.500 FORMAT "%8.3" ECU_ADDRESS 0xD0000A7C /end MEASUREMENT
/begin MEASUREMENT mste "" UBYTE m_ub_b25p6 1 100 0.00 25.50 FORMAT "%5.2" ECU_ADDRESS 0xD0000EB5 /end MEASUREMENT
/begin MEASUREMENT mstedte "" UBYTE m_ub_b25p6 1 100 0.00 25.50 FORMAT "%5.2" ECU_ADDRESS 0xD0000EB6 /end MEASUREMENT
/begin MEASUREMENT mstedte_w "" UWORD m_uw_b25p6 1 100 0.00 25.59961 FORMAT "%8.5" ECU_ADDRESS 0xD0000A52 /end MEASUREMENT
/begin MEASUREMENT msteo_w "" UWORD m_uw_b25p6 1 100 0.0003906250 25.59961 FORMAT "%8.5" ECU_ADDRESS 0xD0000A54 /end MEASUREMENT
/begin MEASUREMENT mstesmxi_w "" UWORD m_uw_b25p6 1 100 0.00 25.59961 FORMAT "%8.5" ECU_ADDRESS 0xD0000A62 /end MEASUREMENT
/begin MEASUREMENT mstesmx_w "" UWORD m_uw_b25p6 1 100 0.00 25.59961 FORMAT "%8.5" ECU_ADDRESS 0xD0000A64 /end MEASUREMENT
/begin MEASUREMENT mstesoll_w "" UWORD m_uw_b25p6 1 100 0.00 25.59961 FORMAT "%8.5" ECU_ADDRESS 0xD0000A68 /end MEASUREMENT
/begin MEASUREMENT mste_w "" UWORD m_uw_b25p6 1 100 0.00 25.59961 FORMAT "%8.5" ECU_ADDRESS 0xD0000A56 /end MEASUREMENT
/begin MEASUREMENT NEngInd_nOpt "" SWORD EngN 1 100 -16384.00 16383.50 FORMAT "%8.2" ECU_ADDRESS 0xD000356A /end MEASUREMENT
/begin MEASUREMENT nltrstdone "" UBYTE B_TRUE 1 100 0.00 1.00000000000 BIT_MASK 0x1 FORMAT "%13.11" ECU_ADDRESS 0xD000004A /end MEASUREMENT
/begin MEASUREMENT nmaxext_w "" UWORD nmot_uw_q0p25 1 100 0.00 16383.75 FORMAT "%8.2" ECU_ADDRESS 0xD0000B40 /end MEASUREMENT
/begin MEASUREMENT nsa_w "" SWORD nmot_q0p5 1 100 -16384.00 16383.50 FORMAT "%8.2" ECU_ADDRESS 0xD0000B58 /end MEASUREMENT
/begin MEASUREMENT OilT_stTSensDsplNoAvl "" UBYTE OneToOne 1 100 0.00 255.0 FORMAT "%5.1" ECU_ADDRESS 0xD0003C9D /end MEASUREMENT
/begin MEASUREMENT Oil_bPresEna "" UBYTE OneToOne 1 100 0.00 255.0 BIT_MASK 0x1 FORMAT "%5.1" ECU_ADDRESS 0xD0003C9E /end MEASUREMENT
/begin MEASUREMENT Oil_bPresWarn "" UBYTE OneToOne 1 100 0.00 255.0 BIT_MASK 0x1 FORMAT "%5.1" ECU_ADDRESS 0xD0003C9F /end MEASUREMENT
/begin MEASUREMENT Oil_bShtrpPSwtVlvCtl "" UBYTE OneToOne 1 100 0.00 255.0 BIT_MASK 0x1 FORMAT "%5.1" ECU_ADDRESS 0xD0003CA0 /end MEASUREMENT
/begin MEASUREMENT Oil_stAvusWarn "" UBYTE OneToOne 1 100 0.00 1.000 BIT_MASK 0x4 FORMAT "%5.3" ECU_ADDRESS 0xD0000081 /end MEASUREMENT
/begin MEASUREMENT Oil_stTempTime "" UBYTE OneToOne 1 100 0.00 255.0 FORMAT "%5.1" ECU_ADDRESS 0xD0003CA1 /end MEASUREMENT
/begin MEASUREMENT Oil_tPULS "" SWORD Temp_Cels 1 100 -3549.940 3003.560 FORMAT "%8.3" ECU_ADDRESS 0xD000356C /end MEASUREMENT
/begin MEASUREMENT ones_w "" UWORD dez 1 100 0.00 65535.00 FORMAT "%8.2" ECU_ADDRESS 0xD0000B42 /end MEASUREMENT
/begin MEASUREMENT pach "" UBYTE p_q156p86 1 100 0.00 39999. FORMAT "%5.0" ECU_ADDRESS 0xD0000F17 /end MEASUREMENT
/begin MEASUREMENT pach_w "" UWORD p_sw_q0p9155 1 100 0.00 60000.92 FORMAT "%8.2" ECU_ADDRESS 0xD0000B44 /end MEASUREMENT
/begin MEASUREMENT PFltPOp_stEngPOp "" UBYTE OneToOne 1 100 0.00 255.0 FORMAT "%5.1" ECU_ADDRESS 0xD0003CA2 /end MEASUREMENT
/begin MEASUREMENT phtevpu_w "" UWORD fak_uw_b2 1 100 0.00 1.999969 FORMAT "%8.6" ECU_ADDRESS 0xD0000A58 /end MEASUREMENT
/begin MEASUREMENT phtev_w "" UWORD p_q0p0195 1 100 0.00 1279.980 FORMAT "%8.3" ECU_ADDRESS 0xD0000A3E /end MEASUREMENT
/begin MEASUREMENT pndkpu "" UBYTE fak_ub_b2 1 100 0.00 1.992188 FORMAT "%8.6" ECU_ADDRESS 0xD0000EB3 /end MEASUREMENT
/begin MEASUREMENT psl "" UBYTE p_q500 1 100 0.00 127500. FORMAT "%5.0" ECU_ADDRESS 0xD0000F18 /end MEASUREMENT
/begin MEASUREMENT pspvds_w "" UWORD fak_uw_b2 1 100 0.00 1.999969 FORMAT "%8.6" ECU_ADDRESS 0xD0000B46 /end MEASUREMENT
/begin MEASUREMENT psrrldc_w "" UWORD p_uw_q0p078 1 100 0.00 5119.922 FORMAT "%8.3" ECU_ADDRESS 0xAFE8014C /end MEASUREMENT
/begin MEASUREMENT pssol_w "" UWORD p_uw_q0p039 1 100 0.00 2559.961 FORMAT "%8.3" ECU_ADDRESS 0xD0000B48 /end MEASUREMENT
/begin MEASUREMENT PthSet_stOvrRun "" UBYTE B_TRUE 1 100 0.00 1.00000000000 BIT_MASK 0x1 FORMAT "%13.11" ECU_ADDRESS 0xD0000062 /end MEASUREMENT
/begin MEASUREMENT PthSet_stOvrRun_MSG "" UBYTE OneToOne 1 100 0.00 255.0 FORMAT "%5.1" ECU_ADDRESS 0xD0003CA8 /end MEASUREMENT
/begin MEASUREMENT pur_w "" UWORD p_uw_q0p039 1 100 0.00 2559.961 FORMAT "%8.3" ECU_ADDRESS 0xD0000B4A /end MEASUREMENT
/begin MEASUREMENT qdnmot_w "" SWORD fak_q0p015625 1 100 -512.0000 511.9844 FORMAT "%8.4" ECU_ADDRESS 0xD0000A38 /end MEASUREMENT
/begin MEASUREMENT qmsdyn "" UBYTE fak_ub_b16 1 100 0.00 15.94 FORMAT "%5.2" ECU_ADDRESS 0xD0000EB7 /end MEASUREMENT
/begin MEASUREMENT qtetemin "" UBYTE fak_ub_b4 1 100 0.00 3.984 FORMAT "%5.3" ECU_ADDRESS 0xD0000EBE /end MEASUREMENT
/begin MEASUREMENT rclteev_w "" SWORD fak_q0p000488 1 100 -16.00000 15.99951 FORMAT "%8.5" ECU_ADDRESS 0xD0000A6A /end MEASUREMENT
/begin MEASUREMENT rcltevvz_w "" SWORD fak_q0p000488 1 100 -16.00000 15.99951 FORMAT "%8.5" ECU_ADDRESS 0xD0000A6C /end MEASUREMENT
/begin MEASUREMENT rkgb_w "" UWORD rel_uw_b3072 1 100 0.00 3071.953 FORMAT "%8.3" ECU_ADDRESS 0xD0000A6E /end MEASUREMENT
/begin MEASUREMENT rkg_old_w "" UWORD rel_uw_b3072 1 100 0.00 3071.953 FORMAT "%8.3" ECU_ADDRESS 0xD0000A70 /end MEASUREMENT
/begin MEASUREMENT rkte_w "" SWORD rel_sw_q0p0468 1 100 -1536.000 1535.953 FORMAT "%8.3" ECU_ADDRESS 0xD0000A72 /end MEASUREMENT
/begin MEASUREMENT rlsol_w "" UWORD rel_uw_q0p0234 1 100 0.00 1535.977 FORMAT "%8.3" ECU_ADDRESS 0xD0000B4C /end MEASUREMENT
/begin MEASUREMENT rltedte_w "" UWORD rel_q0p0234 1 100 0.00 1535.977 FORMAT "%8.3" ECU_ADDRESS 0xD0000B58 /end MEASUREMENT
/begin MEASUREMENT RngMod_stAdap "" UBYTE OneToOne 1 100 0.00 255.0 FORMAT "%5.1" ECU_ADDRESS 0xD0003CA9 /end MEASUREMENT
/begin MEASUREMENT RngMod_stDrvState "" UBYTE OneToOne 1 100 0.00 255.0 FORMAT "%5.1" ECU_ADDRESS 0xD0003CAA /end MEASUREMENT
/begin MEASUREMENT RngMod_trqClthMin "" SWORD md_q0p1 1 100 -3276.800 0.00 FORMAT "%8.3" ECU_ADDRESS 0xD000357C /end MEASUREMENT
/begin MEASUREMENT RngMod_trqCrSMax "" SWORD md_q0p1 1 100 -3276.800 3276.700 FORMAT "%8.3" ECU_ADDRESS 0xD000357E /end MEASUREMENT
/begin MEASUREMENT RngMod_trqCrSMin "" SWORD md_q0p1 1 100 -3276.800 0.00 FORMAT "%8.3" ECU_ADDRESS 0xD0003580 /end MEASUREMENT
/begin MEASUREMENT RngMod_trqInrBsMin "" SWORD Trq 1 100 -3276.800 3276.700 FORMAT "%8.3" ECU_ADDRESS 0xD0003582 /end MEASUREMENT
/begin MEASUREMENT RngMod_trqInrBsMin_MSG "" SWORD Trq 1 100 -3276.800 3276.700 FORMAT "%8.3" ECU_ADDRESS 0xD0003584 /end MEASUREMENT
/begin MEASUREMENT RngMod_trqLos "" SWORD md_sw_q0p1 1 100 -3276.800 3276.700 FORMAT "%8.3" ECU_ADDRESS 0xD0003586 /end MEASUREMENT
/begin MEASUREMENT sfpArray "" UWORD DEZ 1 100 0.00 65535.00 FORMAT "%8.2" ARRAY_SIZE 4 ECU_ADDRESS 0xD0001872 /end MEASUREMENT
/begin MEASUREMENT Shtrp_bBasAdpt "" UBYTE OneToOne 1 100 0.00 255.0 BIT_MASK 0x1 FORMAT "%5.1" ECU_ADDRESS 0xD0003CD6 /end MEASUREMENT
/begin MEASUREMENT Shtrp_stAct "" UBYTE OneToOne 1 100 0.00 255.0 FORMAT "%5.1" ECU_ADDRESS 0xD0003CAD /end MEASUREMENT
/begin MEASUREMENT Signals_Default "" SLONG OneToOne 1 100 -2147483648.00 2147483647.00 FORMAT "%13.2" ECU_ADDRESS 0xD0003078 /end MEASUREMENT
/begin MEASUREMENT Signals_FillSigMess_u8 "" SLONG OneToOne 1 100 -2147483648.00 2147483647.00 FORMAT "%13.2" ECU_ADDRESS 0xD0004682 /end MEASUREMENT
/begin MEASUREMENT SLmpCtl_bEquivAvl "" UBYTE OneToOne 1 100 0.00 1.000 BIT_MASK 0x40 FORMAT "%5.3" ECU_ADDRESS 0xD000006D /end MEASUREMENT
/begin MEASUREMENT SLmpCtl_bOilLvlCntAvl "" UBYTE OneToOne 1 100 0.00 1.000 BIT_MASK 0x80 FORMAT "%5.3" ECU_ADDRESS 0xD0000076 /end MEASUREMENT
/begin MEASUREMENT SLmpCtl_dConsEquiv "" UWORD Fac_WearSotIdx 1 100 0.00 0.001310700 FORMAT "%11.9" ECU_ADDRESS 0xD0003616 /end MEASUREMENT
/begin MEASUREMENT SLmpCtl_dOilLvlCnt "" UBYTE OneToOne 1 100 0.00 255.0 FORMAT "%5.1" ECU_ADDRESS 0xD0003CAB /end MEASUREMENT
/begin MEASUREMENT SLmpCtl_dSotEquiv "" UWORD Fac_WearSotIdx 1 100 0.00 0.001310700 FORMAT "%11.9" ECU_ADDRESS 0xD0003618 /end MEASUREMENT
/begin MEASUREMENT SLmpCtl_dSotIdx "" SWORD OneToOne 1 100 -32768.00 32767.00 FORMAT "%8.2" ECU_ADDRESS 0xD0003588 /end MEASUREMENT
/begin MEASUREMENT SLmpCtl_dWearEquiv "" UWORD Fac_WearSotIdx 1 100 0.00 0.001310700 FORMAT "%11.9" ECU_ADDRESS 0xD000361A /end MEASUREMENT
/begin MEASUREMENT SLmpCtl_dWearIdx "" SWORD OneToOne 1 100 -32768.00 32767.00 FORMAT "%8.2" ECU_ADDRESS 0xD000358A /end MEASUREMENT
/begin MEASUREMENT SLmpCtl_rOilLvl "" SWORD Prc 1 100 -400.0000 399.9878 FORMAT "%8.4" ECU_ADDRESS 0xD000358C /end MEASUREMENT
/begin MEASUREMENT SLmpCtl_stOil "" UWORD OneToOne 1 100 0.00 65535.00 FORMAT "%8.2" ECU_ADDRESS 0xD000361C /end MEASUREMENT
/begin MEASUREMENT SLmpCtl_swtEna "" UBYTE OneToOne 1 100 0.00 1.000 BIT_MASK 0x2 FORMAT "%5.3" ECU_ADDRESS 0xD000006E /end MEASUREMENT
/begin MEASUREMENT SLmpCtl_swtTyp "" UBYTE OneToOne 1 100 0.00 255.0 FORMAT "%5.1" ECU_ADDRESS 0xD0003CAC /end MEASUREMENT
/begin MEASUREMENT SLmpCtl_volOil "" SWORD volFilgLvl_ml 1 100 -32768.00 32767.00 FORMAT "%8.2" ECU_ADDRESS 0xD000358E /end MEASUREMENT
/begin MEASUREMENT SLmpCtl_volOilShrtTAvrg "" SWORD volFilgLvl_ml 1 100 -32768.00 32767.00 FORMAT "%8.2" ECU_ADDRESS 0xD0003590 /end MEASUREMENT
/begin MEASUREMENT SpdGov_nSetPLo "" SWORD nmot_sw_q0p5 1 100 -16384.00 16383.50 FORMAT "%8.2" ARRAY_SIZE 2 ECU_ADDRESS 0xD0003592 /end MEASUREMENT
/begin MEASUREMENT SpdGov_rIncrRmn "" SWORD rel_q0p012207 1 100 -400.0000 399.9878 FORMAT "%8.4" ECU_ADDRESS 0xD0003596 /end MEASUREMENT
/begin MEASUREMENT SpdGov_st "" UWORD dez 1 100 0.00 65535.00 FORMAT "%8.2" ECU_ADDRESS 0xD000361E /end MEASUREMENT
/begin MEASUREMENT sststadap "" UBYTE dez 1 100 0.00 255.0 FORMAT "%5.1" ECU_ADDRESS 0xD0000EA6 /end MEASUREMENT
/begin MEASUREMENT STADAP_save_FF.status "" UBYTE B_TRUE 1 100 0.00 1.00000000000 BIT_MASK 0x1 FORMAT "%13.11" ECU_ADDRESS 0xD00016F8 /end MEASUREMENT
/begin MEASUREMENT StrtCtl_stMode "" UBYTE OneToOne 1 100 0.00 255.0 BIT_MASK 0x1 FORMAT "%5.1" ECU_ADDRESS 0xD0003CB1 /end MEASUREMENT
/begin MEASUREMENT StrtCtl_stT75 "" UBYTE OneToOne 1 100 0.00 255.0 BIT_MASK 0x1 FORMAT "%5.1" ECU_ADDRESS 0xD0003CB2 /end MEASUREMENT
/begin MEASUREMENT Strt_stStaActv "" UBYTE OneToOne 1 100 0.00 255.0 FORMAT "%5.1" ECU_ADDRESS 0xD0003CD7 /end MEASUREMENT
/begin MEASUREMENT StSys_stSpareStrt "" UBYTE OneToOne 1 100 0.00 255.0 BIT_MASK 0x1 FORMAT "%5.1" ECU_ADDRESS 0xD0003CAF /end MEASUREMENT
/begin MEASUREMENT SyC_ctDeadline1msErr "" UBYTE OneToOne 1 100 0.00 255.0 FORMAT "%5.1" ECU_ADDRESS 0xD0003D09 /end MEASUREMENT
/begin MEASUREMENT SyC_ctInit "" UBYTE OneToOne 1 100 0.00 255.0 FORMAT "%5.1" ECU_ADDRESS 0xAFE8074C /end MEASUREMENT
/begin MEASUREMENT SyC_ctTiPostDrvMax "" UBYTE OneToOne 1 100 0.00 255.0 FORMAT "%5.1" ECU_ADDRESS 0xAFE801CE /end MEASUREMENT
/begin MEASUREMENT SyC_ctTiPreDrvMax "" UBYTE OneToOne 1 100 0.00 255.0 FORMAT "%5.1" ECU_ADDRESS 0xAFE80150 /end MEASUREMENT
/begin MEASUREMENT SyC_ctUnderVltg "" UBYTE OneToOne 1 100 0.00 255.0 FORMAT "%5.1" ECU_ADDRESS 0xAFE8074D /end MEASUREMENT
/begin MEASUREMENT SyC_stHistTiPostDrvMax "" UBYTE OneToOne 1 100 0.00 255.0 FORMAT "%5.1" ECU_ADDRESS 0xAFE801CF /end MEASUREMENT
/begin MEASUREMENT SyC_stHistTiPreDrvMax "" UBYTE OneToOne 1 100 0.00 255.0 FORMAT "%5.1" ECU_ADDRESS 0xAFE80151 /end MEASUREMENT
/begin MEASUREMENT SyC_stMn "" UBYTE ExeCon_State_01 1 100 0.00 3.00000000000 FORMAT "%13.11" ECU_ADDRESS 0xD0003CB3 /end MEASUREMENT
/begin MEASUREMENT SyC_stMnOld "" UBYTE ExeCon_State_01 1 100 0.00 3.00000000000 FORMAT "%13.11" ECU_ADDRESS 0xD0003CB4 /end MEASUREMENT
/begin MEASUREMENT SyC_stPostDrv "" UBYTE SyC_PostDrv_State 1 100 0.00 8.00000000000 FORMAT "%13.11" ECU_ADDRESS 0xD0003CB5 /end MEASUREMENT
/begin MEASUREMENT SyC_stPostDrvFin "" UBYTE OneToOne 1 100 0.00 255.0 FORMAT "%5.1" ECU_ADDRESS 0xAFE80733 /end MEASUREMENT
/begin MEASUREMENT SyC_stPreDrv "" UBYTE SyC_PreDrv_State 1 100 0.00 9.00000000000 FORMAT "%13.11" ECU_ADDRESS 0xD0003CB6 /end MEASUREMENT
/begin MEASUREMENT SyC_stPreDrvFin "" UBYTE OneToOne 1 100 0.00 255.0 FORMAT "%5.1" ECU_ADDRESS 0xAFE806FE /end MEASUREMENT
/begin MEASUREMENT SyC_stSub "" UBYTE ExeCon_State_02 1 100 0.00 6.00000000000 FORMAT "%13.11" ECU_ADDRESS 0xD0003CB7 /end MEASUREMENT
/begin MEASUREMENT SyC_stSubOld "" UBYTE ExeCon_State_02 1 100 0.00 6.00000000000 FORMAT "%13.11" ECU_ADDRESS 0xD0003CB8 /end MEASUREMENT
/begin MEASUREMENT SyC_stSwtOn_mp "" UBYTE OneToOne 1 100 0.00 255.0 FORMAT "%5.1" ECU_ADDRESS 0xD00053EC /end MEASUREMENT
/begin MEASUREMENT SyC_stT15 "" UBYTE OneToOne 1 100 0.00 255.0 BIT_MASK 0x1 FORMAT "%5.1" ECU_ADDRESS 0xD0003CD8 /end MEASUREMENT
/begin MEASUREMENT SyC_tiBoot_mp "" ULONG Time_usec_q1_COMPU 1 100 0.00 4294967295.00 FORMAT "%13.2" ECU_ADDRESS 0xD0005274 /end MEASUREMENT
/begin MEASUREMENT SyC_tiDrv "" ULONG Time_msec_q10_COMPU 1 100 0.00 42949672950.0 FORMAT "%13.1" ECU_ADDRESS 0xD000233C /end MEASUREMENT
/begin MEASUREMENT SyC_tiFrst10ms "" UWORD Time_msec_q1_COMPU 1 100 0.00 65535.00 FORMAT "%8.2" ECU_ADDRESS 0xD0003620 /end MEASUREMENT
/begin MEASUREMENT SyC_tiIniEnd_mp "" UWORD Time_usec_q1_COMPU 1 100 0.00 65535.00 FORMAT "%8.2" ECU_ADDRESS 0xD00053A8 /end MEASUREMENT
/begin MEASUREMENT SyC_tiIniSyn_mp "" UWORD Time_usec_q1_COMPU 1 100 0.00 65535.00 FORMAT "%8.2" ECU_ADDRESS 0xD00053AA /end MEASUREMENT
/begin MEASUREMENT SyC_tiIni_mp "" ULONG Time_usec_q1_COMPU 1 100 0.00 4294967295.00 FORMAT "%13.2" ECU_ADDRESS 0xD0005278 /end MEASUREMENT
/begin MEASUREMENT SyC_tiPostDrv "" ULONG Time_msec_q10_COMPU 1 100 0.00 42949672950.0 FORMAT "%13.1" ECU_ADDRESS 0xD0002340 /end MEASUREMENT
/begin MEASUREMENT SyC_tiPreDrv "" ULONG Time_msec_q10_COMPU 1 100 0.00 42949672950.0 FORMAT "%13.1" ECU_ADDRESS 0xD0002344 /end MEASUREMENT
/begin MEASUREMENT SyC_tiUnderVltg_mp "" UBYTE OneToOne_ms 1 100 0.00 255.0 FORMAT "%5.1" ECU_ADDRESS 0xD00053ED /end MEASUREMENT
/begin MEASUREMENT S_ac "" UBYTE B_TRUE 1 100 0.00 1.00000000000 BIT_MASK 0x4 FORMAT "%13.11" ECU_ADDRESS 0xD000006A /end MEASUREMENT
/begin MEASUREMENT S_fs1 "" UBYTE B_TRUE 1 100 0.00 1.00000000000 BIT_MASK 0x1 FORMAT "%13.11" ECU_ADDRESS 0xD000007D /end MEASUREMENT
/begin MEASUREMENT S_fs2 "" UBYTE B_TRUE 1 100 0.00 1.00000000000 BIT_MASK 0x1 FORMAT "%13.11" ECU_ADDRESS 0xD0000096 /end MEASUREMENT
/begin MEASUREMENT S_ko "" UBYTE B_TRUE 1 100 0.00 1.00000000000 BIT_MASK 0x8 FORMAT "%13.11" ECU_ADDRESS 0xD0000068 /end MEASUREMENT
/begin MEASUREMENT T15_flgOn "" UBYTE OneToOne 1 100 0.00 1.000 BIT_MASK 0x1 FORMAT "%5.3" ECU_ADDRESS 0xD0000067 /end MEASUREMENT
/begin MEASUREMENT T15_st "" UBYTE OneToOne 1 100 0.00 1.000 BIT_MASK 0x1 FORMAT "%5.3" ECU_ADDRESS 0xD0003CD9 /end MEASUREMENT
/begin MEASUREMENT T15_stRaw "" UBYTE OneToOne 1 100 0.00 255.0 FORMAT "%5.1" ECU_ADDRESS 0xD0003CB9 /end MEASUREMENT
/begin MEASUREMENT T50_st "" UBYTE OneToOne 1 100 0.00 255.0 FORMAT "%5.1" ECU_ADDRESS 0xD0003CBA /end MEASUREMENT
/begin MEASUREMENT tandk_w "" UWORD temp_q0p0234_o273 1 100 -273.1500 1262.827 FORMAT "%8.3" ECU_ADDRESS 0xD0000B4E /end MEASUREMENT
/begin MEASUREMENT tanskst_w "" UWORD temp_q0p0234_o273 1 100 -273.1500 1262.827 FORMAT "%8.3" ECU_ADDRESS 0xD0000B50 /end MEASUREMENT
/begin MEASUREMENT tansloc "" UBYTE temp_ub_q0p75_o48 1 100 -48.00 143.3 FORMAT "%5.1" ECU_ADDRESS 0xD0000EB1 /end MEASUREMENT
/begin MEASUREMENT tansst "" UBYTE temp_ub_q0p75_o48 1 100 -48.00 143.3 FORMAT "%5.1" ECU_ADDRESS 0xD0000F1A /end MEASUREMENT
/begin MEASUREMENT tateout_w "" UWORD rel_uw_b100 1 100 0.00 99.99847 FORMAT "%8.5" ECU_ADDRESS 0xD0000A48 /end MEASUREMENT
/begin MEASUREMENT tatesoll "" UBYTE rel_ub_b99p6 1 100 0.00 99.61 FORMAT "%5.2" ECU_ADDRESS 0xD0000EB2 /end MEASUREMENT
/begin MEASUREMENT tatesoll_w "" UWORD rel_uw_b100 1 100 0.00 99.99847 FORMAT "%8.5" ECU_ADDRESS 0xD0000A4A /end MEASUREMENT
/begin MEASUREMENT teini "" UBYTE temp_ub_q0p75_o48 1 100 -48.00 143.3 FORMAT "%5.1" ECU_ADDRESS 0xD0000EC4 /end MEASUREMENT
/begin MEASUREMENT tengdmd "" UBYTE temp_ub_q0p75_o48 1 100 -48.00 143.3 FORMAT "%5.1" ECU_ADDRESS 0xD0000EA0 /end MEASUREMENT
/begin MEASUREMENT tengstdmd "" UBYTE temp_ub_q0p75_o48 1 100 -48.00 143.3 FORMAT "%5.1" ECU_ADDRESS 0xD0000EA1 /end MEASUREMENT
/begin MEASUREMENT tevper "" UBYTE t500usxms_ub_q0p5 1 100 0.5000 127.5 FORMAT "%5.1" ECU_ADDRESS 0xD0000EB4 /end MEASUREMENT
/begin MEASUREMENT tfst_w "" UWORD vol_q0p1_l 1 100 0.00 6553.500 FORMAT "%8.3" ECU_ADDRESS 0xD0000B52 /end MEASUREMENT
/begin MEASUREMENT tfteini_w "" UWORD t_q0p1 1 100 0.00 6553.500 FORMAT "%8.3" ECU_ADDRESS 0xD0000A88 /end MEASUREMENT
/begin MEASUREMENT ThrVlv_rAct "" SWORD Prc 1 100 0.00 100.0000 FORMAT "%8.4" ECU_ADDRESS 0xD00035BA /end MEASUREMENT
/begin MEASUREMENT ThrVlv_stMon "" UWORD OneToOne 1 100 0.00 65535.00 FORMAT "%8.2" ECU_ADDRESS 0xD0003638 /end MEASUREMENT
/begin MEASUREMENT tkatm "" UBYTE temp_ub_q5_o50 1 100 -50.00 1225. FORMAT "%5.0" ECU_ADDRESS 0xD0000F1B /end MEASUREMENT
/begin MEASUREMENT tmotrk_w "" SWORD Temp_Cels 1 100 -3549.940 3003.560 FORMAT "%8.3" ECU_ADDRESS 0xD0000B54 /end MEASUREMENT
/begin MEASUREMENT tmstrk_w "" SWORD Temp_Cels 1 100 -3549.940 3003.560 FORMAT "%8.3" ECU_ADDRESS 0xD0000B56 /end MEASUREMENT
/begin MEASUREMENT tmstsst "" UBYTE temp_ub_q0p75_o48 1 100 -48.00 143.3 FORMAT "%5.1" ECU_ADDRESS 0xD0000EA8 /end MEASUREMENT
/begin MEASUREMENT tnachl_w "" UWORD t100msxs_uw_b6553p6 1 100 0.00 6553.500 FORMAT "%8.3" ECU_ADDRESS 0xAFE80146 /end MEASUREMENT
/begin MEASUREMENT tnst "" UBYTE t1sxs_ub_b255 1 100 0.00 255.0 FORMAT "%5.1" ECU_ADDRESS 0xD0000F1C /end MEASUREMENT
/begin MEASUREMENT tpnt_aktiv "" UBYTE dez 1 100 0.00 7.000 FORMAT "%5.3" ECU_ADDRESS 0xD0000F1D /end MEASUREMENT
/begin MEASUREMENT TrbCh_r "" SLONG Fact 1 100 -4.00000000000 3.99987792969 FORMAT "%13.11" ECU_ADDRESS 0xD000230C /end MEASUREMENT
/begin MEASUREMENT trfdysf_w "" UWORD t_q0p01 1 100 0.00 655.3500 FORMAT "%8.4" ECU_ADDRESS 0xD0000B58 /end MEASUREMENT
/begin MEASUREMENT trfdysh_w "" UWORD t_q0p01 1 100 0.00 655.3500 FORMAT "%8.4" ECU_ADDRESS 0xD0000B58 /end MEASUREMENT
/begin MEASUREMENT TSDa_tClntIniVal "" SWORD Temp_Cels 1 100 -3549.940 3003.560 FORMAT "%8.3" ECU_ADDRESS 0xD0003598 /end MEASUREMENT
/begin MEASUREMENT TSDa_tClntRadOut "" SWORD Temp_Cels 1 100 -3549.940 3003.560 FORMAT "%8.3" ECU_ADDRESS 0xD000359A /end MEASUREMENT
/begin MEASUREMENT tststadap "" UBYTE temp_ub_q0p75_o48 1 100 -48.00 143.3 FORMAT "%5.1" ECU_ADDRESS 0xD0000EA9 /end MEASUREMENT
/begin MEASUREMENT TS_tClntEngOut "" SWORD Temp_Cels 1 100 -3549.940 3003.560 FORMAT "%8.3" ECU_ADDRESS 0xD00035A2 /end MEASUREMENT
/begin MEASUREMENT tvkmax_w "" UWORD temp_q0p0234_o273 1 100 -273.1500 1262.827 FORMAT "%8.3" ECU_ADDRESS 0xD0000B58 /end MEASUREMENT
/begin MEASUREMENT tvlues1 "" UBYTE tv_ub_b100 1 100 0.00 99.61 FORMAT "%5.2" ECU_ADDRESS 0xD0000ECB /end MEASUREMENT
/begin MEASUREMENT tvtevptu_w "" UWORD t_q0p01_ms 1 100 0.00 655.3500 FORMAT "%8.4" ECU_ADDRESS 0xD0000A42 /end MEASUREMENT
/begin MEASUREMENT TWCC_bTstReqPri "" UBYTE B_TRUE 1 100 0.00 1.00000000000 BIT_MASK 0x80 FORMAT "%13.11" ECU_ADDRESS 0xD0000095 /end MEASUREMENT
/begin MEASUREMENT TWCD_bFinOSCMeasScndB1 "" UBYTE B_TRUE 1 100 0.00 1.00000000000 BIT_MASK 0x80 FORMAT "%13.11" ECU_ADDRESS 0xD0000090 /end MEASUREMENT
/begin MEASUREMENT upotpwm "" UBYTE spg_ub_b5 1 100 0.00 4.980 FORMAT "%5.3" ECU_ADDRESS 0xD0000ECC /end MEASUREMENT
/begin MEASUREMENT VehMot_drAccPedUnFlt "" SWORD PrcPerSec 1 100 -20000.00 19999.39 FORMAT "%8.2" ECU_ADDRESS 0xD00035C0 /end MEASUREMENT
/begin MEASUREMENT VehMot_drAccPedUnFltCor "" SWORD PrcPerSec_10ms 1 100 -40000.00 39998.78 FORMAT "%8.2" ECU_ADDRESS 0xD00035C2 /end MEASUREMENT
/begin MEASUREMENT VehMot_stPrpCrCtl "" UBYTE OneToOne 1 100 0.00 255.0 FORMAT "%5.1" ECU_ADDRESS 0xD0003CCB /end MEASUREMENT
/begin MEASUREMENT VehMot_stPrpLLim "" UBYTE OneToOne 1 100 0.00 255.0 FORMAT "%5.1" ECU_ADDRESS 0xD0003CCC /end MEASUREMENT
/begin MEASUREMENT VMD_rVirtAPP "" SWORD Prc 1 100 -400.0000 399.9878 FORMAT "%8.4" ECU_ADDRESS 0xD00035BE /end MEASUREMENT
/begin MEASUREMENT VMSI_stDCS "" UWORD OneToOne 1 100 0.00 65535.00 FORMAT "%8.2" ECU_ADDRESS 0xD000363A /end MEASUREMENT
/begin MEASUREMENT VMSI_stTCS "" UWORD OneToOne 1 100 0.00 65535.00 FORMAT "%8.2" ECU_ADDRESS 0xD000363C /end MEASUREMENT
/begin MEASUREMENT VMSI_swtSlipCtl "" UBYTE OneToOne 1 100 0.00 255.0 FORMAT "%5.1" ECU_ADDRESS 0xD0003CC8 /end MEASUREMENT
/begin MEASUREMENT WaHtEl_stOK "" UBYTE OneToOne 1 100 0.00 255.0 FORMAT "%5.1" ECU_ADDRESS 0xD0003CCE /end MEASUREMENT
/begin MEASUREMENT wnwsa_w "" SWORD kw_sw_q0p0078 1 100 -256.0000 255.9922 FORMAT "%8.4" ECU_ADDRESS 0xD0000B58 /end MEASUREMENT
/begin MEASUREMENT wtacvol_w "" UWORD Volt 1 100 0.00 13107.00 FORMAT "%8.2" ECU_ADDRESS 0xD0003642 /end MEASUREMENT
/begin MEASUREMENT wtverd_w "" UWORD Volt 1 100 0.00 13107.00 FORMAT "%8.2" ECU_ADDRESS 0xD0003644 /end MEASUREMENT
/begin MEASUREMENT zeros_w "" UWORD dez 1 100 0.00 65535.00 FORMAT "%8.2" ECU_ADDRESS 0xD0000B58 /end MEASUREMENT
/begin MEASUREMENT zvbausw "" UBYTE dez 1 100 0.00 255.0 FORMAT "%5.1" ECU_ADDRESS 0xD0000EAA /end MEASUREMENT
/begin MEASUREMENT zvbmg "" UBYTE dez 1 100 0.00 255.0 FORMAT "%5.1" ECU_ADDRESS 0xD0000EAB /end MEASUREMENT
/begin MEASUREMENT zwspaebts "" SBYTE kw_q0p75 1 100 -96.00 95.25 FORMAT "%5.2" ECU_ADDRESS 0xD0000F1E /end MEASUREMENT
/begin MEASUREMENT zzylzue "" UBYTE dez 1 100 0.00 11.00 FORMAT "%5.2" ECU_ADDRESS 0xD0000EAD /end MEASUREMENT
/begin FUNCTION Signals_Std "1.16.0"
 /begin DEF_CHARACTERISTIC Signals_Mode1Pid_CA Signals_Mode1SigNum_CA Signals_stSrv01SuppPid_CA /end DEF_CHARACTERISTIC
 /begin LOC_MEASUREMENT Signals_Default Signals_FillSigMess_u8 /end LOC_MEASUREMENT
 FUNCTION_VERSION "1.16.0" /end FUNCTION
/begin FUNCTION SpdGov2ME "2.0.0" /begin DEF_CHARACTERISTIC DNLLRESW /end DEF_CHARACTERISTIC
 /begin IN_MEASUREMENT B_ll B_llr B_nmax B_nozwe dn_w etazwbm etazwvg miopt_w nstat /end IN_MEASUREMENT
 /begin OUT_MEASUREMENT B_llde dmrllr_w HLSDem_nSetPLo SpdGov_nSetPLo SpdGov_st /end OUT_MEASUREMENT
 FUNCTION_VERSION "2.0.0" /end FUNCTION
/begin FUNCTION Spi "1.9.0" FUNCTION_VERSION "1.9.0" /end FUNCTION
/begin FUNCTION SrvA_Ascet "1.8.0" FUNCTION_VERSION "1.8.0" /end FUNCTION
/begin FUNCTION SrvB "1.14.3" FUNCTION_VERSION "1.14.3" /end FUNCTION
/begin FUNCTION SrvF "1.13.0" FUNCTION_VERSION "1.13.0" /end FUNCTION
/begin FUNCTION SrvX "1.13.2" FUNCTION_VERSION "1.13.2" /end FUNCTION
/begin FUNCTION SSTBER ""
 /begin DEF_CHARACTERISTIC FHO04ESUB SGA08MDUB SIM06ESUW SKS06ESUB SMI04LLUB SMI04TEUW SML05LKUB SML08LHUB SNG06LLSB SNM04TEUB SNM06LLUW SNM07ESUB SNM08LHUB SNM16OPUW SNM16ZUUW SNM24ZUUB SRL11OPUW SRL12ZUUW SRL16ZUUB SRP06ESUB STA04LLUB STA04TEUB STA06ESUB STM04SAUB STM06LLUB STM08__UB STM09ESUB STM10TMUB STM12ESUB STMS06LLUB STS08ESUB STS12ESUB /end DEF_CHARACTERISTIC
 /begin IN_MEASUREMENT fho gangi imlatm_w kstaa mifa_w misol_w ml ngfil nmot nmot_w rl rlp rl_w tans tmot tmst /end IN_MEASUREMENT
 /begin OUT_MEASUREMENT esst_fho04esub esst_sga08mdub esst_sim06esuw esst_sks06esub esst_smi04llub esst_smi04teuw esst_sml05lkub esst_sml08lhub esst_snm04teub esst_snm06lluw esst_snm07esub esst_snm08lhub esst_snm16zuuw esst_snm24zuub esst_srl11opuw esst_srl12zuuw esst_srl16zuub esst_srp06esub esst_sta04llub esst_sta04teub esst_sta06esub esst_stm04saub esst_stm08__ub esst_stm09esub esst_stm10tmub esst_stm12esub esst_stms06llub esst_sts08esub esst_sts12esub /end OUT_MEASUREMENT
/end FUNCTION
/begin FUNCTION SSTDMD "1.30.0"
 /begin DEF_CHARACTERISTIC CWMIDMD SMI08DMUB SNM08DMUB SNM09DM1UB SNM09DM2UB TMOTSELDMD /end DEF_CHARACTERISTIC
 /begin IN_MEASUREMENT B_autget B_gsch B_mdzgstp miautget_w miist_w nmot tmot tmst /end IN_MEASUREMENT
 /begin OUT_MEASUREMENT esst_smi08dmub esst_snm08dmub esst_snm09dm1ub esst_snm09dm2ub midmd midmd_w tengdmd tengstdmd /end OUT_MEASUREMENT
 FUNCTION_VERSION "1.30.0" /end FUNCTION
/begin FUNCTION STADAP "1.7.0"
 /begin DEF_CHARACTERISTIC CWSTADAP FSTAIFRES KFADASTEP KFDNBNSKH KFDNBURNS KFNSTAMX KLADAPSRES KLDNFHO KLKSTAAINI KLKSTAMN KLKSTAMX KLSSTTMST KLWSTADAP KSTATMSTI KSTTOPMN LINCAUSW NSTAK QDNBURNOK TMLIM ZBURNABR ZSYAUSWINC ZSYNAUSW ZSYNCHECKN ZSYNDEL /end DEF_CHARACTERISTIC
 /begin IN_MEASUREMENT B_adrsta B_kha B_nmin B_staclr B_staneut B_stanodec B_stanoinc B_stanosav B_vbmg dnmot_w fho nmot_w nstat tmst top_w /end IN_MEASUREMENT
 /begin OUT_MEASUREMENT B_ad B_incmxres B_staa kstaa kstatmst /end OUT_MEASUREMENT
 /begin LOC_MEASUREMENT adapdec_w adapinc_w adastepc_w adasteps adastep_w B_adapend B_ausw B_badburn B_kstaue B_nodec B_noinc B_stadapon B_stano dkstaamn_w dkstaamx_w dkstaa_w dnburns_w dssttmst kstaold kstaoldon qdnmot_w sststadap STADAP_save_FF.status tmstsst tststadap zvbausw zvbmg /end LOC_MEASUREMENT
 FUNCTION_VERSION "1.7.0" /end FUNCTION
/begin FUNCTION Stm58Bw016 "1.10.0" FUNCTION_VERSION "1.10.0" /end FUNCTION
/begin FUNCTION Strt_VDModel "1.1.0" /begin IN_MEASUREMENT T50_st /end IN_MEASUREMENT /begin OUT_MEASUREMENT Strt_stStaActv /end OUT_MEASUREMENT FUNCTION_VERSION "1.1.0" /end FUNCTION
/begin FUNCTION SWAdp ""
 /begin DEF_CHARACTERISTIC B_komd_c B_ubpvg_C Com_pIntMnf_C Com_stPIntMnf_C CoVeh_stAlt_C CoVeh_trqMaxAC_C CoVeh_trqPrpLimErr_C dmrkh_C IMSDTEVA mdwan_w_C SWADP_10ms SWADP_20ms S_ko_C TDTEZAM TVACVOL TVERDELI WNWREO /end DEF_CHARACTERISTIC
 /begin IN_MEASUREMENT ActMod_trqInr AirC_stPsCmpr AirC_trqCmprMax AltIO_st APP_drUnFlt APP_r BasSvr_bFuncTstReq B_dknolu B_edks B_llr B_madko B_madll B_nozwe B_psrgg B_st B_stend B_tmsrt Clth_st dmrac dmrllr_w dns Epm_nEng Fan1_r Fan_r fho_w fklafa_w HLSDem_bNMaxPrio kr_monitor miist_w MILLmp_stPs ngfil nmot_w nstat Oil_tSwmp psrr_w PT_bGrip PT_rTrq pu_w pvd_w rlmin_w rl_w tabst_w taev_w tahso_w tans tansk_w tasrg_w tavdk_w tavso_w tkihkm_w tmot tmst tnst_w tosp Tra_stTII Tra_stTSC vpsrvd_w wdkba_w wkrmav /end IN_MEASUREMENT
 /begin OUT_MEASUREMENT ACCI_aGbxSet ACCI_aSetBrkDem ACCI_aTolNgv ACCI_bACCStp ACCI_bCorCodTSK ACCI_bTSK ACCI_mVehHi ACCI_rSlpRoad ACCI_stActESP ACCI_stCrCtl ACCI_stDrvTrnCoShOff ACCI_stGearInfoMT1 ACCI_stLmp ACCI_stMVeh ACCI_stNLim ACCI_stRSlpRoad AccPed_rAPP ACCtl_tAcVolR ActMod_trqCrSWoTraIntv AC_tEvapT AFCtl_stFltFul Airbg_bFrmRx AirC_bNIdlDem AirC_stCmpr AirC_stCmprAct AirC_stCmprOffCode AirC_stCmprRedTrq AirC_trqDes AirSys_pCACDsNrm Air_pCACDs Air_tCACDs AltIO_trqDes AltIO_uAltDes APP_rUnFltShtrp arqttev_w BasSvrAppl_stFCodPresent BasSvrAppl_swtCodAC BasSvrAppl_swtCodAirb BasSvrAppl_swtCodPark BasSvrAppl_swtFCodAC BasSvrAppl_swtFCodAlt BasSvrAppl_swtFCodESP BasSvrAppl_swtFCodSLmpCtl BasSvrAppl_swtLCodAC BasSvrAppl_swtLCodPrePost BasSvrAppl_swtLCodVehType BrkP_p Brk_bLoPres Brk_stExt BusDiag_bNoMon BusDiag_bTDiagStrt B_acres B_adshs B_aofmsdea B_apdkti2 B_asc_reg B_asr B_ate B_clradbbo B_clradfof B_clreepr B_dfonrst B_dkpu B_dksbeg B_dkvsf B_drlmx B_dteaam B_dteabu B_dteenf B_dtefrr B_dtemsfr B_dtephm B_dternm B_dtes B_dtest B_dtmbh B_edss B_ells B_engrestr B_etavdk B_evabeep B_evdmtbc B_evdmtec B_evdmtmo B_evdmtoc B_fa B_faagr B_faam B_faan B_faatm B_fadss B_fadylsu B_fafonrm B_fagals B_fahsh B_fahsv B_faiumpr B_fakat B_fakath B_fakth B_fakvs B_falr B_falra B_falrhk B_falrsfk B_falrshk B_falsh B_falzsr B_fanwrad B_fanwse B_fapllsu B_fasf B_fash B_fatp B_fatv B_fcotr B_fgr B_fhz B_fklanf B_fkmsmn B_fkmsmx B_fkpvmn B_fkpvmx B_fofkhseg B_fofrun0 B_fproab B_frmeing B_frmfrz B_fs B_fushk B_globd B_gsaf B_hlsumx B_hos B_hrlsunp B_iclsabg B_klobd B_komd B_lf1 B_lf1res B_lf2 B_lf2res B_load1 B_load2 B_load3 B_lrndia B_lrndiaur B_lrnws B_lrs B_lsuabgl B_lsuoffs B_luft B_mdeeub B_mdmin B_minflsu B_msr B_ngsawe B_nlh B_nmaxext B_nsoltcu B_plra B_pusab B_ricalf B_rinabg B_rlperno B_rluoffs B_rqttev B_savfgr B_savmd B_savmsr B_sbblsu B_sch B_sgs B_sgsred B_skh B_sl B_slperno B_spabgl B_spdtevh B_spf3k B_sttakt B_tahrmx B_talval B_tansh B_tevior B_trsah B_ubpvg B_uhsig B_vl B_zhhrlsu CoEOM_stOpModeAct CoESS_stRcpt CoETS_bIntvActvDesNoTra CoETS_trqInrActDrv CoME_stIdlSpdInc CoME_tiOffStrtAC Com_pIntMnf Com_rAltLoadBEM Com_rClthPos Com_stAC Com_stAirBg Com_stAltLoadBEM Com_stBrk Com_stClth Com_stClthErr Com_stClthModlRng Com_stCrCtl Com_stCrshIntsty Com_stPIntMnf Com_stVehSpdSensErr Com_vVeh Conv_trqLd CoPOM_bChZero CoPOM_bEffOk CoPOM_bHybP1 CoPOM_bTrqIntvOk CoVeh_rClgDes CoVeh_stAlt CoVeh_stWaHt CoVeh_tClntDes CoVeh_trqMaxAC CoVeh_trqPrpLimErr CoVMD_stDiffDesTrq CoVMD_swtCCSel CrCtl_numSymbol CrCtl_numTxt CrCtl_st CrCtl_stCrCtlConf CrCtl_stDia CrCtl_stDsplHighLine CrCtl_stNoDspl CrCtl_vDes CrCtl_vDesDspl CrC_stPan CrC_stSixPos CtT_stCtTMonActv CtT_stIntegEnbl CtT_stThmDiagBrk DiffIO_rTrqDfftl DiffIO_stCfg DiffIO_trqPrtDfftl dmrkhmn_w dmrkh_w dmrmx_w dmsnte_w DrvPrgSwt_bSprt DrvPrgSwt_bWntrActv DrvPrgSwt_numCurrCAN DrvPrgSwt_st ECl_bRedTrq EEM_pwrAltDes EngDa_pwrEngHi EngDa_tStrt EngDem_nMax EngDem_stErr EngPrt_stTempPrtShftUp EngPrt_trqLimWoIncLd EnvP_facCor ErrLmp_stSVS evtmod FanCtl_bARActv FanCtl_stHotLmp FanCtl_stOk FanCtl_tiAR Fan_bFan3Ena Fan_rPs Fan_rRelClg Fan_st Fan_stShutOff flambts FlSys_volFlConsDspl frdter_w FuelT_t fwnwe fwnwvs_w gangauti Gbx_numGear Gbx_rTrqTra Gbx_stNPos Gbx_stPNPos GlbDa_stVehicleHalt HEGOD_bS2B1InhbRiEval HEGOD_bS2B1ReqRcn HEGOD_tiDeltaFltPerB1 HEGO_bS2B1HtgSuffRi HEGO_bS2B1Vld HEGO_uS2B1 HEGO_uS2B1Extd HLSDem_bShrtTrpSpdRmp InjCrv_stInjCharActVal InjCtl_qSetUnBal lamelsh_w lamesok_w lbz LIGov_nDiff LLim_stMaxActvLvlECU mdgen_w mdkocan mdwan_w miasrs_w mifafu_w migs_w mimsr_w msndks_w NEngInd_nOpt nmaxext_w nsa_w OilT_stTSensDsplNoAvl Oil_bPresEna Oil_bPresWarn Oil_bShtrpPSwtVlvCtl Oil_stAvusWarn Oil_stTempTime Oil_tPULS ones_w pach pach_w PFltPOp_stEngPOp psl pspvds_w psrrldc_w pssol_w PthSet_stOvrRun PthSet_stOvrRun_MSG pur_w rlsol_w rltedte_w RngMod_trqInrBsMin RngMod_trqInrBsMin_MSG sfpArray Shtrp_bBasAdpt Shtrp_stAct SLmpCtl_bEquivAvl SLmpCtl_bOilLvlCntAvl SLmpCtl_dConsEquiv SLmpCtl_dOilLvlCnt SLmpCtl_dSotEquiv SLmpCtl_dSotIdx SLmpCtl_dWearEquiv SLmpCtl_dWearIdx SLmpCtl_rOilLvl SLmpCtl_stOil SLmpCtl_swtEna SLmpCtl_swtTyp SLmpCtl_volOil SLmpCtl_volOilShrtTAvrg SpdGov_rIncrRmn StrtCtl_stMode StrtCtl_stT75 StSys_stSpareStrt S_ac S_fs1 S_fs2 S_ko T50_st tandk_w tanskst_w tansst tfst_w ThrVlv_rAct ThrVlv_stMon tkatm tmotrk_w tmstrk_w tnst tpnt_aktiv TrbCh_r trfdysf_w trfdysh_w tvkmax_w TWCC_bTstReqPri TWCD_bFinOSCMeasScndB1 VehMot_drAccPedUnFlt VehMot_drAccPedUnFltCor VehMot_stPrpCrCtl VehMot_stPrpLLim VMD_rVirtAPP VMSI_stDCS VMSI_stTCS VMSI_swtSlipCtl WaHtEl_stOK wnwsa_w wtacvol_w wtverd_w zeros_w zwspaebts /end OUT_MEASUREMENT
/end FUNCTION
/begin FUNCTION SyC2ME "1.8.0" /begin IN_MEASUREMENT B_eepwf SyC_stSub /end IN_MEASUREMENT /begin OUT_MEASUREMENT B_nachl B_nachlauf B_norm B_wakeup tnachl_w /end OUT_MEASUREMENT /begin LOC_MEASUREMENT nltrstdone /end LOC_MEASUREMENT FUNCTION_VERSION "1.8.0" /end FUNCTION
/begin FUNCTION SyC_CalWakeup "1.10.0" /begin IN_MEASUREMENT SyC_stMn SyC_stT15 /end IN_MEASUREMENT FUNCTION_VERSION "1.10.0" /end FUNCTION
/begin FUNCTION SyC_Deadline "1.10.0" /begin LOC_MEASUREMENT SyC_ctDeadline1msErr /end LOC_MEASUREMENT FUNCTION_VERSION "1.10.0" /end FUNCTION
/begin FUNCTION SyC_Main "1.14.0" /begin DEF_CHARACTERISTIC SyC_stTest_C SyC_swtTestEna_C /end DEF_CHARACTERISTIC
 /begin IN_MEASUREMENT MoCCom_stWDAActvMsg Mo_stIrvErrReacMsg SyC_stPostDrv SyC_stPreDrv T15_st /end IN_MEASUREMENT
 /begin OUT_MEASUREMENT SyC_stMn SyC_stMnOld SyC_stSub SyC_stSubOld SyC_stT15 SyC_tiDrv SyC_tiFrst10ms SyC_tiPostDrv SyC_tiPreDrv /end OUT_MEASUREMENT
 /begin LOC_MEASUREMENT SyC_tiBoot_mp SyC_tiIniEnd_mp SyC_tiIniSyn_mp SyC_tiIni_mp /end LOC_MEASUREMENT
 FUNCTION_VERSION "1.14.0" /end FUNCTION
/begin FUNCTION SyC_PostDrv "1.11.0" /begin DEF_CHARACTERISTIC SyC_tiPostDrvMax_C SyC_tiPostDrvMin_C SyC_tiPostDrvResv_C /end DEF_CHARACTERISTIC /begin IN_MEASUREMENT Epm_nEng SyC_stSub /end IN_MEASUREMENT /begin OUT_MEASUREMENT SyC_stPostDrv /end OUT_MEASUREMENT /begin LOC_MEASUREMENT SyC_ctTiPostDrvMax SyC_stHistTiPostDrvMax SyC_stPostDrvFin /end LOC_MEASUREMENT FUNCTION_VERSION "1.11.0" /end FUNCTION
/begin FUNCTION SyC_PreDrv "1.12.0" /begin DEF_CHARACTERISTIC SyC_tiPreDrvMax_C SyC_tiPreDrvResv_C /end DEF_CHARACTERISTIC
 /begin IN_MEASUREMENT MoCCom_ctErrMMMsg MRly_st MRly_stAct SyC_stSub SyC_stT15 T15_st /end IN_MEASUREMENT
 /begin OUT_MEASUREMENT SyC_ctTiPreDrvMax SyC_stHistTiPreDrvMax SyC_stPreDrv SyC_stPreDrvFin /end OUT_MEASUREMENT
 /begin LOC_MEASUREMENT SyC_stSwtOn_mp /end LOC_MEASUREMENT
 FUNCTION_VERSION "1.12.0" /end FUNCTION
/begin FUNCTION SyC_Shutdown "1.12.0" FUNCTION_VERSION "1.12.0" /end FUNCTION
/begin FUNCTION SyC_StopCnt "1.13.0" FUNCTION_VERSION "1.13.0" /end FUNCTION
/begin FUNCTION SyC_UnderVltg "1.10.0" /begin LOC_MEASUREMENT SyC_ctInit SyC_ctUnderVltg SyC_tiUnderVltg_mp /end LOC_MEASUREMENT FUNCTION_VERSION "1.10.0" /end FUNCTION
/begin FUNCTION SYNTIZW "1.2.0" /begin IN_MEASUREMENT zzyl /end IN_MEASUREMENT /begin OUT_MEASUREMENT zzylzue /end OUT_MEASUREMENT FUNCTION_VERSION "1.2.0" /end FUNCTION
/begin FUNCTION T152MED "4.0.0" /begin IN_MEASUREMENT T15_st /end IN_MEASUREMENT /begin OUT_MEASUREMENT B_kl15 /end OUT_MEASUREMENT FUNCTION_VERSION "4.0.0" /end FUNCTION
/begin FUNCTION T15_DD "10.1.0" /begin OUT_MEASUREMENT T15_stRaw /end OUT_MEASUREMENT FUNCTION_VERSION "10.1.0" /end FUNCTION
/begin FUNCTION T15_VD "10.1.0" /begin DEF_CHARACTERISTIC T15_tiDebHiLo_C T15_tiDebLoHi_C /end DEF_CHARACTERISTIC /begin IN_MEASUREMENT ESC_tiSampling T15_stRaw /end IN_MEASUREMENT /begin OUT_MEASUREMENT T15_flgOn T15_st /end OUT_MEASUREMENT FUNCTION_VERSION "10.1.0" /end FUNCTION
/begin FUNCTION TEADAP "1.6.0"
 /begin DEF_CHARACTERISTIC FBTEFKA FBTEFKAX FTEADMAX FTEADMINH KFFTEAD KFKORMTMOD MSTEFTEAD ZKFTEAD /end DEF_CHARACTERISTIC
 /begin REF_CHARACTERISTIC CWFPCES /end REF_CHARACTERISTIC
 /begin IN_MEASUREMENT B_fvgte B_rkteb B_te B_ten fkakormt_w fkaste fkastexm_w imsteini mksbg msntetev_w /end IN_MEASUREMENT
 /begin OUT_MEASUREMENT B_fteadber fteadf ftead_w /end OUT_MEASUREMENT
 /begin LOC_MEASUREMENT fkastexm kintftead kormtmod_w /end LOC_MEASUREMENT
 FUNCTION_VERSION "1.6.0" /end FUNCTION
/begin FUNCTION TEATEV "1.8.0"
 /begin DEF_CHARACTERISTIC CWFPCTVTEV FTVTEVTANS KFTEVP KFTVPHTEV KFWTVTEV MSNTEVO TATEGMX TATEMSN /end DEF_CHARACTERISTIC
 /begin IN_MEASUREMENT B_tevtini msntesol_w nmot phtevpu_w pndk_w pu tans ubsq /end IN_MEASUREMENT
 /begin OUT_MEASUREMENT B_tatewi msntetev_w msntevo_w pndkpu tateout_w tatesoll_w tevper /end OUT_MEASUREMENT
 /begin LOC_MEASUREMENT phtev_w tansloc tatesoll tvtevptu_w /end LOC_MEASUREMENT
 FUNCTION_VERSION "1.8.0" /end FUNCTION
/begin FUNCTION TEBGTEV "1.7.1" /begin DEF_CHARACTERISTIC KLAFTE /end DEF_CHARACTERISTIC /begin REF_CHARACTERISTIC CWFPC /end REF_CHARACTERISTIC /begin IN_MEASUREMENT B_mstefg fho_w ftvdk_w msntetev_w msntevo_w pndkpu /end IN_MEASUREMENT /begin OUT_MEASUREMENT ftho_w mste mstedte mstedte_w msteo_w mste_w phtevpu_w /end OUT_MEASUREMENT /begin LOC_MEASUREMENT fafte_w /end LOC_MEASUREMENT FUNCTION_VERSION "1.7.1" /end FUNCTION
/begin FUNCTION TEEB "1.29.0"
 /begin DEF_CHARACTERISTIC CWFPC CWFPCES FTEADRPL FTEADSPH TATELL TMSTTE TMTE TTEATMTPA TTEAUS TVATEH TVATEL TVEVLOCTE TVTEB UBTEMN UBTEMX /end DEF_CHARACTERISTIC
 /begin IN_MEASUREMENT B_atmtpa B_evloc B_fa B_fvgte B_lamka B_lamrb B_lamsdef B_ll B_nmot B_rbte B_sabte fteadf msntetev_w tans tmot tmst tnsez_w ubsq_w /end IN_MEASUREMENT
 /begin OUT_MEASUREMENT B_fteadh B_lteab B_mstefg B_te B_teakt B_tef B_tei B_ten /end OUT_MEASUREMENT
 /begin LOC_MEASUREMENT B_gerte B_tvateh B_tvatel /end LOC_MEASUREMENT
 FUNCTION_VERSION "1.29.0" /end FUNCTION
/begin FUNCTION TEKOMS "1.8.1" /begin IN_MEASUREMENT msntes_w /end IN_MEASUREMENT /begin OUT_MEASUREMENT msntesol_w /end OUT_MEASUREMENT FUNCTION_VERSION "1.8.1" /end FUNCTION
/begin FUNCTION TELAM "1.6.0" /begin DEF_CHARACTERISTIC FKAKORBAO FKAKORBAV LAMTEMN LAMTEMX /end DEF_CHARACTERISTIC /begin IN_MEASUREMENT B_lr B_mstefg frm_w lamsons_w /end IN_MEASUREMENT /begin OUT_MEASUREMENT B_lamrb B_rbte fkakormt_w fkakormx_w /end OUT_MEASUREMENT FUNCTION_VERSION "1.6.0" /end FUNCTION
/begin FUNCTION TEMSSOLS "1.4.0" /begin DEF_CHARACTERISTIC FGWRMSMX KFDMSTES KLFDMSTES KLZKMSTES /end DEF_CHARACTERISTIC
 /begin IN_MEASUREMENT B_mstefg B_teakt fgwrte ftevflox_w ktevanst mksbg msntevo_w msteo_w /end IN_MEASUREMENT
 /begin OUT_MEASUREMENT msntes_w mstesoll_w /end OUT_MEASUREMENT
 /begin LOC_MEASUREMENT dmstes_w mstesmxi_w mstesmx_w /end LOC_MEASUREMENT
 FUNCTION_VERSION "1.4.0" /end FUNCTION
/begin FUNCTION TERK "1.3.1"
 /begin DEF_CHARACTERISTIC DSTEMIN FRKTEMN FRKTEMX FVERMN FVERZDYN FVRMDYN NVERZMN SQM05TEUB /end DEF_CHARACTERISTIC
 /begin IN_MEASUREMENT B_nmot ftead_w mssgin_w mssgout_w mste_w nmot nmot_w rkg_w umsrln_w /end IN_MEASUREMENT
 /begin OUT_MEASUREMENT B_rkteb rkte_w /end OUT_MEASUREMENT
 /begin LOC_MEASUREMENT qmsdyn rclteev_w rcltevvz_w rkgb_w rkg_old_w /end LOC_MEASUREMENT
 FUNCTION_VERSION "1.3.1" /end FUNCTION
/begin FUNCTION TESIGOUT "1.3.1"
 /begin DEF_CHARACTERISTIC BPHUTEB CWFPCPHU FKAKORBMN FKAKORBMX FKATEIBGMN FKATEINPMN FKATEINPMX FTEADNPMN FTEADNPMX IMSTEFVMN KFTETPU KLIMSTEFV KLTEMSZ TFKAKORFV ZKFKATEIFV ZKFTEADVA ZKFTEADVNA /end DEF_CHARACTERISTIC
 /begin IN_MEASUREMENT B_fteadber B_rkteb B_tei B_zora fkakormt_w fkatei fteadf ftead_w msntetev_w mstedte_w pu tumg /end IN_MEASUREMENT
 /begin OUT_MEASUREMENT B_fvgte /end OUT_MEASUREMENT
 /begin LOC_MEASUREMENT B_fkateifv B_imstemin coumsnte_w fkateif fkateifv fkateiims fteadvir imstefv_w /end LOC_MEASUREMENT
 FUNCTION_VERSION "1.3.1" /end FUNCTION
/begin FUNCTION TESIGTE "1.1.1" /begin DEF_CHARACTERISTIC KTEVANMK MSDKLMMN SMK05TEUB /end DEF_CHARACTERISTIC /begin IN_MEASUREMENT lamsbg_w ml_w msdkalm_w mste qtitimnh rflmorgi_w umsrln_w /end IN_MEASUREMENT
 /begin OUT_MEASUREMENT esst_smk05teub ktevanst lamsbgm_w mksbg mssgin_w mssgout_w qtetemin /end OUT_MEASUREMENT
 FUNCTION_VERSION "1.1.1" /end FUNCTION
/begin FUNCTION TESKSOL "3.14.1"
 /begin DEF_CHARACTERISTIC CWTEINI FGWRKA FKAPROG FKASTINX FKATEB FSRFKAS KFFKASX KFFTEVFX KFKASNH KFTEINI KFTEKAH KLTEINIFHO TFTEINI TQTEAB TQTEXMAB /end DEF_CHARACTERISTIC
 /begin REF_CHARACTERISTIC SMI04TEUW SMK05TEUB SNM04TEUB STA04TEUB /end REF_CHARACTERISTIC
 /begin IN_MEASUREMENT B_lteab B_rkteb B_teakt B_ten esst_smi04teuw esst_smk05teub esst_snm04teub esst_sta04teub fho fkakormx_w fteadf ftead_w ktevanst lamsbgm_w misol_w mksbg msntetev_w mssgin_w mstedte_w msteo_w mste_w nmot pndkpu qtetemin tans tmot tumg /end IN_MEASUREMENT
 /begin OUT_MEASUREMENT fgwrte fkaste fkastexm_w fkatei ftefsoll_w ftevflox_w imsteini /end OUT_MEASUREMENT
 /begin LOC_MEASUREMENT dfkaster dfkastes_w dfkasteub fkakordl fkastes fkastes_w fkastexu fkastex_w fkastold_w ftevflxm_w teini tfteini_w /end LOC_MEASUREMENT
 FUNCTION_VERSION "3.14.1" /end FUNCTION
/begin FUNCTION ThS2ME "5.0.0"
 /begin DEF_CHARACTERISTIC THS2ME_stConf_CW VF2ME_CWVF2ME_C VF2ME_THRESBKOE_C VF2ME_UPOTPWM_C /end DEF_CHARACTERISTIC
 /begin IN_MEASUREMENT ACCtl_stTrqResv AC_trqMaxAC AirC_bNIdlDem AirC_stCmprAct Com_stAC Fan_r TS_nMinAC /end IN_MEASUREMENT
 /begin OUT_MEASUREMENT B_klimex B_koe B_nac B_nlel dmrlf tvlues1 upotpwm /end OUT_MEASUREMENT
 FUNCTION_VERSION "5.0.0" /end FUNCTION
/begin FUNCTION ThS_AdpLcy "3.0.0" /begin IN_MEASUREMENT Fan_st /end IN_MEASUREMENT /begin OUT_MEASUREMENT Fan1_r /end OUT_MEASUREMENT FUNCTION_VERSION "3.0.0" /end FUNCTION
/begin FUNCTION Tle6232 "1.7.1" FUNCTION_VERSION "1.7.1" /end FUNCTION
/begin FUNCTION Tle8209 "1.4.1" FUNCTION_VERSION "1.4.1" /end FUNCTION
/begin FUNCTION TMO2ETS "4.0.0" /begin DEF_CHARACTERISTIC MDNORM RngMod_stAdap_C /end DEF_CHARACTERISTIC /begin REF_CHARACTERISTIC ETADZW /end REF_CHARACTERISTIC
 /begin IN_MEASUREMENT B_madko B_madll etakh_w mdverb_w mdverl_w midstn_w mifa_w miist_w mimax_w zwopt zwspae /end IN_MEASUREMENT
 /begin OUT_MEASUREMENT ActMod_trqCrS ActMod_trqInr etakh etazwmn etazwmn_w ftrq2mi_w miautget_w mifab_w mistt RngMod_stAdap RngMod_stDrvState RngMod_trqClthMin RngMod_trqCrSMax RngMod_trqCrSMin RngMod_trqLos /end OUT_MEASUREMENT
 /begin LOC_MEASUREMENT dzwspae /end LOC_MEASUREMENT
 FUNCTION_VERSION "4.0.0" /end FUNCTION
/begin FUNCTION Tp "9.7.0" FUNCTION_VERSION "9.7.0" /end FUNCTION
/begin FUNCTION TSDa_tClnt "2.0.0" /begin DEF_CHARACTERISTIC TSDa_tRadOutSubs_C /end DEF_CHARACTERISTIC /begin IN_MEASUREMENT CEngDsT_t /end IN_MEASUREMENT /begin OUT_MEASUREMENT TSDa_tClntIniVal TSDa_tClntRadOut TS_tClntEngOut /end OUT_MEASUREMENT FUNCTION_VERSION "2.0.0" /end FUNCTION
/begin FUNCTION TS_Axispoints "8.0.0" FUNCTION_VERSION "8.0.0" /end FUNCTION
/begin COMPU_METHOD Acc "" RAT_FUNC "%6.5" "m/s^2" COEFFS 0 1000 0 0 0 1 /end COMPU_METHOD
/begin COMPU_METHOD ACCIMass "" RAT_FUNC "%6.2" "kg" COEFFS 0 1 0 0 0 1 /end COMPU_METHOD
/begin COMPU_METHOD B_TRUE "" TAB_VERB "%6.3" "" COMPU_TAB_REF B_TRUE /end COMPU_METHOD
/begin COMPU_VTAB B_TRUE "" TAB_VERB 2 0 "----" 1 "TRUE" /end COMPU_VTAB
/begin COMPU_METHOD DEZ "" RAT_FUNC "%6.2" "" COEFFS 0 1 0 0 0 1 /end COMPU_METHOD
/begin COMPU_METHOD dez "" RAT_FUNC "%6.2" "" COEFFS 0 1 0 0 0 1 /end COMPU_METHOD
/begin COMPU_METHOD DtyCyc "" RAT_FUNC "%6.4" "%" COEFFS 0 100 0 0 0 1 /end COMPU_METHOD
/begin COMPU_METHOD EngN "" RAT_FUNC "%6.3" "rpm" COEFFS 0 2 0 0 0 1 /end COMPU_METHOD
/begin COMPU_METHOD ExeCon_State_01 "" TAB_VERB "%6.3" "" COMPU_TAB_REF ExeCon_State_01 /end COMPU_METHOD
/begin COMPU_VTAB ExeCon_State_01 "" TAB_VERB 4 0 "SYC_BOOT" 1 "SYC_PROC_INIT" 2 "SYC_PROC_EXEC" 3 "SYC_SHUTDOWN" /end COMPU_VTAB
/begin COMPU_METHOD ExeCon_State_02 "" TAB_VERB "%6.3" "" COMPU_TAB_REF ExeCon_State_02 /end COMPU_METHOD
/begin COMPU_VTAB ExeCon_State_02 "" TAB_VERB 7 0 "SYC_INI" 1 "SYC_INISYN" 2 "SYC_INIEND" 3 "SYC_PREDRIVE" 4 "SYC_DRIVE" 5 "SYC_POSTDRIVE" 6 "SYC_POST_OS_EXIT" /end COMPU_VTAB
/begin COMPU_METHOD Fact "" RAT_FUNC "%6.5" "-" COEFFS 0 8192 0 0 0 1 /end COMPU_METHOD
/begin COMPU_METHOD Fac_WearSotIdx "" RAT_FUNC "%10.9" "-" COEFFS 0 50000000 0 0 0 1 /end COMPU_METHOD
/begin COMPU_METHOD fak_q0p000244 "" RAT_FUNC "%6.5" "-" COEFFS 0 65536 0 0 0 16 /end COMPU_METHOD
/begin COMPU_METHOD fak_q0p000488 "" RAT_FUNC "%6.5" "-" COEFFS 0 65536 0 0 0 32 /end COMPU_METHOD
/begin COMPU_METHOD fak_q0p0009766 "" RAT_FUNC "%6.5" "-" COEFFS 0 65536 0 0 0 64 /end COMPU_METHOD
/begin COMPU_METHOD fak_q0p0078 "" RAT_FUNC "%6.4" "-" COEFFS 0 128 0 0 0 1 /end COMPU_METHOD
/begin COMPU_METHOD fak_q0p015625 "" RAT_FUNC "%6.4" "-" COEFFS 0 64 0 0 0 1 /end COMPU_METHOD
/begin COMPU_METHOD fak_q0p1 "" RAT_FUNC "%6.3" "-" COEFFS 0 1 0 0 0 0.1 /end COMPU_METHOD
/begin COMPU_METHOD fak_q0p5 "" RAT_FUNC "%6.3" "-" COEFFS 0 1 0 0 0 0.5 /end COMPU_METHOD
/begin COMPU_METHOD fak_q2p384Em4_pc_DIV_Nm "" RAT_FUNC "%6.5" "%/Nm" COEFFS 0 1048576 0 0 0 250 /end COMPU_METHOD
/begin COMPU_METHOD fak_sb_b0p5 "" RAT_FUNC "%10.6" "" COEFFS 0 256 0 0 0 1 /end COMPU_METHOD
/begin COMPU_METHOD fak_sb_b1 "" RAT_FUNC "%6.4" "-" COEFFS 0 256 0 0 0 2 /end COMPU_METHOD
/begin COMPU_METHOD fak_sb_b16 "" RAT_FUNC "%6.3" "-" COEFFS 0 256 0 0 0 32 /end COMPU_METHOD
/begin COMPU_METHOD fak_sb_b2 "" RAT_FUNC "%6.4" "-" COEFFS 0 256 0 0 0 4 /end COMPU_METHOD
/begin COMPU_METHOD fak_sb_b64 "" RAT_FUNC "%6.3" "-" COEFFS 0 256 0 0 0 128 /end COMPU_METHOD
/begin COMPU_METHOD fak_sw_b1 "" RAT_FUNC "%7.6" "-" COEFFS 0 65536 0 0 0 2 /end COMPU_METHOD
/begin COMPU_METHOD fak_sw_b4 "" RAT_FUNC "%6.5" "-" COEFFS 0 65536 0 0 0 8 /end COMPU_METHOD
/begin COMPU_METHOD fak_sw_b64 "" RAT_FUNC "%6.4" "-" COEFFS 0 65536 0 0 0 128 /end COMPU_METHOD
/begin COMPU_METHOD fak_ub_b0p5 "" RAT_FUNC "%6.4" "-" COEFFS 0 256 0 0 0 0.5 /end COMPU_METHOD
/begin COMPU_METHOD fak_ub_b1 "" RAT_FUNC "%6.4" "-" COEFFS 0 256 0 0 0 1 /end COMPU_METHOD
/begin COMPU_METHOD fak_ub_b16 "" RAT_FUNC "%6.4" "-" COEFFS 0 256 0 0 0 16 /end COMPU_METHOD
/begin COMPU_METHOD fak_ub_b2 "" RAT_FUNC "%8.5" "-" COEFFS 0 256 0 0 0 2 /end COMPU_METHOD
/begin COMPU_METHOD fak_ub_b4 "" RAT_FUNC "%6.4" "-" COEFFS 0 256 0 0 0 4 /end COMPU_METHOD
/begin COMPU_METHOD fak_ub_b64 "" RAT_FUNC "%6.3" "-" COEFFS 0 256 0 0 0 64 /end COMPU_METHOD
/begin COMPU_METHOD fak_ub_b8 "" RAT_FUNC "%6.4" "-" COEFFS 0 256 0 0 0 8 /end COMPU_METHOD
/begin COMPU_METHOD fak_ub_q0p064 "" RAT_FUNC "%6.4" "" COEFFS 0 25600 0 0 0 1632 /end COMPU_METHOD
/begin COMPU_METHOD fak_uw_b0p5 "" RAT_FUNC "%8.7" "-" COEFFS 0 65536 0 0 0 0.5 /end COMPU_METHOD
/begin COMPU_METHOD fak_uw_b1 "" RAT_FUNC "%7.6" "-" COEFFS 0 65536 0 0 0 1 /end COMPU_METHOD
/begin COMPU_METHOD fak_uw_b16 "" RAT_FUNC "%6.5" "-" COEFFS 0 65536 0 0 0 16 /end COMPU_METHOD
/begin COMPU_METHOD fak_uw_b2 "" RAT_FUNC "%7.6" "-" COEFFS 0 65536 0 0 0 2 /end COMPU_METHOD
/begin COMPU_METHOD fak_uw_b4 "" RAT_FUNC "%7.6" "-" COEFFS 0 65536 0 0 0 4 /end COMPU_METHOD
/begin COMPU_METHOD InjMass "" RAT_FUNC "%6.4" "mg/hub" COEFFS 0 100 0 0 0 1 /end COMPU_METHOD
/begin COMPU_METHOD kw_q0p0078 "" RAT_FUNC "%6.4" "Grad KW" COEFFS 0 128 0 0 0 1 /end COMPU_METHOD
/begin COMPU_METHOD kw_q0p75 "" RAT_FUNC "%6.3" "Grad KW" COEFFS 0 4 0 0 0 3 /end COMPU_METHOD
/begin COMPU_METHOD kw_sw_q0p0078 "" RAT_FUNC "%6.4" "Grad KW" COEFFS 0 128 0 0 0 1 /end COMPU_METHOD
/begin COMPU_METHOD md_q0p1 "" RAT_FUNC "%6.3" "Nm" COEFFS 0 10 0 0 0 1 /end COMPU_METHOD
/begin COMPU_METHOD md_sw_q0p1 "" RAT_FUNC "%6.3" "Nm" COEFFS 0 10 0 0 0 1 /end COMPU_METHOD
/begin COMPU_METHOD md_ub_q10 "" RAT_FUNC "%6.1" "Nm" COEFFS 0 1 0 0 0 10 /end COMPU_METHOD
/begin COMPU_METHOD mgrad_q0p400001 "" RAT_FUNC "%6.3" "kg/h" COEFFS 0 195312 0 0 0 78125 /end COMPU_METHOD
/begin COMPU_METHOD m_q0p002441_kg_DIV_h_s "" RAT_FUNC "%6.4" "kg/(h*s)" COEFFS 0 65536 0 0 0 160 /end COMPU_METHOD
/begin COMPU_METHOD m_q0p1 "" RAT_FUNC "%6.3" "kg/h" COEFFS 0 10 0 0 0 1 /end COMPU_METHOD
/begin COMPU_METHOD m_q4_kg_DIV_h "" RAT_FUNC "%6.2" "kg/h" COEFFS 0 1 0 0 0 4 /end COMPU_METHOD
/begin COMPU_METHOD m_ub_b25p6 "" RAT_FUNC "%6.3" "kg/h" COEFFS 0 256 0 0 0 25.6 /end COMPU_METHOD
/begin COMPU_METHOD m_ub_q0p0444 "" RAT_FUNC "%6.4" "g" COEFFS 0 1 0 0 0 0.0444 /end COMPU_METHOD
/begin COMPU_METHOD m_uw_b23p3 "" RAT_FUNC "%6.5" "kg" COEFFS 0 2812.5 0 0 0 1 /end COMPU_METHOD
/begin COMPU_METHOD m_uw_b25p6 "" RAT_FUNC "%6.5" "kg/h" COEFFS 0 65536 0 0 0 25.6 /end COMPU_METHOD
/begin COMPU_METHOD m_uw_b6553p5 "" RAT_FUNC "%6.3" "kg/h" COEFFS 0 1 0 0 0 0.1 /end COMPU_METHOD
/begin COMPU_METHOD nmotg_sb_q100 "" RAT_FUNC "%6.0" "1/(min*s)" COEFFS 0 1 0 0 0 100 /end COMPU_METHOD
/begin COMPU_METHOD nmot_q0p5 "" RAT_FUNC "%6.3" "1/min" COEFFS 0 2 0 0 0 1 /end COMPU_METHOD
/begin COMPU_METHOD nmot_q4 "" RAT_FUNC "%6.2" "U/min" COEFFS 0 1 0 0 0 4 /end COMPU_METHOD
/begin COMPU_METHOD nmot_sw_q0p25 "" RAT_FUNC "%6.3" "1/min" COEFFS 0 1 0 0 0 0.25 /end COMPU_METHOD
/begin COMPU_METHOD nmot_sw_q0p5 "" RAT_FUNC "%6.3" "1/min" COEFFS 0 2 0 0 0 1 /end COMPU_METHOD
/begin COMPU_METHOD nmot_ub_q10 "" RAT_FUNC "%6.1" "1/min" COEFFS 0 1 0 0 0 10 /end COMPU_METHOD
/begin COMPU_METHOD nmot_ub_q40 "" RAT_FUNC "%6.1" "1/min" COEFFS 0 1 0 0 0 40 /end COMPU_METHOD
/begin COMPU_METHOD nmot_uw_q0p25 "" RAT_FUNC "%6.3" "1/min" COEFFS 0 1 0 0 0 0.25 /end COMPU_METHOD
/begin COMPU_METHOD OneToOne "" RAT_FUNC "%6.2" "-" COEFFS 0 1 0 0 0 1 /end COMPU_METHOD
/begin COMPU_METHOD OneToOne_ms "" RAT_FUNC "%6.2" "ms" COEFFS 0 1 0 0 0 1 /end COMPU_METHOD
/begin COMPU_METHOD perio_q0p3125 "" RAT_FUNC "%6.3" "1/s" COEFFS 0 32 0 0 0 10 /end COMPU_METHOD
/begin COMPU_METHOD perio_q4p76836Em5 "" RAT_FUNC "%7.6" "1/s" COEFFS 0 256000000 0 0 0 12207 /end COMPU_METHOD
/begin COMPU_METHOD perio_ub_b0p012207 "" RAT_FUNC "%10.8" "1/s" COEFFS 0 256 0 0 0 0.012207 /end COMPU_METHOD
/begin COMPU_METHOD Prc "" RAT_FUNC "%6.4" "%" COEFFS 0 81.92 0 0 0 1 /end COMPU_METHOD
/begin COMPU_METHOD PrcPerSec "" RAT_FUNC "%6.3" "%/s" COEFFS 0 1.6384 0 0 0 1 /end COMPU_METHOD
/begin COMPU_METHOD PrcPerSec_10ms "" RAT_FUNC "%6.2" "%/s" COEFFS 0 0.8192 0 0 0 1 /end COMPU_METHOD
/begin COMPU_METHOD Pres_hPa "" RAT_FUNC "%6.2" "hPa" COEFFS 0 1 0 0 0 1 /end COMPU_METHOD
/begin COMPU_METHOD Pwr "" RAT_FUNC "%6.2" "W" COEFFS 0 0.10610329539459 0 0 0 1 /end COMPU_METHOD
/begin COMPU_METHOD Pwr_kW "" RAT_FUNC "%6.4" "kW" COEFFS 0 100 0 0 0 1 /end COMPU_METHOD
/begin COMPU_METHOD p_q0p0195 "" RAT_FUNC "%6.4" "hPa" COEFFS 0 256 0 0 0 5 /end COMPU_METHOD
/begin COMPU_METHOD p_q1 "" RAT_FUNC "%6.2" "hPa" COEFFS 0 1 0 0 0 1 /end COMPU_METHOD
/begin COMPU_METHOD p_q156p86 "" RAT_FUNC "%6.0" "hPa" COEFFS 0 1 0 0 0 156.86 /end COMPU_METHOD
/begin COMPU_METHOD p_q500 "" RAT_FUNC "%6.0" "hPa" COEFFS 0 1 0 0 0 500 /end COMPU_METHOD
/begin COMPU_METHOD p_sw_q0p9155 "" RAT_FUNC "%6.2" "hPa" COEFFS 0 32767 0 0 0 30000 /end COMPU_METHOD
/begin COMPU_METHOD p_ub_q5 "" RAT_FUNC "%6.2" "hPa" COEFFS 0 1 0 0 0 5 /end COMPU_METHOD
/begin COMPU_METHOD p_uw_q0p039 "" RAT_FUNC "%6.4" "hPa" COEFFS 0 256 0 0 0 10 /end COMPU_METHOD
/begin COMPU_METHOD p_uw_q0p078 "" RAT_FUNC "%6.4" "hPa" COEFFS 0 256 0 0 0 20 /end COMPU_METHOD
/begin COMPU_METHOD rel_q0p01 "" RAT_FUNC "%6.4" "%" COEFFS 0 100 0 0 0 1 /end COMPU_METHOD
/begin COMPU_METHOD rel_q0p012207 "" RAT_FUNC "%6.4" "%" COEFFS 0 8192 0 0 0 100 /end COMPU_METHOD
/begin COMPU_METHOD rel_q0p0234 "" RAT_FUNC "%6.4" "%" COEFFS 0 128 0 0 0 3 /end COMPU_METHOD
/begin COMPU_METHOD rel_q0p75 "" RAT_FUNC "%6.3" "%" COEFFS 0 4 0 0 0 3 /end COMPU_METHOD
/begin COMPU_METHOD rel_sw_b100 "" RAT_FUNC "%6.4" "%" COEFFS 0 32768 0 0 0 100 /end COMPU_METHOD
/begin COMPU_METHOD rel_sw_q0p0468 "" RAT_FUNC "%6.4" "%" COEFFS 0 65536 0 0 0 3072 /end COMPU_METHOD
/begin COMPU_METHOD rel_ub_b100 "" RAT_FUNC "%6.3" "%" COEFFS 0 256 0 0 0 100 /end COMPU_METHOD
/begin COMPU_METHOD rel_ub_b127p5 "" RAT_FUNC "%6.3" "%" COEFFS 0 2 0 0 0 1 /end COMPU_METHOD
/begin COMPU_METHOD rel_ub_b99p6 "" RAT_FUNC "%6.3" "%" COEFFS 0 256 0 0 0 100 /end COMPU_METHOD
/begin COMPU_METHOD rel_ub_q0p75 "" RAT_FUNC "%6.3" "%" COEFFS 0 1 0 0 0 0.75 /end COMPU_METHOD
/begin COMPU_METHOD rel_uw_b100 "" RAT_FUNC "%6.4" "%" COEFFS 0 65536 0 0 0 100 /end COMPU_METHOD
/begin COMPU_METHOD rel_uw_b3072 "" RAT_FUNC "%6.4" "%" COEFFS 0 65536 0 0 0 3072 /end COMPU_METHOD
/begin COMPU_METHOD rel_uw_q0p0234 "" RAT_FUNC "%6.4" "%" COEFFS 0 32 0 0 0 0.75 /end COMPU_METHOD
/begin COMPU_METHOD Signals_IntSigNumVerb "" TAB_VERB "%6.3" "" COMPU_TAB_REF Signals_IntSigNumVerb /end COMPU_METHOD
/begin COMPU_VTAB Signals_IntSigNumVerb "" TAB_VERB 60 0 "SIGNALS_Signals_Default" 1 "SIGNALS_APP_rUnFlt" 2 "SIGNALS_Brk_st" 3 "SIGNALS_Brk_stRed" 4 "SIGNALS_EpmCaS_phiOfsCorr" 5 "SIGNALS_Epm_nEng" 6 "SIGNALS_Epm_stOpMode" 7 "SIGNALS_Epm_stSync" 8 "SIGNALS_I15031_FILLSIG1h" 9 "SIGNALS_I15031_FILLSIG2h" 10 "SIGNALS_I15031_FILLSIG4h" 11 "SIGNALS_PID01h" 12 "SIGNALS_PID03h_0" 13 "SIGNALS_PID03h_1" 14 "SIGNALS_PID04h" 15 "SIGNALS_PID05h" 16 "SIGNALS_PID06h_0" 17 "SIGNALS_PID07h_0" 18 "SIGNALS_PID0D_VehV_vSens" 19 "SIGNALS_PID0Eh" 20 "SIGNALS_PID0bh" 21 "SIGNALS_PID14h_0" 22 "SIGNALS_PID14h_1" 23 "SIGNALS_PID15h_1" 24 "SIGNALS_PID1Ch" 25 "SIGNALS_PID1Fh" 26 "SIGNALS_PID21h" 27 "SIGNALS_PID2Eh" 28 "SIGNALS_PID30h" 29 "SIGNALS_PID31h" 30 "SIGNALS_PID3Ch" 31 "SIGNALS_PID42h" 32 "SIGNALS_PID43h" 33 "SIGNALS_PID44h" 34 "SIGNALS_PID49_APP_uRaw1unLim" 35 "SIGNALS_PID4A_APP_uRaw2unLimWoNTP" 36 "SIGNALS_PID4FAh" 37 "SIGNALS_PID4FBh" 38 "SIGNALS_PID4FCh" 39 "SIGNALS_PID4FDh" 40 "SIGNALS_PID50Ah" 41 "SIGNALS_PID50Bh" 42 "SIGNALS_PID50Ch" 43 "SIGNALS_PID50Dh" 44 "SIGNALS_PID56h_0" 45 "SIGNALS_PID5A_APP_rOBDPID5A" 46 "SIGNALS_PID5Fh" 47 "SIGNALS_Signals_FillSig_1Bit" 48 "SIGNALS_Signals_FillSig_1Byte" 49 "SIGNALS_Signals_FillSig_2Bit" 50 "SIGNALS_Signals_FillSig_2Byte" 51 "SIGNALS_Signals_FillSig_3Bit" 52 "SIGNALS_Signals_FillSig_4Bit" 53 "SIGNALS_Signals_FillSig_4Byte" 54 "SIGNALS_Signals_FillSig_5Bit" 55 "SIGNALS_Signals_FillSig_6Bit" 56 "SIGNALS_Signals_FillSig_7Bit" 57 "SIGNALS_T15_stRaw" 58 "SIGNALS_VehV_a" 59 "SIGNALS_VehV_v" /end COMPU_VTAB
/begin COMPU_METHOD Signals_PidVerbSupp "" TAB_VERB "%6.3" "" COMPU_TAB_REF Signals_PidVerbSupp /end COMPU_METHOD
/begin COMPU_VTAB Signals_PidVerbSupp "" TAB_VERB 28 0 "PID_NOT_SUPPORTED" 3 "PID_0x03" 4 "PID_0x04" 5 "PID_0x05" 6 "PID_0x06" 7 "PID_0x07" 11 "PID_0x0B" 12 "PID_0x0C" 13 "PID_0x0D" 14 "PID_0x0E" 20 "PID_0x14" 21 "PID_0x15" 28 "PID_0x1C" 31 "PID_0x1F" 33 "PID_0x21" 46 "PID_0x2E" 48 "PID_0x30" 49 "PID_0x31" 60 "PID_0x3C" 66 "PID_0x42" 67 "PID_0x43" 68 "PID_0x44" 73 "PID_0x49" 74 "PID_0x4A" 79 "PID_0x4F" 80 "PID_0x50" 86 "PID_0x56" 90 "PID_0x5A" /end COMPU_VTAB
/begin COMPU_METHOD spg_q0p00039 "" RAT_FUNC "%6.5" "V" COEFFS 0 1 0 0 0 0.000390625 /end COMPU_METHOD
/begin COMPU_METHOD spg_q0p00488 "" RAT_FUNC "%6.4" "V" COEFFS 0 1024 0 0 0 5 /end COMPU_METHOD
/begin COMPU_METHOD spg_q0p1 "" RAT_FUNC "%6.3" "V" COEFFS 0 1 0 0 0 0.1 /end COMPU_METHOD
/begin COMPU_METHOD spg_ub_b5 "" RAT_FUNC "%6.4" "V" COEFFS 0 256 0 0 0 5 /end COMPU_METHOD
/begin COMPU_METHOD SyC_PostDrv_State "" TAB_VERB "%6.3" "" COMPU_TAB_REF SyC_PostDrv_State /end COMPU_METHOD
/begin COMPU_VTAB SyC_PostDrv_State "" TAB_VERB 9 0 "SYC_POSTDRV_INACTV" 1 "SYC_POSTDRV_DSM_BGN" 2 "SYC_POSTDRV_EEP_BGN" 3 "SYC_POSTDRV_WAIT" 4 "SYC_POSTDRV_NWM" 5 "SYC_POSTDRV_DSM_END" 6 "SYC_POSTDRV_EEP_END" 7 "SYC_POSTDRV_MIN_TIME" 8 "SYC_POSTDRV_DONE" /end COMPU_VTAB
/begin COMPU_METHOD SyC_PreDrv_State "" TAB_VERB "%6.3" "" COMPU_TAB_REF SyC_PreDrv_State /end COMPU_METHOD
/begin COMPU_VTAB SyC_PreDrv_State "" TAB_VERB 10 0 "SYC_PREDRV_INI_DRV" 1 "SYC_PREDRV_DONE" 2 "SYC_PREDRV_INI_SHDWN" 3 "SYC_PREDRV_PROLONG" 4 "SYC_PREDRV_NWM" 5 "SYC_PREDRV_EEP" 6 "SYC_PREDRV_DSM" 7 "SYC_PREDRV_MR" 8 "SYC_PREDRV_MOM" 9 "SYC_PREDRV_EXIT" /end COMPU_VTAB
/begin COMPU_METHOD SyC_Time_100ms "" RAT_FUNC "%6.3" "s" COEFFS 0 1000 0 0 0 100 /end COMPU_METHOD
/begin COMPU_METHOD SY_TLR_Compu "" TAB_VERB "%6.3" "" COMPU_TAB_REF SY_TLR_Compu /end COMPU_METHOD
/begin COMPU_VTAB SY_TLR_Compu "" TAB_VERB 2 0 "kein Testereingriff LR aktiv" 1 "Testereingriff LR aktiv" /end COMPU_VTAB
/begin COMPU_METHOD SY_TMDR_Compu "" TAB_VERB "%6.3" "" COMPU_TAB_REF SY_TMDR_Compu /end COMPU_METHOD
/begin COMPU_VTAB SY_TMDR_Compu "" TAB_VERB 2 0 "kein Testereingriff Momentenreserve LL" 1 "Testereingriff Momentenreserve LL" /end COMPU_VTAB
/begin COMPU_METHOD SY_TMKI_Compu "" TAB_VERB "%6.3" "" COMPU_TAB_REF SY_TMKI_Compu /end COMPU_METHOD
/begin COMPU_VTAB SY_TMKI_Compu "" TAB_VERB 2 0 "Kühlmitteltemperatur nicht aus Kombiinstrument" 1 "Kühlmitteltemperatur aus Kombiinstrument" /end COMPU_VTAB
/begin COMPU_METHOD SY_TMO2KA_Compu "" TAB_VERB "%6.3" "" COMPU_TAB_REF SY_TMO2KA_Compu /end COMPU_METHOD
/begin COMPU_VTAB SY_TMO2KA_Compu "" TAB_VERB 3 0 "no influence modelled" 1 "add-on calibration" 2 "independent calibration" /end COMPU_VTAB
/begin COMPU_METHOD SY_TMOEZWS_Compu "" TAB_VERB "%6.3" "" COMPU_TAB_REF SY_TMOEZWS_Compu /end COMPU_METHOD
/begin COMPU_VTAB SY_TMOEZWS_Compu "" TAB_VERB 2 0 "no delta ignition effiency in stratified modes" 1 "delta ignition effiency in stratified modes" /end COMPU_VTAB
/begin COMPU_METHOD SY_TMOHKS_Compu "" TAB_VERB "%6.3" "" COMPU_TAB_REF SY_TMOHKS_Compu /end COMPU_METHOD
/begin COMPU_VTAB SY_TMOHKS_Compu "" TAB_VERB 2 0 "no influence of HKS in torque model" 1 "consideration of HKS in torque model" /end COMPU_VTAB
/begin COMPU_METHOD SY_TMOHSST_Compu "" TAB_VERB "%6.3" "" COMPU_TAB_REF SY_TMOHSST_Compu /end COMPU_METHOD
/begin COMPU_VTAB SY_TMOHSST_Compu "" TAB_VERB 2 0 "0" 1 "1" /end COMPU_VTAB
/begin COMPU_METHOD SY_TMOLAMH_Compu "" TAB_VERB "%6.3" "" COMPU_TAB_REF SY_TMOLAMH_Compu /end COMPU_METHOD
/begin COMPU_VTAB SY_TMOLAMH_Compu "" TAB_VERB 2 0 "NO" 1 "STG1" /end COMPU_VTAB
/begin COMPU_METHOD SY_TMOLAM_Compu "" TAB_VERB "%6.3" "" COMPU_TAB_REF SY_TMOLAM_Compu /end COMPU_METHOD
/begin COMPU_VTAB SY_TMOLAM_Compu "" TAB_VERB 3 0 "no lambda influence in torque model" 1 "basic modelling" 2 "enhanced modelling" /end COMPU_VTAB
/begin COMPU_METHOD SY_TMOLB_Compu "" TAB_VERB "%6.3" "" COMPU_TAB_REF SY_TMOLB_Compu /end COMPU_METHOD
/begin COMPU_VTAB SY_TMOLB_Compu "" TAB_VERB 3 0 "torque model without charge motion" 1 "torque model with charge motion (basic)" 2 "torque model with charge motion (enhanced)" /end COMPU_VTAB
/begin COMPU_METHOD SY_TMOMDI_Compu "" TAB_VERB "%6.3" "" COMPU_TAB_REF SY_TMOMDI_Compu /end COMPU_METHOD
/begin COMPU_VTAB SY_TMOMDI_Compu "" TAB_VERB 3 0 "0" 1 "1" 2 "2" /end COMPU_VTAB
/begin COMPU_METHOD SY_TMORRI_Compu "" TAB_VERB "%6.3" "" COMPU_TAB_REF SY_TMORRI_Compu /end COMPU_METHOD
/begin COMPU_VTAB SY_TMORRI_Compu "" TAB_VERB 3 0 "torque model without residual gas rate" 1 "torque model with residual gas rate (basic)" 2 "torque model with residual gas rate (enhanced)" /end COMPU_VTAB
/begin COMPU_METHOD SY_TMOTFIL_Compu "" TAB_VERB "%6.3" "" COMPU_TAB_REF SY_TMOTFIL_Compu /end COMPU_METHOD
/begin COMPU_VTAB SY_TMOTFIL_Compu "" TAB_VERB 2 0 "SY_TMOTFIL==0" 1 "SY_TMOTFIL>0" /end COMPU_VTAB
/begin COMPU_METHOD SY_TMRWEX_Compu "" TAB_VERB "%6.3" "" COMPU_TAB_REF SY_TMRWEX_Compu /end COMPU_METHOD
/begin COMPU_VTAB SY_TMRWEX_Compu "" TAB_VERB 2 0 "SY_TMRWEX == 0" 1 "SY_TMRWEX > 0" /end COMPU_VTAB
/begin COMPU_METHOD SY_TMTTMON_Compu "" TAB_VERB "%6.3" "" COMPU_TAB_REF SY_TMTTMON_Compu /end COMPU_METHOD
/begin COMPU_VTAB SY_TMTTMON_Compu "" TAB_VERB 2 0 "False" 1 "True" /end COMPU_VTAB
/begin COMPU_METHOD SY_TNLS_Compu "" TAB_VERB "%6.3" "" COMPU_TAB_REF SY_TNLS_Compu /end COMPU_METHOD
/begin COMPU_VTAB SY_TNLS_Compu "" TAB_VERB 2 0 "kein Testereingriff für LL Solldrehzahl möglich" 1 "Testereingriff für LL Solldrehzahl möglich" /end COMPU_VTAB
/begin COMPU_METHOD SY_TOCH_Compu "" TAB_VERB "%6.3" "" COMPU_TAB_REF SY_TOCH_Compu /end COMPU_METHOD
/begin COMPU_VTAB SY_TOCH_Compu "" TAB_VERB 3 0 "deaktivierte FG OTMTOCH" 1 "aktivierte FG OTMTOCH" 2 "aktivierte (16bit) FG OTMTOCH" /end COMPU_VTAB
/begin COMPU_METHOD SY_TOSPCN_Compu "" TAB_VERB "%6.3" "" COMPU_TAB_REF SY_TOSPCN_Compu /end COMPU_METHOD
/begin COMPU_VTAB SY_TOSPCN_Compu "" TAB_VERB 4 2 "CAN_VOLT" 1 "SG" 0 "NO_SENS" 3 "CAN_TEMP" /end COMPU_VTAB
/begin COMPU_METHOD SY_TOSPCSD_Compu "" TAB_VERB "%6.3" "" COMPU_TAB_REF SY_TOSPCSD_Compu /end COMPU_METHOD
/begin COMPU_VTAB SY_TOSPCSD_Compu "" TAB_VERB 2 0 "SY_TOSPCSD" 1 "SY_TOSPCSD" /end COMPU_VTAB
/begin COMPU_METHOD SY_TOSPMAI_Compu "" TAB_VERB "%6.3" "" COMPU_TAB_REF SY_TOSPMAI_Compu /end COMPU_METHOD
/begin COMPU_VTAB SY_TOSPMAI_Compu "" TAB_VERB 2 0 "DISABL" 1 "ENABL" /end COMPU_VTAB
/begin COMPU_METHOD SY_TOSPPLD_Compu "" TAB_VERB "%6.3" "" COMPU_TAB_REF SY_TOSPPLD_Compu /end COMPU_METHOD
/begin COMPU_VTAB SY_TOSPPLD_Compu "" TAB_VERB 2 0 "SY_TOSPPLD" 1 "SY_TOSPPLD" /end COMPU_VTAB
/begin COMPU_METHOD SY_TOSP_Compu "" TAB_VERB "%6.3" "" COMPU_TAB_REF SY_TOSP_Compu /end COMPU_METHOD
/begin COMPU_VTAB SY_TOSP_Compu "" TAB_VERB 3 0 "deaktivierte FG OTMTOSPCP" 1 "aktivierte FG OTMTOSPCP" 2 "aktivierte (16bit-Wert) FG OTMTOSPCP" /end COMPU_VTAB
/begin COMPU_METHOD SY_TPEACNR_Compu "" TAB_VERB "%6.3" "" COMPU_TAB_REF SY_TPEACNR_Compu /end COMPU_METHOD
/begin COMPU_VTAB SY_TPEACNR_Compu "" TAB_VERB 2 0 "False" 1 "True" /end COMPU_VTAB
/begin COMPU_METHOD SY_TPEFWG_Compu "" TAB_VERB "%6.3" "" COMPU_TAB_REF SY_TPEFWG_Compu /end COMPU_METHOD
/begin COMPU_VTAB SY_TPEFWG_Compu "" TAB_VERB 2 0 "False" 1 "True" /end COMPU_VTAB
/begin COMPU_METHOD SY_TPEMF_Compu "" TAB_VERB "%6.3" "" COMPU_TAB_REF SY_TPEMF_Compu /end COMPU_METHOD
/begin COMPU_VTAB SY_TPEMF_Compu "" TAB_VERB 2 0 "False" 1 "True" /end COMPU_VTAB
/begin COMPU_METHOD SY_TSPHK_Compu "" TAB_VERB "%6.3" "" COMPU_TAB_REF SY_TSPHK_Compu /end COMPU_METHOD
/begin COMPU_VTAB SY_TSPHK_Compu "" TAB_VERB 2 0 "False" 1 "True" /end COMPU_VTAB
/begin COMPU_METHOD SY_TTEV_Compu "" TAB_VERB "%6.3" "" COMPU_TAB_REF SY_TTEV_Compu /end COMPU_METHOD
/begin COMPU_VTAB SY_TTEV_Compu "" TAB_VERB 2 0 "keine Stellglieddiagnose TEV möglich" 1 "Stellglieddiagnose TEV möglich" /end COMPU_VTAB
/begin COMPU_METHOD SY_TUMG_Compu "" TAB_VERB "%6.3" "" COMPU_TAB_REF SY_TUMG_Compu /end COMPU_METHOD
/begin COMPU_VTAB SY_TUMG_Compu "" TAB_VERB 4 0 "no source, signal not available" 1 "Sensor" 2 "tans" 3 "CAN" /end COMPU_VTAB
/begin COMPU_METHOD SY_TUMSIC_Compu "" TAB_VERB "%6.3" "" COMPU_TAB_REF SY_TUMSIC_Compu /end COMPU_METHOD
/begin COMPU_VTAB SY_TUMSIC_Compu "" TAB_VERB 3 0 "s1-array only" 1 "Block-SIC only" 2 "s1-array and Block-SIC" /end COMPU_VTAB
/begin COMPU_METHOD SY_TURBO_Compu "" TAB_VERB "%6.3" "" COMPU_TAB_REF SY_TURBO_Compu /end COMPU_METHOD
/begin COMPU_VTAB SY_TURBO_Compu "" TAB_VERB 2 0 "keinTurbolader vorhanden" 1 "Turbolader vorhanden" /end COMPU_VTAB
/begin COMPU_METHOD SY_TWDKS_Compu "" TAB_VERB "%6.3" "" COMPU_TAB_REF SY_TWDKS_Compu /end COMPU_METHOD
/begin COMPU_VTAB SY_TWDKS_Compu "" TAB_VERB 2 0 "kein Testereingriff Sollwinkel DVE aktiv" 1 "Testereingriff Sollwinkel DVE aktiv" /end COMPU_VTAB
/begin COMPU_METHOD SY_TWSLP_Compu "" TAB_VERB "%6.3" "" COMPU_TAB_REF SY_TWSLP_Compu /end COMPU_METHOD
/begin COMPU_VTAB SY_TWSLP_Compu "" TAB_VERB 2 0 "Wicklungstemperaturmodell nicht integriert" 1 "Wicklungstemperaturmodell integriert" /end COMPU_VTAB
/begin COMPU_METHOD SY_UB1ADC_Compu "" TAB_VERB "%6.3" "" COMPU_TAB_REF SY_UB1ADC_Compu /end COMPU_METHOD
/begin COMPU_VTAB SY_UB1ADC_Compu "" TAB_VERB 2 0 "False" 1 "True" /end COMPU_VTAB
/begin COMPU_METHOD SY_UBDEDIQ_Compu "" RAT_FUNC "%6.2" "" COEFFS 0 1 0 0 0 1 /end COMPU_METHOD
/begin COMPU_METHOD SY_UBDEENQ_Compu "" RAT_FUNC "%6.2" "" COEFFS 0 1 0 0 0 1 /end COMPU_METHOD
/begin COMPU_METHOD SY_UBDEEN_Compu "" RAT_FUNC "%6.2" "" COEFFS 0 1 0 0 0 1 /end COMPU_METHOD
/begin COMPU_METHOD SY_UBR_Compu "" TAB_VERB "%6.3" "" COMPU_TAB_REF SY_UBR_Compu /end COMPU_METHOD
/begin COMPU_VTAB SY_UBR_Compu "" TAB_VERB 2 0 "Signal Hauptrelaisspannung nicht vorhanden" 1 "Signal Hauptrelaisspannung vorhanden" /end COMPU_VTAB
/begin COMPU_METHOD SY_UBSQ_W_Compu "" RAT_FUNC "%6.2" "" COEFFS 0 1 0 0 0 1 /end COMPU_METHOD
/begin COMPU_METHOD SY_UHR_Compu "" RAT_FUNC "%6.2" "" COEFFS 0 1 0 0 0 1 /end COMPU_METHOD
/begin COMPU_METHOD SY_UKAT2_Compu "" TAB_VERB "%6.3" "" COMPU_TAB_REF SY_UKAT2_Compu /end COMPU_METHOD
/begin COMPU_VTAB SY_UKAT2_Compu "" TAB_VERB 2 0 "Unterflurkatalystor nicht vorhanden, Bank2" 1 "Unterflurkatalystor vorhanden, Bank2" /end COMPU_VTAB
/begin COMPU_METHOD SY_UKAT_Compu "" TAB_VERB "%6.3" "" COMPU_TAB_REF SY_UKAT_Compu /end COMPU_METHOD
/begin COMPU_VTAB SY_UKAT_Compu "" TAB_VERB 2 0 "Unterflurkatalystor nicht vorhanden" 1 "Unterflurkatalystor vorhanden" /end COMPU_VTAB
/begin COMPU_METHOD SY_UKAUFL_Compu "" TAB_VERB "%6.3" "" COMPU_TAB_REF SY_UKAUFL_Compu /end COMPU_METHOD
/begin COMPU_VTAB SY_UKAUFL_Compu "" TAB_VERB 2 0 "no correction" 1 "correction depending of lamsbg_w" /end COMPU_VTAB
/begin COMPU_METHOD SY_VARCODE_Compu "" TAB_VERB "%6.3" "" COMPU_TAB_REF SY_VARCODE_Compu /end COMPU_METHOD
/begin COMPU_VTAB SY_VARCODE_Compu "" TAB_VERB 2 0 "Variantencodierung-Schnittstelle nicht freigegeben" 1 "Variantencodierung-Schnittstelle freigegeben" /end COMPU_VTAB
/begin COMPU_METHOD SY_VARL_Compu "" TAB_VERB "%6.3" "" COMPU_TAB_REF SY_VARL_Compu /end COMPU_METHOD
/begin COMPU_VTAB SY_VARL_Compu "" TAB_VERB 2 0 "False" 1 "True" /end COMPU_VTAB
/begin COMPU_METHOD SY_VARTEST_Compu "" RAT_FUNC "%6.2" "" COEFFS 0 1 0 0 0 1 /end COMPU_METHOD
/begin COMPU_METHOD SY_VAR_Compu "" RAT_FUNC "%6.2" "" COEFFS 0 1 0 0 0 1 /end COMPU_METHOD
/begin COMPU_METHOD SY_VDEO_Compu "" TAB_VERB "%6.3" "" COMPU_TAB_REF SY_VDEO_Compu /end COMPU_METHOD
/begin COMPU_VTAB SY_VDEO_Compu "" TAB_VERB 3 0 "kein Verdichter verbaut" 1 "Verdichter vor Drosselklappe verbaut Verdichter v" 2 "Verdichter nach Drosselklappe verbaut" /end COMPU_VTAB
/begin COMPU_METHOD SY_VD_Compu "" TAB_VERB "%6.3" "" COMPU_TAB_REF SY_VD_Compu /end COMPU_METHOD
/begin COMPU_VTAB SY_VD_Compu "" TAB_VERB 4 0 "no booster" 1 "TC (ATL)" 2 "compressor" 3 "SC-E (EZV)" /end COMPU_VTAB
/begin COMPU_METHOD SY_VHE_Compu "" TAB_VERB "%6.3" "" COMPU_TAB_REF SY_VHE_Compu /end COMPU_METHOD
/begin COMPU_VTAB SY_VHE_Compu "" TAB_VERB 3 0 "0" 1 "1" 2 "2" /end COMPU_VTAB
/begin COMPU_METHOD SY_VS_Compu "" TAB_VERB "%6.3" "" COMPU_TAB_REF SY_VS_Compu /end COMPU_METHOD
/begin COMPU_VTAB SY_VS_Compu "" TAB_VERB 2 0 "keine Ventilhubsteuerung vorhanden" 1 "Ventilhubsteuerung vorhanden" /end COMPU_VTAB
/begin COMPU_METHOD SY_VVT_Compu "" RAT_FUNC "%6.2" "" COEFFS 0 1 0 0 0 1 /end COMPU_METHOD
/begin COMPU_METHOD SY_WFP_Compu "" TAB_VERB "%6.3" "" COMPU_TAB_REF SY_WFP_Compu /end COMPU_METHOD
/begin COMPU_VTAB SY_WFP_Compu "" TAB_VERB 2 0 "no winter program" 1 "winter program, by trigger switch" /end COMPU_VTAB
/begin COMPU_METHOD SY_WFS_Compu "" RAT_FUNC "%6.2" "" COEFFS 0 1 0 0 0 1 /end COMPU_METHOD
/begin COMPU_METHOD SY_WMIN_Compu "" RAT_FUNC "%6.2" "" COEFFS 0 1 0 0 0 1 /end COMPU_METHOD
/begin COMPU_METHOD SY_WNWADM_Compu "" TAB_VERB "%6.3" "" COMPU_TAB_REF SY_WNWADM_Compu /end COMPU_METHOD
/begin COMPU_VTAB SY_WNWADM_Compu "" TAB_VERB 2 0 "Correction of camshaft angles by cam adaptation" 1 "No correction of cam angles by cam adapdaptation" /end COMPU_VTAB
/begin COMPU_METHOD SY_ZAGPATTERNMX_Compu "" RAT_FUNC "%6.2" "" COEFFS 0 1 0 0 0 1 /end COMPU_METHOD
/begin COMPU_METHOD SY_ZAMSDK_Compu "" TAB_VERB "%6.3" "" COMPU_TAB_REF SY_ZAMSDK_Compu /end COMPU_METHOD
/begin COMPU_VTAB SY_ZAMSDK_Compu "" TAB_VERB 2 0 "False" 1 "True" /end COMPU_VTAB
/begin COMPU_METHOD SY_ZAS_Compu "" TAB_VERB "%6.3" "" COMPU_TAB_REF SY_ZAS_Compu /end COMPU_METHOD
/begin COMPU_VTAB SY_ZAS_Compu "" TAB_VERB 2 0 "Zylinderabschaltung nicht vorhanden" 1 "Zylinderabschaltung vorhanden" /end COMPU_VTAB
/begin COMPU_METHOD SY_ZBLRELS_Compu "" TAB_VERB "%6.3" "" COMPU_TAB_REF SY_ZBLRELS_Compu /end COMPU_METHOD
/begin COMPU_VTAB SY_ZBLRELS_Compu "" TAB_VERB 3 0 "SY_ZBLRELS_0" 1 "SY_ZBLRELS_1" 2 "SY_ZBLRELS_2" /end COMPU_VTAB
/begin COMPU_METHOD SY_ZCSTCW_Compu "" TAB_VERB "%6.3" "" COMPU_TAB_REF SY_ZCSTCW_Compu /end COMPU_METHOD
/begin COMPU_VTAB SY_ZCSTCW_Compu "" TAB_VERB 2 0 "SY_ZCSTCW == 0" 1 "SY_ZCSTCW == 1" /end COMPU_VTAB
/begin COMPU_METHOD SY_ZCSTES_Compu "" TAB_VERB "%6.3" "" COMPU_TAB_REF SY_ZCSTES_Compu /end COMPU_METHOD
/begin COMPU_VTAB SY_ZCSTES_Compu "" TAB_VERB 2 0 "False" 1 "True" /end COMPU_VTAB
/begin COMPU_METHOD SY_ZCSTFA1_Compu "" TAB_VERB "%6.3" "" COMPU_TAB_REF SY_ZCSTFA1_Compu /end COMPU_METHOD
/begin COMPU_VTAB SY_ZCSTFA1_Compu "" TAB_VERB 2 0 "SY_ZCSTFA1 == 0" 1 "SY_ZCSTFA1 == 1" /end COMPU_VTAB
/begin COMPU_METHOD SY_ZCSTFA2_Compu "" TAB_VERB "%6.3" "" COMPU_TAB_REF SY_ZCSTFA2_Compu /end COMPU_METHOD
/begin COMPU_VTAB SY_ZCSTFA2_Compu "" TAB_VERB 2 0 "SY_ZCSTFA2 == 0" 1 "SY_ZCSTFA2 == 1" /end COMPU_VTAB
/begin COMPU_METHOD SY_ZCSTFLT_Compu "" TAB_VERB "%6.3" "" COMPU_TAB_REF SY_ZCSTFLT_Compu /end COMPU_METHOD
/begin COMPU_VTAB SY_ZCSTFLT_Compu "" TAB_VERB 2 0 "SY_ZCSTFLT == 0" 1 "SY_ZCSTFLT == 1" /end COMPU_VTAB
/begin COMPU_METHOD SY_ZCSTKKH_Compu "" TAB_VERB "%6.3" "" COMPU_TAB_REF SY_ZCSTKKH_Compu /end COMPU_METHOD
/begin COMPU_VTAB SY_ZCSTKKH_Compu "" TAB_VERB 2 0 "False" 1 "True" /end COMPU_VTAB
/begin COMPU_METHOD SY_ZCSTOSP_Compu "" TAB_VERB "%6.3" "" COMPU_TAB_REF SY_ZCSTOSP_Compu /end COMPU_METHOD
/begin COMPU_VTAB SY_ZCSTOSP_Compu "" TAB_VERB 2 0 "SY_ZCSTOSP == 0" 1 "SY_ZCSTOSP == 1" /end COMPU_VTAB
/begin COMPU_METHOD SY_ZCSTUM_Compu "" TAB_VERB "%6.3" "" COMPU_TAB_REF SY_ZCSTUM_Compu /end COMPU_METHOD
/begin COMPU_VTAB SY_ZCSTUM_Compu "" TAB_VERB 3 2 "SY_ZCSTUM_2" 1 "SY_ZCSTUM_1" 0 "SY_ZCSTUM_0" /end COMPU_VTAB
/begin COMPU_METHOD SY_ZEL_Compu "" TAB_VERB "%6.3" "" COMPU_TAB_REF SY_ZEL_Compu /end COMPU_METHOD
/begin COMPU_VTAB SY_ZEL_Compu "" TAB_VERB 2 0 "False" 1 "True" /end COMPU_VTAB
/begin COMPU_METHOD SY_ZGST_Compu "" TAB_VERB "%6.3" "" COMPU_TAB_REF SY_ZGST_Compu /end COMPU_METHOD
/begin COMPU_VTAB SY_ZGST_Compu "" TAB_VERB 3 0 "SY_ZGST_0" 2 "SY_ZGST_2" 1 "SY_ZGST_1" /end COMPU_VTAB
/begin COMPU_METHOD SY_ZMS_Compu "" TAB_VERB "%6.3" "" COMPU_TAB_REF SY_ZMS_Compu /end COMPU_METHOD
/begin COMPU_VTAB SY_ZMS_Compu "" TAB_VERB 2 0 "kein Zweimassenschwungrad Schutz ist aktiv" 1 "Zweimassenschwungrad Schutz ist aktiv" /end COMPU_VTAB
/begin COMPU_METHOD SY_ZNDAUS_Compu "" TAB_VERB "%6.3" "" COMPU_TAB_REF SY_ZNDAUS_Compu /end COMPU_METHOD
/begin COMPU_VTAB SY_ZNDAUS_Compu "" TAB_VERB 2 1 "Zündausgabe Einzelfunke" 2 "Zündausgabe Doppelfunke" /end COMPU_VTAB
/begin COMPU_METHOD SY_ZYLOFFH_Compu "" RAT_FUNC "%6.2" "" COEFFS 0 1 0 0 0 1 /end COMPU_METHOD
/begin COMPU_METHOD SY_ZYLOFFS_Compu "" RAT_FUNC "%6.2" "" COEFFS 0 1 0 0 0 1 /end COMPU_METHOD
/begin COMPU_METHOD SY_ZYLZA_Compu "" TAB_VERB "%6.3" "" COMPU_TAB_REF SY_ZYLZA_Compu /end COMPU_METHOD
/begin COMPU_VTAB SY_ZYLZA_Compu "" TAB_VERB 10 4 "4" 5 "5" 6 "6" 8 "8" 12 "12" 3 "3" 10 "10" 18 "16" 16 "18" 2 "2" /end COMPU_VTAB
/begin COMPU_METHOD SY_ZYLZG_Compu "" RAT_FUNC "%6.2" "" COEFFS 0 1 0 0 0 1 /end COMPU_METHOD
/begin COMPU_METHOD SY_ZZBANKB_Compu "" RAT_FUNC "%6.2" "" COEFFS 0 1 0 0 0 1 /end COMPU_METHOD
/begin COMPU_METHOD SY_ZZBANKC_Compu "" RAT_FUNC "%6.2" "" COEFFS 0 1 0 0 0 1 /end COMPU_METHOD
/begin COMPU_METHOD SY_ZZBANK_Compu "" RAT_FUNC "%6.2" "" COEFFS 0 1 0 0 0 1 /end COMPU_METHOD
/begin COMPU_METHOD SY_ZZLAM_Compu "" TAB_VERB "%6.3" "" COMPU_TAB_REF SY_ZZLAM_Compu /end COMPU_METHOD
/begin COMPU_VTAB SY_ZZLAM_Compu "" TAB_VERB 2 0 "keine zylinderindividuelle Lambdaregelung" 1 "zylinderindividuelle Lambdaregelung vorhanden" /end COMPU_VTAB
/begin COMPU_METHOD SY_ZZRL_Compu "" RAT_FUNC "%6.2" "" COEFFS 0 1 0 0 0 1 /end COMPU_METHOD
/begin COMPU_METHOD SY_ZZSG_Compu "" RAT_FUNC "%6.2" "" COEFFS 0 1 0 0 0 1 /end COMPU_METHOD
/begin COMPU_METHOD SY_ZZYLB1_Compu "" RAT_FUNC "%6.2" "" COEFFS 0 1 0 0 0 1 /end COMPU_METHOD
/begin COMPU_METHOD SY_ZZYLB2_Compu "" RAT_FUNC "%6.2" "" COEFFS 0 1 0 0 0 1 /end COMPU_METHOD
/begin COMPU_METHOD t100msxs_uw_b6553p5 "" RAT_FUNC "%6.3" "s" COEFFS 0 1 0 0 0 0.1 /end COMPU_METHOD
/begin COMPU_METHOD t100msxs_uw_b6553p6 "" RAT_FUNC "%6.3" "s" COEFFS 0 10 0 0 0 1 /end COMPU_METHOD
/begin COMPU_METHOD T15_ATS_SY_Compu "" TAB_VERB "%6.3" "" COMPU_TAB_REF T15_ATS_SY_Compu /end COMPU_METHOD
/begin COMPU_VTAB T15_ATS_SY_Compu "" TAB_VERB 2 0 "False" 1 "True" /end COMPU_VTAB
/begin COMPU_METHOD T15_ON_VLDT_COM_SY_Compu "" TAB_VERB "%6.3" "" COMPU_TAB_REF T15_ON_VLDT_COM_SY_Compu /end COMPU_METHOD
/begin COMPU_VTAB T15_ON_VLDT_COM_SY_Compu "" TAB_VERB 2 0 "False" 1 "True" /end COMPU_VTAB
/begin COMPU_METHOD t1sxs_ub_b255 "" RAT_FUNC "%6.2" "s" COEFFS 0 1 0 0 0 1 /end COMPU_METHOD
/begin COMPU_METHOD t500usxms_ub_q0p5 "" RAT_FUNC "%6.3" "ms" COEFFS 0 1 0 0 0 0.5 /end COMPU_METHOD
/begin COMPU_METHOD t6minxmin_q6 "" RAT_FUNC "%6.2" "min" COEFFS 0 1 0 0 0 6 /end COMPU_METHOD
/begin COMPU_METHOD TCAT2DMDL_SC_Compu "" TAB_VERB "%6.3" "" COMPU_TAB_REF TCAT2DMDL_SC_Compu /end COMPU_METHOD
/begin COMPU_VTAB TCAT2DMDL_SC_Compu "" TAB_VERB 2 0 "0" 1 "1" /end COMPU_VTAB
/begin COMPU_METHOD TCSOVRDSTSCINC_SY_Compu "" TAB_VERB "%6.3" "" COMPU_TAB_REF TCSOVRDSTSCINC_SY_Compu /end COMPU_METHOD
/begin COMPU_VTAB TCSOVRDSTSCINC_SY_Compu "" TAB_VERB 2 0 "incr. TSC interv. overrides TCS interv." 1 "TCS interv. overrides incr. TSC interv." /end COMPU_VTAB
/begin COMPU_METHOD TDC_ADAP_SY_Compu "" TAB_VERB "%6.3" "" COMPU_TAB_REF TDC_ADAP_SY_Compu /end COMPU_METHOD
/begin COMPU_VTAB TDC_ADAP_SY_Compu "" TAB_VERB 3 0 "NO_TDC_ADAP" 1 "TDC_ADAP" 2 "TDC_ADAP_CPP" /end COMPU_VTAB
/begin COMPU_METHOD TDC_UNEQLGEOM_SY_Compu "" TAB_VERB "%6.3" "" COMPU_TAB_REF TDC_UNEQLGEOM_SY_Compu /end COMPU_METHOD
/begin COMPU_VTAB TDC_UNEQLGEOM_SY_Compu "" TAB_VERB 2 0 "EQL_TDC" 1 "UNEQL_TDC" /end COMPU_VTAB
/begin COMPU_METHOD Temp_Cels "" RAT_FUNC "%6.1" "deg C" COEFFS 0 10 2731.4 0 0 1 /end COMPU_METHOD
/begin COMPU_METHOD Temp_Cels1 "" RAT_FUNC "%6.1" "deg C" COEFFS 0 100 27314 0 0 1 /end COMPU_METHOD
/begin COMPU_METHOD Temp_Fahr "" RAT_FUNC "%6.1" "deg F" COEFFS 0 5.55555555555556 2553.62222222222 0 0 1 /end COMPU_METHOD
/begin COMPU_METHOD Temp_Kelv_Sec_CtT_Mon "" RAT_FUNC "%7.6" "deg C/s" COEFFS 0 40960 0 0 0 1 /end COMPU_METHOD
/begin COMPU_METHOD temp_q0p0234_o273 "" RAT_FUNC "%6.1" "Grad C" COEFFS 0 1 273.15 0 0 0.0234375 /end COMPU_METHOD
/begin COMPU_METHOD temp_q0p75_om48 "" RAT_FUNC "%6.2" "Grad C" COEFFS 0 4 192 0 0 3 /end COMPU_METHOD
/begin COMPU_METHOD temp_sb_q0p75 "" RAT_FUNC "%6.3" "Grad C" COEFFS 0 1 0 0 0 0.75 /end COMPU_METHOD
/begin COMPU_METHOD temp_ub_q0p75_o48 "" RAT_FUNC "%6.2" "Grad C" COEFFS 0 1 48 0 0 0.75 /end COMPU_METHOD
/begin COMPU_METHOD temp_ub_q5_o50 "" RAT_FUNC "%6.2" "Grad C" COEFFS 0 1 50 0 0 5 /end COMPU_METHOD
/begin COMPU_METHOD THMMNG_SY_Compu "" TAB_VERB "%6.3" "" COMPU_TAB_REF THMMNG_SY_Compu /end COMPU_METHOD
/begin COMPU_VTAB THMMNG_SY_Compu "" TAB_VERB 2 0 "FALSE" 1 "TRUE" /end COMPU_VTAB
/begin COMPU_METHOD THMPMP_SY_Compu "" TAB_VERB "%6.3" "" COMPU_TAB_REF THMPMP_SY_Compu /end COMPU_METHOD
/begin COMPU_VTAB THMPMP_SY_Compu "" TAB_VERB 2 0 "False" 1 "True" /end COMPU_VTAB
/begin COMPU_METHOD THRVLV_SENSCAL_SY_Compu "" TAB_VERB "%6.3" "" COMPU_TAB_REF THRVLV_SENSCAL_SY_Compu /end COMPU_METHOD
/begin COMPU_VTAB THRVLV_SENSCAL_SY_Compu "" TAB_VERB 2 0 "False" 1 "True" /end COMPU_VTAB
/begin COMPU_METHOD Time100_us "" RAT_FUNC "%6.0" "us" COEFFS 0 0.01 0 0 0 1 /end COMPU_METHOD
/begin COMPU_METHOD TimeDeb "" RAT_FUNC "%6.1" "ms" COEFFS 0 0.1 0 0 0 1 /end COMPU_METHOD
/begin COMPU_METHOD TimeDelay_s_2 "" RAT_FUNC "%9.4" "s" COEFFS 0 0 1 0 0.0596046447753906 0 /end COMPU_METHOD
/begin COMPU_METHOD TimeDelay_s_Lin_16 "" RAT_FUNC "%6.5" "s" COEFFS 0 6553.4 0 0 0 1 /end COMPU_METHOD
/begin COMPU_METHOD TimeDelay_s_Lin_16_2 "" RAT_FUNC "%6.4" "s" COEFFS 0 131.068 0 0 0 1 /end COMPU_METHOD
/begin COMPU_METHOD TimeEngOn "" RAT_FUNC "%6.2" "s" COEFFS 0 1 0 0 0 1 /end COMPU_METHOD
/begin COMPU_METHOD Time_4s "" RAT_FUNC "%6.2" "s" COEFFS 0 0.25 0 0 0 1 /end COMPU_METHOD
/begin COMPU_METHOD Time_HiRes "" RAT_FUNC "%6.3" "ms" COEFFS 0 8 0 0 0 1 /end COMPU_METHOD
/begin COMPU_METHOD Time_msec_q10_COMPU "" RAT_FUNC "%6.1" "ms" COEFFS 0 1 0 0 0 10 /end COMPU_METHOD
/begin COMPU_METHOD Time_msec_q1_COMPU "" RAT_FUNC "%6.2" "ms" COEFFS 0 1 0 0 0 1 /end COMPU_METHOD
/begin COMPU_METHOD Time_ms_100ms "" RAT_FUNC "%6.0" "ms" COEFFS 0 0.01 0 0 0 1 /end COMPU_METHOD
/begin COMPU_METHOD Time_ms_20ms "" RAT_FUNC "%6.1" "ms" COEFFS 0 0.05 0 0 0 1 /end COMPU_METHOD
/begin COMPU_METHOD Time_RtmLoRes "" RAT_FUNC "%6.3" "ms" COEFFS 0 10 0 0 0 1 /end COMPU_METHOD
/begin COMPU_METHOD Time_s "" RAT_FUNC "%6.4" "s" COEFFS 0 100 0 0 0 1 /end COMPU_METHOD
/begin COMPU_METHOD Time_sec_q1_COMPU "" RAT_FUNC "%6.2" "s" COEFFS 0 1 0 0 0 1 /end COMPU_METHOD
/begin COMPU_METHOD Time_s_1 "" RAT_FUNC "%6.5" "" COEFFS 0 1000 0 0 0 1 /end COMPU_METHOD
/begin COMPU_METHOD Time_usec_q1_COMPU "" RAT_FUNC "%6.2" "us" COEFFS 0 1 0 0 0 1 /end COMPU_METHOD
/begin COMPU_METHOD TIPIN_SY_Compu "" TAB_VERB "%6.3" "" COMPU_TAB_REF TIPIN_SY_Compu /end COMPU_METHOD
/begin COMPU_VTAB TIPIN_SY_Compu "" TAB_VERB 2 0 "0" 1 "1" /end COMPU_VTAB
/begin COMPU_METHOD TLE6232_SY_Compu "" TAB_VERB "%6.3" "" COMPU_TAB_REF TLE6232_SY_Compu /end COMPU_METHOD
/begin COMPU_VTAB TLE6232_SY_Compu "" TAB_VERB 3 2 "two TLE6232" 0 "no TLE6232" 1 "one TLE6232" /end COMPU_VTAB
/begin COMPU_METHOD TLE7209_SY_Compu "" TAB_VERB "%6.3" "" COMPU_TAB_REF TLE7209_SY_Compu /end COMPU_METHOD
/begin COMPU_VTAB TLE7209_SY_Compu "" TAB_VERB 3 0 "no TLE7209" 1 "one TLE7209" 2 "two TLE7209" /end COMPU_VTAB
/begin COMPU_METHOD TLE8209_SY_Compu "" TAB_VERB "%6.3" "" COMPU_TAB_REF TLE8209_SY_Compu /end COMPU_METHOD
/begin COMPU_VTAB TLE8209_SY_Compu "" TAB_VERB 7 0 "0" 1 "1" 2 "2" 3 "3" 4 "4" 5 "5" 6 "6" /end COMPU_VTAB
/begin COMPU_METHOD TME_VAR_SY_Compu "" TAB_VERB "%6.3" "" COMPU_TAB_REF TME_VAR_SY_Compu /end COMPU_METHOD
/begin COMPU_VTAB TME_VAR_SY_Compu "" TAB_VERB 32 1 "DAI" 3 "VWW" 5 "AUD" 22 "FOR" 147 "HYU" 999 "ALL" 214 "AVT" 9 "FIA" 21 "GMU" 159 "HON" 160 "MAZ" 123 "MIT" 20 "NIS" 14 "PSA" 4 "POR" 15 "REN" 248 "SUZ" 308 "TAT" 72 "TOY" 6 "OPE" 19 "VOL" 55 "ROL" 18 "SAB" 69 "FER" 51 "SEA" 204 "VVW" 17 "ALF" 289 "AMG" 11 "BMW" 183 "CU" 385 "UAES" 243 "DMC" /end COMPU_VTAB
/begin COMPU_METHOD TMFWPRT_SY_Compu "" TAB_VERB "%6.3" "" COMPU_TAB_REF TMFWPRT_SY_Compu /end COMPU_METHOD
/begin COMPU_VTAB TMFWPRT_SY_Compu "" TAB_VERB 5 0 "TMFW protection is disabled" 1 "EngPrt_TMFWShutoff is activated" 2 "StSys_TrqShutOff is activated" 3 "BBZMS is activated" 4 "EngPrt_TMFWShutoff  and StSys_TrqShutoff is activa" /end COMPU_VTAB
/begin COMPU_METHOD TmotQnts_SY_Compu "" TAB_VERB "%6.3" "" COMPU_TAB_REF TmotQnts_SY_Compu /end COMPU_METHOD
/begin COMPU_VTAB TmotQnts_SY_Compu "" TAB_VERB 2 0 "TmotQnts_SY == 0" 1 "TmotQnts_SY == 1" /end COMPU_VTAB
/begin COMPU_METHOD TPROT_FINGERPRINT_SY_Compu "" TAB_VERB "%6.3" "" COMPU_TAB_REF TPROT_FINGERPRINT_SY_Compu /end COMPU_METHOD
/begin COMPU_VTAB TPROT_FINGERPRINT_SY_Compu "" TAB_VERB 2 0 "False" 1 "True" /end COMPU_VTAB
/begin COMPU_METHOD TQRESL_SC_Compu "" TAB_VERB "%6.3" "" COMPU_TAB_REF TQRESL_SC_Compu /end COMPU_METHOD
/begin COMPU_VTAB TQRESL_SC_Compu "" TAB_VERB 2 0 "Torque resolution of 0.1Nm" 1 "Torque resolution of 0.125Nm" /end COMPU_VTAB
/begin COMPU_METHOD TRANOIPRV_SY_Compu "" TAB_VERB "%6.3" "" COMPU_TAB_REF TRANOIPRV_SY_Compu /end COMPU_METHOD
/begin COMPU_VTAB TRANOIPRV_SY_Compu "" TAB_VERB 2 0 "no anti-rattling available" 1 "anti-rattling available" /end COMPU_VTAB
/begin COMPU_METHOD TRANSPTMODE_SY_Compu "" TAB_VERB "%6.3" "" COMPU_TAB_REF TRANSPTMODE_SY_Compu /end COMPU_METHOD
/begin COMPU_VTAB TRANSPTMODE_SY_Compu "" TAB_VERB 2 0 "False" 1 "True" /end COMPU_VTAB
/begin COMPU_METHOD TransR "" RAT_FUNC "%6.4" "-" COEFFS 0 100 0 0 0 1 /end COMPU_METHOD
/begin COMPU_METHOD TRATYPE_MT_SY_Compu "" TAB_VERB "%6.3" "" COMPU_TAB_REF TRATYPE_MT_SY_Compu /end COMPU_METHOD
/begin COMPU_VTAB TRATYPE_MT_SY_Compu "" TAB_VERB 1 0 "Manual_Tra" /end COMPU_VTAB
/begin COMPU_METHOD TRA_AST_SY_Compu "" TAB_VERB "%6.3" "" COMPU_TAB_REF TRA_AST_SY_Compu /end COMPU_METHOD
/begin COMPU_VTAB TRA_AST_SY_Compu "" TAB_VERB 3 0 "NOT_AVL" 1 "CFG" 2 "AVL" /end COMPU_VTAB
/begin COMPU_METHOD TRA_AT_SY_Compu "" TAB_VERB "%6.3" "" COMPU_TAB_REF TRA_AT_SY_Compu /end COMPU_METHOD
/begin COMPU_VTAB TRA_AT_SY_Compu "" TAB_VERB 3 0 "NOT_AVL" 1 "CFG" 2 "AVL" /end COMPU_VTAB
/begin COMPU_METHOD TRA_CVT_SY_Compu "" TAB_VERB "%6.3" "" COMPU_TAB_REF TRA_CVT_SY_Compu /end COMPU_METHOD
/begin COMPU_VTAB TRA_CVT_SY_Compu "" TAB_VERB 3 0 "NOT_AVL" 1 "CFG" 2 "AVL" /end COMPU_VTAB
/begin COMPU_METHOD TRA_DCT_SY_Compu "" TAB_VERB "%6.3" "" COMPU_TAB_REF TRA_DCT_SY_Compu /end COMPU_METHOD
/begin COMPU_VTAB TRA_DCT_SY_Compu "" TAB_VERB 3 0 "NOT_AVL" 1 "CFG" 2 "AVL" /end COMPU_VTAB
/begin COMPU_METHOD TRA_INTERLOCK_SY_Compu "" TAB_VERB "%6.3" "" COMPU_TAB_REF TRA_INTERLOCK_SY_Compu /end COMPU_METHOD
/begin COMPU_VTAB TRA_INTERLOCK_SY_Compu "" TAB_VERB 2 0 "FALSE" 1 "TRUE" /end COMPU_VTAB
/begin COMPU_METHOD TRA_MT_SY_Compu "" TAB_VERB "%6.3" "" COMPU_TAB_REF TRA_MT_SY_Compu /end COMPU_METHOD
/begin COMPU_VTAB TRA_MT_SY_Compu "" TAB_VERB 3 0 "NOT_AVL" 1 "CFG" 2 "AVL" /end COMPU_VTAB
/begin COMPU_METHOD TRBCH_CAN_SY_Compu "" TAB_VERB "%6.3" "" COMPU_TAB_REF TRBCH_CAN_SY_Compu /end COMPU_METHOD
/begin COMPU_VTAB TRBCH_CAN_SY_Compu "" TAB_VERB 2 0 "FALSE" 1 "TRUE" /end COMPU_VTAB
/begin COMPU_METHOD TrnvrsAcc "" RAT_FUNC "%6.4" "g" COEFFS 0 100 0 0 0 1 /end COMPU_METHOD
/begin COMPU_METHOD Trq "" RAT_FUNC "%6.3" "Nm" COEFFS 0 10 0 0 0 1 /end COMPU_METHOD
/begin COMPU_METHOD TRQBS_WOINTV_SY_Compu "" TAB_VERB "%6.3" "" COMPU_TAB_REF TRQBS_WOINTV_SY_Compu /end COMPU_METHOD
/begin COMPU_VTAB TRQBS_WOINTV_SY_Compu "" TAB_VERB 2 0 "no addtional modelling" 1 "addtional modelling of basic torque w/o interventi" /end COMPU_VTAB
/begin COMPU_METHOD TRQBS_WOTRAINTV_SY_Compu "" TAB_VERB "%6.3" "" COMPU_TAB_REF TRQBS_WOTRAINTV_SY_Compu /end COMPU_METHOD
/begin COMPU_VTAB TRQBS_WOTRAINTV_SY_Compu "" TAB_VERB 2 0 "no addtional modelling" 1 "addtional modelling of basic torque w.o. tra.intv." /end COMPU_VTAB
/begin COMPU_METHOD TRQCONV_SY_Compu "" TAB_VERB "%6.3" "" COMPU_TAB_REF TRQCONV_SY_Compu /end COMPU_METHOD
/begin COMPU_VTAB TRQCONV_SY_Compu "" TAB_VERB 2 1 "True" 0 "False" /end COMPU_VTAB
/begin COMPU_METHOD TRQINF_SY_Compu "" TAB_VERB "%6.3" "" COMPU_TAB_REF TRQINF_SY_Compu /end COMPU_METHOD
/begin COMPU_VTAB TRQINF_SY_Compu "" TAB_VERB 2 1 "TRUE" 0 "FALSE" /end COMPU_VTAB
/begin COMPU_METHOD TRQLIMCOORD2ECU_SY_Compu "" TAB_VERB "%6.3" "" COMPU_TAB_REF TRQLIMCOORD2ECU_SY_Compu /end COMPU_METHOD
/begin COMPU_VTAB TRQLIMCOORD2ECU_SY_Compu "" TAB_VERB 2 0 "not enabled" 1 "enabled" /end COMPU_VTAB
/begin COMPU_METHOD TrqPerSec "" RAT_FUNC "%6.2" "Nm/s" COEFFS 0 1 0 0 0 1 /end COMPU_METHOD
/begin COMPU_METHOD TrqPrp "" RAT_FUNC "%6.2" "Nm" COEFFS 0 0.625 0 0 0 1 /end COMPU_METHOD
/begin COMPU_METHOD TrqPrpHigh "" RAT_FUNC "%6.3" "Nm" COEFFS 0 10 0 0 0 1 /end COMPU_METHOD
/begin COMPU_METHOD tv_ub_b100 "" RAT_FUNC "%6.3" "%TV" COEFFS 0 256 0 0 0 100 /end COMPU_METHOD
/begin COMPU_METHOD t_q0p01 "" RAT_FUNC "%6.4" "" COEFFS 0 100 0 0 0 1 /end COMPU_METHOD
/begin COMPU_METHOD t_q0p01_ms "" RAT_FUNC "%6.4" "ms" COEFFS 0 1 0 0 0 0.01 /end COMPU_METHOD
/begin COMPU_METHOD t_q0p02 "" RAT_FUNC "%6.4" "s" COEFFS 0 100 0 0 0 2 /end COMPU_METHOD
/begin COMPU_METHOD t_q0p1 "" RAT_FUNC "%6.3" "s" COEFFS 0 10 0 0 0 1 /end COMPU_METHOD
/begin COMPU_METHOD t_q0p32000082 "" RAT_FUNC "%6.3" "s" COEFFS 0 48828 0 0 0 15625 /end COMPU_METHOD
/begin COMPU_METHOD t_q5p96046Em8_min "" RAT_FUNC "%10.9" "min" COEFFS 0 16777216 0 0 0 1 /end COMPU_METHOD
/begin COMPU_METHOD Vel "" RAT_FUNC "%6.4" "km/h" COEFFS 0 100 0 0 0 1 /end COMPU_METHOD
/begin COMPU_METHOD volFilgLvl_ml "" RAT_FUNC "%6.2" "ml" COEFFS 0 1 0 0 0 1 /end COMPU_METHOD
/begin COMPU_METHOD Volt "" RAT_FUNC "%6.3" "mV" COEFFS 0 5 0 0 0 1 /end COMPU_METHOD
/begin COMPU_METHOD Volt_Batt "" RAT_FUNC "%6.1" "mV" COEFFS 0 0.05 0 0 0 1 /end COMPU_METHOD
/begin COMPU_METHOD vol_q0p1_l "" RAT_FUNC "%6.3" "l" COEFFS 0 1 0 0 0 0.1 /end COMPU_METHOD
/begin COMPU_METHOD vol_q1_ul "" RAT_FUNC "%6.2" "µL" COEFFS 0 1 0 0 0 1 /end COMPU_METHOD
/begin COMPU_METHOD zk100msxs_ub_b25p5 "" RAT_FUNC "%6.3" "s" COEFFS 0 0 256 0 10 0 /end COMPU_METHOD
/begin COMPU_METHOD zk100msxs_uw_b6553p6 "" RAT_FUNC "%6.1" "s" COEFFS 0 0 65536 0 10 0 /end COMPU_METHOD
/begin COMPU_METHOD zw_sb_q0p75 "" RAT_FUNC "%6.3" "Grad KW" COEFFS 0 255 0 0 0 191.25 /end COMPU_METHOD
/begin COMPU_METHOD default "" RAT_FUNC "%6.2" "" COEFFS 0 1 0 0 0 1 /end COMPU_METHOD
/begin RECORD_LAYOUT GkfWU8 FNC_VALUES 1 UBYTE COLUMN_DIR DIRECT /end RECORD_LAYOUT
/begin RECORD_LAYOUT GklWU16 FNC_VALUES 1 UWORD COLUMN_DIR DIRECT /end RECORD_LAYOUT
/begin RECORD_LAYOUT GklWU8 FNC_VALUES 1 UBYTE COLUMN_DIR DIRECT /end RECORD_LAYOUT
/begin RECORD_LAYOUT KfAxU8AyU8SstxS16SstyU8WS16 NO_AXIS_PTS_X 1 UBYTE NO_AXIS_PTS_Y 2 UBYTE AXIS_PTS_X 3 SWORD INDEX_INCR DIRECT AXIS_PTS_Y 4 UBYTE INDEX_INCR DIRECT FNC_VALUES 5 SWORD COLUMN_DIR DIRECT /end RECORD_LAYOUT
/begin RECORD_LAYOUT KfAxU8AyU8SstxS16SstyU8WU16 NO_AXIS_PTS_X 1 UBYTE NO_AXIS_PTS_Y 2 UBYTE AXIS_PTS_X 3 SWORD INDEX_INCR DIRECT AXIS_PTS_Y 4 UBYTE INDEX_INCR DIRECT FNC_VALUES 5 UWORD COLUMN_DIR DIRECT /end RECORD_LAYOUT
/begin RECORD_LAYOUT KfAxU8AyU8SstxU16SstyU16WS16 NO_AXIS_PTS_X 1 UWORD NO_AXIS_PTS_Y 2 UWORD AXIS_PTS_X 3 UWORD INDEX_INCR DIRECT AXIS_PTS_Y 4 UWORD INDEX_INCR DIRECT FNC_VALUES 5 SWORD COLUMN_DIR DIRECT /end RECORD_LAYOUT
/begin RECORD_LAYOUT KfAxU8AyU8SstxU16SstyU16WU16 NO_AXIS_PTS_X 1 UWORD NO_AXIS_PTS_Y 2 UWORD AXIS_PTS_X 3 UWORD INDEX_INCR DIRECT AXIS_PTS_Y 4 UWORD INDEX_INCR DIRECT FNC_VALUES 5 UWORD COLUMN_DIR DIRECT /end RECORD_LAYOUT
/begin RECORD_LAYOUT KfAxU8AyU8SstxU8SstyU16WU16 NO_AXIS_PTS_X 1 UBYTE NO_AXIS_PTS_Y 2 UBYTE AXIS_PTS_X 3 UBYTE INDEX_INCR DIRECT AXIS_PTS_Y 4 UWORD INDEX_INCR DIRECT FNC_VALUES 5 UWORD COLUMN_DIR DIRECT /end RECORD_LAYOUT
/begin RECORD_LAYOUT KfAxU8AyU8SstxU8SstyU8WU8 NO_AXIS_PTS_X 1 UBYTE NO_AXIS_PTS_Y 2 UBYTE AXIS_PTS_X 3 UBYTE INDEX_INCR DIRECT AXIS_PTS_Y 4 UBYTE INDEX_INCR DIRECT FNC_VALUES 5 UBYTE COLUMN_DIR DIRECT /end RECORD_LAYOUT
/begin RECORD_LAYOUT KlAxU8SstxS8WU8 NO_AXIS_PTS_X 1 UBYTE AXIS_PTS_X 2 SBYTE INDEX_INCR DIRECT FNC_VALUES 3 UBYTE COLUMN_DIR DIRECT /end RECORD_LAYOUT
/begin RECORD_LAYOUT KlAxU8SstxU16WS16 NO_AXIS_PTS_X 1 UWORD AXIS_PTS_X 2 UWORD INDEX_INCR DIRECT FNC_VALUES 3 SWORD COLUMN_DIR DIRECT /end RECORD_LAYOUT
/begin RECORD_LAYOUT KlAxU8SstxU16WU16 NO_AXIS_PTS_X 1 UWORD AXIS_PTS_X 2 UWORD INDEX_INCR DIRECT FNC_VALUES 3 UWORD COLUMN_DIR DIRECT /end RECORD_LAYOUT
/begin RECORD_LAYOUT KlAxU8SstxU16WU8 NO_AXIS_PTS_X 1 UWORD AXIS_PTS_X 2 UWORD INDEX_INCR DIRECT FNC_VALUES 3 UBYTE COLUMN_DIR DIRECT /end RECORD_LAYOUT
/begin RECORD_LAYOUT KlAxU8SstxU8WU16 NO_AXIS_PTS_X 1 UBYTE AXIS_PTS_X 2 UBYTE INDEX_INCR DIRECT FNC_VALUES 3 UWORD COLUMN_DIR DIRECT /end RECORD_LAYOUT
/begin RECORD_LAYOUT KlAxU8SstxU8WU8 NO_AXIS_PTS_X 1 UBYTE AXIS_PTS_X 2 UBYTE INDEX_INCR DIRECT FNC_VALUES 3 UBYTE COLUMN_DIR DIRECT /end RECORD_LAYOUT
/begin RECORD_LAYOUT KwUb FNC_VALUES 1 UBYTE COLUMN_DIR DIRECT /end RECORD_LAYOUT
/begin RECORD_LAYOUT KwUw FNC_VALUES 1 UWORD COLUMN_DIR DIRECT /end RECORD_LAYOUT
/begin RECORD_LAYOUT KwWS16 FNC_VALUES 1 SWORD COLUMN_DIR DIRECT /end RECORD_LAYOUT
/begin RECORD_LAYOUT KwWS32 FNC_VALUES 1 SLONG COLUMN_DIR DIRECT /end RECORD_LAYOUT
/begin RECORD_LAYOUT KwWS8 FNC_VALUES 1 SBYTE COLUMN_DIR DIRECT /end RECORD_LAYOUT
/begin RECORD_LAYOUT KwWU1 FNC_VALUES 1 UBYTE COLUMN_DIR DIRECT /end RECORD_LAYOUT
/begin RECORD_LAYOUT KwWU16 FNC_VALUES 1 UWORD COLUMN_DIR DIRECT /end RECORD_LAYOUT
/begin RECORD_LAYOUT KwWU8 FNC_VALUES 1 UBYTE COLUMN_DIR DIRECT /end RECORD_LAYOUT
/begin RECORD_LAYOUT SstAU8SstS8 NO_AXIS_PTS_X 1 SBYTE AXIS_PTS_X 2 SBYTE INDEX_INCR DIRECT /end RECORD_LAYOUT
/begin RECORD_LAYOUT SstAU8SstU16 NO_AXIS_PTS_X 1 UWORD AXIS_PTS_X 2 UWORD INDEX_INCR DIRECT /end RECORD_LAYOUT
/begin RECORD_LAYOUT SstAU8SstU8 NO_AXIS_PTS_X 1 UBYTE AXIS_PTS_X 2 UBYTE INDEX_INCR DIRECT /end RECORD_LAYOUT
/begin RECORD_LAYOUT SstAUbSstUb NO_AXIS_PTS_X 1 UBYTE AXIS_PTS_X 2 UBYTE INDEX_INCR DIRECT /end RECORD_LAYOUT
/begin RECORD_LAYOUT SstAUwSstUw NO_AXIS_PTS_X 1 UWORD AXIS_PTS_X 2 UWORD INDEX_INCR DIRECT /end RECORD_LAYOUT
/begin RECORD_LAYOUT ValA_Wu16 FNC_VALUES 1 UWORD COLUMN_DIR DIRECT /end RECORD_LAYOUT
/begin RECORD_LAYOUT ValA_Wu8 FNC_VALUES 1 UBYTE COLUMN_DIR DIRECT /end RECORD_LAYOUT
/begin RECORD_LAYOUT Val_Ws16 FNC_VALUES 1 SWORD COLUMN_DIR DIRECT /end RECORD_LAYOUT
/begin RECORD_LAYOUT Val_Wu16 FNC_VALUES 1 UWORD COLUMN_DIR DIRECT /end RECORD_LAYOUT
/begin RECORD_LAYOUT Val_Wu8 FNC_VALUES 1 UBYTE COLUMN_DIR DIRECT /end RECORD_LAYOUT
/end MODULE
/end PROJECT
