ASAP2_VERSION 1 4
/begin PROJECT M17955S3CC411_110Y0320 "M17955S3CC411_110Y0320"
/begin HEADER "" VERSION "M17955S3CC411_110Y0320" PROJECT_NO M17955S3CC411_110Y0320 /end HEADER
/begin MODULE DIM ""
/begin MOD_COMMON "" BYTE_ORDER MSB_LAST ALIGNMENT_BYTE 1 ALIGNMENT_WORD 2 ALIGNMENT_LONG 4 ALIGNMENT_FLOAT32_IEEE 4 /end MOD_COMMON
/begin CHARACTERISTIC CWDKS "" VALUE 0x80044314 KwWU8 255.0 dez 0.00 255.0 FORMAT "%5.1" /end CHARACTERISTIC
/begin CHARACTERISTIC DFES_FaultTyp.DFC_TMPmin_C "" VALUE 0x80041A8F Val_Wu8 255.0 DFES_OneToOne 0.00 255.0 FORMAT "%5.1" /end CHARACTERISTIC
/begin CHARACTERISTIC DFES_FaultTyp.DFC_TMPnpl_C "" VALUE 0x80041A90 Val_Wu8 255.0 DFES_OneToOne 0.00 255.0 FORMAT "%5.1" /end CHARACTERISTIC
/begin CHARACTERISTIC DFES_FaultTyp.DFC_TMmax_C "" VALUE 0x80041A91 Val_Wu8 255.0 DFES_OneToOne 0.00 255.0 FORMAT "%5.1" /end CHARACTERISTIC
/begin CHARACTERISTIC DFES_FaultTyp.DFC_TUMmax_C "" VALUE 0x80041A92 Val_Wu8 255.0 DFES_OneToOne 0.00 255.0 FORMAT "%5.1" /end CHARACTERISTIC
/begin CHARACTERISTIC DFES_FaultTyp.DFC_TWCCTrimMaxB1_C "" VALUE 0x80041A93 Val_Wu8 255.0 DFES_OneToOne 0.00 255.0 FORMAT "%5.1" /end CHARACTERISTIC
/begin CHARACTERISTIC DFES_FaultTyp.DFC_TWCCTrimMinB1_C "" VALUE 0x80041A94 Val_Wu8 255.0 DFES_OneToOne 0.00 255.0 FORMAT "%5.1" /end CHARACTERISTIC
/begin CHARACTERISTIC DFES_FaultTyp.DFC_TWCDPriCatB1_C "" VALUE 0x80041A95 Val_Wu8 255.0 DFES_OneToOne 0.00 255.0 FORMAT "%5.1" /end CHARACTERISTIC
/begin CHARACTERISTIC DFES_FaultTyp.DFC_UBRmax_C "" VALUE 0x80041A96 Val_Wu8 255.0 DFES_OneToOne 0.00 255.0 FORMAT "%5.1" /end CHARACTERISTIC
/begin CHARACTERISTIC DFES_FaultTyp.DFC_UBmax_C "" VALUE 0x80041A97 Val_Wu8 255.0 DFES_OneToOne 0.00 255.0 FORMAT "%5.1" /end CHARACTERISTIC
/begin CHARACTERISTIC DFES_FaultTyp.DFC_UBmin_C "" VALUE 0x80041A98 Val_Wu8 255.0 DFES_OneToOne 0.00 255.0 FORMAT "%5.1" /end CHARACTERISTIC
/begin CHARACTERISTIC DFES_FaultTyp.DFC_UBnpl_C "" VALUE 0x80041A99 Val_Wu8 255.0 DFES_OneToOne 0.00 255.0 FORMAT "%5.1" /end CHARACTERISTIC
/begin CHARACTERISTIC DFES_GrpRpr.DFC_Unused_C "" VALUE 0x80041B62 Val_Wu16 211. DFC_Verb 0.00 211. FORMAT "%2.0" READ_ONLY /end CHARACTERISTIC
/begin CHARACTERISTIC DFES_GrpRpr.DFC_AltMaxPwr_C "" VALUE 0x80041B64 Val_Wu16 211. DFC_Verb 0.00 211. FORMAT "%2.0" /end CHARACTERISTIC
/begin CHARACTERISTIC DFES_GrpRpr.DFC_BrkNpl_C "" VALUE 0x80041B66 Val_Wu16 211. DFC_Verb 0.00 211. FORMAT "%2.0" /end CHARACTERISTIC
/begin CHARACTERISTIC DFES_GrpRpr.DFC_Cj930SSp1Mon_C "" VALUE 0x80041B68 Val_Wu16 211. DFC_Verb 0.00 211. FORMAT "%2.0" /end CHARACTERISTIC
/begin CHARACTERISTIC DFES_GrpRpr.DFC_Cj930SSp2Mon_C "" VALUE 0x80041B6A Val_Wu16 211. DFC_Verb 0.00 211. FORMAT "%2.0" /end CHARACTERISTIC
/begin CHARACTERISTIC DFES_GrpRpr.DFC_Cj930SSp3Mon_C "" VALUE 0x80041B6C Val_Wu16 211. DFC_Verb 0.00 211. FORMAT "%2.0" /end CHARACTERISTIC
/begin CHARACTERISTIC DFES_GrpRpr.DFC_IdleChrgActrAMax_C "" VALUE 0x80041B6E Val_Wu16 211. DFC_Verb 0.00 211. FORMAT "%2.0" /end CHARACTERISTIC
/begin CHARACTERISTIC DFES_GrpRpr.DFC_IdleChrgActrAMin_C "" VALUE 0x80041B70 Val_Wu16 211. DFC_Verb 0.00 211. FORMAT "%2.0" /end CHARACTERISTIC
/begin CHARACTERISTIC DFES_GrpRpr.DFC_IdleChrgActrASig_C "" VALUE 0x80041B72 Val_Wu16 211. DFC_Verb 0.00 211. FORMAT "%2.0" /end CHARACTERISTIC
/begin CHARACTERISTIC DFES_GrpRpr.DFC_IdleChrgActrBMax_C "" VALUE 0x80041B74 Val_Wu16 211. DFC_Verb 0.00 211. FORMAT "%2.0" /end CHARACTERISTIC
/begin CHARACTERISTIC DFES_GrpRpr.DFC_IdleChrgActrBMin_C "" VALUE 0x80041B76 Val_Wu16 211. DFC_Verb 0.00 211. FORMAT "%2.0" /end CHARACTERISTIC
/begin CHARACTERISTIC DFES_GrpRpr.DFC_IdleChrgActrBSig_C "" VALUE 0x80041B78 Val_Wu16 211. DFC_Verb 0.00 211. FORMAT "%2.0" /end CHARACTERISTIC
/begin CHARACTERISTIC DFES_GrpRpr.DFC_IdleChrgActrGovDeCold_C "" VALUE 0x80041B7A Val_Wu16 211. DFC_Verb 0.00 211. FORMAT "%2.0" /end CHARACTERISTIC
/begin CHARACTERISTIC DFES_GrpRpr.DFC_IdleChrgActrGovDeMax_C "" VALUE 0x80041B7C Val_Wu16 211. DFC_Verb 0.00 211. FORMAT "%2.0" /end CHARACTERISTIC
/begin CHARACTERISTIC DFES_GrpRpr.DFC_IdleChrgActrGovDeMin_C "" VALUE 0x80041B7E Val_Wu16 211. DFC_Verb 0.00 211. FORMAT "%2.0" /end CHARACTERISTIC
/begin CHARACTERISTIC DFES_GrpRpr.DFC_IdleChrgActrNAMax_C "" VALUE 0x80041B80 Val_Wu16 211. DFC_Verb 0.00 211. FORMAT "%2.0" /end CHARACTERISTIC
/begin CHARACTERISTIC DFES_GrpRpr.DFC_IdleChrgActrNAMin_C "" VALUE 0x80041B82 Val_Wu16 211. DFC_Verb 0.00 211. FORMAT "%2.0" /end CHARACTERISTIC
/begin CHARACTERISTIC DFES_GrpRpr.DFC_IdleChrgActrNASig_C "" VALUE 0x80041B84 Val_Wu16 211. DFC_Verb 0.00 211. FORMAT "%2.0" /end CHARACTERISTIC
/begin CHARACTERISTIC DFES_GrpRpr.DFC_IdleChrgActrNBMax_C "" VALUE 0x80041B86 Val_Wu16 211. DFC_Verb 0.00 211. FORMAT "%2.0" /end CHARACTERISTIC
/begin CHARACTERISTIC DFES_GrpRpr.DFC_IdleChrgActrNBMin_C "" VALUE 0x80041B88 Val_Wu16 211. DFC_Verb 0.00 211. FORMAT "%2.0" /end CHARACTERISTIC
/begin CHARACTERISTIC DFES_GrpRpr.DFC_IdleChrgActrNBSig_C "" VALUE 0x80041B8A Val_Wu16 211. DFC_Verb 0.00 211. FORMAT "%2.0" /end CHARACTERISTIC
/begin CHARACTERISTIC DFES_GrpRpr.DFC_IdleChrgActrOverTmp_C "" VALUE 0x80041B8C Val_Wu16 211. DFC_Verb 0.00 211. FORMAT "%2.0" /end CHARACTERISTIC
/begin CHARACTERISTIC DFES_GrpRpr.DFC_MonUMaxSupply1_C "" VALUE 0x80041B8E Val_Wu16 211. DFC_Verb 0.00 211. FORMAT "%2.0" /end CHARACTERISTIC
/begin CHARACTERISTIC DFES_GrpRpr.DFC_MonUMinSupply1_C "" VALUE 0x80041B90 Val_Wu16 211. DFC_Verb 0.00 211. FORMAT "%2.0" /end CHARACTERISTIC
/begin CHARACTERISTIC DFES_GrpRpr.DFC_ClthNplClsd_C "" VALUE 0x80041B92 Val_Wu16 211. DFC_Verb 0.00 211. FORMAT "%2.0" /end CHARACTERISTIC
/begin CHARACTERISTIC DFES_GrpRpr.DFC_ClthNplOpn_C "" VALUE 0x80041B94 Val_Wu16 211. DFC_Verb 0.00 211. FORMAT "%2.0" /end CHARACTERISTIC
/begin CHARACTERISTIC DFES_GrpRpr.DFC_IgnClPsDevComErr1_C "" VALUE 0x80041B96 Val_Wu16 211. DFC_Verb 0.00 211. FORMAT "%2.0" /end CHARACTERISTIC
/begin CHARACTERISTIC DFES_GrpRpr.DFC_IgnClPsOpenLoad0_C "" VALUE 0x80041B98 Val_Wu16 211. DFC_Verb 0.00 211. FORMAT "%2.0" /end CHARACTERISTIC
/begin CHARACTERISTIC DFES_GrpRpr.DFC_IgnClPsOpenLoad1_C "" VALUE 0x80041B9A Val_Wu16 211. DFC_Verb 0.00 211. FORMAT "%2.0" /end CHARACTERISTIC
/begin CHARACTERISTIC DFES_GrpRpr.DFC_IgnClPsOpenLoad2_C "" VALUE 0x80041B9C Val_Wu16 211. DFC_Verb 0.00 211. FORMAT "%2.0" /end CHARACTERISTIC
/begin CHARACTERISTIC DFES_GrpRpr.DFC_IgnClPsShCirBatt0_C "" VALUE 0x80041B9E Val_Wu16 211. DFC_Verb 0.00 211. FORMAT "%2.0" /end CHARACTERISTIC
/begin CHARACTERISTIC DFES_GrpRpr.DFC_IgnClPsShCirBatt1_C "" VALUE 0x80041BA0 Val_Wu16 211. DFC_Verb 0.00 211. FORMAT "%2.0" /end CHARACTERISTIC
/begin CHARACTERISTIC DFES_GrpRpr.DFC_IgnClPsShCirBatt2_C "" VALUE 0x80041BA2 Val_Wu16 211. DFC_Verb 0.00 211. FORMAT "%2.0" /end CHARACTERISTIC
/begin CHARACTERISTIC DFES_GrpRpr.DFC_IgnClPsShCirGnd0_C "" VALUE 0x80041BA4 Val_Wu16 211. DFC_Verb 0.00 211. FORMAT "%2.0" /end CHARACTERISTIC
/begin CHARACTERISTIC DFES_GrpRpr.DFC_IgnClPsShCirGnd1_C "" VALUE 0x80041BA6 Val_Wu16 211. DFC_Verb 0.00 211. FORMAT "%2.0" /end CHARACTERISTIC
/begin CHARACTERISTIC DFES_GrpRpr.DFC_IgnClPsShCirGnd2_C "" VALUE 0x80041BA8 Val_Wu16 211. DFC_Verb 0.00 211. FORMAT "%2.0" /end CHARACTERISTIC
/begin CHARACTERISTIC DFES_GrpRpr.DFC_KnDetSens1PortAMax_C "" VALUE 0x80041BAA Val_Wu16 211. DFC_Verb 0.00 211. FORMAT "%2.0" /end CHARACTERISTIC
/begin CHARACTERISTIC DFES_GrpRpr.DFC_KnDetSens1PortAMin_C "" VALUE 0x80041BAC Val_Wu16 211. DFC_Verb 0.00 211. FORMAT "%2.0" /end CHARACTERISTIC
/begin CHARACTERISTIC DFES_GrpRpr.DFC_KnDetSens1PortBMax_C "" VALUE 0x80041BAE Val_Wu16 211. DFC_Verb 0.00 211. FORMAT "%2.0" /end CHARACTERISTIC
/begin CHARACTERISTIC DFES_GrpRpr.DFC_KnDetSens1PortBMin_C "" VALUE 0x80041BB0 Val_Wu16 211. DFC_Verb 0.00 211. FORMAT "%2.0" /end CHARACTERISTIC
/begin CHARACTERISTIC DFES_GrpRpr.DFC_VehVWhlErr_C "" VALUE 0x80041BB2 Val_Wu16 211. DFC_Verb 0.00 211. FORMAT "%2.0" /end CHARACTERISTIC
/begin CHARACTERISTIC DFES_GrpRpr.DFC_AirCCmprOL_C "" VALUE 0x80041BB4 Val_Wu16 211. DFC_Verb 0.00 211. FORMAT "%2.0" /end CHARACTERISTIC
/begin CHARACTERISTIC DFES_GrpRpr.DFC_AirCCmprOvrTemp_C "" VALUE 0x80041BB6 Val_Wu16 211. DFC_Verb 0.00 211. FORMAT "%2.0" /end CHARACTERISTIC
/begin CHARACTERISTIC DFES_GrpRpr.DFC_AirCCmprSCB_C "" VALUE 0x80041BB8 Val_Wu16 211. DFC_Verb 0.00 211. FORMAT "%2.0" /end CHARACTERISTIC
/begin CHARACTERISTIC DFES_GrpRpr.DFC_AirCCmprSCG_C "" VALUE 0x80041BBA Val_Wu16 211. DFC_Verb 0.00 211. FORMAT "%2.0" /end CHARACTERISTIC
/begin CHARACTERISTIC DFES_GrpRpr.DFC_AltIOLdSRCMin_C "" VALUE 0x80041BBC Val_Wu16 211. DFC_Verb 0.00 211. FORMAT "%2.0" /end CHARACTERISTIC
/begin CHARACTERISTIC DFES_GrpRpr.DFC_AltIOOL_C "" VALUE 0x80041BBE Val_Wu16 211. DFC_Verb 0.00 211. FORMAT "%2.0" /end CHARACTERISTIC
/begin CHARACTERISTIC DFES_GrpRpr.DFC_AltIOOvrTemp_C "" VALUE 0x80041BC0 Val_Wu16 211. DFC_Verb 0.00 211. FORMAT "%2.0" /end CHARACTERISTIC
/begin CHARACTERISTIC DFES_GrpRpr.DFC_AltIOSCB_C "" VALUE 0x80041BC2 Val_Wu16 211. DFC_Verb 0.00 211. FORMAT "%2.0" /end CHARACTERISTIC
/begin CHARACTERISTIC DFES_GrpRpr.DFC_AltIOSCG_C "" VALUE 0x80041BC4 Val_Wu16 211. DFC_Verb 0.00 211. FORMAT "%2.0" /end CHARACTERISTIC
/begin CHARACTERISTIC DFES_GrpRpr.DFC_DevLibBattUHi_C "" VALUE 0x80041BC6 Val_Wu16 211. DFC_Verb 0.00 211. FORMAT "%2.0" /end CHARACTERISTIC
/begin CHARACTERISTIC DFES_GrpRpr.DFC_DevLibBattULo_C "" VALUE 0x80041BC8 Val_Wu16 211. DFC_Verb 0.00 211. FORMAT "%2.0" /end CHARACTERISTIC
/begin CHARACTERISTIC DFES_GrpRpr.DFC_FanDIOOL_C "" VALUE 0x80041BCA Val_Wu16 211. DFC_Verb 0.00 211. FORMAT "%2.0" /end CHARACTERISTIC
/begin CHARACTERISTIC DFES_GrpRpr.DFC_FanDIOOvrTemp_C "" VALUE 0x80041BCC Val_Wu16 211. DFC_Verb 0.00 211. FORMAT "%2.0" /end CHARACTERISTIC
/begin CHARACTERISTIC DFES_GrpRpr.DFC_FanDIOSCB_C "" VALUE 0x80041BCE Val_Wu16 211. DFC_Verb 0.00 211. FORMAT "%2.0" /end CHARACTERISTIC
/begin CHARACTERISTIC DFES_GrpRpr.DFC_FanDIOSCG_C "" VALUE 0x80041BD0 Val_Wu16 211. DFC_Verb 0.00 211. FORMAT "%2.0" /end CHARACTERISTIC
/begin CHARACTERISTIC DFES_GrpRpr.DFC_FanPWMOL_C "" VALUE 0x80041BD2 Val_Wu16 211. DFC_Verb 0.00 211. FORMAT "%2.0" /end CHARACTERISTIC
/begin CHARACTERISTIC DFES_GrpRpr.DFC_FanPWMOvrTemp_C "" VALUE 0x80041BD4 Val_Wu16 211. DFC_Verb 0.00 211. FORMAT "%2.0" /end CHARACTERISTIC
/begin CHARACTERISTIC DFES_GrpRpr.DFC_FanPWMSCB_C "" VALUE 0x80041BD6 Val_Wu16 211. DFC_Verb 0.00 211. FORMAT "%2.0" /end CHARACTERISTIC
/begin CHARACTERISTIC DFES_GrpRpr.DFC_FanPWMSCG_C "" VALUE 0x80041BD8 Val_Wu16 211. DFC_Verb 0.00 211. FORMAT "%2.0" /end CHARACTERISTIC
/begin CHARACTERISTIC DFES_GrpRpr.DFC_AirCClntPAnaSRCMax_C "" VALUE 0x80041BDA Val_Wu16 211. DFC_Verb 0.00 211. FORMAT "%2.0" /end CHARACTERISTIC
/begin CHARACTERISTIC DFES_GrpRpr.DFC_AirCClntPAnaSRCMin_C "" VALUE 0x80041BDC Val_Wu16 211. DFC_Verb 0.00 211. FORMAT "%2.0" /end CHARACTERISTIC
/begin CHARACTERISTIC DFES_GrpRpr.DFC_AirCSwtNpl_C "" VALUE 0x80041BDE Val_Wu16 211. DFC_Verb 0.00 211. FORMAT "%2.0" /end CHARACTERISTIC
/begin CHARACTERISTIC DFES_GrpRpr.DFC_AirCSwtSig_C "" VALUE 0x80041BE0 Val_Wu16 211. DFC_Verb 0.00 211. FORMAT "%2.0" /end CHARACTERISTIC
/begin CHARACTERISTIC DFES_GrpRpr.DFC_AltIOLdSRCMax_C "" VALUE 0x80041BE2 Val_Wu16 211. DFC_Verb 0.00 211. FORMAT "%2.0" /end CHARACTERISTIC
/begin CHARACTERISTIC DFES_GrpRpr.DFC_BrkSig_C "" VALUE 0x80041BE4 Val_Wu16 211. DFC_Verb 0.00 211. FORMAT "%2.0" /end CHARACTERISTIC
/begin CHARACTERISTIC DFES_GrpRpr.DFC_ClthEPBNpl_C "" VALUE 0x80041BE6 Val_Wu16 211. DFC_Verb 0.00 211. FORMAT "%2.0" /end CHARACTERISTIC
/begin CHARACTERISTIC DFES_GrpRpr.DFC_ClthEPBSensErr_C "" VALUE 0x80041BE8 Val_Wu16 211. DFC_Verb 0.00 211. FORMAT "%2.0" /end CHARACTERISTIC
/begin CHARACTERISTIC DFES_GrpRpr.DFC_ClthErr_C "" VALUE 0x80041BEA Val_Wu16 211. DFC_Verb 0.00 211. FORMAT "%2.0" /end CHARACTERISTIC
/begin CHARACTERISTIC DFES_GrpRpr.DFC_ClthSig_C "" VALUE 0x80041BEC Val_Wu16 211. DFC_Verb 0.00 211. FORMAT "%2.0" /end CHARACTERISTIC
/begin CHARACTERISTIC DFES_GrpRpr.DFC_MILLmpOL_C "" VALUE 0x80041BEE Val_Wu16 211. DFC_Verb 0.00 211. FORMAT "%2.0" /end CHARACTERISTIC
/begin CHARACTERISTIC DFES_GrpRpr.DFC_MILLmpSCB_C "" VALUE 0x80041BF0 Val_Wu16 211. DFC_Verb 0.00 211. FORMAT "%2.0" /end CHARACTERISTIC
/begin CHARACTERISTIC DFES_GrpRpr.DFC_MILLmpSCG_C "" VALUE 0x80041BF2 Val_Wu16 211. DFC_Verb 0.00 211. FORMAT "%2.0" /end CHARACTERISTIC
/begin CHARACTERISTIC DFES_GrpRpr.DFC_SRCHighAPP1_C "" VALUE 0x80041BF4 Val_Wu16 211. DFC_Verb 0.00 211. FORMAT "%2.0" /end CHARACTERISTIC
/begin CHARACTERISTIC DFES_GrpRpr.DFC_SRCHighAPP2_C "" VALUE 0x80041BF6 Val_Wu16 211. DFC_Verb 0.00 211. FORMAT "%2.0" /end CHARACTERISTIC
/begin CHARACTERISTIC DFES_GrpRpr.DFC_SRCLowAPP1_C "" VALUE 0x80041BF8 Val_Wu16 211. DFC_Verb 0.00 211. FORMAT "%2.0" /end CHARACTERISTIC
/begin CHARACTERISTIC DFES_GrpRpr.DFC_SRCLowAPP2_C "" VALUE 0x80041BFA Val_Wu16 211. DFC_Verb 0.00 211. FORMAT "%2.0" /end CHARACTERISTIC
/begin CHARACTERISTIC DFES_GrpRpr.DFC_SyncAPP_C "" VALUE 0x80041BFC Val_Wu16 211. DFC_Verb 0.00 211. FORMAT "%2.0" /end CHARACTERISTIC
/begin CHARACTERISTIC DFES_GrpRpr.DFC_VehVMax_C "" VALUE 0x80041BFE Val_Wu16 211. DFC_Verb 0.00 211. FORMAT "%2.0" /end CHARACTERISTIC
/begin CHARACTERISTIC DFES_GrpRpr.DFC_VehVPlaus_C "" VALUE 0x80041C00 Val_Wu16 211. DFC_Verb 0.00 211. FORMAT "%2.0" /end CHARACTERISTIC
/begin CHARACTERISTIC DFES_GrpRpr.DFC_VehVSig_C "" VALUE 0x80041C02 Val_Wu16 211. DFC_Verb 0.00 211. FORMAT "%2.0" /end CHARACTERISTIC
/begin CHARACTERISTIC DFES_GrpRpr.DFC_BusDiagBusOffNodeA_C "" VALUE 0x80041C04 Val_Wu16 211. DFC_Verb 0.00 211. FORMAT "%2.0" /end CHARACTERISTIC
/begin CHARACTERISTIC DFES_GrpRpr.DFC_ComACSensTO_C "" VALUE 0x80041C06 Val_Wu16 211. DFC_Verb 0.00 211. FORMAT "%2.0" /end CHARACTERISTIC
/begin CHARACTERISTIC DFES_GrpRpr.DFC_ComAWD1TO_C "" VALUE 0x80041C08 Val_Wu16 211. DFC_Verb 0.00 211. FORMAT "%2.0" /end CHARACTERISTIC
/begin CHARACTERISTIC DFES_GrpRpr.DFC_ComBRK10TO_C "" VALUE 0x80041C0A Val_Wu16 211. DFC_Verb 0.00 211. FORMAT "%2.0" /end CHARACTERISTIC
/begin CHARACTERISTIC DFES_GrpRpr.DFC_ComGW11TO_C "" VALUE 0x80041C0C Val_Wu16 211. DFC_Verb 0.00 211. FORMAT "%2.0" /end CHARACTERISTIC
/begin CHARACTERISTIC DFES_GrpRpr.DFC_ComLVL1TO_C "" VALUE 0x80041C0E Val_Wu16 211. DFC_Verb 0.00 211. FORMAT "%2.0" /end CHARACTERISTIC
/begin CHARACTERISTIC DFES_GrpRpr.DFC_ComPRKA01TO_C "" VALUE 0x80041C10 Val_Wu16 211. DFC_Verb 0.00 211. FORMAT "%2.0" /end CHARACTERISTIC
/begin CHARACTERISTIC DFES_GrpRpr.DFC_ComPRKH01TO_C "" VALUE 0x80041C12 Val_Wu16 211. DFC_Verb 0.00 211. FORMAT "%2.0" /end CHARACTERISTIC
/begin CHARACTERISTIC DFES_GrpRpr.DFC_ComPRKH1TO_C "" VALUE 0x80041C14 Val_Wu16 211. DFC_Verb 0.00 211. FORMAT "%2.0" /end CHARACTERISTIC
/begin CHARACTERISTIC DFES_GrpRpr.DFC_ComTRBCH1TO_C "" VALUE 0x80041C16 Val_Wu16 211. DFC_Verb 0.00 211. FORMAT "%2.0" /end CHARACTERISTIC
/begin CHARACTERISTIC DFES_GrpRpr.DFC_ComTRBCH2TO_C "" VALUE 0x80041C18 Val_Wu16 211. DFC_Verb 0.00 211. FORMAT "%2.0" /end CHARACTERISTIC
/begin CHARACTERISTIC DFES_GrpRpr.DFC_DK_C "" VALUE 0x80041C1A Val_Wu16 211. DFC_Verb 0.00 211. FORMAT "%2.0" /end CHARACTERISTIC
/begin CHARACTERISTIC DFES_GrpRpr.DFC_DKRSA_C "" VALUE 0x80041C1C Val_Wu16 211. DFC_Verb 0.00 211. FORMAT "%2.0" /end CHARACTERISTIC
/begin CHARACTERISTIC DFES_GrpRpr.DFC_DKVSmax_C "" VALUE 0x80041C1E Val_Wu16 211. DFC_Verb 0.00 211. FORMAT "%2.0" /end CHARACTERISTIC
/begin CHARACTERISTIC DFES_GrpRpr.DFC_DKmax_C "" VALUE 0x80041C20 Val_Wu16 211. DFC_Verb 0.00 211. FORMAT "%2.0" /end CHARACTERISTIC
/begin CHARACTERISTIC DFES_GrpRpr.DFC_DKmin_C "" VALUE 0x80041C22 Val_Wu16 211. DFC_Verb 0.00 211. FORMAT "%2.0" /end CHARACTERISTIC
/begin CHARACTERISTIC DFES_GrpRpr.DFC_DSSmax_C "" VALUE 0x80041C24 Val_Wu16 211. DFC_Verb 0.00 211. FORMAT "%2.0" /end CHARACTERISTIC
/begin CHARACTERISTIC DFES_GrpRpr.DFC_EEPEraseErr_C "" VALUE 0x80041C26 Val_Wu16 211. DFC_Verb 0.00 211. FORMAT "%2.0" /end CHARACTERISTIC
/begin CHARACTERISTIC DFES_GrpRpr.DFC_EEPRdErr_C "" VALUE 0x80041C28 Val_Wu16 211. DFC_Verb 0.00 211. FORMAT "%2.0" /end CHARACTERISTIC
/begin CHARACTERISTIC DFES_GrpRpr.DFC_EEPWrErr_C "" VALUE 0x80041C2A Val_Wu16 211. DFC_Verb 0.00 211. FORMAT "%2.0" /end CHARACTERISTIC
/begin CHARACTERISTIC DFES_GrpRpr.DFC_EV1max_C "" VALUE 0x80041C2C Val_Wu16 211. DFC_Verb 0.00 211. FORMAT "%2.0" /end CHARACTERISTIC
/begin CHARACTERISTIC DFES_GrpRpr.DFC_EV1min_C "" VALUE 0x80041C2E Val_Wu16 211. DFC_Verb 0.00 211. FORMAT "%2.0" /end CHARACTERISTIC
/begin CHARACTERISTIC DFES_GrpRpr.DFC_EV1sig_C "" VALUE 0x80041C30 Val_Wu16 211. DFC_Verb 0.00 211. FORMAT "%2.0" /end CHARACTERISTIC
/begin CHARACTERISTIC DFES_GrpRpr.DFC_EV2max_C "" VALUE 0x80041C32 Val_Wu16 211. DFC_Verb 0.00 211. FORMAT "%2.0" /end CHARACTERISTIC
/begin CHARACTERISTIC DFES_GrpRpr.DFC_EV2min_C "" VALUE 0x80041C34 Val_Wu16 211. DFC_Verb 0.00 211. FORMAT "%2.0" /end CHARACTERISTIC
/begin CHARACTERISTIC DFES_GrpRpr.DFC_EV2sig_C "" VALUE 0x80041C36 Val_Wu16 211. DFC_Verb 0.00 211. FORMAT "%2.0" /end CHARACTERISTIC
/begin CHARACTERISTIC DFES_GrpRpr.DFC_EV3max_C "" VALUE 0x80041C38 Val_Wu16 211. DFC_Verb 0.00 211. FORMAT "%2.0" /end CHARACTERISTIC
/begin CHARACTERISTIC DFES_GrpRpr.DFC_EV3min_C "" VALUE 0x80041C3A Val_Wu16 211. DFC_Verb 0.00 211. FORMAT "%2.0" /end CHARACTERISTIC
/begin CHARACTERISTIC DFES_GrpRpr.DFC_EV3sig_C "" VALUE 0x80041C3C Val_Wu16 211. DFC_Verb 0.00 211. FORMAT "%2.0" /end CHARACTERISTIC
/begin CHARACTERISTIC DFES_GrpRpr.DFC_EpmCaSI1ErrSig_C "" VALUE 0x80041C3E Val_Wu16 211. DFC_Verb 0.00 211. FORMAT "%2.0" /end CHARACTERISTIC
/begin CHARACTERISTIC DFES_GrpRpr.DFC_EpmCaSI1NoSig_C "" VALUE 0x80041C40 Val_Wu16 211. DFC_Verb 0.00 211. FORMAT "%2.0" /end CHARACTERISTIC
/begin CHARACTERISTIC DFES_GrpRpr.DFC_EpmCaSI1NoSigMax_C "" VALUE 0x80041C42 Val_Wu16 211. DFC_Verb 0.00 211. FORMAT "%2.0" /end CHARACTERISTIC
/begin CHARACTERISTIC DFES_GrpRpr.DFC_EpmCaSI1NoSigMin_C "" VALUE 0x80041C44 Val_Wu16 211. DFC_Verb 0.00 211. FORMAT "%2.0" /end CHARACTERISTIC
/begin CHARACTERISTIC DFES_GrpRpr.DFC_EpmCaSI1OfsErr_C "" VALUE 0x80041C46 Val_Wu16 211. DFC_Verb 0.00 211. FORMAT "%2.0" /end CHARACTERISTIC
/begin CHARACTERISTIC DFES_GrpRpr.DFC_EpmCrSErrSig_C "" VALUE 0x80041C48 Val_Wu16 211. DFC_Verb 0.00 211. FORMAT "%2.0" /end CHARACTERISTIC
/begin CHARACTERISTIC DFES_GrpRpr.DFC_EpmCrSNoSig_C "" VALUE 0x80041C4A Val_Wu16 211. DFC_Verb 0.00 211. FORMAT "%2.0" /end CHARACTERISTIC
/begin CHARACTERISTIC DFES_GrpRpr.DFC_FRAmax_C "" VALUE 0x80041C4C Val_Wu16 211. DFC_Verb 0.00 211. FORMAT "%2.0" /end CHARACTERISTIC
/begin CHARACTERISTIC DFES_GrpRpr.DFC_FRAmin_C "" VALUE 0x80041C4E Val_Wu16 211. DFC_Verb 0.00 211. FORMAT "%2.0" /end CHARACTERISTIC
/begin CHARACTERISTIC DFES_GrpRpr.DFC_HEGOS1B1ElecMax_C "" VALUE 0x80041C50 Val_Wu16 211. DFC_Verb 0.00 211. FORMAT "%2.0" /end CHARACTERISTIC
/begin CHARACTERISTIC DFES_GrpRpr.DFC_HEGOS1B1ElecMin_C "" VALUE 0x80041C52 Val_Wu16 211. DFC_Verb 0.00 211. FORMAT "%2.0" /end CHARACTERISTIC
/begin CHARACTERISTIC DFES_GrpRpr.DFC_HEGOS1B1ElecNpl_C "" VALUE 0x80041C54 Val_Wu16 211. DFC_Verb 0.00 211. FORMAT "%2.0" /end CHARACTERISTIC
/begin CHARACTERISTIC DFES_GrpRpr.DFC_HEGOS1B1ElecSig_C "" VALUE 0x80041C56 Val_Wu16 211. DFC_Verb 0.00 211. FORMAT "%2.0" /end CHARACTERISTIC
/begin CHARACTERISTIC DFES_GrpRpr.DFC_HEGOS1B1HtgNpl_C "" VALUE 0x80041C58 Val_Wu16 211. DFC_Verb 0.00 211. FORMAT "%2.0" /end CHARACTERISTIC
/begin CHARACTERISTIC DFES_GrpRpr.DFC_HEGOS1B1HtrPsMax_C "" VALUE 0x80041C5A Val_Wu16 211. DFC_Verb 0.00 211. FORMAT "%2.0" /end CHARACTERISTIC
/begin CHARACTERISTIC DFES_GrpRpr.DFC_HEGOS1B1HtrPsMin_C "" VALUE 0x80041C5C Val_Wu16 211. DFC_Verb 0.00 211. FORMAT "%2.0" /end CHARACTERISTIC
/begin CHARACTERISTIC DFES_GrpRpr.DFC_HEGOS1B1HtrPsSig_C "" VALUE 0x80041C5E Val_Wu16 211. DFC_Verb 0.00 211. FORMAT "%2.0" /end CHARACTERISTIC
/begin CHARACTERISTIC DFES_GrpRpr.DFC_HEGOS1B1StkMax_C "" VALUE 0x80041C60 Val_Wu16 211. DFC_Verb 0.00 211. FORMAT "%2.0" /end CHARACTERISTIC
/begin CHARACTERISTIC DFES_GrpRpr.DFC_HEGOS1B1StkMin_C "" VALUE 0x80041C62 Val_Wu16 211. DFC_Verb 0.00 211. FORMAT "%2.0" /end CHARACTERISTIC
/begin CHARACTERISTIC DFES_GrpRpr.DFC_HEGOS2B1RstrcnLean_C "" VALUE 0x80041C64 Val_Wu16 211. DFC_Verb 0.00 211. FORMAT "%2.0" /end CHARACTERISTIC
/begin CHARACTERISTIC DFES_GrpRpr.DFC_HEGOS2B1RstrcnRich_C "" VALUE 0x80041C66 Val_Wu16 211. DFC_Verb 0.00 211. FORMAT "%2.0" /end CHARACTERISTIC
/begin CHARACTERISTIC DFES_GrpRpr.DFC_IdleChrgActrJamVlvClsd_C "" VALUE 0x80041C68 Val_Wu16 211. DFC_Verb 0.00 211. FORMAT "%2.0" /end CHARACTERISTIC
/begin CHARACTERISTIC DFES_GrpRpr.DFC_IdleChrgActrJamVlvOpn_C "" VALUE 0x80041C6A Val_Wu16 211. DFC_Verb 0.00 211. FORMAT "%2.0" /end CHARACTERISTIC
/begin CHARACTERISTIC DFES_GrpRpr.DFC_IgnClPsDevOscErr1_C "" VALUE 0x80041C6C Val_Wu16 211. DFC_Verb 0.00 211. FORMAT "%2.0" /end CHARACTERISTIC
/begin CHARACTERISTIC DFES_GrpRpr.DFC_KPEmax_C "" VALUE 0x80041C6E Val_Wu16 211. DFC_Verb 0.00 211. FORMAT "%2.0" /end CHARACTERISTIC
/begin CHARACTERISTIC DFES_GrpRpr.DFC_KPEmin_C "" VALUE 0x80041C70 Val_Wu16 211. DFC_Verb 0.00 211. FORMAT "%2.0" /end CHARACTERISTIC
/begin CHARACTERISTIC DFES_GrpRpr.DFC_KPEsig_C "" VALUE 0x80041C72 Val_Wu16 211. DFC_Verb 0.00 211. FORMAT "%2.0" /end CHARACTERISTIC
/begin CHARACTERISTIC DFES_GrpRpr.DFC_KS1max_C "" VALUE 0x80041C74 Val_Wu16 211. DFC_Verb 0.00 211. FORMAT "%2.0" /end CHARACTERISTIC
/begin CHARACTERISTIC DFES_GrpRpr.DFC_KS1min_C "" VALUE 0x80041C76 Val_Wu16 211. DFC_Verb 0.00 211. FORMAT "%2.0" /end CHARACTERISTIC
/begin CHARACTERISTIC DFES_GrpRpr.DFC_LLRKHmax_C "" VALUE 0x80041C78 Val_Wu16 211. DFC_Verb 0.00 211. FORMAT "%2.0" /end CHARACTERISTIC
/begin CHARACTERISTIC DFES_GrpRpr.DFC_LLRKHmin_C "" VALUE 0x80041C7A Val_Wu16 211. DFC_Verb 0.00 211. FORMAT "%2.0" /end CHARACTERISTIC
/begin CHARACTERISTIC DFES_GrpRpr.DFC_LLRKHnpl_C "" VALUE 0x80041C7C Val_Wu16 211. DFC_Verb 0.00 211. FORMAT "%2.0" /end CHARACTERISTIC
/begin CHARACTERISTIC DFES_GrpRpr.DFC_LLRmax_C "" VALUE 0x80041C7E Val_Wu16 211. DFC_Verb 0.00 211. FORMAT "%2.0" /end CHARACTERISTIC
/begin CHARACTERISTIC DFES_GrpRpr.DFC_LLRmin_C "" VALUE 0x80041C80 Val_Wu16 211. DFC_Verb 0.00 211. FORMAT "%2.0" /end CHARACTERISTIC
/begin CHARACTERISTIC DFES_GrpRpr.DFC_LLRnpl_C "" VALUE 0x80041C82 Val_Wu16 211. DFC_Verb 0.00 211. FORMAT "%2.0" /end CHARACTERISTIC
/begin CHARACTERISTIC DFES_GrpRpr.DFC_LMmax_C "" VALUE 0x80041C84 Val_Wu16 211. DFC_Verb 0.00 211. FORMAT "%2.0" /end CHARACTERISTIC
/begin CHARACTERISTIC DFES_GrpRpr.DFC_LZSRnpl_C "" VALUE 0x80041C86 Val_Wu16 211. DFC_Verb 0.00 211. FORMAT "%2.0" /end CHARACTERISTIC
/begin CHARACTERISTIC DFES_GrpRpr.DFC_MD_C "" VALUE 0x80041C88 Val_Wu16 211. DFC_Verb 0.00 211. FORMAT "%2.0" /end CHARACTERISTIC
/begin CHARACTERISTIC DFES_GrpRpr.DFC_MD00min_C "" VALUE 0x80041C8A Val_Wu16 211. DFC_Verb 0.00 211. FORMAT "%2.0" /end CHARACTERISTIC
/begin CHARACTERISTIC DFES_GrpRpr.DFC_MD00npl_C "" VALUE 0x80041C8C Val_Wu16 211. DFC_Verb 0.00 211. FORMAT "%2.0" /end CHARACTERISTIC
/begin CHARACTERISTIC DFES_GrpRpr.DFC_MD01min_C "" VALUE 0x80041C8E Val_Wu16 211. DFC_Verb 0.00 211. FORMAT "%2.0" /end CHARACTERISTIC
/begin CHARACTERISTIC DFES_GrpRpr.DFC_MD01npl_C "" VALUE 0x80041C90 Val_Wu16 211. DFC_Verb 0.00 211. FORMAT "%2.0" /end CHARACTERISTIC
/begin CHARACTERISTIC DFES_GrpRpr.DFC_MD02min_C "" VALUE 0x80041C92 Val_Wu16 211. DFC_Verb 0.00 211. FORMAT "%2.0" /end CHARACTERISTIC
/begin CHARACTERISTIC DFES_GrpRpr.DFC_MD02npl_C "" VALUE 0x80041C94 Val_Wu16 211. DFC_Verb 0.00 211. FORMAT "%2.0" /end CHARACTERISTIC
/begin CHARACTERISTIC DFES_GrpRpr.DFC_MD03min_C "" VALUE 0x80041C96 Val_Wu16 211. DFC_Verb 0.00 211. FORMAT "%2.0" /end CHARACTERISTIC
/begin CHARACTERISTIC DFES_GrpRpr.DFC_MD03npl_C "" VALUE 0x80041C98 Val_Wu16 211. DFC_Verb 0.00 211. FORMAT "%2.0" /end CHARACTERISTIC
/begin CHARACTERISTIC DFES_GrpRpr.DFC_MD04min_C "" VALUE 0x80041C9A Val_Wu16 211. DFC_Verb 0.00 211. FORMAT "%2.0" /end CHARACTERISTIC
/begin CHARACTERISTIC DFES_GrpRpr.DFC_MD04npl_C "" VALUE 0x80041C9C Val_Wu16 211. DFC_Verb 0.00 211. FORMAT "%2.0" /end CHARACTERISTIC
/begin CHARACTERISTIC DFES_GrpRpr.DFC_MDCyl_0_C "" VALUE 0x80041C9E Val_Wu16 211. DFC_Verb 0.00 211. FORMAT "%2.0" /end CHARACTERISTIC
/begin CHARACTERISTIC DFES_GrpRpr.DFC_MDCyl_1_C "" VALUE 0x80041CA0 Val_Wu16 211. DFC_Verb 0.00 211. FORMAT "%2.0" /end CHARACTERISTIC
/begin CHARACTERISTIC DFES_GrpRpr.DFC_MDCyl_2_C "" VALUE 0x80041CA2 Val_Wu16 211. DFC_Verb 0.00 211. FORMAT "%2.0" /end CHARACTERISTIC
/begin CHARACTERISTIC DFES_GrpRpr.DFC_MDFC_C "" VALUE 0x80041CA4 Val_Wu16 211. DFC_Verb 0.00 211. FORMAT "%2.0" /end CHARACTERISTIC
/begin CHARACTERISTIC DFES_GrpRpr.DFC_MDmin_C "" VALUE 0x80041CA6 Val_Wu16 211. DFC_Verb 0.00 211. FORMAT "%2.0" /end CHARACTERISTIC
/begin CHARACTERISTIC DFES_GrpRpr.DFC_MDnpl_C "" VALUE 0x80041CA8 Val_Wu16 211. DFC_Verb 0.00 211. FORMAT "%2.0" /end CHARACTERISTIC
/begin CHARACTERISTIC DFES_GrpRpr.DFC_MoCADCNTP_C "" VALUE 0x80041CAA Val_Wu16 211. DFC_Verb 0.00 211. FORMAT "%2.0" /end CHARACTERISTIC
/begin CHARACTERISTIC DFES_GrpRpr.DFC_MoCADCTst_C "" VALUE 0x80041CAC Val_Wu16 211. DFC_Verb 0.00 211. FORMAT "%2.0" /end CHARACTERISTIC
/begin CHARACTERISTIC DFES_GrpRpr.DFC_MoCComctErrMM_C "" VALUE 0x80041CAE Val_Wu16 211. DFC_Verb 0.00 211. FORMAT "%2.0" /end CHARACTERISTIC
/begin CHARACTERISTIC DFES_GrpRpr.DFC_OCWDAActv_C "" VALUE 0x80041CB0 Val_Wu16 211. DFC_Verb 0.00 211. FORMAT "%2.0" /end CHARACTERISTIC
/begin CHARACTERISTIC DFES_GrpRpr.DFC_OCWDACom_C "" VALUE 0x80041CB2 Val_Wu16 211. DFC_Verb 0.00 211. FORMAT "%2.0" /end CHARACTERISTIC
/begin CHARACTERISTIC DFES_GrpRpr.DFC_ORAmax_C "" VALUE 0x80041CB4 Val_Wu16 211. DFC_Verb 0.00 211. FORMAT "%2.0" /end CHARACTERISTIC
/begin CHARACTERISTIC DFES_GrpRpr.DFC_ORAmin_C "" VALUE 0x80041CB6 Val_Wu16 211. DFC_Verb 0.00 211. FORMAT "%2.0" /end CHARACTERISTIC
/begin CHARACTERISTIC DFES_GrpRpr.DFC_PSR1max_C "" VALUE 0x80041CB8 Val_Wu16 211. DFC_Verb 0.00 211. FORMAT "%2.0" /end CHARACTERISTIC
/begin CHARACTERISTIC DFES_GrpRpr.DFC_PSRBmax_C "" VALUE 0x80041CBA Val_Wu16 211. DFC_Verb 0.00 211. FORMAT "%2.0" /end CHARACTERISTIC
/begin CHARACTERISTIC DFES_GrpRpr.DFC_PSRBmin_C "" VALUE 0x80041CBC Val_Wu16 211. DFC_Verb 0.00 211. FORMAT "%2.0" /end CHARACTERISTIC
/begin CHARACTERISTIC DFES_GrpRpr.DFC_PSREmax_C "" VALUE 0x80041CBE Val_Wu16 211. DFC_Verb 0.00 211. FORMAT "%2.0" /end CHARACTERISTIC
/begin CHARACTERISTIC DFES_GrpRpr.DFC_PSREmin_C "" VALUE 0x80041CC0 Val_Wu16 211. DFC_Verb 0.00 211. FORMAT "%2.0" /end CHARACTERISTIC
/begin CHARACTERISTIC DFES_GrpRpr.DFC_PSRPmax_C "" VALUE 0x80041CC2 Val_Wu16 211. DFC_Verb 0.00 211. FORMAT "%2.0" /end CHARACTERISTIC
/begin CHARACTERISTIC DFES_GrpRpr.DFC_PSRPmin_C "" VALUE 0x80041CC4 Val_Wu16 211. DFC_Verb 0.00 211. FORMAT "%2.0" /end CHARACTERISTIC
/begin CHARACTERISTIC DFES_GrpRpr.DFC_PSRPsig_C "" VALUE 0x80041CC6 Val_Wu16 211. DFC_Verb 0.00 211. FORMAT "%2.0" /end CHARACTERISTIC
/begin CHARACTERISTIC DFES_GrpRpr.DFC_PSRmax_C "" VALUE 0x80041CC8 Val_Wu16 211. DFC_Verb 0.00 211. FORMAT "%2.0" /end CHARACTERISTIC
/begin CHARACTERISTIC DFES_GrpRpr.DFC_SSpMon1_C "" VALUE 0x80041CCA Val_Wu16 211. DFC_Verb 0.00 211. FORMAT "%2.0" /end CHARACTERISTIC
/begin CHARACTERISTIC DFES_GrpRpr.DFC_SSpMon2_C "" VALUE 0x80041CCC Val_Wu16 211. DFC_Verb 0.00 211. FORMAT "%2.0" /end CHARACTERISTIC
/begin CHARACTERISTIC DFES_GrpRpr.DFC_SSpMon3_C "" VALUE 0x80041CCE Val_Wu16 211. DFC_Verb 0.00 211. FORMAT "%2.0" /end CHARACTERISTIC
/begin CHARACTERISTIC DFES_GrpRpr.DFC_SWReset_0_C "" VALUE 0x80041CD0 Val_Wu16 211. DFC_Verb 0.00 211. FORMAT "%2.0" /end CHARACTERISTIC
/begin CHARACTERISTIC DFES_GrpRpr.DFC_SWReset_1_C "" VALUE 0x80041CD2 Val_Wu16 211. DFC_Verb 0.00 211. FORMAT "%2.0" /end CHARACTERISTIC
/begin CHARACTERISTIC DFES_GrpRpr.DFC_SWReset_2_C "" VALUE 0x80041CD4 Val_Wu16 211. DFC_Verb 0.00 211. FORMAT "%2.0" /end CHARACTERISTIC
/begin CHARACTERISTIC DFES_GrpRpr.DFC_TASREmax_C "" VALUE 0x80041CD6 Val_Wu16 211. DFC_Verb 0.00 211. FORMAT "%2.0" /end CHARACTERISTIC
/begin CHARACTERISTIC DFES_GrpRpr.DFC_TASREmin_C "" VALUE 0x80041CD8 Val_Wu16 211. DFC_Verb 0.00 211. FORMAT "%2.0" /end CHARACTERISTIC
/begin CHARACTERISTIC DFES_GrpRpr.DFC_TASREnpl_C "" VALUE 0x80041CDA Val_Wu16 211. DFC_Verb 0.00 211. FORMAT "%2.0" /end CHARACTERISTIC
/begin CHARACTERISTIC DFES_GrpRpr.DFC_TASRmax_C "" VALUE 0x80041CDC Val_Wu16 211. DFC_Verb 0.00 211. FORMAT "%2.0" /end CHARACTERISTIC
/begin CHARACTERISTIC DFES_GrpRpr.DFC_TAmax_C "" VALUE 0x80041CDE Val_Wu16 211. DFC_Verb 0.00 211. FORMAT "%2.0" /end CHARACTERISTIC
/begin CHARACTERISTIC DFES_GrpRpr.DFC_TEVEmax_C "" VALUE 0x80041CE0 Val_Wu16 211. DFC_Verb 0.00 211. FORMAT "%2.0" /end CHARACTERISTIC
/begin CHARACTERISTIC DFES_GrpRpr.DFC_TEVEmin_C "" VALUE 0x80041CE2 Val_Wu16 211. DFC_Verb 0.00 211. FORMAT "%2.0" /end CHARACTERISTIC
/begin CHARACTERISTIC DFES_GrpRpr.DFC_TEVEsig_C "" VALUE 0x80041CE4 Val_Wu16 211. DFC_Verb 0.00 211. FORMAT "%2.0" /end CHARACTERISTIC
/begin CHARACTERISTIC DFES_GrpRpr.DFC_TMCSmax_C "" VALUE 0x80041CE6 Val_Wu16 211. DFC_Verb 0.00 211. FORMAT "%2.0" /end CHARACTERISTIC
/begin CHARACTERISTIC DFES_GrpRpr.DFC_TMCSmin_C "" VALUE 0x80041CE8 Val_Wu16 211. DFC_Verb 0.00 211. FORMAT "%2.0" /end CHARACTERISTIC
/begin CHARACTERISTIC DFES_GrpRpr.DFC_TMEmax_C "" VALUE 0x80041CEA Val_Wu16 211. DFC_Verb 0.00 211. FORMAT "%2.0" /end CHARACTERISTIC
/begin CHARACTERISTIC DFES_GrpRpr.DFC_TMEmin_C "" VALUE 0x80041CEC Val_Wu16 211. DFC_Verb 0.00 211. FORMAT "%2.0" /end CHARACTERISTIC
/begin CHARACTERISTIC DFES_GrpRpr.DFC_TMEnpl_C "" VALUE 0x80041CEE Val_Wu16 211. DFC_Verb 0.00 211. FORMAT "%2.0" /end CHARACTERISTIC
/begin CHARACTERISTIC DFES_GrpRpr.DFC_TMEsig_C "" VALUE 0x80041CF0 Val_Wu16 211. DFC_Verb 0.00 211. FORMAT "%2.0" /end CHARACTERISTIC
/begin CHARACTERISTIC DFES_GrpRpr.DFC_TMPmax_C "" VALUE 0x80041CF2 Val_Wu16 211. DFC_Verb 0.00 211. FORMAT "%2.0" /end CHARACTERISTIC
/begin CHARACTERISTIC DFES_GrpRpr.DFC_TMPmin_C "" VALUE 0x80041CF4 Val_Wu16 211. DFC_Verb 0.00 211. FORMAT "%2.0" /end CHARACTERISTIC
/begin CHARACTERISTIC DFES_GrpRpr.DFC_TMPnpl_C "" VALUE 0x80041CF6 Val_Wu16 211. DFC_Verb 0.00 211. FORMAT "%2.0" /end CHARACTERISTIC
/begin CHARACTERISTIC DFES_GrpRpr.DFC_TMmax_C "" VALUE 0x80041CF8 Val_Wu16 211. DFC_Verb 0.00 211. FORMAT "%2.0" /end CHARACTERISTIC
/begin CHARACTERISTIC DFES_GrpRpr.DFC_TUMmax_C "" VALUE 0x80041CFA Val_Wu16 211. DFC_Verb 0.00 211. FORMAT "%2.0" /end CHARACTERISTIC
/begin CHARACTERISTIC DFES_GrpRpr.DFC_TWCCTrimMaxB1_C "" VALUE 0x80041CFC Val_Wu16 211. DFC_Verb 0.00 211. FORMAT "%2.0" /end CHARACTERISTIC
/begin CHARACTERISTIC DFES_GrpRpr.DFC_TWCCTrimMinB1_C "" VALUE 0x80041CFE Val_Wu16 211. DFC_Verb 0.00 211. FORMAT "%2.0" /end CHARACTERISTIC
/begin CHARACTERISTIC DFES_GrpRpr.DFC_TWCDPriCatB1_C "" VALUE 0x80041D00 Val_Wu16 211. DFC_Verb 0.00 211. FORMAT "%2.0" /end CHARACTERISTIC
/begin CHARACTERISTIC DFES_GrpRpr.DFC_UBRmax_C "" VALUE 0x80041D02 Val_Wu16 211. DFC_Verb 0.00 211. FORMAT "%2.0" /end CHARACTERISTIC
/begin CHARACTERISTIC DFES_GrpRpr.DFC_UBmax_C "" VALUE 0x80041D04 Val_Wu16 211. DFC_Verb 0.00 211. FORMAT "%2.0" /end CHARACTERISTIC
/begin CHARACTERISTIC DFES_GrpRpr.DFC_UBmin_C "" VALUE 0x80041D06 Val_Wu16 211. DFC_Verb 0.00 211. FORMAT "%2.0" /end CHARACTERISTIC
/begin CHARACTERISTIC DFES_GrpRpr.DFC_UBnpl_C "" VALUE 0x80041D08 Val_Wu16 211. DFC_Verb 0.00 211. FORMAT "%2.0" /end CHARACTERISTIC
/begin CHARACTERISTIC DFES_MonEvtMSK0_C "" VALUE 0x800403EE Val_Wu16 65535.00 OneToOne 0.00 65535.00 FORMAT "%8.2" /end CHARACTERISTIC
/begin CHARACTERISTIC DFES_MonEvtMSK1_C "" VALUE 0x800403F0 Val_Wu16 65535.00 OneToOne 0.00 65535.00 FORMAT "%8.2" /end CHARACTERISTIC
/begin CHARACTERISTIC DFES_MonRepeat_C "" VALUE 0x800403F2 Val_Wu8 255.0 OneToOne 0.00 255.0 FORMAT "%5.1" /end CHARACTERISTIC
/begin CHARACTERISTIC DFES_numClsDlt_CA "" VAL_BLK 0x800403F3 ValA_Wu8 255.0 DFES_OneToOne 0.00 255.0 FORMAT "%5.1" NUMBER 20 /end CHARACTERISTIC
/begin CHARACTERISTIC DFES_numClsFaultCycl_CA "" VAL_BLK 0x80040407 ValA_Wu8 255.0 DFES_OneToOne 0.00 255.0 FORMAT "%5.1" NUMBER 20 /end CHARACTERISTIC
/begin CHARACTERISTIC DFES_numClsHealCycl_CA "" VAL_BLK 0x8004041B ValA_Wu8 255.0 DFES_OneToOne 0.00 255.0 FORMAT "%5.1" NUMBER 20 /end CHARACTERISTIC
/begin CHARACTERISTIC DFES_numClsPndDlt_CA "" VAL_BLK 0x8004042F ValA_Wu8 255.0 DFES_OneToOne 0.00 255.0 FORMAT "%5.1" NUMBER 20 /end CHARACTERISTIC
/begin CHARACTERISTIC DFES_numClsSvcDlt_CA "" VAL_BLK 0x80040443 ValA_Wu8 255.0 DFES_OneToOne 0.00 255.0 FORMAT "%5.1" NUMBER 20 /end CHARACTERISTIC
/begin CHARACTERISTIC DFES_numClsSVSFaultCycl_CA "" VAL_BLK 0x80040457 ValA_Wu8 255.0 DFES_OneToOne 0.00 255.0 FORMAT "%5.1" NUMBER 20 /end CHARACTERISTIC
/begin CHARACTERISTIC DFES_numClsSVSHealCycl_CA "" VAL_BLK 0x8004046B ValA_Wu8 255.0 DFES_OneToOne 0.00 255.0 FORMAT "%5.1" NUMBER 20 /end CHARACTERISTIC
/begin CHARACTERISTIC DFES_ThresSimCond.t_C "" VALUE 0x80040480 Val_Wu8 255.0 DFES_tPID05 -40.00 215.0 FORMAT "%5.1" /end CHARACTERISTIC
/begin CHARACTERISTIC DFES_ThresSimCond.r_C "" VALUE 0x80040481 Val_Wu8 100.0 DFES_rPID04 0.00 100.0 FORMAT "%5.1" /end CHARACTERISTIC
/begin CHARACTERISTIC DFES_ThresSimCond.n_C "" VALUE 0x80040482 Val_Wu16 16383.75 DFES_nPID0C 0.00 16383.75 FORMAT "%8.2" /end CHARACTERISTIC
/begin CHARACTERISTIC DFES_xAsgnExtdFrzFrSig_CA "" VAL_BLK 0x80040484 ValA_Wu16 59.0000000000 Signals_IntSigNumVerb 0.00 59.0000000000 FORMAT "%13.10" NUMBER 1 /end CHARACTERISTIC
/begin CHARACTERISTIC DFES_xAsgnFrzFrSig_CA "" VAL_BLK 0x80040486 ValA_Wu16 59.0000000000 Signals_IntSigNumVerb 0.00 59.0000000000 FORMAT "%13.10" NUMBER 18 /end CHARACTERISTIC
/begin CHARACTERISTIC DFES_xClsDltTrg_CA "" VAL_BLK 0x800404AA ValA_Wu8 8. DSMAUX_DTRGVerb 0.00 8. FORMAT "%2.0" NUMBER 20 /end CHARACTERISTIC
/begin CHARACTERISTIC DFES_xClsFaultTrg_CA "" VAL_BLK 0x800404BE ValA_Wu8 8. DSMAUX_DTRGVerb 0.00 8. FORMAT "%2.0" NUMBER 20 /end CHARACTERISTIC
/begin CHARACTERISTIC DFES_xClsFltMIL_CA "" VAL_BLK 0x800404D2 ValA_Wu8 8.00000000000 DFES_LampFlt 0.00 8.00000000000 FORMAT "%13.11" NUMBER 20 /end CHARACTERISTIC
/begin CHARACTERISTIC DFES_xClsFltSVS_CA "" VAL_BLK 0x800404E6 ValA_Wu8 8.00000000000 DFES_LampFlt 0.00 8.00000000000 FORMAT "%13.11" NUMBER 20 /end CHARACTERISTIC
/begin CHARACTERISTIC DFES_xClsHealTrg_CA "" VAL_BLK 0x800404FA ValA_Wu8 8. DSMAUX_DTRGVerb 0.00 8. FORMAT "%2.0" NUMBER 20 /end CHARACTERISTIC
/begin CHARACTERISTIC DFES_xClsPndDltTrg_CA "" VAL_BLK 0x8004050E ValA_Wu8 8. DSMAUX_DTRGVerb 0.00 8. FORMAT "%2.0" NUMBER 20 /end CHARACTERISTIC
/begin CHARACTERISTIC DFES_xClsPrio_CA "" VAL_BLK 0x80040522 ValA_Wu8 228.000000000 DFES_TstVisAndPrio 4.00000000000 232.000000000 FORMAT "%13.9" NUMBER 20 /end CHARACTERISTIC
/begin CHARACTERISTIC DFES_xClsSvcDltTrg_CA "" VAL_BLK 0x80040536 ValA_Wu8 8. DSMAUX_DTRGVerb 0.00 8. FORMAT "%2.0" NUMBER 20 /end CHARACTERISTIC
/begin CHARACTERISTIC DFES_xClsSVSFaultTrg_CA "" VAL_BLK 0x8004054A ValA_Wu8 8. DSMAUX_DTRGVerb 0.00 8. FORMAT "%2.0" NUMBER 20 /end CHARACTERISTIC
/begin CHARACTERISTIC DFES_xClsSVSHealTrg_CA "" VAL_BLK 0x8004055E ValA_Wu8 8. DSMAUX_DTRGVerb 0.00 8. FORMAT "%2.0" NUMBER 20 /end CHARACTERISTIC
/begin CHARACTERISTIC Diag_stOBDPtcol_C "" VALUE 0x8004BC6A Val_Wu8 3.00000000000 Diag_OBDPtcol_Val 0.00 3.00000000000 FORMAT "%13.11" /end CHARACTERISTIC
/begin CHARACTERISTIC DINH_FId.DFC_AltMaxPwr_CA "" VAL_BLK 0x80040572 ValA_Wu16 125. DINH_FIdVerb 0.00 125. FORMAT "%2.0" NUMBER 2 /end CHARACTERISTIC
/begin CHARACTERISTIC DINH_FId.DFC_BrkNpl_CA "" VAL_BLK 0x80040576 ValA_Wu16 125. DINH_FIdVerb 0.00 125. FORMAT "%2.0" NUMBER 2 /end CHARACTERISTIC
/begin CHARACTERISTIC DINH_FId.DFC_Cj930SSp1Mon_CA "" VAL_BLK 0x8004057A ValA_Wu16 125. DINH_FIdVerb 0.00 125. FORMAT "%2.0" NUMBER 2 /end CHARACTERISTIC
/begin CHARACTERISTIC DINH_FId.DFC_Cj930SSp2Mon_CA "" VAL_BLK 0x8004057E ValA_Wu16 125. DINH_FIdVerb 0.00 125. FORMAT "%2.0" NUMBER 2 /end CHARACTERISTIC
/begin CHARACTERISTIC DINH_FId.DFC_Cj930SSp3Mon_CA "" VAL_BLK 0x80040582 ValA_Wu16 125. DINH_FIdVerb 0.00 125. FORMAT "%2.0" NUMBER 2 /end CHARACTERISTIC
/begin CHARACTERISTIC DINH_FId.DFC_IdleChrgActrAMax_CA "" VAL_BLK 0x80040586 ValA_Wu16 125. DINH_FIdVerb 0.00 125. FORMAT "%2.0" NUMBER 3 /end CHARACTERISTIC
/begin CHARACTERISTIC DINH_FId.DFC_IdleChrgActrAMin_CA "" VAL_BLK 0x8004058C ValA_Wu16 125. DINH_FIdVerb 0.00 125. FORMAT "%2.0" NUMBER 3 /end CHARACTERISTIC
/begin CHARACTERISTIC DINH_FId.DFC_IdleChrgActrASig_CA "" VAL_BLK 0x80040592 ValA_Wu16 125. DINH_FIdVerb 0.00 125. FORMAT "%2.0" NUMBER 3 /end CHARACTERISTIC
/begin CHARACTERISTIC DINH_FId.DFC_IdleChrgActrBMax_CA "" VAL_BLK 0x80040598 ValA_Wu16 125. DINH_FIdVerb 0.00 125. FORMAT "%2.0" NUMBER 3 /end CHARACTERISTIC
/begin CHARACTERISTIC DINH_FId.DFC_IdleChrgActrBMin_CA "" VAL_BLK 0x8004059E ValA_Wu16 125. DINH_FIdVerb 0.00 125. FORMAT "%2.0" NUMBER 3 /end CHARACTERISTIC
/begin CHARACTERISTIC DINH_FId.DFC_IdleChrgActrBSig_CA "" VAL_BLK 0x800405A4 ValA_Wu16 125. DINH_FIdVerb 0.00 125. FORMAT "%2.0" NUMBER 3 /end CHARACTERISTIC
/begin CHARACTERISTIC DINH_FId.DFC_IdleChrgActrGovDeCold_CA "" VAL_BLK 0x800405AA ValA_Wu16 125. DINH_FIdVerb 0.00 125. FORMAT "%2.0" NUMBER 3 /end CHARACTERISTIC
/begin CHARACTERISTIC DINH_FId.DFC_IdleChrgActrGovDeMax_CA "" VAL_BLK 0x800405B0 ValA_Wu16 125. DINH_FIdVerb 0.00 125. FORMAT "%2.0" NUMBER 3 /end CHARACTERISTIC
/begin CHARACTERISTIC DINH_FId.DFC_IdleChrgActrGovDeMin_CA "" VAL_BLK 0x800405B6 ValA_Wu16 125. DINH_FIdVerb 0.00 125. FORMAT "%2.0" NUMBER 3 /end CHARACTERISTIC
/begin CHARACTERISTIC DINH_FId.DFC_IdleChrgActrNAMax_CA "" VAL_BLK 0x800405BC ValA_Wu16 125. DINH_FIdVerb 0.00 125. FORMAT "%2.0" NUMBER 3 /end CHARACTERISTIC
/begin CHARACTERISTIC DINH_FId.DFC_IdleChrgActrNAMin_CA "" VAL_BLK 0x800405C2 ValA_Wu16 125. DINH_FIdVerb 0.00 125. FORMAT "%2.0" NUMBER 3 /end CHARACTERISTIC
/begin CHARACTERISTIC DINH_FId.DFC_IdleChrgActrNASig_CA "" VAL_BLK 0x800405C8 ValA_Wu16 125. DINH_FIdVerb 0.00 125. FORMAT "%2.0" NUMBER 3 /end CHARACTERISTIC
/begin CHARACTERISTIC DINH_FId.DFC_IdleChrgActrNBMax_CA "" VAL_BLK 0x800405CE ValA_Wu16 125. DINH_FIdVerb 0.00 125. FORMAT "%2.0" NUMBER 3 /end CHARACTERISTIC
/begin CHARACTERISTIC DINH_FId.DFC_IdleChrgActrNBMin_CA "" VAL_BLK 0x800405D4 ValA_Wu16 125. DINH_FIdVerb 0.00 125. FORMAT "%2.0" NUMBER 3 /end CHARACTERISTIC
/begin CHARACTERISTIC DINH_FId.DFC_IdleChrgActrNBSig_CA "" VAL_BLK 0x800405DA ValA_Wu16 125. DINH_FIdVerb 0.00 125. FORMAT "%2.0" NUMBER 3 /end CHARACTERISTIC
/begin CHARACTERISTIC DINH_FId.DFC_IdleChrgActrOverTmp_CA "" VAL_BLK 0x800405E0 ValA_Wu16 125. DINH_FIdVerb 0.00 125. FORMAT "%2.0" NUMBER 3 /end CHARACTERISTIC
/begin CHARACTERISTIC DINH_FId.DFC_MonUMaxSupply1_CA "" VAL_BLK 0x800405E6 ValA_Wu16 125. DINH_FIdVerb 0.00 125. FORMAT "%2.0" NUMBER 2 /end CHARACTERISTIC
/begin CHARACTERISTIC DINH_FId.DFC_MonUMinSupply1_CA "" VAL_BLK 0x800405EA ValA_Wu16 125. DINH_FIdVerb 0.00 125. FORMAT "%2.0" NUMBER 2 /end CHARACTERISTIC
/begin CHARACTERISTIC DINH_FId.DFC_ClthNplClsd_CA "" VAL_BLK 0x800405EE ValA_Wu16 125. DINH_FIdVerb 0.00 125. FORMAT "%2.0" NUMBER 4 /end CHARACTERISTIC
/begin CHARACTERISTIC DINH_FId.DFC_ClthNplOpn_CA "" VAL_BLK 0x800405F6 ValA_Wu16 125. DINH_FIdVerb 0.00 125. FORMAT "%2.0" NUMBER 4 /end CHARACTERISTIC
/begin CHARACTERISTIC DINH_FId.DFC_IgnClPsDevComErr1_CA "" VAL_BLK 0x800405FE ValA_Wu16 125. DINH_FIdVerb 0.00 125. FORMAT "%2.0" NUMBER 2 /end CHARACTERISTIC
/begin CHARACTERISTIC DINH_FId.DFC_IgnClPsOpenLoad0_CA "" VAL_BLK 0x80040602 ValA_Wu16 125. DINH_FIdVerb 0.00 125. FORMAT "%2.0" NUMBER 2 /end CHARACTERISTIC
/begin CHARACTERISTIC DINH_FId.DFC_IgnClPsOpenLoad1_CA "" VAL_BLK 0x80040606 ValA_Wu16 125. DINH_FIdVerb 0.00 125. FORMAT "%2.0" NUMBER 2 /end CHARACTERISTIC
/begin CHARACTERISTIC DINH_FId.DFC_IgnClPsOpenLoad2_CA "" VAL_BLK 0x8004060A ValA_Wu16 125. DINH_FIdVerb 0.00 125. FORMAT "%2.0" NUMBER 2 /end CHARACTERISTIC
/begin CHARACTERISTIC DINH_FId.DFC_IgnClPsShCirBatt0_CA "" VAL_BLK 0x8004060E ValA_Wu16 125. DINH_FIdVerb 0.00 125. FORMAT "%2.0" NUMBER 2 /end CHARACTERISTIC
/begin CHARACTERISTIC DINH_FId.DFC_IgnClPsShCirBatt1_CA "" VAL_BLK 0x80040612 ValA_Wu16 125. DINH_FIdVerb 0.00 125. FORMAT "%2.0" NUMBER 2 /end CHARACTERISTIC
/begin CHARACTERISTIC DINH_FId.DFC_IgnClPsShCirBatt2_CA "" VAL_BLK 0x80040616 ValA_Wu16 125. DINH_FIdVerb 0.00 125. FORMAT "%2.0" NUMBER 2 /end CHARACTERISTIC
/begin CHARACTERISTIC DINH_FId.DFC_IgnClPsShCirGnd0_CA "" VAL_BLK 0x8004061A ValA_Wu16 125. DINH_FIdVerb 0.00 125. FORMAT "%2.0" NUMBER 2 /end CHARACTERISTIC
/begin CHARACTERISTIC DINH_FId.DFC_IgnClPsShCirGnd1_CA "" VAL_BLK 0x8004061E ValA_Wu16 125. DINH_FIdVerb 0.00 125. FORMAT "%2.0" NUMBER 2 /end CHARACTERISTIC
/begin CHARACTERISTIC DINH_FId.DFC_IgnClPsShCirGnd2_CA "" VAL_BLK 0x80040622 ValA_Wu16 125. DINH_FIdVerb 0.00 125. FORMAT "%2.0" NUMBER 2 /end CHARACTERISTIC
/begin CHARACTERISTIC DINH_FId.DFC_KnDetSens1PortAMax_CA "" VAL_BLK 0x80040626 ValA_Wu16 125. DINH_FIdVerb 0.00 125. FORMAT "%2.0" NUMBER 4 /end CHARACTERISTIC
/begin CHARACTERISTIC DINH_FId.DFC_KnDetSens1PortAMin_CA "" VAL_BLK 0x8004062E ValA_Wu16 125. DINH_FIdVerb 0.00 125. FORMAT "%2.0" NUMBER 4 /end CHARACTERISTIC
/begin CHARACTERISTIC DINH_FId.DFC_KnDetSens1PortBMax_CA "" VAL_BLK 0x80040636 ValA_Wu16 125. DINH_FIdVerb 0.00 125. FORMAT "%2.0" NUMBER 4 /end CHARACTERISTIC
/begin CHARACTERISTIC DINH_FId.DFC_KnDetSens1PortBMin_CA "" VAL_BLK 0x8004063E ValA_Wu16 125. DINH_FIdVerb 0.00 125. FORMAT "%2.0" NUMBER 4 /end CHARACTERISTIC
/begin CHARACTERISTIC DINH_FId.DFC_VehVWhlErr_CA "" VAL_BLK 0x80040646 ValA_Wu16 125. DINH_FIdVerb 0.00 125. FORMAT "%2.0" NUMBER 4 /end CHARACTERISTIC
/begin CHARACTERISTIC DINH_FId.DFC_AirCCmprOL_CA "" VAL_BLK 0x8004064E ValA_Wu16 125. DINH_FIdVerb 0.00 125. FORMAT "%2.0" NUMBER 2 /end CHARACTERISTIC
/begin CHARACTERISTIC DINH_FId.DFC_AirCCmprOvrTemp_CA "" VAL_BLK 0x80040652 ValA_Wu16 125. DINH_FIdVerb 0.00 125. FORMAT "%2.0" NUMBER 2 /end CHARACTERISTIC
/begin CHARACTERISTIC DINH_FId.DFC_AirCCmprSCB_CA "" VAL_BLK 0x80040656 ValA_Wu16 125. DINH_FIdVerb 0.00 125. FORMAT "%2.0" NUMBER 2 /end CHARACTERISTIC
/begin CHARACTERISTIC DINH_FId.DFC_AirCCmprSCG_CA "" VAL_BLK 0x8004065A ValA_Wu16 125. DINH_FIdVerb 0.00 125. FORMAT "%2.0" NUMBER 2 /end CHARACTERISTIC
/begin CHARACTERISTIC DINH_FId.DFC_AltIOLdSRCMin_CA "" VAL_BLK 0x8004065E ValA_Wu16 125. DINH_FIdVerb 0.00 125. FORMAT "%2.0" NUMBER 4 /end CHARACTERISTIC
/begin CHARACTERISTIC DINH_FId.DFC_AltIOOL_CA "" VAL_BLK 0x80040666 ValA_Wu16 125. DINH_FIdVerb 0.00 125. FORMAT "%2.0" NUMBER 2 /end CHARACTERISTIC
/begin CHARACTERISTIC DINH_FId.DFC_AltIOOvrTemp_CA "" VAL_BLK 0x8004066A ValA_Wu16 125. DINH_FIdVerb 0.00 125. FORMAT "%2.0" NUMBER 2 /end CHARACTERISTIC
/begin CHARACTERISTIC DINH_FId.DFC_AltIOSCB_CA "" VAL_BLK 0x8004066E ValA_Wu16 125. DINH_FIdVerb 0.00 125. FORMAT "%2.0" NUMBER 2 /end CHARACTERISTIC
/begin CHARACTERISTIC DINH_FId.DFC_AltIOSCG_CA "" VAL_BLK 0x80040672 ValA_Wu16 125. DINH_FIdVerb 0.00 125. FORMAT "%2.0" NUMBER 2 /end CHARACTERISTIC
/begin CHARACTERISTIC DINH_FId.DFC_DevLibBattUHi_CA "" VAL_BLK 0x80040676 ValA_Wu16 125. DINH_FIdVerb 0.00 125. FORMAT "%2.0" NUMBER 2 /end CHARACTERISTIC
/begin CHARACTERISTIC DINH_FId.DFC_DevLibBattULo_CA "" VAL_BLK 0x8004067A ValA_Wu16 125. DINH_FIdVerb 0.00 125. FORMAT "%2.0" NUMBER 2 /end CHARACTERISTIC
/begin CHARACTERISTIC DINH_FId.DFC_FanDIOOL_CA "" VAL_BLK 0x8004067E ValA_Wu16 125. DINH_FIdVerb 0.00 125. FORMAT "%2.0" NUMBER 3 /end CHARACTERISTIC
/begin CHARACTERISTIC DINH_FId.DFC_FanDIOOvrTemp_CA "" VAL_BLK 0x80040684 ValA_Wu16 125. DINH_FIdVerb 0.00 125. FORMAT "%2.0" NUMBER 2 /end CHARACTERISTIC
/begin CHARACTERISTIC DINH_FId.DFC_FanDIOSCB_CA "" VAL_BLK 0x80040688 ValA_Wu16 125. DINH_FIdVerb 0.00 125. FORMAT "%2.0" NUMBER 3 /end CHARACTERISTIC
/begin CHARACTERISTIC DINH_FId.DFC_FanDIOSCG_CA "" VAL_BLK 0x8004068E ValA_Wu16 125. DINH_FIdVerb 0.00 125. FORMAT "%2.0" NUMBER 3 /end CHARACTERISTIC
/begin CHARACTERISTIC DINH_FId.DFC_FanPWMOL_CA "" VAL_BLK 0x80040694 ValA_Wu16 125. DINH_FIdVerb 0.00 125. FORMAT "%2.0" NUMBER 2 /end CHARACTERISTIC
/begin CHARACTERISTIC DINH_FId.DFC_FanPWMOvrTemp_CA "" VAL_BLK 0x80040698 ValA_Wu16 125. DINH_FIdVerb 0.00 125. FORMAT "%2.0" NUMBER 2 /end CHARACTERISTIC
/begin CHARACTERISTIC DINH_FId.DFC_FanPWMSCB_CA "" VAL_BLK 0x8004069C ValA_Wu16 125. DINH_FIdVerb 0.00 125. FORMAT "%2.0" NUMBER 2 /end CHARACTERISTIC
/begin CHARACTERISTIC DINH_FId.DFC_FanPWMSCG_CA "" VAL_BLK 0x800406A0 ValA_Wu16 125. DINH_FIdVerb 0.00 125. FORMAT "%2.0" NUMBER 2 /end CHARACTERISTIC
/begin CHARACTERISTIC DINH_FId.DFC_AirCClntPAnaSRCMax_CA "" VAL_BLK 0x800406A4 ValA_Wu16 125. DINH_FIdVerb 0.00 125. FORMAT "%2.0" NUMBER 5 /end CHARACTERISTIC
/begin CHARACTERISTIC DINH_FId.DFC_AirCClntPAnaSRCMin_CA "" VAL_BLK 0x800406AE ValA_Wu16 125. DINH_FIdVerb 0.00 125. FORMAT "%2.0" NUMBER 5 /end CHARACTERISTIC
/begin CHARACTERISTIC DINH_FId.DFC_AirCSwtNpl_CA "" VAL_BLK 0x800406B8 ValA_Wu16 125. DINH_FIdVerb 0.00 125. FORMAT "%2.0" NUMBER 3 /end CHARACTERISTIC
/begin CHARACTERISTIC DINH_FId.DFC_AirCSwtSig_CA "" VAL_BLK 0x800406BE ValA_Wu16 125. DINH_FIdVerb 0.00 125. FORMAT "%2.0" NUMBER 3 /end CHARACTERISTIC
/begin CHARACTERISTIC DINH_FId.DFC_AltIOLdSRCMax_CA "" VAL_BLK 0x800406C4 ValA_Wu16 125. DINH_FIdVerb 0.00 125. FORMAT "%2.0" NUMBER 4 /end CHARACTERISTIC
/begin CHARACTERISTIC DINH_FId.DFC_BrkSig_CA "" VAL_BLK 0x800406CC ValA_Wu16 125. DINH_FIdVerb 0.00 125. FORMAT "%2.0" NUMBER 2 /end CHARACTERISTIC
/begin CHARACTERISTIC DINH_FId.DFC_ClthEPBNpl_CA "" VAL_BLK 0x800406D0 ValA_Wu16 125. DINH_FIdVerb 0.00 125. FORMAT "%2.0" NUMBER 3 /end CHARACTERISTIC
/begin CHARACTERISTIC DINH_FId.DFC_ClthEPBSensErr_CA "" VAL_BLK 0x800406D6 ValA_Wu16 125. DINH_FIdVerb 0.00 125. FORMAT "%2.0" NUMBER 4 /end CHARACTERISTIC
/begin CHARACTERISTIC DINH_FId.DFC_ClthErr_CA "" VAL_BLK 0x800406DE ValA_Wu16 125. DINH_FIdVerb 0.00 125. FORMAT "%2.0" NUMBER 2 /end CHARACTERISTIC
/begin CHARACTERISTIC DINH_FId.DFC_ClthSig_Enf_CA "" VAL_BLK 0x800406E2 ValA_Wu16 125. DINH_FIdVerb 0.00 125. FORMAT "%2.0" NUMBER 3 /end CHARACTERISTIC
/begin CHARACTERISTIC DINH_FId.DFC_ClthSig_CA "" VAL_BLK 0x800406E8 ValA_Wu16 125. DINH_FIdVerb 0.00 125. FORMAT "%2.0" NUMBER 3 /end CHARACTERISTIC
/begin CHARACTERISTIC DINH_FId.DFC_MILLmpOL_CA "" VAL_BLK 0x800406EE ValA_Wu16 125. DINH_FIdVerb 0.00 125. FORMAT "%2.0" NUMBER 2 /end CHARACTERISTIC
/begin CHARACTERISTIC DINH_FId.DFC_MILLmpSCB_CA "" VAL_BLK 0x800406F2 ValA_Wu16 125. DINH_FIdVerb 0.00 125. FORMAT "%2.0" NUMBER 2 /end CHARACTERISTIC
/begin CHARACTERISTIC DINH_FId.DFC_MILLmpSCG_CA "" VAL_BLK 0x800406F6 ValA_Wu16 125. DINH_FIdVerb 0.00 125. FORMAT "%2.0" NUMBER 2 /end CHARACTERISTIC
/begin CHARACTERISTIC DINH_FId.DFC_SRCHighAPP1_CA "" VAL_BLK 0x800406FA ValA_Wu16 125. DINH_FIdVerb 0.00 125. FORMAT "%2.0" NUMBER 3 /end CHARACTERISTIC
/begin CHARACTERISTIC DINH_FId.DFC_SRCHighAPP2_CA "" VAL_BLK 0x80040700 ValA_Wu16 125. DINH_FIdVerb 0.00 125. FORMAT "%2.0" NUMBER 3 /end CHARACTERISTIC
/begin CHARACTERISTIC DINH_FId.DFC_SRCLowAPP1_CA "" VAL_BLK 0x80040706 ValA_Wu16 125. DINH_FIdVerb 0.00 125. FORMAT "%2.0" NUMBER 2 /end CHARACTERISTIC
/begin CHARACTERISTIC DINH_FId.DFC_SRCLowAPP2_CA "" VAL_BLK 0x8004070A ValA_Wu16 125. DINH_FIdVerb 0.00 125. FORMAT "%2.0" NUMBER 2 /end CHARACTERISTIC
/begin CHARACTERISTIC DINH_FId.DFC_SyncAPP_CA "" VAL_BLK 0x8004070E ValA_Wu16 125. DINH_FIdVerb 0.00 125. FORMAT "%2.0" NUMBER 4 /end CHARACTERISTIC
/begin CHARACTERISTIC DINH_FId.DFC_VehVMax_CA "" VAL_BLK 0x80040716 ValA_Wu16 125. DINH_FIdVerb 0.00 125. FORMAT "%2.0" NUMBER 21 /end CHARACTERISTIC
/begin CHARACTERISTIC DINH_FId.DFC_VehVPlaus_CA "" VAL_BLK 0x80040740 ValA_Wu16 125. DINH_FIdVerb 0.00 125. FORMAT "%2.0" NUMBER 21 /end CHARACTERISTIC
/begin CHARACTERISTIC DINH_FId.DFC_VehVSig_CA "" VAL_BLK 0x8004076A ValA_Wu16 125. DINH_FIdVerb 0.00 125. FORMAT "%2.0" NUMBER 20 /end CHARACTERISTIC
/begin CHARACTERISTIC DINH_FId.DFC_BusDiagBusOffNodeA_CA "" VAL_BLK 0x80040792 ValA_Wu16 125. DINH_FIdVerb 0.00 125. FORMAT "%2.0" NUMBER 4 /end CHARACTERISTIC
/begin CHARACTERISTIC DINH_FId.DFC_ComACSensTO_CA "" VAL_BLK 0x8004079A ValA_Wu16 125. DINH_FIdVerb 0.00 125. FORMAT "%2.0" NUMBER 2 /end CHARACTERISTIC
/begin CHARACTERISTIC DINH_FId.DFC_ComAWD1TO_CA "" VAL_BLK 0x8004079E ValA_Wu16 125. DINH_FIdVerb 0.00 125. FORMAT "%2.0" NUMBER 2 /end CHARACTERISTIC
/begin CHARACTERISTIC DINH_FId.DFC_ComBRK10TO_CA "" VAL_BLK 0x800407A2 ValA_Wu16 125. DINH_FIdVerb 0.00 125. FORMAT "%2.0" NUMBER 2 /end CHARACTERISTIC
/begin CHARACTERISTIC DINH_FId.DFC_ComGW11TO_CA "" VAL_BLK 0x800407A6 ValA_Wu16 125. DINH_FIdVerb 0.00 125. FORMAT "%2.0" NUMBER 2 /end CHARACTERISTIC
/begin CHARACTERISTIC DINH_FId.DFC_ComLVL1TO_CA "" VAL_BLK 0x800407AA ValA_Wu16 125. DINH_FIdVerb 0.00 125. FORMAT "%2.0" NUMBER 2 /end CHARACTERISTIC
/begin CHARACTERISTIC DINH_FId.DFC_ComPRKA01TO_CA "" VAL_BLK 0x800407AE ValA_Wu16 125. DINH_FIdVerb 0.00 125. FORMAT "%2.0" NUMBER 2 /end CHARACTERISTIC
/begin CHARACTERISTIC DINH_FId.DFC_ComPRKH01TO_CA "" VAL_BLK 0x800407B2 ValA_Wu16 125. DINH_FIdVerb 0.00 125. FORMAT "%2.0" NUMBER 2 /end CHARACTERISTIC
/begin CHARACTERISTIC DINH_FId.DFC_ComPRKH1TO_CA "" VAL_BLK 0x800407B6 ValA_Wu16 125. DINH_FIdVerb 0.00 125. FORMAT "%2.0" NUMBER 2 /end CHARACTERISTIC
/begin CHARACTERISTIC DINH_FId.DFC_ComTRBCH1TO_CA "" VAL_BLK 0x800407BA ValA_Wu16 125. DINH_FIdVerb 0.00 125. FORMAT "%2.0" NUMBER 2 /end CHARACTERISTIC
/begin CHARACTERISTIC DINH_FId.DFC_ComTRBCH2TO_CA "" VAL_BLK 0x800407BE ValA_Wu16 125. DINH_FIdVerb 0.00 125. FORMAT "%2.0" NUMBER 2 /end CHARACTERISTIC
/begin CHARACTERISTIC DINH_FId.DFC_DK_CA "" VAL_BLK 0x800407C2 ValA_Wu16 125. DINH_FIdVerb 0.00 125. FORMAT "%2.0" NUMBER 11 /end CHARACTERISTIC
/begin CHARACTERISTIC DINH_FId.DFC_DKRSA_CA "" VAL_BLK 0x800407D8 ValA_Wu16 125. DINH_FIdVerb 0.00 125. FORMAT "%2.0" NUMBER 3 /end CHARACTERISTIC
/begin CHARACTERISTIC DINH_FId.DFC_DKVSmax_CA "" VAL_BLK 0x800407DE ValA_Wu16 125. DINH_FIdVerb 0.00 125. FORMAT "%2.0" NUMBER 2 /end CHARACTERISTIC
/begin CHARACTERISTIC DINH_FId.DFC_DKmax_CA "" VAL_BLK 0x800407E2 ValA_Wu16 125. DINH_FIdVerb 0.00 125. FORMAT "%2.0" NUMBER 2 /end CHARACTERISTIC
/begin CHARACTERISTIC DINH_FId.DFC_DKmin_CA "" VAL_BLK 0x800407E6 ValA_Wu16 125. DINH_FIdVerb 0.00 125. FORMAT "%2.0" NUMBER 2 /end CHARACTERISTIC
/begin CHARACTERISTIC DINH_FId.DFC_DSSmax_CA "" VAL_BLK 0x800407EA ValA_Wu16 125. DINH_FIdVerb 0.00 125. FORMAT "%2.0" NUMBER 2 /end CHARACTERISTIC
/begin CHARACTERISTIC DINH_FId.DFC_EEPEraseErr_CA "" VAL_BLK 0x800407EE ValA_Wu16 125. DINH_FIdVerb 0.00 125. FORMAT "%2.0" NUMBER 2 /end CHARACTERISTIC
/begin CHARACTERISTIC DINH_FId.DFC_EEPRdErr_CA "" VAL_BLK 0x800407F2 ValA_Wu16 125. DINH_FIdVerb 0.00 125. FORMAT "%2.0" NUMBER 2 /end CHARACTERISTIC
/begin CHARACTERISTIC DINH_FId.DFC_EEPWrErr_CA "" VAL_BLK 0x800407F6 ValA_Wu16 125. DINH_FIdVerb 0.00 125. FORMAT "%2.0" NUMBER 2 /end CHARACTERISTIC
/begin CHARACTERISTIC DINH_FId.DFC_EV1max_CA "" VAL_BLK 0x800407FA ValA_Wu16 125. DINH_FIdVerb 0.00 125. FORMAT "%2.0" NUMBER 3 /end CHARACTERISTIC
/begin CHARACTERISTIC DINH_FId.DFC_EV1min_CA "" VAL_BLK 0x80040800 ValA_Wu16 125. DINH_FIdVerb 0.00 125. FORMAT "%2.0" NUMBER 4 /end CHARACTERISTIC
/begin CHARACTERISTIC DINH_FId.DFC_EV1sig_CA "" VAL_BLK 0x80040808 ValA_Wu16 125. DINH_FIdVerb 0.00 125. FORMAT "%2.0" NUMBER 3 /end CHARACTERISTIC
/begin CHARACTERISTIC DINH_FId.DFC_EV2max_CA "" VAL_BLK 0x8004080E ValA_Wu16 125. DINH_FIdVerb 0.00 125. FORMAT "%2.0" NUMBER 3 /end CHARACTERISTIC
/begin CHARACTERISTIC DINH_FId.DFC_EV2min_CA "" VAL_BLK 0x80040814 ValA_Wu16 125. DINH_FIdVerb 0.00 125. FORMAT "%2.0" NUMBER 4 /end CHARACTERISTIC
/begin CHARACTERISTIC DINH_FId.DFC_EV2sig_CA "" VAL_BLK 0x8004081C ValA_Wu16 125. DINH_FIdVerb 0.00 125. FORMAT "%2.0" NUMBER 3 /end CHARACTERISTIC
/begin CHARACTERISTIC DINH_FId.DFC_EV3max_CA "" VAL_BLK 0x80040822 ValA_Wu16 125. DINH_FIdVerb 0.00 125. FORMAT "%2.0" NUMBER 3 /end CHARACTERISTIC
/begin CHARACTERISTIC DINH_FId.DFC_EV3min_CA "" VAL_BLK 0x80040828 ValA_Wu16 125. DINH_FIdVerb 0.00 125. FORMAT "%2.0" NUMBER 4 /end CHARACTERISTIC
/begin CHARACTERISTIC DINH_FId.DFC_EV3sig_CA "" VAL_BLK 0x80040830 ValA_Wu16 125. DINH_FIdVerb 0.00 125. FORMAT "%2.0" NUMBER 3 /end CHARACTERISTIC
/begin CHARACTERISTIC DINH_FId.DFC_EpmCaSI1ErrSig_CA "" VAL_BLK 0x80040836 ValA_Wu16 125. DINH_FIdVerb 0.00 125. FORMAT "%2.0" NUMBER 6 /end CHARACTERISTIC
/begin CHARACTERISTIC DINH_FId.DFC_EpmCaSI1NoSig_CA "" VAL_BLK 0x80040842 ValA_Wu16 125. DINH_FIdVerb 0.00 125. FORMAT "%2.0" NUMBER 6 /end CHARACTERISTIC
/begin CHARACTERISTIC DINH_FId.DFC_EpmCaSI1NoSigMax_CA "" VAL_BLK 0x8004084E ValA_Wu16 125. DINH_FIdVerb 0.00 125. FORMAT "%2.0" NUMBER 6 /end CHARACTERISTIC
/begin CHARACTERISTIC DINH_FId.DFC_EpmCaSI1NoSigMin_CA "" VAL_BLK 0x8004085A ValA_Wu16 125. DINH_FIdVerb 0.00 125. FORMAT "%2.0" NUMBER 6 /end CHARACTERISTIC
/begin CHARACTERISTIC DINH_FId.DFC_EpmCaSI1OfsErr_CA "" VAL_BLK 0x80040866 ValA_Wu16 125. DINH_FIdVerb 0.00 125. FORMAT "%2.0" NUMBER 10 /end CHARACTERISTIC
/begin CHARACTERISTIC DINH_FId.DFC_EpmCrSErrSig_Enf_CA "" VAL_BLK 0x8004087A ValA_Wu16 125. DINH_FIdVerb 0.00 125. FORMAT "%2.0" NUMBER 3 /end CHARACTERISTIC
/begin CHARACTERISTIC DINH_FId.DFC_EpmCrSErrSig_CA "" VAL_BLK 0x80040880 ValA_Wu16 125. DINH_FIdVerb 0.00 125. FORMAT "%2.0" NUMBER 13 /end CHARACTERISTIC
/begin CHARACTERISTIC DINH_FId.DFC_EpmCrSNoSig_Enf_CA "" VAL_BLK 0x8004089A ValA_Wu16 125. DINH_FIdVerb 0.00 125. FORMAT "%2.0" NUMBER 3 /end CHARACTERISTIC
/begin CHARACTERISTIC DINH_FId.DFC_EpmCrSNoSig_CA "" VAL_BLK 0x800408A0 ValA_Wu16 125. DINH_FIdVerb 0.00 125. FORMAT "%2.0" NUMBER 13 /end CHARACTERISTIC
/begin CHARACTERISTIC DINH_FId.DFC_FRAmax_CA "" VAL_BLK 0x800408BA ValA_Wu16 125. DINH_FIdVerb 0.00 125. FORMAT "%2.0" NUMBER 3 /end CHARACTERISTIC
/begin CHARACTERISTIC DINH_FId.DFC_FRAmin_CA "" VAL_BLK 0x800408C0 ValA_Wu16 125. DINH_FIdVerb 0.00 125. FORMAT "%2.0" NUMBER 3 /end CHARACTERISTIC
/begin CHARACTERISTIC DINH_FId.DFC_HEGOS1B1ElecMax_CA "" VAL_BLK 0x800408C6 ValA_Wu16 125. DINH_FIdVerb 0.00 125. FORMAT "%2.0" NUMBER 8 /end CHARACTERISTIC
/begin CHARACTERISTIC DINH_FId.DFC_HEGOS1B1ElecMin_CA "" VAL_BLK 0x800408D6 ValA_Wu16 125. DINH_FIdVerb 0.00 125. FORMAT "%2.0" NUMBER 7 /end CHARACTERISTIC
/begin CHARACTERISTIC DINH_FId.DFC_HEGOS1B1ElecNpl_CA "" VAL_BLK 0x800408E4 ValA_Wu16 125. DINH_FIdVerb 0.00 125. FORMAT "%2.0" NUMBER 6 /end CHARACTERISTIC
/begin CHARACTERISTIC DINH_FId.DFC_HEGOS1B1ElecSig_CA "" VAL_BLK 0x800408F0 ValA_Wu16 125. DINH_FIdVerb 0.00 125. FORMAT "%2.0" NUMBER 7 /end CHARACTERISTIC
/begin CHARACTERISTIC DINH_FId.DFC_HEGOS1B1HtgNpl_CA "" VAL_BLK 0x800408FE ValA_Wu16 125. DINH_FIdVerb 0.00 125. FORMAT "%2.0" NUMBER 5 /end CHARACTERISTIC
/begin CHARACTERISTIC DINH_FId.DFC_HEGOS1B1HtrPsMax_CA "" VAL_BLK 0x80040908 ValA_Wu16 125. DINH_FIdVerb 0.00 125. FORMAT "%2.0" NUMBER 7 /end CHARACTERISTIC
/begin CHARACTERISTIC DINH_FId.DFC_HEGOS1B1HtrPsMin_CA "" VAL_BLK 0x80040916 ValA_Wu16 125. DINH_FIdVerb 0.00 125. FORMAT "%2.0" NUMBER 7 /end CHARACTERISTIC
/begin CHARACTERISTIC DINH_FId.DFC_HEGOS1B1HtrPsSig_CA "" VAL_BLK 0x80040924 ValA_Wu16 125. DINH_FIdVerb 0.00 125. FORMAT "%2.0" NUMBER 7 /end CHARACTERISTIC
/begin CHARACTERISTIC DINH_FId.DFC_HEGOS1B1StkMax_CA "" VAL_BLK 0x80040932 ValA_Wu16 125. DINH_FIdVerb 0.00 125. FORMAT "%2.0" NUMBER 2 /end CHARACTERISTIC
/begin CHARACTERISTIC DINH_FId.DFC_HEGOS1B1StkMin_CA "" VAL_BLK 0x80040936 ValA_Wu16 125. DINH_FIdVerb 0.00 125. FORMAT "%2.0" NUMBER 2 /end CHARACTERISTIC
/begin CHARACTERISTIC DINH_FId.DFC_HEGOS2B1RstrcnLean_CA "" VAL_BLK 0x8004093A ValA_Wu16 125. DINH_FIdVerb 0.00 125. FORMAT "%2.0" NUMBER 4 /end CHARACTERISTIC
/begin CHARACTERISTIC DINH_FId.DFC_HEGOS2B1RstrcnRich_CA "" VAL_BLK 0x80040942 ValA_Wu16 125. DINH_FIdVerb 0.00 125. FORMAT "%2.0" NUMBER 4 /end CHARACTERISTIC
/begin CHARACTERISTIC DINH_FId.DFC_IdleChrgActrJamVlvClsd_CA "" VAL_BLK 0x8004094A ValA_Wu16 125. DINH_FIdVerb 0.00 125. FORMAT "%2.0" NUMBER 4 /end CHARACTERISTIC
/begin CHARACTERISTIC DINH_FId.DFC_IdleChrgActrJamVlvOpn_CA "" VAL_BLK 0x80040952 ValA_Wu16 125. DINH_FIdVerb 0.00 125. FORMAT "%2.0" NUMBER 4 /end CHARACTERISTIC
/begin CHARACTERISTIC DINH_FId.DFC_IgnClPsDevOscErr1_CA "" VAL_BLK 0x8004095A ValA_Wu16 125. DINH_FIdVerb 0.00 125. FORMAT "%2.0" NUMBER 2 /end CHARACTERISTIC
/begin CHARACTERISTIC DINH_FId.DFC_KPEmax_CA "" VAL_BLK 0x8004095E ValA_Wu16 125. DINH_FIdVerb 0.00 125. FORMAT "%2.0" NUMBER 2 /end CHARACTERISTIC
/begin CHARACTERISTIC DINH_FId.DFC_KPEmin_CA "" VAL_BLK 0x80040962 ValA_Wu16 125. DINH_FIdVerb 0.00 125. FORMAT "%2.0" NUMBER 2 /end CHARACTERISTIC
/begin CHARACTERISTIC DINH_FId.DFC_KPEsig_CA "" VAL_BLK 0x80040966 ValA_Wu16 125. DINH_FIdVerb 0.00 125. FORMAT "%2.0" NUMBER 2 /end CHARACTERISTIC
/begin CHARACTERISTIC DINH_FId.DFC_KS1max_CA "" VAL_BLK 0x8004096A ValA_Wu16 125. DINH_FIdVerb 0.00 125. FORMAT "%2.0" NUMBER 3 /end CHARACTERISTIC
/begin CHARACTERISTIC DINH_FId.DFC_KS1min_CA "" VAL_BLK 0x80040970 ValA_Wu16 125. DINH_FIdVerb 0.00 125. FORMAT "%2.0" NUMBER 3 /end CHARACTERISTIC
/begin CHARACTERISTIC DINH_FId.DFC_LLRKHmax_CA "" VAL_BLK 0x80040976 ValA_Wu16 125. DINH_FIdVerb 0.00 125. FORMAT "%2.0" NUMBER 2 /end CHARACTERISTIC
/begin CHARACTERISTIC DINH_FId.DFC_LLRKHmin_CA "" VAL_BLK 0x8004097A ValA_Wu16 125. DINH_FIdVerb 0.00 125. FORMAT "%2.0" NUMBER 2 /end CHARACTERISTIC
/begin CHARACTERISTIC DINH_FId.DFC_LLRKHnpl_CA "" VAL_BLK 0x8004097E ValA_Wu16 125. DINH_FIdVerb 0.00 125. FORMAT "%2.0" NUMBER 2 /end CHARACTERISTIC
/begin CHARACTERISTIC DINH_FId.DFC_LLRmax_CA "" VAL_BLK 0x80040982 ValA_Wu16 125. DINH_FIdVerb 0.00 125. FORMAT "%2.0" NUMBER 2 /end CHARACTERISTIC
/begin CHARACTERISTIC DINH_FId.DFC_LLRmin_CA "" VAL_BLK 0x80040986 ValA_Wu16 125. DINH_FIdVerb 0.00 125. FORMAT "%2.0" NUMBER 2 /end CHARACTERISTIC
/begin CHARACTERISTIC DINH_FId.DFC_LLRnpl_CA "" VAL_BLK 0x8004098A ValA_Wu16 125. DINH_FIdVerb 0.00 125. FORMAT "%2.0" NUMBER 2 /end CHARACTERISTIC
/begin CHARACTERISTIC DINH_FId.DFC_LMmax_CA "" VAL_BLK 0x8004098E ValA_Wu16 125. DINH_FIdVerb 0.00 125. FORMAT "%2.0" NUMBER 3 /end CHARACTERISTIC
/begin CHARACTERISTIC DINH_FId.DFC_LZSRnpl_CA "" VAL_BLK 0x80040994 ValA_Wu16 125. DINH_FIdVerb 0.00 125. FORMAT "%2.0" NUMBER 2 /end CHARACTERISTIC
/begin CHARACTERISTIC DINH_FId.DFC_MD_CA "" VAL_BLK 0x80040998 ValA_Wu16 125. DINH_FIdVerb 0.00 125. FORMAT "%2.0" NUMBER 7 /end CHARACTERISTIC
/begin CHARACTERISTIC DINH_FId.DFC_MD00min_CA "" VAL_BLK 0x800409A6 ValA_Wu16 125. DINH_FIdVerb 0.00 125. FORMAT "%2.0" NUMBER 2 /end CHARACTERISTIC
/begin CHARACTERISTIC DINH_FId.DFC_MD00npl_CA "" VAL_BLK 0x800409AA ValA_Wu16 125. DINH_FIdVerb 0.00 125. FORMAT "%2.0" NUMBER 2 /end CHARACTERISTIC
/begin CHARACTERISTIC DINH_FId.DFC_MD01min_CA "" VAL_BLK 0x800409AE ValA_Wu16 125. DINH_FIdVerb 0.00 125. FORMAT "%2.0" NUMBER 2 /end CHARACTERISTIC
/begin CHARACTERISTIC DINH_FId.DFC_MD01npl_CA "" VAL_BLK 0x800409B2 ValA_Wu16 125. DINH_FIdVerb 0.00 125. FORMAT "%2.0" NUMBER 2 /end CHARACTERISTIC
/begin CHARACTERISTIC DINH_FId.DFC_MD02min_CA "" VAL_BLK 0x800409B6 ValA_Wu16 125. DINH_FIdVerb 0.00 125. FORMAT "%2.0" NUMBER 2 /end CHARACTERISTIC
/begin CHARACTERISTIC DINH_FId.DFC_MD02npl_CA "" VAL_BLK 0x800409BA ValA_Wu16 125. DINH_FIdVerb 0.00 125. FORMAT "%2.0" NUMBER 2 /end CHARACTERISTIC
/begin CHARACTERISTIC DINH_FId.DFC_MD03min_CA "" VAL_BLK 0x800409BE ValA_Wu16 125. DINH_FIdVerb 0.00 125. FORMAT "%2.0" NUMBER 2 /end CHARACTERISTIC
/begin CHARACTERISTIC DINH_FId.DFC_MD03npl_CA "" VAL_BLK 0x800409C2 ValA_Wu16 125. DINH_FIdVerb 0.00 125. FORMAT "%2.0" NUMBER 2 /end CHARACTERISTIC
/begin CHARACTERISTIC DINH_FId.DFC_MD04min_CA "" VAL_BLK 0x800409C6 ValA_Wu16 125. DINH_FIdVerb 0.00 125. FORMAT "%2.0" NUMBER 2 /end CHARACTERISTIC
/begin CHARACTERISTIC DINH_FId.DFC_MD04npl_CA "" VAL_BLK 0x800409CA ValA_Wu16 125. DINH_FIdVerb 0.00 125. FORMAT "%2.0" NUMBER 2 /end CHARACTERISTIC
/begin CHARACTERISTIC DINH_FId.DFC_MDCyl_0_CA "" VAL_BLK 0x800409CE ValA_Wu16 125. DINH_FIdVerb 0.00 125. FORMAT "%2.0" NUMBER 2 /end CHARACTERISTIC
/begin CHARACTERISTIC DINH_FId.DFC_MDCyl_1_CA "" VAL_BLK 0x800409D2 ValA_Wu16 125. DINH_FIdVerb 0.00 125. FORMAT "%2.0" NUMBER 2 /end CHARACTERISTIC
/begin CHARACTERISTIC DINH_FId.DFC_MDCyl_2_CA "" VAL_BLK 0x800409D6 ValA_Wu16 125. DINH_FIdVerb 0.00 125. FORMAT "%2.0" NUMBER 2 /end CHARACTERISTIC
/begin CHARACTERISTIC DINH_FId.DFC_MDFC_CA "" VAL_BLK 0x800409DA ValA_Wu16 125. DINH_FIdVerb 0.00 125. FORMAT "%2.0" NUMBER 2 /end CHARACTERISTIC
/begin CHARACTERISTIC DINH_FId.DFC_MDmin_CA "" VAL_BLK 0x800409DE ValA_Wu16 125. DINH_FIdVerb 0.00 125. FORMAT "%2.0" NUMBER 2 /end CHARACTERISTIC
/begin CHARACTERISTIC DINH_FId.DFC_MDnpl_CA "" VAL_BLK 0x800409E2 ValA_Wu16 125. DINH_FIdVerb 0.00 125. FORMAT "%2.0" NUMBER 2 /end CHARACTERISTIC
/begin CHARACTERISTIC DINH_FId.DFC_MoCADCNTP_CA "" VAL_BLK 0x800409E6 ValA_Wu16 125. DINH_FIdVerb 0.00 125. FORMAT "%2.0" NUMBER 2 /end CHARACTERISTIC
/begin CHARACTERISTIC DINH_FId.DFC_MoCADCTst_CA "" VAL_BLK 0x800409EA ValA_Wu16 125. DINH_FIdVerb 0.00 125. FORMAT "%2.0" NUMBER 2 /end CHARACTERISTIC
/begin CHARACTERISTIC DINH_FId.DFC_MoCComctErrMM_CA "" VAL_BLK 0x800409EE ValA_Wu16 125. DINH_FIdVerb 0.00 125. FORMAT "%2.0" NUMBER 2 /end CHARACTERISTIC
/begin CHARACTERISTIC DINH_FId.DFC_OCWDAActv_CA "" VAL_BLK 0x800409F2 ValA_Wu16 125. DINH_FIdVerb 0.00 125. FORMAT "%2.0" NUMBER 2 /end CHARACTERISTIC
/begin CHARACTERISTIC DINH_FId.DFC_OCWDACom_CA "" VAL_BLK 0x800409F6 ValA_Wu16 125. DINH_FIdVerb 0.00 125. FORMAT "%2.0" NUMBER 2 /end CHARACTERISTIC
/begin CHARACTERISTIC DINH_FId.DFC_ORAmax_CA "" VAL_BLK 0x800409FA ValA_Wu16 125. DINH_FIdVerb 0.00 125. FORMAT "%2.0" NUMBER 3 /end CHARACTERISTIC
/begin CHARACTERISTIC DINH_FId.DFC_ORAmin_CA "" VAL_BLK 0x80040A00 ValA_Wu16 125. DINH_FIdVerb 0.00 125. FORMAT "%2.0" NUMBER 3 /end CHARACTERISTIC
/begin CHARACTERISTIC DINH_FId.DFC_PSR1max_CA "" VAL_BLK 0x80040A06 ValA_Wu16 125. DINH_FIdVerb 0.00 125. FORMAT "%2.0" NUMBER 2 /end CHARACTERISTIC
/begin CHARACTERISTIC DINH_FId.DFC_PSRBmax_CA "" VAL_BLK 0x80040A0A ValA_Wu16 125. DINH_FIdVerb 0.00 125. FORMAT "%2.0" NUMBER 10 /end CHARACTERISTIC
/begin CHARACTERISTIC DINH_FId.DFC_PSRBmin_CA "" VAL_BLK 0x80040A1E ValA_Wu16 125. DINH_FIdVerb 0.00 125. FORMAT "%2.0" NUMBER 10 /end CHARACTERISTIC
/begin CHARACTERISTIC DINH_FId.DFC_PSREmax_CA "" VAL_BLK 0x80040A32 ValA_Wu16 125. DINH_FIdVerb 0.00 125. FORMAT "%2.0" NUMBER 10 /end CHARACTERISTIC
/begin CHARACTERISTIC DINH_FId.DFC_PSREmin_CA "" VAL_BLK 0x80040A46 ValA_Wu16 125. DINH_FIdVerb 0.00 125. FORMAT "%2.0" NUMBER 10 /end CHARACTERISTIC
/begin CHARACTERISTIC DINH_FId.DFC_PSRPmax_CA "" VAL_BLK 0x80040A5A ValA_Wu16 125. DINH_FIdVerb 0.00 125. FORMAT "%2.0" NUMBER 8 /end CHARACTERISTIC
/begin CHARACTERISTIC DINH_FId.DFC_PSRPmin_CA "" VAL_BLK 0x80040A6A ValA_Wu16 125. DINH_FIdVerb 0.00 125. FORMAT "%2.0" NUMBER 8 /end CHARACTERISTIC
/begin CHARACTERISTIC DINH_FId.DFC_PSRPsig_CA "" VAL_BLK 0x80040A7A ValA_Wu16 125. DINH_FIdVerb 0.00 125. FORMAT "%2.0" NUMBER 8 /end CHARACTERISTIC
/begin CHARACTERISTIC DINH_FId.DFC_PSRmax_CA "" VAL_BLK 0x80040A8A ValA_Wu16 125. DINH_FIdVerb 0.00 125. FORMAT "%2.0" NUMBER 2 /end CHARACTERISTIC
/begin CHARACTERISTIC DINH_FId.DFC_SSpMon1_Enf_CA "" VAL_BLK 0x80040A8E ValA_Wu16 125. DINH_FIdVerb 0.00 125. FORMAT "%2.0" NUMBER 3 /end CHARACTERISTIC
/begin CHARACTERISTIC DINH_FId.DFC_SSpMon1_CA "" VAL_BLK 0x80040A94 ValA_Wu16 125. DINH_FIdVerb 0.00 125. FORMAT "%2.0" NUMBER 2 /end CHARACTERISTIC
/begin CHARACTERISTIC DINH_FId.DFC_SSpMon2_Enf_CA "" VAL_BLK 0x80040A98 ValA_Wu16 125. DINH_FIdVerb 0.00 125. FORMAT "%2.0" NUMBER 3 /end CHARACTERISTIC
/begin CHARACTERISTIC DINH_FId.DFC_SSpMon2_CA "" VAL_BLK 0x80040A9E ValA_Wu16 125. DINH_FIdVerb 0.00 125. FORMAT "%2.0" NUMBER 9 /end CHARACTERISTIC
/begin CHARACTERISTIC DINH_FId.DFC_SSpMon3_Enf_CA "" VAL_BLK 0x80040AB0 ValA_Wu16 125. DINH_FIdVerb 0.00 125. FORMAT "%2.0" NUMBER 3 /end CHARACTERISTIC
/begin CHARACTERISTIC DINH_FId.DFC_SSpMon3_CA "" VAL_BLK 0x80040AB6 ValA_Wu16 125. DINH_FIdVerb 0.00 125. FORMAT "%2.0" NUMBER 3 /end CHARACTERISTIC
/begin CHARACTERISTIC DINH_FId.DFC_SWReset_0_CA "" VAL_BLK 0x80040ABC ValA_Wu16 125. DINH_FIdVerb 0.00 125. FORMAT "%2.0" NUMBER 2 /end CHARACTERISTIC
/begin CHARACTERISTIC DINH_FId.DFC_SWReset_1_CA "" VAL_BLK 0x80040AC0 ValA_Wu16 125. DINH_FIdVerb 0.00 125. FORMAT "%2.0" NUMBER 2 /end CHARACTERISTIC
/begin CHARACTERISTIC DINH_FId.DFC_SWReset_2_CA "" VAL_BLK 0x80040AC4 ValA_Wu16 125. DINH_FIdVerb 0.00 125. FORMAT "%2.0" NUMBER 2 /end CHARACTERISTIC
/begin CHARACTERISTIC DINH_FId.DFC_TASREmax_CA "" VAL_BLK 0x80040AC8 ValA_Wu16 125. DINH_FIdVerb 0.00 125. FORMAT "%2.0" NUMBER 9 /end CHARACTERISTIC
/begin CHARACTERISTIC DINH_FId.DFC_TASREmin_CA "" VAL_BLK 0x80040ADA ValA_Wu16 125. DINH_FIdVerb 0.00 125. FORMAT "%2.0" NUMBER 9 /end CHARACTERISTIC
/begin CHARACTERISTIC DINH_FId.DFC_TASREnpl_CA "" VAL_BLK 0x80040AEC ValA_Wu16 125. DINH_FIdVerb 0.00 125. FORMAT "%2.0" NUMBER 9 /end CHARACTERISTIC
/begin CHARACTERISTIC DINH_FId.DFC_TASRmax_CA "" VAL_BLK 0x80040AFE ValA_Wu16 125. DINH_FIdVerb 0.00 125. FORMAT "%2.0" NUMBER 2 /end CHARACTERISTIC
/begin CHARACTERISTIC DINH_FId.DFC_TAmax_CA "" VAL_BLK 0x80040B02 ValA_Wu16 125. DINH_FIdVerb 0.00 125. FORMAT "%2.0" NUMBER 2 /end CHARACTERISTIC
/begin CHARACTERISTIC DINH_FId.DFC_TEVEmax_CA "" VAL_BLK 0x80040B06 ValA_Wu16 125. DINH_FIdVerb 0.00 125. FORMAT "%2.0" NUMBER 12 /end CHARACTERISTIC
/begin CHARACTERISTIC DINH_FId.DFC_TEVEmin_CA "" VAL_BLK 0x80040B1E ValA_Wu16 125. DINH_FIdVerb 0.00 125. FORMAT "%2.0" NUMBER 12 /end CHARACTERISTIC
/begin CHARACTERISTIC DINH_FId.DFC_TEVEsig_CA "" VAL_BLK 0x80040B36 ValA_Wu16 125. DINH_FIdVerb 0.00 125. FORMAT "%2.0" NUMBER 12 /end CHARACTERISTIC
/begin CHARACTERISTIC DINH_FId.DFC_TMCSmax_CA "" VAL_BLK 0x80040B4E ValA_Wu16 125. DINH_FIdVerb 0.00 125. FORMAT "%2.0" NUMBER 15 /end CHARACTERISTIC
/begin CHARACTERISTIC DINH_FId.DFC_TMCSmin_CA "" VAL_BLK 0x80040B6C ValA_Wu16 125. DINH_FIdVerb 0.00 125. FORMAT "%2.0" NUMBER 15 /end CHARACTERISTIC
/begin CHARACTERISTIC DINH_FId.DFC_TMEmax_CA "" VAL_BLK 0x80040B8A ValA_Wu16 125. DINH_FIdVerb 0.00 125. FORMAT "%2.0" NUMBER 17 /end CHARACTERISTIC
/begin CHARACTERISTIC DINH_FId.DFC_TMEmin_CA "" VAL_BLK 0x80040BAC ValA_Wu16 125. DINH_FIdVerb 0.00 125. FORMAT "%2.0" NUMBER 17 /end CHARACTERISTIC
/begin CHARACTERISTIC DINH_FId.DFC_TMEnpl_CA "" VAL_BLK 0x80040BCE ValA_Wu16 125. DINH_FIdVerb 0.00 125. FORMAT "%2.0" NUMBER 17 /end CHARACTERISTIC
/begin CHARACTERISTIC DINH_FId.DFC_TMEsig_CA "" VAL_BLK 0x80040BF0 ValA_Wu16 125. DINH_FIdVerb 0.00 125. FORMAT "%2.0" NUMBER 17 /end CHARACTERISTIC
/begin CHARACTERISTIC DINH_FId.DFC_TMPmax_CA "" VAL_BLK 0x80040C12 ValA_Wu16 125. DINH_FIdVerb 0.00 125. FORMAT "%2.0" NUMBER 15 /end CHARACTERISTIC
/begin CHARACTERISTIC DINH_FId.DFC_TMPmin_CA "" VAL_BLK 0x80040C30 ValA_Wu16 125. DINH_FIdVerb 0.00 125. FORMAT "%2.0" NUMBER 15 /end CHARACTERISTIC
/begin CHARACTERISTIC DINH_FId.DFC_TMPnpl_CA "" VAL_BLK 0x80040C4E ValA_Wu16 125. DINH_FIdVerb 0.00 125. FORMAT "%2.0" NUMBER 15 /end CHARACTERISTIC
/begin CHARACTERISTIC DINH_FId.DFC_TMmax_CA "" VAL_BLK 0x80040C6C ValA_Wu16 125. DINH_FIdVerb 0.00 125. FORMAT "%2.0" NUMBER 3 /end CHARACTERISTIC
/begin CHARACTERISTIC DINH_FId.DFC_TUMmax_CA "" VAL_BLK 0x80040C72 ValA_Wu16 125. DINH_FIdVerb 0.00 125. FORMAT "%2.0" NUMBER 3 /end CHARACTERISTIC
/begin CHARACTERISTIC DINH_FId.DFC_TWCCTrimMaxB1_CA "" VAL_BLK 0x80040C78 ValA_Wu16 125. DINH_FIdVerb 0.00 125. FORMAT "%2.0" NUMBER 3 /end CHARACTERISTIC
/begin CHARACTERISTIC DINH_FId.DFC_TWCCTrimMinB1_CA "" VAL_BLK 0x80040C7E ValA_Wu16 125. DINH_FIdVerb 0.00 125. FORMAT "%2.0" NUMBER 3 /end CHARACTERISTIC
/begin CHARACTERISTIC DINH_FId.DFC_TWCDPriCatB1_CA "" VAL_BLK 0x80040C84 ValA_Wu16 125. DINH_FIdVerb 0.00 125. FORMAT "%2.0" NUMBER 2 /end CHARACTERISTIC
/begin CHARACTERISTIC DINH_FId.DFC_UBRmax_CA "" VAL_BLK 0x80040C88 ValA_Wu16 125. DINH_FIdVerb 0.00 125. FORMAT "%2.0" NUMBER 3 /end CHARACTERISTIC
/begin CHARACTERISTIC DINH_FId.DFC_UBmax_CA "" VAL_BLK 0x80040C8E ValA_Wu16 125. DINH_FIdVerb 0.00 125. FORMAT "%2.0" NUMBER 3 /end CHARACTERISTIC
/begin CHARACTERISTIC DINH_FId.DFC_UBmin_CA "" VAL_BLK 0x80040C94 ValA_Wu16 125. DINH_FIdVerb 0.00 125. FORMAT "%2.0" NUMBER 2 /end CHARACTERISTIC
/begin CHARACTERISTIC DINH_FId.DFC_UBnpl_CA "" VAL_BLK 0x80040C98 ValA_Wu16 125. DINH_FIdVerb 0.00 125. FORMAT "%2.0" NUMBER 3 /end CHARACTERISTIC
/begin CHARACTERISTIC DINH_FId.DSQ_ACClntP_CA "" VAL_BLK 0x80040C9E ValA_Wu16 125. DINH_FIdVerb 0.00 125. FORMAT "%2.0" NUMBER 2 /end CHARACTERISTIC
/begin CHARACTERISTIC DINH_FId.DSQ_AirCCmprActr_CA "" VAL_BLK 0x80040CA2 ValA_Wu16 125. DINH_FIdVerb 0.00 125. FORMAT "%2.0" NUMBER 2 /end CHARACTERISTIC
/begin CHARACTERISTIC DINH_FId.DSQ_AltIOActr_CA "" VAL_BLK 0x80040CA6 ValA_Wu16 125. DINH_FIdVerb 0.00 125. FORMAT "%2.0" NUMBER 2 /end CHARACTERISTIC
/begin CHARACTERISTIC DINH_FId.DSQ_AltIOLoad_CA "" VAL_BLK 0x80040CAA ValA_Wu16 125. DINH_FIdVerb 0.00 125. FORMAT "%2.0" NUMBER 3 /end CHARACTERISTIC
/begin CHARACTERISTIC DINH_FId.DSQ_AltTrqDes_CA "" VAL_BLK 0x80040CB0 ValA_Wu16 125. DINH_FIdVerb 0.00 125. FORMAT "%2.0" NUMBER 2 /end CHARACTERISTIC
/begin CHARACTERISTIC DINH_FId.DSQ_BattUSSpThrVlv_CA "" VAL_BLK 0x80040CB4 ValA_Wu16 125. DINH_FIdVerb 0.00 125. FORMAT "%2.0" NUMBER 2 /end CHARACTERISTIC
/begin CHARACTERISTIC DINH_FId.DSQ_CEngDsT_CA "" VAL_BLK 0x80040CB8 ValA_Wu16 125. DINH_FIdVerb 0.00 125. FORMAT "%2.0" NUMBER 3 /end CHARACTERISTIC
/begin CHARACTERISTIC DINH_FId.DSQ_Clth_CA "" VAL_BLK 0x80040CBE ValA_Wu16 125. DINH_FIdVerb 0.00 125. FORMAT "%2.0" NUMBER 2 /end CHARACTERISTIC
/begin CHARACTERISTIC DINH_FId.DSQ_DSMInhibitAlways_CA "" VAL_BLK 0x80040CC2 ValA_Wu16 125. DINH_FIdVerb 0.00 125. FORMAT "%2.0" NUMBER 3 /end CHARACTERISTIC
/begin CHARACTERISTIC DINH_FId.DSQ_EpmReverseRun_CA "" VAL_BLK 0x80040CC8 ValA_Wu16 125. DINH_FIdVerb 0.00 125. FORMAT "%2.0" NUMBER 4 /end CHARACTERISTIC
/begin CHARACTERISTIC DINH_FId.DSQ_FanDIO_CA "" VAL_BLK 0x80040CD0 ValA_Wu16 125. DINH_FIdVerb 0.00 125. FORMAT "%2.0" NUMBER 2 /end CHARACTERISTIC
/begin CHARACTERISTIC DINH_FId.DSQ_FanPWM_CA "" VAL_BLK 0x80040CD4 ValA_Wu16 125. DINH_FIdVerb 0.00 125. FORMAT "%2.0" NUMBER 2 /end CHARACTERISTIC
/begin CHARACTERISTIC DINH_FId.DSQ_IdleChrgActMod_CA "" VAL_BLK 0x80040CD8 ValA_Wu16 125. DINH_FIdVerb 0.00 125. FORMAT "%2.0" NUMBER 3 /end CHARACTERISTIC
/begin CHARACTERISTIC DINH_FId.DSQ_VehV_CA "" VAL_BLK 0x80040CDE ValA_Wu16 125. DINH_FIdVerb 0.00 125. FORMAT "%2.0" NUMBER 4 /end CHARACTERISTIC
/begin CHARACTERISTIC DINH_FId.DSQ_stAPP_CA "" VAL_BLK 0x80040CE6 ValA_Wu16 125. DINH_FIdVerb 0.00 125. FORMAT "%2.0" NUMBER 2 /end CHARACTERISTIC
/begin CHARACTERISTIC DINH_FId.DSQ_stAPP1_CA "" VAL_BLK 0x80040CEA ValA_Wu16 125. DINH_FIdVerb 0.00 125. FORMAT "%2.0" NUMBER 7 /end CHARACTERISTIC
/begin CHARACTERISTIC DINH_FId.DSQ_stAPP2_CA "" VAL_BLK 0x80040CF8 ValA_Wu16 125. DINH_FIdVerb 0.00 125. FORMAT "%2.0" NUMBER 8 /end CHARACTERISTIC
/begin CHARACTERISTIC DINH_Lim.DFC_AltMaxPwr_CA "" VAL_BLK 0x80041032 ValA_Wu8 14.0000000000 DINH_LimDFCVerb 0.00 14.0000000000 FORMAT "%13.10" NUMBER 2 /end CHARACTERISTIC
/begin CHARACTERISTIC DINH_Lim.DFC_BrkNpl_CA "" VAL_BLK 0x80041034 ValA_Wu8 14.0000000000 DINH_LimDFCVerb 0.00 14.0000000000 FORMAT "%13.10" NUMBER 2 /end CHARACTERISTIC
/begin CHARACTERISTIC DINH_Lim.DFC_Cj930SSp1Mon_CA "" VAL_BLK 0x80041036 ValA_Wu8 14.0000000000 DINH_LimDFCVerb 0.00 14.0000000000 FORMAT "%13.10" NUMBER 2 /end CHARACTERISTIC
/begin CHARACTERISTIC DINH_Lim.DFC_Cj930SSp2Mon_CA "" VAL_BLK 0x80041038 ValA_Wu8 14.0000000000 DINH_LimDFCVerb 0.00 14.0000000000 FORMAT "%13.10" NUMBER 2 /end CHARACTERISTIC
/begin CHARACTERISTIC DINH_Lim.DFC_Cj930SSp3Mon_CA "" VAL_BLK 0x8004103A ValA_Wu8 14.0000000000 DINH_LimDFCVerb 0.00 14.0000000000 FORMAT "%13.10" NUMBER 2 /end CHARACTERISTIC
/begin CHARACTERISTIC DINH_Lim.DFC_IdleChrgActrAMax_CA "" VAL_BLK 0x8004103C ValA_Wu8 14.0000000000 DINH_LimDFCVerb 0.00 14.0000000000 FORMAT "%13.10" NUMBER 3 /end CHARACTERISTIC
/begin CHARACTERISTIC DINH_Lim.DFC_IdleChrgActrAMin_CA "" VAL_BLK 0x8004103F ValA_Wu8 14.0000000000 DINH_LimDFCVerb 0.00 14.0000000000 FORMAT "%13.10" NUMBER 3 /end CHARACTERISTIC
/begin CHARACTERISTIC DINH_Lim.DFC_IdleChrgActrASig_CA "" VAL_BLK 0x80041042 ValA_Wu8 14.0000000000 DINH_LimDFCVerb 0.00 14.0000000000 FORMAT "%13.10" NUMBER 3 /end CHARACTERISTIC
/begin CHARACTERISTIC DINH_Lim.DFC_IdleChrgActrBMax_CA "" VAL_BLK 0x80041045 ValA_Wu8 14.0000000000 DINH_LimDFCVerb 0.00 14.0000000000 FORMAT "%13.10" NUMBER 3 /end CHARACTERISTIC
/begin CHARACTERISTIC DINH_Lim.DFC_IdleChrgActrBMin_CA "" VAL_BLK 0x80041048 ValA_Wu8 14.0000000000 DINH_LimDFCVerb 0.00 14.0000000000 FORMAT "%13.10" NUMBER 3 /end CHARACTERISTIC
/begin CHARACTERISTIC DINH_Lim.DFC_IdleChrgActrBSig_CA "" VAL_BLK 0x8004104B ValA_Wu8 14.0000000000 DINH_LimDFCVerb 0.00 14.0000000000 FORMAT "%13.10" NUMBER 3 /end CHARACTERISTIC
/begin CHARACTERISTIC DINH_Lim.DFC_IdleChrgActrGovDeCold_CA "" VAL_BLK 0x8004104E ValA_Wu8 14.0000000000 DINH_LimDFCVerb 0.00 14.0000000000 FORMAT "%13.10" NUMBER 3 /end CHARACTERISTIC
/begin CHARACTERISTIC DINH_Lim.DFC_IdleChrgActrGovDeMax_CA "" VAL_BLK 0x80041051 ValA_Wu8 14.0000000000 DINH_LimDFCVerb 0.00 14.0000000000 FORMAT "%13.10" NUMBER 3 /end CHARACTERISTIC
/begin CHARACTERISTIC DINH_Lim.DFC_IdleChrgActrGovDeMin_CA "" VAL_BLK 0x80041054 ValA_Wu8 14.0000000000 DINH_LimDFCVerb 0.00 14.0000000000 FORMAT "%13.10" NUMBER 3 /end CHARACTERISTIC
/begin CHARACTERISTIC DINH_Lim.DFC_IdleChrgActrNAMax_CA "" VAL_BLK 0x80041057 ValA_Wu8 14.0000000000 DINH_LimDFCVerb 0.00 14.0000000000 FORMAT "%13.10" NUMBER 3 /end CHARACTERISTIC
/begin CHARACTERISTIC DINH_Lim.DFC_IdleChrgActrNAMin_CA "" VAL_BLK 0x8004105A ValA_Wu8 14.0000000000 DINH_LimDFCVerb 0.00 14.0000000000 FORMAT "%13.10" NUMBER 3 /end CHARACTERISTIC
/begin CHARACTERISTIC DINH_Lim.DFC_IdleChrgActrNASig_CA "" VAL_BLK 0x8004105D ValA_Wu8 14.0000000000 DINH_LimDFCVerb 0.00 14.0000000000 FORMAT "%13.10" NUMBER 3 /end CHARACTERISTIC
/begin CHARACTERISTIC DINH_Lim.DFC_IdleChrgActrNBMax_CA "" VAL_BLK 0x80041060 ValA_Wu8 14.0000000000 DINH_LimDFCVerb 0.00 14.0000000000 FORMAT "%13.10" NUMBER 3 /end CHARACTERISTIC
/begin CHARACTERISTIC DINH_Lim.DFC_IdleChrgActrNBMin_CA "" VAL_BLK 0x80041063 ValA_Wu8 14.0000000000 DINH_LimDFCVerb 0.00 14.0000000000 FORMAT "%13.10" NUMBER 3 /end CHARACTERISTIC
/begin CHARACTERISTIC DINH_Lim.DFC_IdleChrgActrNBSig_CA "" VAL_BLK 0x80041066 ValA_Wu8 14.0000000000 DINH_LimDFCVerb 0.00 14.0000000000 FORMAT "%13.10" NUMBER 3 /end CHARACTERISTIC
/begin CHARACTERISTIC DINH_Lim.DFC_IdleChrgActrOverTmp_CA "" VAL_BLK 0x80041069 ValA_Wu8 14.0000000000 DINH_LimDFCVerb 0.00 14.0000000000 FORMAT "%13.10" NUMBER 3 /end CHARACTERISTIC
/begin CHARACTERISTIC DINH_Lim.DFC_MonUMaxSupply1_CA "" VAL_BLK 0x8004106C ValA_Wu8 14.0000000000 DINH_LimDFCVerb 0.00 14.0000000000 FORMAT "%13.10" NUMBER 2 /end CHARACTERISTIC
/begin CHARACTERISTIC DINH_Lim.DFC_MonUMinSupply1_CA "" VAL_BLK 0x8004106E ValA_Wu8 14.0000000000 DINH_LimDFCVerb 0.00 14.0000000000 FORMAT "%13.10" NUMBER 2 /end CHARACTERISTIC
/begin CHARACTERISTIC DINH_Lim.DFC_ClthNplClsd_CA "" VAL_BLK 0x80041070 ValA_Wu8 14.0000000000 DINH_LimDFCVerb 0.00 14.0000000000 FORMAT "%13.10" NUMBER 4 /end CHARACTERISTIC
/begin CHARACTERISTIC DINH_Lim.DFC_ClthNplOpn_CA "" VAL_BLK 0x80041074 ValA_Wu8 14.0000000000 DINH_LimDFCVerb 0.00 14.0000000000 FORMAT "%13.10" NUMBER 4 /end CHARACTERISTIC
/begin CHARACTERISTIC DINH_Lim.DFC_IgnClPsDevComErr1_CA "" VAL_BLK 0x80041078 ValA_Wu8 14.0000000000 DINH_LimDFCVerb 0.00 14.0000000000 FORMAT "%13.10" NUMBER 2 /end CHARACTERISTIC
/begin CHARACTERISTIC DINH_Lim.DFC_IgnClPsOpenLoad0_CA "" VAL_BLK 0x8004107A ValA_Wu8 14.0000000000 DINH_LimDFCVerb 0.00 14.0000000000 FORMAT "%13.10" NUMBER 2 /end CHARACTERISTIC
/begin CHARACTERISTIC DINH_Lim.DFC_IgnClPsOpenLoad1_CA "" VAL_BLK 0x8004107C ValA_Wu8 14.0000000000 DINH_LimDFCVerb 0.00 14.0000000000 FORMAT "%13.10" NUMBER 2 /end CHARACTERISTIC
/begin CHARACTERISTIC DINH_Lim.DFC_IgnClPsOpenLoad2_CA "" VAL_BLK 0x8004107E ValA_Wu8 14.0000000000 DINH_LimDFCVerb 0.00 14.0000000000 FORMAT "%13.10" NUMBER 2 /end CHARACTERISTIC
/begin CHARACTERISTIC DINH_Lim.DFC_IgnClPsShCirBatt0_CA "" VAL_BLK 0x80041080 ValA_Wu8 14.0000000000 DINH_LimDFCVerb 0.00 14.0000000000 FORMAT "%13.10" NUMBER 2 /end CHARACTERISTIC
/begin CHARACTERISTIC DINH_Lim.DFC_IgnClPsShCirBatt1_CA "" VAL_BLK 0x80041082 ValA_Wu8 14.0000000000 DINH_LimDFCVerb 0.00 14.0000000000 FORMAT "%13.10" NUMBER 2 /end CHARACTERISTIC
/begin CHARACTERISTIC DINH_Lim.DFC_IgnClPsShCirBatt2_CA "" VAL_BLK 0x80041084 ValA_Wu8 14.0000000000 DINH_LimDFCVerb 0.00 14.0000000000 FORMAT "%13.10" NUMBER 2 /end CHARACTERISTIC
/begin CHARACTERISTIC DINH_Lim.DFC_IgnClPsShCirGnd0_CA "" VAL_BLK 0x80041086 ValA_Wu8 14.0000000000 DINH_LimDFCVerb 0.00 14.0000000000 FORMAT "%13.10" NUMBER 2 /end CHARACTERISTIC
/begin CHARACTERISTIC DINH_Lim.DFC_IgnClPsShCirGnd1_CA "" VAL_BLK 0x80041088 ValA_Wu8 14.0000000000 DINH_LimDFCVerb 0.00 14.0000000000 FORMAT "%13.10" NUMBER 2 /end CHARACTERISTIC
/begin CHARACTERISTIC DINH_Lim.DFC_IgnClPsShCirGnd2_CA "" VAL_BLK 0x8004108A ValA_Wu8 14.0000000000 DINH_LimDFCVerb 0.00 14.0000000000 FORMAT "%13.10" NUMBER 2 /end CHARACTERISTIC
/begin CHARACTERISTIC DINH_Lim.DFC_KnDetSens1PortAMax_CA "" VAL_BLK 0x8004108C ValA_Wu8 14.0000000000 DINH_LimDFCVerb 0.00 14.0000000000 FORMAT "%13.10" NUMBER 4 /end CHARACTERISTIC
/begin CHARACTERISTIC DINH_Lim.DFC_KnDetSens1PortAMin_CA "" VAL_BLK 0x80041090 ValA_Wu8 14.0000000000 DINH_LimDFCVerb 0.00 14.0000000000 FORMAT "%13.10" NUMBER 4 /end CHARACTERISTIC
/begin CHARACTERISTIC DINH_Lim.DFC_KnDetSens1PortBMax_CA "" VAL_BLK 0x80041094 ValA_Wu8 14.0000000000 DINH_LimDFCVerb 0.00 14.0000000000 FORMAT "%13.10" NUMBER 4 /end CHARACTERISTIC
/begin CHARACTERISTIC DINH_Lim.DFC_KnDetSens1PortBMin_CA "" VAL_BLK 0x80041098 ValA_Wu8 14.0000000000 DINH_LimDFCVerb 0.00 14.0000000000 FORMAT "%13.10" NUMBER 4 /end CHARACTERISTIC
/begin CHARACTERISTIC DINH_Lim.DFC_VehVWhlErr_CA "" VAL_BLK 0x8004109C ValA_Wu8 14.0000000000 DINH_LimDFCVerb 0.00 14.0000000000 FORMAT "%13.10" NUMBER 4 /end CHARACTERISTIC
/begin CHARACTERISTIC DINH_Lim.DFC_AirCCmprOL_CA "" VAL_BLK 0x800410A0 ValA_Wu8 14.0000000000 DINH_LimDFCVerb 0.00 14.0000000000 FORMAT "%13.10" NUMBER 2 /end CHARACTERISTIC
/begin CHARACTERISTIC DINH_Lim.DFC_AirCCmprOvrTemp_CA "" VAL_BLK 0x800410A2 ValA_Wu8 14.0000000000 DINH_LimDFCVerb 0.00 14.0000000000 FORMAT "%13.10" NUMBER 2 /end CHARACTERISTIC
/begin CHARACTERISTIC DINH_Lim.DFC_AirCCmprSCB_CA "" VAL_BLK 0x800410A4 ValA_Wu8 14.0000000000 DINH_LimDFCVerb 0.00 14.0000000000 FORMAT "%13.10" NUMBER 2 /end CHARACTERISTIC
/begin CHARACTERISTIC DINH_Lim.DFC_AirCCmprSCG_CA "" VAL_BLK 0x800410A6 ValA_Wu8 14.0000000000 DINH_LimDFCVerb 0.00 14.0000000000 FORMAT "%13.10" NUMBER 2 /end CHARACTERISTIC
/begin CHARACTERISTIC DINH_Lim.DFC_AltIOLdSRCMin_CA "" VAL_BLK 0x800410A8 ValA_Wu8 14.0000000000 DINH_LimDFCVerb 0.00 14.0000000000 FORMAT "%13.10" NUMBER 4 /end CHARACTERISTIC
/begin CHARACTERISTIC DINH_Lim.DFC_AltIOOL_CA "" VAL_BLK 0x800410AC ValA_Wu8 14.0000000000 DINH_LimDFCVerb 0.00 14.0000000000 FORMAT "%13.10" NUMBER 2 /end CHARACTERISTIC
/begin CHARACTERISTIC DINH_Lim.DFC_AltIOOvrTemp_CA "" VAL_BLK 0x800410AE ValA_Wu8 14.0000000000 DINH_LimDFCVerb 0.00 14.0000000000 FORMAT "%13.10" NUMBER 2 /end CHARACTERISTIC
/begin CHARACTERISTIC DINH_Lim.DFC_AltIOSCB_CA "" VAL_BLK 0x800410B0 ValA_Wu8 14.0000000000 DINH_LimDFCVerb 0.00 14.0000000000 FORMAT "%13.10" NUMBER 2 /end CHARACTERISTIC
/begin CHARACTERISTIC DINH_Lim.DFC_AltIOSCG_CA "" VAL_BLK 0x800410B2 ValA_Wu8 14.0000000000 DINH_LimDFCVerb 0.00 14.0000000000 FORMAT "%13.10" NUMBER 2 /end CHARACTERISTIC
/begin CHARACTERISTIC DINH_Lim.DFC_DevLibBattUHi_CA "" VAL_BLK 0x800410B4 ValA_Wu8 14.0000000000 DINH_LimDFCVerb 0.00 14.0000000000 FORMAT "%13.10" NUMBER 2 /end CHARACTERISTIC
/begin CHARACTERISTIC DINH_Lim.DFC_DevLibBattULo_CA "" VAL_BLK 0x800410B6 ValA_Wu8 14.0000000000 DINH_LimDFCVerb 0.00 14.0000000000 FORMAT "%13.10" NUMBER 2 /end CHARACTERISTIC
/begin CHARACTERISTIC DINH_Lim.DFC_FanDIOOL_CA "" VAL_BLK 0x800410B8 ValA_Wu8 14.0000000000 DINH_LimDFCVerb 0.00 14.0000000000 FORMAT "%13.10" NUMBER 3 /end CHARACTERISTIC
/begin CHARACTERISTIC DINH_Lim.DFC_FanDIOOvrTemp_CA "" VAL_BLK 0x800410BB ValA_Wu8 14.0000000000 DINH_LimDFCVerb 0.00 14.0000000000 FORMAT "%13.10" NUMBER 2 /end CHARACTERISTIC
/begin CHARACTERISTIC DINH_Lim.DFC_FanDIOSCB_CA "" VAL_BLK 0x800410BD ValA_Wu8 14.0000000000 DINH_LimDFCVerb 0.00 14.0000000000 FORMAT "%13.10" NUMBER 3 /end CHARACTERISTIC
/begin CHARACTERISTIC DINH_Lim.DFC_FanDIOSCG_CA "" VAL_BLK 0x800410C0 ValA_Wu8 14.0000000000 DINH_LimDFCVerb 0.00 14.0000000000 FORMAT "%13.10" NUMBER 3 /end CHARACTERISTIC
/begin CHARACTERISTIC DINH_Lim.DFC_FanPWMOL_CA "" VAL_BLK 0x800410C3 ValA_Wu8 14.0000000000 DINH_LimDFCVerb 0.00 14.0000000000 FORMAT "%13.10" NUMBER 2 /end CHARACTERISTIC
/begin CHARACTERISTIC DINH_Lim.DFC_FanPWMOvrTemp_CA "" VAL_BLK 0x800410C5 ValA_Wu8 14.0000000000 DINH_LimDFCVerb 0.00 14.0000000000 FORMAT "%13.10" NUMBER 2 /end CHARACTERISTIC
/begin CHARACTERISTIC DINH_Lim.DFC_FanPWMSCB_CA "" VAL_BLK 0x800410C7 ValA_Wu8 14.0000000000 DINH_LimDFCVerb 0.00 14.0000000000 FORMAT "%13.10" NUMBER 2 /end CHARACTERISTIC
/begin CHARACTERISTIC DINH_Lim.DFC_FanPWMSCG_CA "" VAL_BLK 0x800410C9 ValA_Wu8 14.0000000000 DINH_LimDFCVerb 0.00 14.0000000000 FORMAT "%13.10" NUMBER 2 /end CHARACTERISTIC
/begin CHARACTERISTIC DINH_Lim.DFC_AirCClntPAnaSRCMax_CA "" VAL_BLK 0x800410CB ValA_Wu8 14.0000000000 DINH_LimDFCVerb 0.00 14.0000000000 FORMAT "%13.10" NUMBER 5 /end CHARACTERISTIC
/begin CHARACTERISTIC DINH_Lim.DFC_AirCClntPAnaSRCMin_CA "" VAL_BLK 0x800410D0 ValA_Wu8 14.0000000000 DINH_LimDFCVerb 0.00 14.0000000000 FORMAT "%13.10" NUMBER 5 /end CHARACTERISTIC
/begin CHARACTERISTIC DINH_Lim.DFC_AirCSwtNpl_CA "" VAL_BLK 0x800410D5 ValA_Wu8 14.0000000000 DINH_LimDFCVerb 0.00 14.0000000000 FORMAT "%13.10" NUMBER 3 /end CHARACTERISTIC
/begin CHARACTERISTIC DINH_Lim.DFC_AirCSwtSig_CA "" VAL_BLK 0x800410D8 ValA_Wu8 14.0000000000 DINH_LimDFCVerb 0.00 14.0000000000 FORMAT "%13.10" NUMBER 3 /end CHARACTERISTIC
/begin CHARACTERISTIC DINH_Lim.DFC_AltIOLdSRCMax_CA "" VAL_BLK 0x800410DB ValA_Wu8 14.0000000000 DINH_LimDFCVerb 0.00 14.0000000000 FORMAT "%13.10" NUMBER 4 /end CHARACTERISTIC
/begin CHARACTERISTIC DINH_Lim.DFC_BrkSig_CA "" VAL_BLK 0x800410DF ValA_Wu8 14.0000000000 DINH_LimDFCVerb 0.00 14.0000000000 FORMAT "%13.10" NUMBER 2 /end CHARACTERISTIC
/begin CHARACTERISTIC DINH_Lim.DFC_ClthEPBNpl_CA "" VAL_BLK 0x800410E1 ValA_Wu8 14.0000000000 DINH_LimDFCVerb 0.00 14.0000000000 FORMAT "%13.10" NUMBER 3 /end CHARACTERISTIC
/begin CHARACTERISTIC DINH_Lim.DFC_ClthEPBSensErr_CA "" VAL_BLK 0x800410E4 ValA_Wu8 14.0000000000 DINH_LimDFCVerb 0.00 14.0000000000 FORMAT "%13.10" NUMBER 4 /end CHARACTERISTIC
/begin CHARACTERISTIC DINH_Lim.DFC_ClthErr_CA "" VAL_BLK 0x800410E8 ValA_Wu8 14.0000000000 DINH_LimDFCVerb 0.00 14.0000000000 FORMAT "%13.10" NUMBER 2 /end CHARACTERISTIC
/begin CHARACTERISTIC DINH_Lim.DFC_ClthSig_Enf_CA "" VAL_BLK 0x800410EA ValA_Wu8 14.0000000000 DINH_LimDFCVerb 0.00 14.0000000000 FORMAT "%13.10" NUMBER 3 /end CHARACTERISTIC
/begin CHARACTERISTIC DINH_Lim.DFC_ClthSig_CA "" VAL_BLK 0x800410ED ValA_Wu8 14.0000000000 DINH_LimDFCVerb 0.00 14.0000000000 FORMAT "%13.10" NUMBER 3 /end CHARACTERISTIC
/begin CHARACTERISTIC DINH_Lim.DFC_MILLmpOL_CA "" VAL_BLK 0x800410F0 ValA_Wu8 14.0000000000 DINH_LimDFCVerb 0.00 14.0000000000 FORMAT "%13.10" NUMBER 2 /end CHARACTERISTIC
/begin CHARACTERISTIC DINH_Lim.DFC_MILLmpSCB_CA "" VAL_BLK 0x800410F2 ValA_Wu8 14.0000000000 DINH_LimDFCVerb 0.00 14.0000000000 FORMAT "%13.10" NUMBER 2 /end CHARACTERISTIC
/begin CHARACTERISTIC DINH_Lim.DFC_MILLmpSCG_CA "" VAL_BLK 0x800410F4 ValA_Wu8 14.0000000000 DINH_LimDFCVerb 0.00 14.0000000000 FORMAT "%13.10" NUMBER 2 /end CHARACTERISTIC
/begin CHARACTERISTIC DINH_Lim.DFC_SRCHighAPP1_CA "" VAL_BLK 0x800410F6 ValA_Wu8 14.0000000000 DINH_LimDFCVerb 0.00 14.0000000000 FORMAT "%13.10" NUMBER 3 /end CHARACTERISTIC
/begin CHARACTERISTIC DINH_Lim.DFC_SRCHighAPP2_CA "" VAL_BLK 0x800410F9 ValA_Wu8 14.0000000000 DINH_LimDFCVerb 0.00 14.0000000000 FORMAT "%13.10" NUMBER 3 /end CHARACTERISTIC
/begin CHARACTERISTIC DINH_Lim.DFC_SRCLowAPP1_CA "" VAL_BLK 0x800410FC ValA_Wu8 14.0000000000 DINH_LimDFCVerb 0.00 14.0000000000 FORMAT "%13.10" NUMBER 2 /end CHARACTERISTIC
/begin CHARACTERISTIC DINH_Lim.DFC_SRCLowAPP2_CA "" VAL_BLK 0x800410FE ValA_Wu8 14.0000000000 DINH_LimDFCVerb 0.00 14.0000000000 FORMAT "%13.10" NUMBER 2 /end CHARACTERISTIC
/begin CHARACTERISTIC DINH_Lim.DFC_SyncAPP_CA "" VAL_BLK 0x80041100 ValA_Wu8 14.0000000000 DINH_LimDFCVerb 0.00 14.0000000000 FORMAT "%13.10" NUMBER 4 /end CHARACTERISTIC
/begin CHARACTERISTIC DINH_Lim.DFC_VehVMax_CA "" VAL_BLK 0x80041104 ValA_Wu8 14.0000000000 DINH_LimDFCVerb 0.00 14.0000000000 FORMAT "%13.10" NUMBER 21 /end CHARACTERISTIC
/begin CHARACTERISTIC DINH_Lim.DFC_VehVPlaus_CA "" VAL_BLK 0x80041119 ValA_Wu8 14.0000000000 DINH_LimDFCVerb 0.00 14.0000000000 FORMAT "%13.10" NUMBER 21 /end CHARACTERISTIC
/begin CHARACTERISTIC DINH_Lim.DFC_VehVSig_CA "" VAL_BLK 0x8004112E ValA_Wu8 14.0000000000 DINH_LimDFCVerb 0.00 14.0000000000 FORMAT "%13.10" NUMBER 20 /end CHARACTERISTIC
/begin CHARACTERISTIC DINH_Lim.DFC_BusDiagBusOffNodeA_CA "" VAL_BLK 0x80041142 ValA_Wu8 14.0000000000 DINH_LimDFCVerb 0.00 14.0000000000 FORMAT "%13.10" NUMBER 4 /end CHARACTERISTIC
/begin CHARACTERISTIC DINH_Lim.DFC_ComACSensTO_CA "" VAL_BLK 0x80041146 ValA_Wu8 14.0000000000 DINH_LimDFCVerb 0.00 14.0000000000 FORMAT "%13.10" NUMBER 2 /end CHARACTERISTIC
/begin CHARACTERISTIC DINH_Lim.DFC_ComAWD1TO_CA "" VAL_BLK 0x80041148 ValA_Wu8 14.0000000000 DINH_LimDFCVerb 0.00 14.0000000000 FORMAT "%13.10" NUMBER 2 /end CHARACTERISTIC
/begin CHARACTERISTIC DINH_Lim.DFC_ComBRK10TO_CA "" VAL_BLK 0x8004114A ValA_Wu8 14.0000000000 DINH_LimDFCVerb 0.00 14.0000000000 FORMAT "%13.10" NUMBER 2 /end CHARACTERISTIC
/begin CHARACTERISTIC DINH_Lim.DFC_ComGW11TO_CA "" VAL_BLK 0x8004114C ValA_Wu8 14.0000000000 DINH_LimDFCVerb 0.00 14.0000000000 FORMAT "%13.10" NUMBER 2 /end CHARACTERISTIC
/begin CHARACTERISTIC DINH_Lim.DFC_ComLVL1TO_CA "" VAL_BLK 0x8004114E ValA_Wu8 14.0000000000 DINH_LimDFCVerb 0.00 14.0000000000 FORMAT "%13.10" NUMBER 2 /end CHARACTERISTIC
/begin CHARACTERISTIC DINH_Lim.DFC_ComPRKA01TO_CA "" VAL_BLK 0x80041150 ValA_Wu8 14.0000000000 DINH_LimDFCVerb 0.00 14.0000000000 FORMAT "%13.10" NUMBER 2 /end CHARACTERISTIC
/begin CHARACTERISTIC DINH_Lim.DFC_ComPRKH01TO_CA "" VAL_BLK 0x80041152 ValA_Wu8 14.0000000000 DINH_LimDFCVerb 0.00 14.0000000000 FORMAT "%13.10" NUMBER 2 /end CHARACTERISTIC
/begin CHARACTERISTIC DINH_Lim.DFC_ComPRKH1TO_CA "" VAL_BLK 0x80041154 ValA_Wu8 14.0000000000 DINH_LimDFCVerb 0.00 14.0000000000 FORMAT "%13.10" NUMBER 2 /end CHARACTERISTIC
/begin CHARACTERISTIC DINH_Lim.DFC_ComTRBCH1TO_CA "" VAL_BLK 0x80041156 ValA_Wu8 14.0000000000 DINH_LimDFCVerb 0.00 14.0000000000 FORMAT "%13.10" NUMBER 2 /end CHARACTERISTIC
/begin CHARACTERISTIC DINH_Lim.DFC_ComTRBCH2TO_CA "" VAL_BLK 0x80041158 ValA_Wu8 14.0000000000 DINH_LimDFCVerb 0.00 14.0000000000 FORMAT "%13.10" NUMBER 2 /end CHARACTERISTIC
/begin CHARACTERISTIC DINH_Lim.DFC_DK_CA "" VAL_BLK 0x8004115A ValA_Wu8 14.0000000000 DINH_LimDFCVerb 0.00 14.0000000000 FORMAT "%13.10" NUMBER 11 /end CHARACTERISTIC
/begin CHARACTERISTIC DINH_Lim.DFC_DKRSA_CA "" VAL_BLK 0x80041165 ValA_Wu8 14.0000000000 DINH_LimDFCVerb 0.00 14.0000000000 FORMAT "%13.10" NUMBER 3 /end CHARACTERISTIC
/begin CHARACTERISTIC DINH_Lim.DFC_DKVSmax_CA "" VAL_BLK 0x80041168 ValA_Wu8 14.0000000000 DINH_LimDFCVerb 0.00 14.0000000000 FORMAT "%13.10" NUMBER 2 /end CHARACTERISTIC
/begin CHARACTERISTIC DINH_Lim.DFC_DKmax_CA "" VAL_BLK 0x8004116A ValA_Wu8 14.0000000000 DINH_LimDFCVerb 0.00 14.0000000000 FORMAT "%13.10" NUMBER 2 /end CHARACTERISTIC
/begin CHARACTERISTIC DINH_Lim.DFC_DKmin_CA "" VAL_BLK 0x8004116C ValA_Wu8 14.0000000000 DINH_LimDFCVerb 0.00 14.0000000000 FORMAT "%13.10" NUMBER 2 /end CHARACTERISTIC
/begin CHARACTERISTIC DINH_Lim.DFC_DSSmax_CA "" VAL_BLK 0x8004116E ValA_Wu8 14.0000000000 DINH_LimDFCVerb 0.00 14.0000000000 FORMAT "%13.10" NUMBER 2 /end CHARACTERISTIC
/begin CHARACTERISTIC DINH_Lim.DFC_EEPEraseErr_CA "" VAL_BLK 0x80041170 ValA_Wu8 14.0000000000 DINH_LimDFCVerb 0.00 14.0000000000 FORMAT "%13.10" NUMBER 2 /end CHARACTERISTIC
/begin CHARACTERISTIC DINH_Lim.DFC_EEPRdErr_CA "" VAL_BLK 0x80041172 ValA_Wu8 14.0000000000 DINH_LimDFCVerb 0.00 14.0000000000 FORMAT "%13.10" NUMBER 2 /end CHARACTERISTIC
/begin CHARACTERISTIC DINH_Lim.DFC_EEPWrErr_CA "" VAL_BLK 0x80041174 ValA_Wu8 14.0000000000 DINH_LimDFCVerb 0.00 14.0000000000 FORMAT "%13.10" NUMBER 2 /end CHARACTERISTIC
/begin CHARACTERISTIC DINH_Lim.DFC_EV1max_CA "" VAL_BLK 0x80041176 ValA_Wu8 14.0000000000 DINH_LimDFCVerb 0.00 14.0000000000 FORMAT "%13.10" NUMBER 3 /end CHARACTERISTIC
/begin CHARACTERISTIC DINH_Lim.DFC_EV1min_CA "" VAL_BLK 0x80041179 ValA_Wu8 14.0000000000 DINH_LimDFCVerb 0.00 14.0000000000 FORMAT "%13.10" NUMBER 4 /end CHARACTERISTIC
/begin CHARACTERISTIC DINH_Lim.DFC_EV1sig_CA "" VAL_BLK 0x8004117D ValA_Wu8 14.0000000000 DINH_LimDFCVerb 0.00 14.0000000000 FORMAT "%13.10" NUMBER 3 /end CHARACTERISTIC
/begin CHARACTERISTIC DINH_Lim.DFC_EV2max_CA "" VAL_BLK 0x80041180 ValA_Wu8 14.0000000000 DINH_LimDFCVerb 0.00 14.0000000000 FORMAT "%13.10" NUMBER 3 /end CHARACTERISTIC
/begin CHARACTERISTIC DINH_Lim.DFC_EV2min_CA "" VAL_BLK 0x80041183 ValA_Wu8 14.0000000000 DINH_LimDFCVerb 0.00 14.0000000000 FORMAT "%13.10" NUMBER 4 /end CHARACTERISTIC
/begin CHARACTERISTIC DINH_Lim.DFC_EV2sig_CA "" VAL_BLK 0x80041187 ValA_Wu8 14.0000000000 DINH_LimDFCVerb 0.00 14.0000000000 FORMAT "%13.10" NUMBER 3 /end CHARACTERISTIC
/begin CHARACTERISTIC DINH_Lim.DFC_EV3max_CA "" VAL_BLK 0x8004118A ValA_Wu8 14.0000000000 DINH_LimDFCVerb 0.00 14.0000000000 FORMAT "%13.10" NUMBER 3 /end CHARACTERISTIC
/begin CHARACTERISTIC DINH_Lim.DFC_EV3min_CA "" VAL_BLK 0x8004118D ValA_Wu8 14.0000000000 DINH_LimDFCVerb 0.00 14.0000000000 FORMAT "%13.10" NUMBER 4 /end CHARACTERISTIC
/begin CHARACTERISTIC DINH_Lim.DFC_EV3sig_CA "" VAL_BLK 0x80041191 ValA_Wu8 14.0000000000 DINH_LimDFCVerb 0.00 14.0000000000 FORMAT "%13.10" NUMBER 3 /end CHARACTERISTIC
/begin CHARACTERISTIC DINH_Lim.DFC_EpmCaSI1ErrSig_CA "" VAL_BLK 0x80041194 ValA_Wu8 14.0000000000 DINH_LimDFCVerb 0.00 14.0000000000 FORMAT "%13.10" NUMBER 6 /end CHARACTERISTIC
/begin CHARACTERISTIC DINH_Lim.DFC_EpmCaSI1NoSig_CA "" VAL_BLK 0x8004119A ValA_Wu8 14.0000000000 DINH_LimDFCVerb 0.00 14.0000000000 FORMAT "%13.10" NUMBER 6 /end CHARACTERISTIC
/begin CHARACTERISTIC DINH_Lim.DFC_EpmCaSI1NoSigMax_CA "" VAL_BLK 0x800411A0 ValA_Wu8 14.0000000000 DINH_LimDFCVerb 0.00 14.0000000000 FORMAT "%13.10" NUMBER 6 /end CHARACTERISTIC
/begin CHARACTERISTIC DINH_Lim.DFC_EpmCaSI1NoSigMin_CA "" VAL_BLK 0x800411A6 ValA_Wu8 14.0000000000 DINH_LimDFCVerb 0.00 14.0000000000 FORMAT "%13.10" NUMBER 6 /end CHARACTERISTIC
/begin CHARACTERISTIC DINH_Lim.DFC_EpmCaSI1OfsErr_CA "" VAL_BLK 0x800411AC ValA_Wu8 14.0000000000 DINH_LimDFCVerb 0.00 14.0000000000 FORMAT "%13.10" NUMBER 10 /end CHARACTERISTIC
/begin CHARACTERISTIC DINH_Lim.DFC_EpmCrSErrSig_Enf_CA "" VAL_BLK 0x800411B6 ValA_Wu8 14.0000000000 DINH_LimDFCVerb 0.00 14.0000000000 FORMAT "%13.10" NUMBER 3 /end CHARACTERISTIC
/begin CHARACTERISTIC DINH_Lim.DFC_EpmCrSErrSig_CA "" VAL_BLK 0x800411B9 ValA_Wu8 14.0000000000 DINH_LimDFCVerb 0.00 14.0000000000 FORMAT "%13.10" NUMBER 13 /end CHARACTERISTIC
/begin CHARACTERISTIC DINH_Lim.DFC_EpmCrSNoSig_Enf_CA "" VAL_BLK 0x800411C6 ValA_Wu8 14.0000000000 DINH_LimDFCVerb 0.00 14.0000000000 FORMAT "%13.10" NUMBER 3 /end CHARACTERISTIC
/begin CHARACTERISTIC DINH_Lim.DFC_EpmCrSNoSig_CA "" VAL_BLK 0x800411C9 ValA_Wu8 14.0000000000 DINH_LimDFCVerb 0.00 14.0000000000 FORMAT "%13.10" NUMBER 13 /end CHARACTERISTIC
/begin CHARACTERISTIC DINH_Lim.DFC_FRAmax_CA "" VAL_BLK 0x800411D6 ValA_Wu8 14.0000000000 DINH_LimDFCVerb 0.00 14.0000000000 FORMAT "%13.10" NUMBER 3 /end CHARACTERISTIC
/begin CHARACTERISTIC DINH_Lim.DFC_FRAmin_CA "" VAL_BLK 0x800411D9 ValA_Wu8 14.0000000000 DINH_LimDFCVerb 0.00 14.0000000000 FORMAT "%13.10" NUMBER 3 /end CHARACTERISTIC
/begin CHARACTERISTIC DINH_Lim.DFC_HEGOS1B1ElecMax_CA "" VAL_BLK 0x800411DC ValA_Wu8 14.0000000000 DINH_LimDFCVerb 0.00 14.0000000000 FORMAT "%13.10" NUMBER 8 /end CHARACTERISTIC
/begin CHARACTERISTIC DINH_Lim.DFC_HEGOS1B1ElecMin_CA "" VAL_BLK 0x800411E4 ValA_Wu8 14.0000000000 DINH_LimDFCVerb 0.00 14.0000000000 FORMAT "%13.10" NUMBER 7 /end CHARACTERISTIC
/begin CHARACTERISTIC DINH_Lim.DFC_HEGOS1B1ElecNpl_CA "" VAL_BLK 0x800411EB ValA_Wu8 14.0000000000 DINH_LimDFCVerb 0.00 14.0000000000 FORMAT "%13.10" NUMBER 6 /end CHARACTERISTIC
/begin CHARACTERISTIC DINH_Lim.DFC_HEGOS1B1ElecSig_CA "" VAL_BLK 0x800411F1 ValA_Wu8 14.0000000000 DINH_LimDFCVerb 0.00 14.0000000000 FORMAT "%13.10" NUMBER 7 /end CHARACTERISTIC
/begin CHARACTERISTIC DINH_Lim.DFC_HEGOS1B1HtgNpl_CA "" VAL_BLK 0x800411F8 ValA_Wu8 14.0000000000 DINH_LimDFCVerb 0.00 14.0000000000 FORMAT "%13.10" NUMBER 5 /end CHARACTERISTIC
/begin CHARACTERISTIC DINH_Lim.DFC_HEGOS1B1HtrPsMax_CA "" VAL_BLK 0x800411FD ValA_Wu8 14.0000000000 DINH_LimDFCVerb 0.00 14.0000000000 FORMAT "%13.10" NUMBER 7 /end CHARACTERISTIC
/begin CHARACTERISTIC DINH_Lim.DFC_HEGOS1B1HtrPsMin_CA "" VAL_BLK 0x80041204 ValA_Wu8 14.0000000000 DINH_LimDFCVerb 0.00 14.0000000000 FORMAT "%13.10" NUMBER 7 /end CHARACTERISTIC
/begin CHARACTERISTIC DINH_Lim.DFC_HEGOS1B1HtrPsSig_CA "" VAL_BLK 0x8004120B ValA_Wu8 14.0000000000 DINH_LimDFCVerb 0.00 14.0000000000 FORMAT "%13.10" NUMBER 7 /end CHARACTERISTIC
/begin CHARACTERISTIC DINH_Lim.DFC_HEGOS1B1StkMax_CA "" VAL_BLK 0x80041212 ValA_Wu8 14.0000000000 DINH_LimDFCVerb 0.00 14.0000000000 FORMAT "%13.10" NUMBER 2 /end CHARACTERISTIC
/begin CHARACTERISTIC DINH_Lim.DFC_HEGOS1B1StkMin_CA "" VAL_BLK 0x80041214 ValA_Wu8 14.0000000000 DINH_LimDFCVerb 0.00 14.0000000000 FORMAT "%13.10" NUMBER 2 /end CHARACTERISTIC
/begin CHARACTERISTIC DINH_Lim.DFC_HEGOS2B1RstrcnLean_CA "" VAL_BLK 0x80041216 ValA_Wu8 14.0000000000 DINH_LimDFCVerb 0.00 14.0000000000 FORMAT "%13.10" NUMBER 4 /end CHARACTERISTIC
/begin CHARACTERISTIC DINH_Lim.DFC_HEGOS2B1RstrcnRich_CA "" VAL_BLK 0x8004121A ValA_Wu8 14.0000000000 DINH_LimDFCVerb 0.00 14.0000000000 FORMAT "%13.10" NUMBER 4 /end CHARACTERISTIC
/begin CHARACTERISTIC DINH_Lim.DFC_IdleChrgActrJamVlvClsd_CA "" VAL_BLK 0x8004121E ValA_Wu8 14.0000000000 DINH_LimDFCVerb 0.00 14.0000000000 FORMAT "%13.10" NUMBER 4 /end CHARACTERISTIC
/begin CHARACTERISTIC DINH_Lim.DFC_IdleChrgActrJamVlvOpn_CA "" VAL_BLK 0x80041222 ValA_Wu8 14.0000000000 DINH_LimDFCVerb 0.00 14.0000000000 FORMAT "%13.10" NUMBER 4 /end CHARACTERISTIC
/begin CHARACTERISTIC DINH_Lim.DFC_IgnClPsDevOscErr1_CA "" VAL_BLK 0x80041226 ValA_Wu8 14.0000000000 DINH_LimDFCVerb 0.00 14.0000000000 FORMAT "%13.10" NUMBER 2 /end CHARACTERISTIC
/begin CHARACTERISTIC DINH_Lim.DFC_KPEmax_CA "" VAL_BLK 0x80041228 ValA_Wu8 14.0000000000 DINH_LimDFCVerb 0.00 14.0000000000 FORMAT "%13.10" NUMBER 2 /end CHARACTERISTIC
/begin CHARACTERISTIC DINH_Lim.DFC_KPEmin_CA "" VAL_BLK 0x8004122A ValA_Wu8 14.0000000000 DINH_LimDFCVerb 0.00 14.0000000000 FORMAT "%13.10" NUMBER 2 /end CHARACTERISTIC
/begin CHARACTERISTIC DINH_Lim.DFC_KPEsig_CA "" VAL_BLK 0x8004122C ValA_Wu8 14.0000000000 DINH_LimDFCVerb 0.00 14.0000000000 FORMAT "%13.10" NUMBER 2 /end CHARACTERISTIC
/begin CHARACTERISTIC DINH_Lim.DFC_KS1max_CA "" VAL_BLK 0x8004122E ValA_Wu8 14.0000000000 DINH_LimDFCVerb 0.00 14.0000000000 FORMAT "%13.10" NUMBER 3 /end CHARACTERISTIC
/begin CHARACTERISTIC DINH_Lim.DFC_KS1min_CA "" VAL_BLK 0x80041231 ValA_Wu8 14.0000000000 DINH_LimDFCVerb 0.00 14.0000000000 FORMAT "%13.10" NUMBER 3 /end CHARACTERISTIC
/begin CHARACTERISTIC DINH_Lim.DFC_LLRKHmax_CA "" VAL_BLK 0x80041234 ValA_Wu8 14.0000000000 DINH_LimDFCVerb 0.00 14.0000000000 FORMAT "%13.10" NUMBER 2 /end CHARACTERISTIC
/begin CHARACTERISTIC DINH_Lim.DFC_LLRKHmin_CA "" VAL_BLK 0x80041236 ValA_Wu8 14.0000000000 DINH_LimDFCVerb 0.00 14.0000000000 FORMAT "%13.10" NUMBER 2 /end CHARACTERISTIC
/begin CHARACTERISTIC DINH_Lim.DFC_LLRKHnpl_CA "" VAL_BLK 0x80041238 ValA_Wu8 14.0000000000 DINH_LimDFCVerb 0.00 14.0000000000 FORMAT "%13.10" NUMBER 2 /end CHARACTERISTIC
/begin CHARACTERISTIC DINH_Lim.DFC_LLRmax_CA "" VAL_BLK 0x8004123A ValA_Wu8 14.0000000000 DINH_LimDFCVerb 0.00 14.0000000000 FORMAT "%13.10" NUMBER 2 /end CHARACTERISTIC
/begin CHARACTERISTIC DINH_Lim.DFC_LLRmin_CA "" VAL_BLK 0x8004123C ValA_Wu8 14.0000000000 DINH_LimDFCVerb 0.00 14.0000000000 FORMAT "%13.10" NUMBER 2 /end CHARACTERISTIC
/begin CHARACTERISTIC DINH_Lim.DFC_LLRnpl_CA "" VAL_BLK 0x8004123E ValA_Wu8 14.0000000000 DINH_LimDFCVerb 0.00 14.0000000000 FORMAT "%13.10" NUMBER 2 /end CHARACTERISTIC
/begin CHARACTERISTIC DINH_Lim.DFC_LMmax_CA "" VAL_BLK 0x80041240 ValA_Wu8 14.0000000000 DINH_LimDFCVerb 0.00 14.0000000000 FORMAT "%13.10" NUMBER 3 /end CHARACTERISTIC
/begin CHARACTERISTIC DINH_Lim.DFC_LZSRnpl_CA "" VAL_BLK 0x80041243 ValA_Wu8 14.0000000000 DINH_LimDFCVerb 0.00 14.0000000000 FORMAT "%13.10" NUMBER 2 /end CHARACTERISTIC
/begin CHARACTERISTIC DINH_Lim.DFC_MD_CA "" VAL_BLK 0x80041245 ValA_Wu8 14.0000000000 DINH_LimDFCVerb 0.00 14.0000000000 FORMAT "%13.10" NUMBER 7 /end CHARACTERISTIC
/begin CHARACTERISTIC DINH_Lim.DFC_MD00min_CA "" VAL_BLK 0x8004124C ValA_Wu8 14.0000000000 DINH_LimDFCVerb 0.00 14.0000000000 FORMAT "%13.10" NUMBER 2 /end CHARACTERISTIC
/begin CHARACTERISTIC DINH_Lim.DFC_MD00npl_CA "" VAL_BLK 0x8004124E ValA_Wu8 14.0000000000 DINH_LimDFCVerb 0.00 14.0000000000 FORMAT "%13.10" NUMBER 2 /end CHARACTERISTIC
/begin CHARACTERISTIC DINH_Lim.DFC_MD01min_CA "" VAL_BLK 0x80041250 ValA_Wu8 14.0000000000 DINH_LimDFCVerb 0.00 14.0000000000 FORMAT "%13.10" NUMBER 2 /end CHARACTERISTIC
/begin CHARACTERISTIC DINH_Lim.DFC_MD01npl_CA "" VAL_BLK 0x80041252 ValA_Wu8 14.0000000000 DINH_LimDFCVerb 0.00 14.0000000000 FORMAT "%13.10" NUMBER 2 /end CHARACTERISTIC
/begin CHARACTERISTIC DINH_Lim.DFC_MD02min_CA "" VAL_BLK 0x80041254 ValA_Wu8 14.0000000000 DINH_LimDFCVerb 0.00 14.0000000000 FORMAT "%13.10" NUMBER 2 /end CHARACTERISTIC
/begin CHARACTERISTIC DINH_Lim.DFC_MD02npl_CA "" VAL_BLK 0x80041256 ValA_Wu8 14.0000000000 DINH_LimDFCVerb 0.00 14.0000000000 FORMAT "%13.10" NUMBER 2 /end CHARACTERISTIC
/begin CHARACTERISTIC DINH_Lim.DFC_MD03min_CA "" VAL_BLK 0x80041258 ValA_Wu8 14.0000000000 DINH_LimDFCVerb 0.00 14.0000000000 FORMAT "%13.10" NUMBER 2 /end CHARACTERISTIC
/begin CHARACTERISTIC DINH_Lim.DFC_MD03npl_CA "" VAL_BLK 0x8004125A ValA_Wu8 14.0000000000 DINH_LimDFCVerb 0.00 14.0000000000 FORMAT "%13.10" NUMBER 2 /end CHARACTERISTIC
/begin CHARACTERISTIC DINH_Lim.DFC_MD04min_CA "" VAL_BLK 0x8004125C ValA_Wu8 14.0000000000 DINH_LimDFCVerb 0.00 14.0000000000 FORMAT "%13.10" NUMBER 2 /end CHARACTERISTIC
/begin CHARACTERISTIC DINH_Lim.DFC_MD04npl_CA "" VAL_BLK 0x8004125E ValA_Wu8 14.0000000000 DINH_LimDFCVerb 0.00 14.0000000000 FORMAT "%13.10" NUMBER 2 /end CHARACTERISTIC
/begin CHARACTERISTIC DINH_Lim.DFC_MDCyl_0_CA "" VAL_BLK 0x80041260 ValA_Wu8 14.0000000000 DINH_LimDFCVerb 0.00 14.0000000000 FORMAT "%13.10" NUMBER 2 /end CHARACTERISTIC
/begin CHARACTERISTIC DINH_Lim.DFC_MDCyl_1_CA "" VAL_BLK 0x80041262 ValA_Wu8 14.0000000000 DINH_LimDFCVerb 0.00 14.0000000000 FORMAT "%13.10" NUMBER 2 /end CHARACTERISTIC
/begin CHARACTERISTIC DINH_Lim.DFC_MDCyl_2_CA "" VAL_BLK 0x80041264 ValA_Wu8 14.0000000000 DINH_LimDFCVerb 0.00 14.0000000000 FORMAT "%13.10" NUMBER 2 /end CHARACTERISTIC
/begin CHARACTERISTIC DINH_Lim.DFC_MDFC_CA "" VAL_BLK 0x80041266 ValA_Wu8 14.0000000000 DINH_LimDFCVerb 0.00 14.0000000000 FORMAT "%13.10" NUMBER 2 /end CHARACTERISTIC
/begin CHARACTERISTIC DINH_Lim.DFC_MDmin_CA "" VAL_BLK 0x80041268 ValA_Wu8 14.0000000000 DINH_LimDFCVerb 0.00 14.0000000000 FORMAT "%13.10" NUMBER 2 /end CHARACTERISTIC
/begin CHARACTERISTIC DINH_Lim.DFC_MDnpl_CA "" VAL_BLK 0x8004126A ValA_Wu8 14.0000000000 DINH_LimDFCVerb 0.00 14.0000000000 FORMAT "%13.10" NUMBER 2 /end CHARACTERISTIC
/begin CHARACTERISTIC DINH_Lim.DFC_MoCADCNTP_CA "" VAL_BLK 0x8004126C ValA_Wu8 14.0000000000 DINH_LimDFCVerb 0.00 14.0000000000 FORMAT "%13.10" NUMBER 2 /end CHARACTERISTIC
/begin CHARACTERISTIC DINH_Lim.DFC_MoCADCTst_CA "" VAL_BLK 0x8004126E ValA_Wu8 14.0000000000 DINH_LimDFCVerb 0.00 14.0000000000 FORMAT "%13.10" NUMBER 2 /end CHARACTERISTIC
/begin CHARACTERISTIC DINH_Lim.DFC_MoCComctErrMM_CA "" VAL_BLK 0x80041270 ValA_Wu8 14.0000000000 DINH_LimDFCVerb 0.00 14.0000000000 FORMAT "%13.10" NUMBER 2 /end CHARACTERISTIC
/begin CHARACTERISTIC DINH_Lim.DFC_OCWDAActv_CA "" VAL_BLK 0x80041272 ValA_Wu8 14.0000000000 DINH_LimDFCVerb 0.00 14.0000000000 FORMAT "%13.10" NUMBER 2 /end CHARACTERISTIC
/begin CHARACTERISTIC DINH_Lim.DFC_OCWDACom_CA "" VAL_BLK 0x80041274 ValA_Wu8 14.0000000000 DINH_LimDFCVerb 0.00 14.0000000000 FORMAT "%13.10" NUMBER 2 /end CHARACTERISTIC
/begin CHARACTERISTIC DINH_Lim.DFC_ORAmax_CA "" VAL_BLK 0x80041276 ValA_Wu8 14.0000000000 DINH_LimDFCVerb 0.00 14.0000000000 FORMAT "%13.10" NUMBER 3 /end CHARACTERISTIC
/begin CHARACTERISTIC DINH_Lim.DFC_ORAmin_CA "" VAL_BLK 0x80041279 ValA_Wu8 14.0000000000 DINH_LimDFCVerb 0.00 14.0000000000 FORMAT "%13.10" NUMBER 3 /end CHARACTERISTIC
/begin CHARACTERISTIC DINH_Lim.DFC_PSR1max_CA "" VAL_BLK 0x8004127C ValA_Wu8 14.0000000000 DINH_LimDFCVerb 0.00 14.0000000000 FORMAT "%13.10" NUMBER 2 /end CHARACTERISTIC
/begin CHARACTERISTIC DINH_Lim.DFC_PSRBmax_CA "" VAL_BLK 0x8004127E ValA_Wu8 14.0000000000 DINH_LimDFCVerb 0.00 14.0000000000 FORMAT "%13.10" NUMBER 10 /end CHARACTERISTIC
/begin CHARACTERISTIC DINH_Lim.DFC_PSRBmin_CA "" VAL_BLK 0x80041288 ValA_Wu8 14.0000000000 DINH_LimDFCVerb 0.00 14.0000000000 FORMAT "%13.10" NUMBER 10 /end CHARACTERISTIC
/begin CHARACTERISTIC DINH_Lim.DFC_PSREmax_CA "" VAL_BLK 0x80041292 ValA_Wu8 14.0000000000 DINH_LimDFCVerb 0.00 14.0000000000 FORMAT "%13.10" NUMBER 10 /end CHARACTERISTIC
/begin CHARACTERISTIC DINH_Lim.DFC_PSREmin_CA "" VAL_BLK 0x8004129C ValA_Wu8 14.0000000000 DINH_LimDFCVerb 0.00 14.0000000000 FORMAT "%13.10" NUMBER 10 /end CHARACTERISTIC
/begin CHARACTERISTIC DINH_Lim.DFC_PSRPmax_CA "" VAL_BLK 0x800412A6 ValA_Wu8 14.0000000000 DINH_LimDFCVerb 0.00 14.0000000000 FORMAT "%13.10" NUMBER 8 /end CHARACTERISTIC
/begin CHARACTERISTIC DINH_Lim.DFC_PSRPmin_CA "" VAL_BLK 0x800412AE ValA_Wu8 14.0000000000 DINH_LimDFCVerb 0.00 14.0000000000 FORMAT "%13.10" NUMBER 8 /end CHARACTERISTIC
/begin CHARACTERISTIC DINH_Lim.DFC_PSRPsig_CA "" VAL_BLK 0x800412B6 ValA_Wu8 14.0000000000 DINH_LimDFCVerb 0.00 14.0000000000 FORMAT "%13.10" NUMBER 8 /end CHARACTERISTIC
/begin CHARACTERISTIC DINH_Lim.DFC_PSRmax_CA "" VAL_BLK 0x800412BE ValA_Wu8 14.0000000000 DINH_LimDFCVerb 0.00 14.0000000000 FORMAT "%13.10" NUMBER 2 /end CHARACTERISTIC
/begin CHARACTERISTIC DINH_Lim.DFC_SSpMon1_Enf_CA "" VAL_BLK 0x800412C0 ValA_Wu8 14.0000000000 DINH_LimDFCVerb 0.00 14.0000000000 FORMAT "%13.10" NUMBER 3 /end CHARACTERISTIC
/begin CHARACTERISTIC DINH_Lim.DFC_SSpMon1_CA "" VAL_BLK 0x800412C3 ValA_Wu8 14.0000000000 DINH_LimDFCVerb 0.00 14.0000000000 FORMAT "%13.10" NUMBER 2 /end CHARACTERISTIC
/begin CHARACTERISTIC DINH_Lim.DFC_SSpMon2_Enf_CA "" VAL_BLK 0x800412C5 ValA_Wu8 14.0000000000 DINH_LimDFCVerb 0.00 14.0000000000 FORMAT "%13.10" NUMBER 3 /end CHARACTERISTIC
/begin CHARACTERISTIC DINH_Lim.DFC_SSpMon2_CA "" VAL_BLK 0x800412C8 ValA_Wu8 14.0000000000 DINH_LimDFCVerb 0.00 14.0000000000 FORMAT "%13.10" NUMBER 9 /end CHARACTERISTIC
/begin CHARACTERISTIC DINH_Lim.DFC_SSpMon3_Enf_CA "" VAL_BLK 0x800412D1 ValA_Wu8 14.0000000000 DINH_LimDFCVerb 0.00 14.0000000000 FORMAT "%13.10" NUMBER 3 /end CHARACTERISTIC
/begin CHARACTERISTIC DINH_Lim.DFC_SSpMon3_CA "" VAL_BLK 0x800412D4 ValA_Wu8 14.0000000000 DINH_LimDFCVerb 0.00 14.0000000000 FORMAT "%13.10" NUMBER 3 /end CHARACTERISTIC
/begin CHARACTERISTIC DINH_Lim.DFC_SWReset_0_CA "" VAL_BLK 0x800412D7 ValA_Wu8 14.0000000000 DINH_LimDFCVerb 0.00 14.0000000000 FORMAT "%13.10" NUMBER 2 /end CHARACTERISTIC
/begin CHARACTERISTIC DINH_Lim.DFC_SWReset_1_CA "" VAL_BLK 0x800412D9 ValA_Wu8 14.0000000000 DINH_LimDFCVerb 0.00 14.0000000000 FORMAT "%13.10" NUMBER 2 /end CHARACTERISTIC
/begin CHARACTERISTIC DINH_Lim.DFC_SWReset_2_CA "" VAL_BLK 0x800412DB ValA_Wu8 14.0000000000 DINH_LimDFCVerb 0.00 14.0000000000 FORMAT "%13.10" NUMBER 2 /end CHARACTERISTIC
/begin CHARACTERISTIC DINH_Lim.DFC_TASREmax_CA "" VAL_BLK 0x800412DD ValA_Wu8 14.0000000000 DINH_LimDFCVerb 0.00 14.0000000000 FORMAT "%13.10" NUMBER 9 /end CHARACTERISTIC
/begin CHARACTERISTIC DINH_Lim.DFC_TASREmin_CA "" VAL_BLK 0x800412E6 ValA_Wu8 14.0000000000 DINH_LimDFCVerb 0.00 14.0000000000 FORMAT "%13.10" NUMBER 9 /end CHARACTERISTIC
/begin CHARACTERISTIC DINH_Lim.DFC_TASREnpl_CA "" VAL_BLK 0x800412EF ValA_Wu8 14.0000000000 DINH_LimDFCVerb 0.00 14.0000000000 FORMAT "%13.10" NUMBER 9 /end CHARACTERISTIC
/begin CHARACTERISTIC DINH_Lim.DFC_TASRmax_CA "" VAL_BLK 0x800412F8 ValA_Wu8 14.0000000000 DINH_LimDFCVerb 0.00 14.0000000000 FORMAT "%13.10" NUMBER 2 /end CHARACTERISTIC
/begin CHARACTERISTIC DINH_Lim.DFC_TAmax_CA "" VAL_BLK 0x800412FA ValA_Wu8 14.0000000000 DINH_LimDFCVerb 0.00 14.0000000000 FORMAT "%13.10" NUMBER 2 /end CHARACTERISTIC
/begin CHARACTERISTIC DINH_Lim.DFC_TEVEmax_CA "" VAL_BLK 0x800412FC ValA_Wu8 14.0000000000 DINH_LimDFCVerb 0.00 14.0000000000 FORMAT "%13.10" NUMBER 12 /end CHARACTERISTIC
/begin CHARACTERISTIC DINH_Lim.DFC_TEVEmin_CA "" VAL_BLK 0x80041308 ValA_Wu8 14.0000000000 DINH_LimDFCVerb 0.00 14.0000000000 FORMAT "%13.10" NUMBER 12 /end CHARACTERISTIC
/begin CHARACTERISTIC DINH_Lim.DFC_TEVEsig_CA "" VAL_BLK 0x80041314 ValA_Wu8 14.0000000000 DINH_LimDFCVerb 0.00 14.0000000000 FORMAT "%13.10" NUMBER 12 /end CHARACTERISTIC
/begin CHARACTERISTIC DINH_Lim.DFC_TMCSmax_CA "" VAL_BLK 0x80041320 ValA_Wu8 14.0000000000 DINH_LimDFCVerb 0.00 14.0000000000 FORMAT "%13.10" NUMBER 15 /end CHARACTERISTIC
/begin CHARACTERISTIC DINH_Lim.DFC_TMCSmin_CA "" VAL_BLK 0x8004132F ValA_Wu8 14.0000000000 DINH_LimDFCVerb 0.00 14.0000000000 FORMAT "%13.10" NUMBER 15 /end CHARACTERISTIC
/begin CHARACTERISTIC DINH_Lim.DFC_TMEmax_CA "" VAL_BLK 0x8004133E ValA_Wu8 14.0000000000 DINH_LimDFCVerb 0.00 14.0000000000 FORMAT "%13.10" NUMBER 17 /end CHARACTERISTIC
/begin CHARACTERISTIC DINH_Lim.DFC_TMEmin_CA "" VAL_BLK 0x8004134F ValA_Wu8 14.0000000000 DINH_LimDFCVerb 0.00 14.0000000000 FORMAT "%13.10" NUMBER 17 /end CHARACTERISTIC
/begin CHARACTERISTIC DINH_Lim.DFC_TMEnpl_CA "" VAL_BLK 0x80041360 ValA_Wu8 14.0000000000 DINH_LimDFCVerb 0.00 14.0000000000 FORMAT "%13.10" NUMBER 17 /end CHARACTERISTIC
/begin CHARACTERISTIC DINH_Lim.DFC_TMEsig_CA "" VAL_BLK 0x80041371 ValA_Wu8 14.0000000000 DINH_LimDFCVerb 0.00 14.0000000000 FORMAT "%13.10" NUMBER 17 /end CHARACTERISTIC
/begin CHARACTERISTIC DINH_Lim.DFC_TMPmax_CA "" VAL_BLK 0x80041382 ValA_Wu8 14.0000000000 DINH_LimDFCVerb 0.00 14.0000000000 FORMAT "%13.10" NUMBER 15 /end CHARACTERISTIC
/begin CHARACTERISTIC DINH_Lim.DFC_TMPmin_CA "" VAL_BLK 0x80041391 ValA_Wu8 14.0000000000 DINH_LimDFCVerb 0.00 14.0000000000 FORMAT "%13.10" NUMBER 15 /end CHARACTERISTIC
/begin CHARACTERISTIC DINH_Lim.DFC_TMPnpl_CA "" VAL_BLK 0x800413A0 ValA_Wu8 14.0000000000 DINH_LimDFCVerb 0.00 14.0000000000 FORMAT "%13.10" NUMBER 15 /end CHARACTERISTIC
/begin CHARACTERISTIC DINH_Lim.DFC_TMmax_CA "" VAL_BLK 0x800413AF ValA_Wu8 14.0000000000 DINH_LimDFCVerb 0.00 14.0000000000 FORMAT "%13.10" NUMBER 3 /end CHARACTERISTIC
/begin CHARACTERISTIC DINH_Lim.DFC_TUMmax_CA "" VAL_BLK 0x800413B2 ValA_Wu8 14.0000000000 DINH_LimDFCVerb 0.00 14.0000000000 FORMAT "%13.10" NUMBER 3 /end CHARACTERISTIC
/begin CHARACTERISTIC DINH_Lim.DFC_TWCCTrimMaxB1_CA "" VAL_BLK 0x800413B5 ValA_Wu8 14.0000000000 DINH_LimDFCVerb 0.00 14.0000000000 FORMAT "%13.10" NUMBER 3 /end CHARACTERISTIC
/begin CHARACTERISTIC DINH_Lim.DFC_TWCCTrimMinB1_CA "" VAL_BLK 0x800413B8 ValA_Wu8 14.0000000000 DINH_LimDFCVerb 0.00 14.0000000000 FORMAT "%13.10" NUMBER 3 /end CHARACTERISTIC
/begin CHARACTERISTIC DINH_Lim.DFC_TWCDPriCatB1_CA "" VAL_BLK 0x800413BB ValA_Wu8 14.0000000000 DINH_LimDFCVerb 0.00 14.0000000000 FORMAT "%13.10" NUMBER 2 /end CHARACTERISTIC
/begin CHARACTERISTIC DINH_Lim.DFC_UBRmax_CA "" VAL_BLK 0x800413BD ValA_Wu8 14.0000000000 DINH_LimDFCVerb 0.00 14.0000000000 FORMAT "%13.10" NUMBER 3 /end CHARACTERISTIC
/begin CHARACTERISTIC DINH_Lim.DFC_UBmax_CA "" VAL_BLK 0x800413C0 ValA_Wu8 14.0000000000 DINH_LimDFCVerb 0.00 14.0000000000 FORMAT "%13.10" NUMBER 3 /end CHARACTERISTIC
/begin CHARACTERISTIC DINH_Lim.DFC_UBmin_CA "" VAL_BLK 0x800413C3 ValA_Wu8 14.0000000000 DINH_LimDFCVerb 0.00 14.0000000000 FORMAT "%13.10" NUMBER 2 /end CHARACTERISTIC
/begin CHARACTERISTIC DINH_Lim.DFC_UBnpl_CA "" VAL_BLK 0x800413C5 ValA_Wu8 14.0000000000 DINH_LimDFCVerb 0.00 14.0000000000 FORMAT "%13.10" NUMBER 3 /end CHARACTERISTIC
/begin CHARACTERISTIC DINH_Lim.DSQ_ACClntP_CA "" VAL_BLK 0x800413C8 ValA_Wu8 15.0000000000 DINH_LimDSQVerb 0.00 15.0000000000 FORMAT "%13.10" NUMBER 2 /end CHARACTERISTIC
/begin CHARACTERISTIC DINH_Lim.DSQ_AirCCmprActr_CA "" VAL_BLK 0x800413CA ValA_Wu8 15.0000000000 DINH_LimDSQVerb 0.00 15.0000000000 FORMAT "%13.10" NUMBER 2 /end CHARACTERISTIC
/begin CHARACTERISTIC DINH_Lim.DSQ_AltIOActr_CA "" VAL_BLK 0x800413CC ValA_Wu8 15.0000000000 DINH_LimDSQVerb 0.00 15.0000000000 FORMAT "%13.10" NUMBER 2 /end CHARACTERISTIC
/begin CHARACTERISTIC DINH_Lim.DSQ_AltIOLoad_CA "" VAL_BLK 0x800413CE ValA_Wu8 15.0000000000 DINH_LimDSQVerb 0.00 15.0000000000 FORMAT "%13.10" NUMBER 3 /end CHARACTERISTIC
/begin CHARACTERISTIC DINH_Lim.DSQ_AltTrqDes_CA "" VAL_BLK 0x800413D1 ValA_Wu8 15.0000000000 DINH_LimDSQVerb 0.00 15.0000000000 FORMAT "%13.10" NUMBER 2 /end CHARACTERISTIC
/begin CHARACTERISTIC DINH_Lim.DSQ_BattUSSpThrVlv_CA "" VAL_BLK 0x800413D3 ValA_Wu8 15.0000000000 DINH_LimDSQVerb 0.00 15.0000000000 FORMAT "%13.10" NUMBER 2 /end CHARACTERISTIC
/begin CHARACTERISTIC DINH_Lim.DSQ_CEngDsT_CA "" VAL_BLK 0x800413D5 ValA_Wu8 15.0000000000 DINH_LimDSQVerb 0.00 15.0000000000 FORMAT "%13.10" NUMBER 3 /end CHARACTERISTIC
/begin CHARACTERISTIC DINH_Lim.DSQ_Clth_CA "" VAL_BLK 0x800413D8 ValA_Wu8 15.0000000000 DINH_LimDSQVerb 0.00 15.0000000000 FORMAT "%13.10" NUMBER 2 /end CHARACTERISTIC
/begin CHARACTERISTIC DINH_Lim.DSQ_DSMInhibitAlways_CA "" VAL_BLK 0x800413DA ValA_Wu8 15.0000000000 DINH_LimDSQVerb 0.00 15.0000000000 FORMAT "%13.10" NUMBER 3 /end CHARACTERISTIC
/begin CHARACTERISTIC DINH_Lim.DSQ_EpmReverseRun_CA "" VAL_BLK 0x800413DD ValA_Wu8 15.0000000000 DINH_LimDSQVerb 0.00 15.0000000000 FORMAT "%13.10" NUMBER 4 /end CHARACTERISTIC
/begin CHARACTERISTIC DINH_Lim.DSQ_FanDIO_CA "" VAL_BLK 0x800413E1 ValA_Wu8 15.0000000000 DINH_LimDSQVerb 0.00 15.0000000000 FORMAT "%13.10" NUMBER 2 /end CHARACTERISTIC
/begin CHARACTERISTIC DINH_Lim.DSQ_FanPWM_CA "" VAL_BLK 0x800413E3 ValA_Wu8 15.0000000000 DINH_LimDSQVerb 0.00 15.0000000000 FORMAT "%13.10" NUMBER 2 /end CHARACTERISTIC
/begin CHARACTERISTIC DINH_Lim.DSQ_IdleChrgActMod_CA "" VAL_BLK 0x800413E5 ValA_Wu8 15.0000000000 DINH_LimDSQVerb 0.00 15.0000000000 FORMAT "%13.10" NUMBER 3 /end CHARACTERISTIC
/begin CHARACTERISTIC DINH_Lim.DSQ_VehV_CA "" VAL_BLK 0x800413E8 ValA_Wu8 15.0000000000 DINH_LimDSQVerb 0.00 15.0000000000 FORMAT "%13.10" NUMBER 4 /end CHARACTERISTIC
/begin CHARACTERISTIC DINH_Lim.DSQ_stAPP_CA "" VAL_BLK 0x800413EC ValA_Wu8 15.0000000000 DINH_LimDSQVerb 0.00 15.0000000000 FORMAT "%13.10" NUMBER 2 /end CHARACTERISTIC
/begin CHARACTERISTIC DINH_Lim.DSQ_stAPP1_CA "" VAL_BLK 0x800413EE ValA_Wu8 15.0000000000 DINH_LimDSQVerb 0.00 15.0000000000 FORMAT "%13.10" NUMBER 7 /end CHARACTERISTIC
/begin CHARACTERISTIC DINH_Lim.DSQ_stAPP2_CA "" VAL_BLK 0x800413F5 ValA_Wu8 15.0000000000 DINH_LimDSQVerb 0.00 15.0000000000 FORMAT "%13.10" NUMBER 8 /end CHARACTERISTIC
/begin CHARACTERISTIC DINH_tiUpdObsv_C "" VALUE 0x8004181A Val_Wu16 655.3500 Time_s 0.00 655.3500 FORMAT "%8.4" /end CHARACTERISTIC
/begin CHARACTERISTIC DINH_xFIDObsv_C "" VALUE 0x8004181C Val_Wu16 125. DINH_FIdVerb 0.00 125. FORMAT "%2.0" /end CHARACTERISTIC
/begin CHARACTERISTIC NDKSO "" VALUE 0x80044315 KwWU8 10200. nmot_ub_q40 0.00 10200. FORMAT "%5.0" /end CHARACTERISTIC
/begin CHARACTERISTIC NDKSU "" VALUE 0x80044316 KwWU8 10200. nmot_ub_q40 0.00 10200. FORMAT "%5.0" /end CHARACTERISTIC
/begin AXIS_PTS SNMKRA "" 0x80046282 nmot SstAU8SstU8 10200. nmot_ub_q40 13 0.00 10200. FORMAT "%5.0" DEPOSIT ABSOLUTE /end AXIS_PTS
/begin CHARACTERISTIC UDKSV6ON "" CURVE 0x80044318 GklWU16 319.9951 spg_uw_q0p00488 0.00 319.9951 FORMAT "%8.4"
 /begin AXIS_DESCR COM_AXIS nmot nmot_ub_q40 13 0.00 10200. FORMAT "%5.0" AXIS_PTS_REF SNMKRA /end AXIS_DESCR
/end CHARACTERISTIC
/begin CHARACTERISTIC UDKSV6UN "" CURVE 0x80044332 GklWU16 319.9951 spg_uw_q0p00488 0.00 319.9951 FORMAT "%8.4"
 /begin AXIS_DESCR COM_AXIS nmot nmot_ub_q40 13 0.00 10200. FORMAT "%5.0" AXIS_PTS_REF SNMKRA /end AXIS_DESCR
/end CHARACTERISTIC
/begin MEASUREMENT B_ds "" UBYTE B_TRUE 1 100 0.00 1.00000000000 BIT_MASK 0x2 FORMAT "%13.11" ECU_ADDRESS 0xD0000097 /end MEASUREMENT
/begin MEASUREMENT B_ds2 "" UBYTE B_TRUE 1 100 0.00 1.00000000000 BIT_MASK 0x80 FORMAT "%13.11" ECU_ADDRESS 0xD000002F /end MEASUREMENT
/begin MEASUREMENT DINH_ctMonCorr "" UWORD OneToOne 1 100 0.00 65535.00 FORMAT "%8.2" ECU_ADDRESS 0xD00037DA /end MEASUREMENT
/begin MEASUREMENT DINH_stFId.FId_Unused "" UBYTE DFC_OneToOne 1 100 0.00 255.0 FORMAT "%5.1" ECU_ADDRESS 0xD0003E12 /end MEASUREMENT
/begin MEASUREMENT DINH_stFId.FID_AFRA "" UBYTE DFC_OneToOne 1 100 0.00 255.0 FORMAT "%5.1" ECU_ADDRESS 0xD0003E13 /end MEASUREMENT
/begin MEASUREMENT DINH_stFId.FID_AORA "" UBYTE DFC_OneToOne 1 100 0.00 255.0 FORMAT "%5.1" ECU_ADDRESS 0xD0003E14 /end MEASUREMENT
/begin MEASUREMENT DINH_stFId.FID_ATEH "" UBYTE DFC_OneToOne 1 100 0.00 255.0 FORMAT "%5.1" ECU_ADDRESS 0xD0003E15 /end MEASUREMENT
/begin MEASUREMENT DINH_stFId.FID_ATEL "" UBYTE DFC_OneToOne 1 100 0.00 255.0 FORMAT "%5.1" ECU_ADDRESS 0xD0003E16 /end MEASUREMENT
/begin MEASUREMENT DINH_stFId.FID_ATEN "" UBYTE DFC_OneToOne 1 100 0.00 255.0 FORMAT "%5.1" ECU_ADDRESS 0xD0003E17 /end MEASUREMENT
/begin MEASUREMENT DINH_stFId.FId_InhibitAlways "" UBYTE DFC_OneToOne 1 100 0.00 255.0 FORMAT "%5.1" ECU_ADDRESS 0xD0003E18 /end MEASUREMENT
/begin MEASUREMENT DINH_stFId.FID_BLLRH "" UBYTE DFC_OneToOne 1 100 0.00 255.0 FORMAT "%5.1" ECU_ADDRESS 0xD0003E19 /end MEASUREMENT
/begin MEASUREMENT DINH_stFId.FID_BLLRKH "" UBYTE DFC_OneToOne 1 100 0.00 255.0 FORMAT "%5.1" ECU_ADDRESS 0xD0003E1A /end MEASUREMENT
/begin MEASUREMENT DINH_stFId.FID_BMDFON "" UBYTE DFC_OneToOne 1 100 0.00 255.0 FORMAT "%5.1" ECU_ADDRESS 0xD0003E1B /end MEASUREMENT
/begin MEASUREMENT DINH_stFId.FId_TWCCTrimB1 "" UBYTE DFC_OneToOne 1 100 0.00 255.0 FORMAT "%5.1" ECU_ADDRESS 0xD0003E1C /end MEASUREMENT
/begin MEASUREMENT DINH_stFId.FId_TWCDPriCatB1 "" UBYTE DFC_OneToOne 1 100 0.00 255.0 FORMAT "%5.1" ECU_ADDRESS 0xD0003E1D /end MEASUREMENT
/begin MEASUREMENT DINH_stFId.FID_CEKPVL "" UBYTE DFC_OneToOne 1 100 0.00 255.0 FORMAT "%5.1" ECU_ADDRESS 0xD0003E1E /end MEASUREMENT
/begin MEASUREMENT DINH_stFId.FID_CFONFO "" UBYTE DFC_OneToOne 1 100 0.00 255.0 FORMAT "%5.1" ECU_ADDRESS 0xD0003E1F /end MEASUREMENT
/begin MEASUREMENT DINH_stFId.FID_CKTWTM "" UBYTE DFC_OneToOne 1 100 0.00 255.0 FORMAT "%5.1" ECU_ADDRESS 0xD0003E20 /end MEASUREMENT
/begin MEASUREMENT DINH_stFId.FID_CLFONF "" UBYTE DFC_OneToOne 1 100 0.00 255.0 FORMAT "%5.1" ECU_ADDRESS 0xD0003E21 /end MEASUREMENT
/begin MEASUREMENT DINH_stFId.FID_CMDMIL "" UBYTE DFC_OneToOne 1 100 0.00 255.0 FORMAT "%5.1" ECU_ADDRESS 0xD0003E22 /end MEASUREMENT
/begin MEASUREMENT DINH_stFId.FID_CMDTSB_VFZG "" UBYTE DFC_OneToOne 1 100 0.00 255.0 FORMAT "%5.1" ECU_ADDRESS 0xD0003E23 /end MEASUREMENT
/begin MEASUREMENT DINH_stFId.FID_CNSAD "" UBYTE DFC_OneToOne 1 100 0.00 255.0 FORMAT "%5.1" ECU_ADDRESS 0xD0003E24 /end MEASUREMENT
/begin MEASUREMENT DINH_stFId.FID_CNSAD2 "" UBYTE DFC_OneToOne 1 100 0.00 255.0 FORMAT "%5.1" ECU_ADDRESS 0xD0003E25 /end MEASUREMENT
/begin MEASUREMENT DINH_stFId.FID_CPSRB "" UBYTE DFC_OneToOne 1 100 0.00 255.0 FORMAT "%5.1" ECU_ADDRESS 0xD0003E26 /end MEASUREMENT
/begin MEASUREMENT DINH_stFId.FID_CPSRE "" UBYTE DFC_OneToOne 1 100 0.00 255.0 FORMAT "%5.1" ECU_ADDRESS 0xD0003E27 /end MEASUREMENT
/begin MEASUREMENT DINH_stFId.FID_CPSRP "" UBYTE DFC_OneToOne 1 100 0.00 255.0 FORMAT "%5.1" ECU_ADDRESS 0xD0003E28 /end MEASUREMENT
/begin MEASUREMENT DINH_stFId.FID_CSAFG "" UBYTE DFC_OneToOne 1 100 0.00 255.0 FORMAT "%5.1" ECU_ADDRESS 0xD0003E29 /end MEASUREMENT
/begin MEASUREMENT DINH_stFId.FID_CTM "" UBYTE DFC_OneToOne 1 100 0.00 255.0 FORMAT "%5.1" ECU_ADDRESS 0xD0003E2A /end MEASUREMENT
/begin MEASUREMENT DINH_stFId.FID_CTMCS "" UBYTE DFC_OneToOne 1 100 0.00 255.0 FORMAT "%5.1" ECU_ADDRESS 0xD0003E2B /end MEASUREMENT
/begin MEASUREMENT DINH_stFId.FID_CTMCSMS "" UBYTE DFC_OneToOne 1 100 0.00 255.0 FORMAT "%5.1" ECU_ADDRESS 0xD0003E2C /end MEASUREMENT
/begin MEASUREMENT DINH_stFId.FID_CTMEMS "" UBYTE DFC_OneToOne 1 100 0.00 255.0 FORMAT "%5.1" ECU_ADDRESS 0xD0003E2D /end MEASUREMENT
/begin MEASUREMENT DINH_stFId.FID_CTMMS "" UBYTE DFC_OneToOne 1 100 0.00 255.0 FORMAT "%5.1" ECU_ADDRESS 0xD0003E2E /end MEASUREMENT
/begin MEASUREMENT DINH_stFId.FID_CTMPMS "" UBYTE DFC_OneToOne 1 100 0.00 255.0 FORMAT "%5.1" ECU_ADDRESS 0xD0003E2F /end MEASUREMENT
/begin MEASUREMENT DINH_stFId.FID_DKRSA "" UBYTE DFC_OneToOne 1 100 0.00 255.0 FORMAT "%5.1" ECU_ADDRESS 0xD0003E30 /end MEASUREMENT
/begin MEASUREMENT DINH_stFId.FID_DMDMIL_EevMin01 "" UBYTE DFC_OneToOne 1 100 0.00 255.0 FORMAT "%5.1" ECU_ADDRESS 0xD0003E31 /end MEASUREMENT
/begin MEASUREMENT DINH_stFId.FID_DMDMIL_EevMin02 "" UBYTE DFC_OneToOne 1 100 0.00 255.0 FORMAT "%5.1" ECU_ADDRESS 0xD0003E32 /end MEASUREMENT
/begin MEASUREMENT DINH_stFId.FID_DMDMIL_EevMin03 "" UBYTE DFC_OneToOne 1 100 0.00 255.0 FORMAT "%5.1" ECU_ADDRESS 0xD0003E33 /end MEASUREMENT
/begin MEASUREMENT DINH_stFId.FID_LnKS1 "" UBYTE DFC_OneToOne 1 100 0.00 255.0 FORMAT "%5.1" ECU_ADDRESS 0xD0003E34 /end MEASUREMENT
/begin MEASUREMENT DINH_stFId.FID_NSOLGEN "" UBYTE DFC_OneToOne 1 100 0.00 255.0 FORMAT "%5.1" ECU_ADDRESS 0xD0003E35 /end MEASUREMENT
/begin MEASUREMENT DINH_stFId.FID_PNDKCn "" UBYTE DFC_OneToOne 1 100 0.00 255.0 FORMAT "%5.1" ECU_ADDRESS 0xD0003E36 /end MEASUREMENT
/begin MEASUREMENT DINH_stFId.FID_PNDKCx "" UBYTE DFC_OneToOne 1 100 0.00 255.0 FORMAT "%5.1" ECU_ADDRESS 0xD0003E37 /end MEASUREMENT
/begin MEASUREMENT DINH_stFId.FID_PSL "" UBYTE DFC_OneToOne 1 100 0.00 255.0 FORMAT "%5.1" ECU_ADDRESS 0xD0003E38 /end MEASUREMENT
/begin MEASUREMENT DINH_stFId.FID_PSR2Cn "" UBYTE DFC_OneToOne 1 100 0.00 255.0 FORMAT "%5.1" ECU_ADDRESS 0xD0003E39 /end MEASUREMENT
/begin MEASUREMENT DINH_stFId.FID_PSR2Cx "" UBYTE DFC_OneToOne 1 100 0.00 255.0 FORMAT "%5.1" ECU_ADDRESS 0xD0003E3A /end MEASUREMENT
/begin MEASUREMENT DINH_stFId.FID_PSRCn "" UBYTE DFC_OneToOne 1 100 0.00 255.0 FORMAT "%5.1" ECU_ADDRESS 0xD0003E3B /end MEASUREMENT
/begin MEASUREMENT DINH_stFId.FID_PSRCx "" UBYTE DFC_OneToOne 1 100 0.00 255.0 FORMAT "%5.1" ECU_ADDRESS 0xD0003E3C /end MEASUREMENT
/begin MEASUREMENT DINH_stFId.FId_ACCtl_AcOff "" UBYTE DFC_OneToOne 1 100 0.00 255.0 FORMAT "%5.1" ECU_ADDRESS 0xD0003E3D /end MEASUREMENT
/begin MEASUREMENT DINH_stFId.FId_ACCtl_VehSpd "" UBYTE DFC_OneToOne 1 100 0.00 255.0 FORMAT "%5.1" ECU_ADDRESS 0xD0003E3E /end MEASUREMENT
/begin MEASUREMENT DINH_stFId.FId_APP1FinalDef "" UBYTE DFC_OneToOne 1 100 0.00 255.0 FORMAT "%5.1" ECU_ADDRESS 0xD0003E3F /end MEASUREMENT
/begin MEASUREMENT DINH_stFId.FId_APP1ProvDef "" UBYTE DFC_OneToOne 1 100 0.00 255.0 FORMAT "%5.1" ECU_ADDRESS 0xD0003E40 /end MEASUREMENT
/begin MEASUREMENT DINH_stFId.FId_APP1SRCHigh "" UBYTE DFC_OneToOne 1 100 0.00 255.0 FORMAT "%5.1" ECU_ADDRESS 0xD0003E41 /end MEASUREMENT
/begin MEASUREMENT DINH_stFId.FId_APP1SigPath "" UBYTE DFC_OneToOne 1 100 0.00 255.0 FORMAT "%5.1" ECU_ADDRESS 0xD0003E42 /end MEASUREMENT
/begin MEASUREMENT DINH_stFId.FId_APP2FinalDef "" UBYTE DFC_OneToOne 1 100 0.00 255.0 FORMAT "%5.1" ECU_ADDRESS 0xD0003E43 /end MEASUREMENT
/begin MEASUREMENT DINH_stFId.FId_APP2ProvDef "" UBYTE DFC_OneToOne 1 100 0.00 255.0 FORMAT "%5.1" ECU_ADDRESS 0xD0003E44 /end MEASUREMENT
/begin MEASUREMENT DINH_stFId.FId_APP2SRCHigh "" UBYTE DFC_OneToOne 1 100 0.00 255.0 FORMAT "%5.1" ECU_ADDRESS 0xD0003E45 /end MEASUREMENT
/begin MEASUREMENT DINH_stFId.FId_APP2SigPath "" UBYTE DFC_OneToOne 1 100 0.00 255.0 FORMAT "%5.1" ECU_ADDRESS 0xD0003E46 /end MEASUREMENT
/begin MEASUREMENT DINH_stFId.FId_APPBrkDef "" UBYTE DFC_OneToOne 1 100 0.00 255.0 FORMAT "%5.1" ECU_ADDRESS 0xD0003E47 /end MEASUREMENT
/begin MEASUREMENT DINH_stFId.FId_APPNTP "" UBYTE DFC_OneToOne 1 100 0.00 255.0 FORMAT "%5.1" ECU_ADDRESS 0xD0003E48 /end MEASUREMENT
/begin MEASUREMENT DINH_stFId.FId_APPSyncChk "" UBYTE DFC_OneToOne 1 100 0.00 255.0 FORMAT "%5.1" ECU_ADDRESS 0xD0003E49 /end MEASUREMENT
/begin MEASUREMENT DINH_stFId.FId_APPSyncDef "" UBYTE DFC_OneToOne 1 100 0.00 255.0 FORMAT "%5.1" ECU_ADDRESS 0xD0003E4A /end MEASUREMENT
/begin MEASUREMENT DINH_stFId.FId_APPSyncProvDef "" UBYTE DFC_OneToOne 1 100 0.00 255.0 FORMAT "%5.1" ECU_ADDRESS 0xD0003E4B /end MEASUREMENT
/begin MEASUREMENT DINH_stFId.FId_APPSyncSigProv "" UBYTE DFC_OneToOne 1 100 0.00 255.0 FORMAT "%5.1" ECU_ADDRESS 0xD0003E4C /end MEASUREMENT
/begin MEASUREMENT DINH_stFId.FId_APPVel "" UBYTE DFC_OneToOne 1 100 0.00 255.0 FORMAT "%5.1" ECU_ADDRESS 0xD0003E4D /end MEASUREMENT
/begin MEASUREMENT DINH_stFId.FId_APProvDef "" UBYTE DFC_OneToOne 1 100 0.00 255.0 FORMAT "%5.1" ECU_ADDRESS 0xD0003E4E /end MEASUREMENT
/begin MEASUREMENT DINH_stFId.FId_AirCClntPFrzVal "" UBYTE DFC_OneToOne 1 100 0.00 255.0 FORMAT "%5.1" ECU_ADDRESS 0xD0003E4F /end MEASUREMENT
/begin MEASUREMENT DINH_stFId.FId_AirCClntPRplVal "" UBYTE DFC_OneToOne 1 100 0.00 255.0 FORMAT "%5.1" ECU_ADDRESS 0xD0003E50 /end MEASUREMENT
/begin MEASUREMENT DINH_stFId.FId_AirCSwt "" UBYTE DFC_OneToOne 1 100 0.00 255.0 FORMAT "%5.1" ECU_ADDRESS 0xD0003E51 /end MEASUREMENT
/begin MEASUREMENT DINH_stFId.FId_AltIOFrzVal "" UBYTE DFC_OneToOne 1 100 0.00 255.0 FORMAT "%5.1" ECU_ADDRESS 0xD0003E52 /end MEASUREMENT
/begin MEASUREMENT DINH_stFId.FId_AltIORplVal "" UBYTE DFC_OneToOne 1 100 0.00 255.0 FORMAT "%5.1" ECU_ADDRESS 0xD0003E53 /end MEASUREMENT
/begin MEASUREMENT DINH_stFId.FId_AltIOT15 "" UBYTE DFC_OneToOne 1 100 0.00 255.0 FORMAT "%5.1" ECU_ADDRESS 0xD0003E54 /end MEASUREMENT
/begin MEASUREMENT DINH_stFId.FId_Alt_TrqCan "" UBYTE DFC_OneToOne 1 100 0.00 255.0 FORMAT "%5.1" ECU_ADDRESS 0xD0003E55 /end MEASUREMENT
/begin MEASUREMENT DINH_stFId.FId_Alt_TrqHw "" UBYTE DFC_OneToOne 1 100 0.00 255.0 FORMAT "%5.1" ECU_ADDRESS 0xD0003E56 /end MEASUREMENT
/begin MEASUREMENT DINH_stFId.FId_BrkSwtErr "" UBYTE DFC_OneToOne 1 100 0.00 255.0 FORMAT "%5.1" ECU_ADDRESS 0xD0003E57 /end MEASUREMENT
/begin MEASUREMENT DINH_stFId.FId_CEngDsTtmot "" UBYTE DFC_OneToOne 1 100 0.00 255.0 FORMAT "%5.1" ECU_ADDRESS 0xD0003E58 /end MEASUREMENT
/begin MEASUREMENT DINH_stFId.FId_Clth "" UBYTE DFC_OneToOne 1 100 0.00 255.0 FORMAT "%5.1" ECU_ADDRESS 0xD0003E59 /end MEASUREMENT
/begin MEASUREMENT DINH_stFId.FId_ClthCAN "" UBYTE DFC_OneToOne 1 100 0.00 255.0 FORMAT "%5.1" ECU_ADDRESS 0xD0003E5A /end MEASUREMENT
/begin MEASUREMENT DINH_stFId.FId_ClthEPB "" UBYTE DFC_OneToOne 1 100 0.00 255.0 FORMAT "%5.1" ECU_ADDRESS 0xD0003E5B /end MEASUREMENT
/begin MEASUREMENT DINH_stFId.FId_ClthEPBPlaus "" UBYTE DFC_OneToOne 1 100 0.00 255.0 FORMAT "%5.1" ECU_ADDRESS 0xD0003E5C /end MEASUREMENT
/begin MEASUREMENT DINH_stFId.FId_ClthEPBSensErr "" UBYTE DFC_OneToOne 1 100 0.00 255.0 FORMAT "%5.1" ECU_ADDRESS 0xD0003E5D /end MEASUREMENT
/begin MEASUREMENT DINH_stFId.FId_ClthErr "" UBYTE DFC_OneToOne 1 100 0.00 255.0 FORMAT "%5.1" ECU_ADDRESS 0xD0003E5E /end MEASUREMENT
/begin MEASUREMENT DINH_stFId.FId_ClthSigErr "" UBYTE DFC_OneToOne 1 100 0.00 255.0 FORMAT "%5.1" ECU_ADDRESS 0xD0003E5F /end MEASUREMENT
/begin MEASUREMENT DINH_stFId.FId_CoEngNrml2Strt "" UBYTE DFC_OneToOne 1 100 0.00 255.0 FORMAT "%5.1" ECU_ADDRESS 0xD0003E60 /end MEASUREMENT
/begin MEASUREMENT DINH_stFId.FId_CoTS_SwtOff "" UBYTE DFC_OneToOne 1 100 0.00 255.0 FORMAT "%5.1" ECU_ADDRESS 0xD0003E61 /end MEASUREMENT
/begin MEASUREMENT DINH_stFId.FId_DSMWarmUpCycle "" UBYTE DFC_OneToOne 1 100 0.00 255.0 FORMAT "%5.1" ECU_ADDRESS 0xD0003E62 /end MEASUREMENT
/begin MEASUREMENT DINH_stFId.FId_DSSDK "" UBYTE DFC_OneToOne 1 100 0.00 255.0 FORMAT "%5.1" ECU_ADDRESS 0xD0003E63 /end MEASUREMENT
/begin MEASUREMENT DINH_stFId.FId_EpmBCr "" UBYTE DFC_OneToOne 1 100 0.00 255.0 FORMAT "%5.1" ECU_ADDRESS 0xD0003E64 /end MEASUREMENT
/begin MEASUREMENT DINH_stFId.FId_EpmCaSAdapCaSI1 "" UBYTE DFC_OneToOne 1 100 0.00 255.0 FORMAT "%5.1" ECU_ADDRESS 0xD0003E65 /end MEASUREMENT
/begin MEASUREMENT DINH_stFId.FId_EpmCaSDiagI1 "" UBYTE DFC_OneToOne 1 100 0.00 255.0 FORMAT "%5.1" ECU_ADDRESS 0xD0003E66 /end MEASUREMENT
/begin MEASUREMENT DINH_stFId.FId_EpmCaSErrCaSI1 "" UBYTE DFC_OneToOne 1 100 0.00 255.0 FORMAT "%5.1" ECU_ADDRESS 0xD0003E67 /end MEASUREMENT
/begin MEASUREMENT DINH_stFId.FId_EpmCaSOfsDiagCaSI1 "" UBYTE DFC_OneToOne 1 100 0.00 255.0 FORMAT "%5.1" ECU_ADDRESS 0xD0003E68 /end MEASUREMENT
/begin MEASUREMENT DINH_stFId.FId_EpmCaSOfsErrCaSI1 "" UBYTE DFC_OneToOne 1 100 0.00 255.0 FORMAT "%5.1" ECU_ADDRESS 0xD0003E69 /end MEASUREMENT
/begin MEASUREMENT DINH_stFId.FId_EpmCaSSegI1 "" UBYTE DFC_OneToOne 1 100 0.00 255.0 FORMAT "%5.1" ECU_ADDRESS 0xD0003E6A /end MEASUREMENT
/begin MEASUREMENT DINH_stFId.FId_EpmCrSDiag "" UBYTE DFC_OneToOne 1 100 0.00 255.0 FORMAT "%5.1" ECU_ADDRESS 0xD0003E6B /end MEASUREMENT
/begin MEASUREMENT DINH_stFId.FId_EpmCrSDiagVeh "" UBYTE DFC_OneToOne 1 100 0.00 255.0 FORMAT "%5.1" ECU_ADDRESS 0xD0003E6C /end MEASUREMENT
/begin MEASUREMENT DINH_stFId.FId_EpmCrSErr "" UBYTE DFC_OneToOne 1 100 0.00 255.0 FORMAT "%5.1" ECU_ADDRESS 0xD0003E6D /end MEASUREMENT
/begin MEASUREMENT DINH_stFId.FId_EpmOpMode_InjLock "" UBYTE DFC_OneToOne 1 100 0.00 255.0 FORMAT "%5.1" ECU_ADDRESS 0xD0003E6E /end MEASUREMENT
/begin MEASUREMENT DINH_stFId.FId_EpmRRSCrSFaultCheck "" UBYTE DFC_OneToOne 1 100 0.00 255.0 FORMAT "%5.1" ECU_ADDRESS 0xD0003E6F /end MEASUREMENT
/begin MEASUREMENT DINH_stFId.FId_EpmRRSVehVFaultChck "" UBYTE DFC_OneToOne 1 100 0.00 255.0 FORMAT "%5.1" ECU_ADDRESS 0xD0003E70 /end MEASUREMENT
/begin MEASUREMENT DINH_stFId.FId_ErrBinSens1Bnk1 "" UBYTE DFC_OneToOne 1 100 0.00 255.0 FORMAT "%5.1" ECU_ADDRESS 0xD0003E71 /end MEASUREMENT
/begin MEASUREMENT DINH_stFId.FId_FanCtlCooltT "" UBYTE DFC_OneToOne 1 100 0.00 255.0 FORMAT "%5.1" ECU_ADDRESS 0xD0003E72 /end MEASUREMENT
/begin MEASUREMENT DINH_stFId.FId_FanCtlEnvT "" UBYTE DFC_OneToOne 1 100 0.00 255.0 FORMAT "%5.1" ECU_ADDRESS 0xD0003E73 /end MEASUREMENT
/begin MEASUREMENT DINH_stFId.FId_GangiVehV "" UBYTE DFC_OneToOne 1 100 0.00 255.0 FORMAT "%5.1" ECU_ADDRESS 0xD0003E74 /end MEASUREMENT
/begin MEASUREMENT DINH_stFId.FId_GlbDaLSumvXPtd "" UBYTE DFC_OneToOne 1 100 0.00 255.0 FORMAT "%5.1" ECU_ADDRESS 0xD0003E75 /end MEASUREMENT
/begin MEASUREMENT DINH_stFId.FId_HEGOS1B1DElec "" UBYTE DFC_OneToOne 1 100 0.00 255.0 FORMAT "%5.1" ECU_ADDRESS 0xD0003E76 /end MEASUREMENT
/begin MEASUREMENT DINH_stFId.FId_HEGOS1B1DHtg "" UBYTE DFC_OneToOne 1 100 0.00 255.0 FORMAT "%5.1" ECU_ADDRESS 0xD0003E77 /end MEASUREMENT
/begin MEASUREMENT DINH_stFId.FId_HEGOS1B1Htg "" UBYTE DFC_OneToOne 1 100 0.00 255.0 FORMAT "%5.1" ECU_ADDRESS 0xD0003E78 /end MEASUREMENT
/begin MEASUREMENT DINH_stFId.FId_HEGOS1B1PolarRedPls "" UBYTE DFC_OneToOne 1 100 0.00 255.0 FORMAT "%5.1" ECU_ADDRESS 0xD0003E79 /end MEASUREMENT
/begin MEASUREMENT DINH_stFId.FId_IdleChrgActrDeCold "" UBYTE DFC_OneToOne 1 100 0.00 255.0 FORMAT "%5.1" ECU_ADDRESS 0xD0003E7A /end MEASUREMENT
/begin MEASUREMENT DINH_stFId.FId_IdleChrgActrDeMon "" UBYTE DFC_OneToOne 1 100 0.00 255.0 FORMAT "%5.1" ECU_ADDRESS 0xD0003E7B /end MEASUREMENT
/begin MEASUREMENT DINH_stFId.FId_IdleChrgActrPos "" UBYTE DFC_OneToOne 1 100 0.00 255.0 FORMAT "%5.1" ECU_ADDRESS 0xD0003E7C /end MEASUREMENT
/begin MEASUREMENT DINH_stFId.FId_IdleChrgActrShOff "" UBYTE DFC_OneToOne 1 100 0.00 255.0 FORMAT "%5.1" ECU_ADDRESS 0xD0003E7D /end MEASUREMENT
/begin MEASUREMENT DINH_stFId.FId_IdleChrgActrSysErr "" UBYTE DFC_OneToOne 1 100 0.00 255.0 FORMAT "%5.1" ECU_ADDRESS 0xD0003E7E /end MEASUREMENT
/begin MEASUREMENT DINH_stFId.FId_InhibitNever "" UBYTE DFC_OneToOne 1 100 0.00 255.0 FORMAT "%5.1" ECU_ADDRESS 0xD0003E7F /end MEASUREMENT
/begin MEASUREMENT DINH_stFId.FId_KnDetSens1 "" UBYTE DFC_OneToOne 1 100 0.00 255.0 FORMAT "%5.1" ECU_ADDRESS 0xD0003E80 /end MEASUREMENT
/begin MEASUREMENT DINH_stFId.FId_MSDKG "" UBYTE DFC_OneToOne 1 100 0.00 255.0 FORMAT "%5.1" ECU_ADDRESS 0xD0003E81 /end MEASUREMENT
/begin MEASUREMENT DINH_stFId.FId_PSR "" UBYTE DFC_OneToOne 1 100 0.00 255.0 FORMAT "%5.1" ECU_ADDRESS 0xD0003E82 /end MEASUREMENT
/begin MEASUREMENT DINH_stFId.FId_SHPOTDK "" UBYTE DFC_OneToOne 1 100 0.00 255.0 FORMAT "%5.1" ECU_ADDRESS 0xD0003E83 /end MEASUREMENT
/begin MEASUREMENT DINH_stFId.FId_TOSPM "" UBYTE DFC_OneToOne 1 100 0.00 255.0 FORMAT "%5.1" ECU_ADDRESS 0xD0003E84 /end MEASUREMENT
/begin MEASUREMENT DINH_stFId.FId_TWCDPriCatVldnB1 "" UBYTE DFC_OneToOne 1 100 0.00 255.0 FORMAT "%5.1" ECU_ADDRESS 0xD0003E85 /end MEASUREMENT
/begin MEASUREMENT DINH_stFId.FId_VehVCANFrzVal "" UBYTE DFC_OneToOne 1 100 0.00 255.0 FORMAT "%5.1" ECU_ADDRESS 0xD0003E86 /end MEASUREMENT
/begin MEASUREMENT DINH_stFId.FId_VehVCANReplVal "" UBYTE DFC_OneToOne 1 100 0.00 255.0 FORMAT "%5.1" ECU_ADDRESS 0xD0003E87 /end MEASUREMENT
/begin MEASUREMENT DINH_stFId.FId_VehVFrzVal "" UBYTE DFC_OneToOne 1 100 0.00 255.0 FORMAT "%5.1" ECU_ADDRESS 0xD0003E88 /end MEASUREMENT
/begin MEASUREMENT DINH_stFId.FId_VehVMon "" UBYTE DFC_OneToOne 1 100 0.00 255.0 FORMAT "%5.1" ECU_ADDRESS 0xD0003E89 /end MEASUREMENT
/begin MEASUREMENT DINH_stFId.FId_VehVReplVal "" UBYTE DFC_OneToOne 1 100 0.00 255.0 FORMAT "%5.1" ECU_ADDRESS 0xD0003E8A /end MEASUREMENT
/begin MEASUREMENT DINH_stFId.FId_VehVWhlErrDet "" UBYTE DFC_OneToOne 1 100 0.00 255.0 FORMAT "%5.1" ECU_ADDRESS 0xD0003E8B /end MEASUREMENT
/begin MEASUREMENT DINH_stFId.FId_ZOEZSE "" UBYTE DFC_OneToOne 1 100 0.00 255.0 FORMAT "%5.1" ECU_ADDRESS 0xD0003E8C /end MEASUREMENT
/begin MEASUREMENT DINH_stFId.FId_nmaxmd "" UBYTE DFC_OneToOne 1 100 0.00 255.0 FORMAT "%5.1" ECU_ADDRESS 0xD0003E8D /end MEASUREMENT
/begin MEASUREMENT DINH_stFId.FId_vfzg "" UBYTE DFC_OneToOne 1 100 0.00 255.0 FORMAT "%5.1" ECU_ADDRESS 0xD0003E8E /end MEASUREMENT
/begin MEASUREMENT DINH_stFId.FId_vmaxmd "" UBYTE DFC_OneToOne 1 100 0.00 255.0 FORMAT "%5.1" ECU_ADDRESS 0xD0003E8F /end MEASUREMENT
/begin MEASUREMENT DINH_xFIDObsvInh_mp "" UWORD DFCDSQ_Verb 1 100 0.00 65535. FORMAT "%2.0" ARRAY_SIZE 5 ECU_ADDRESS 0xD00052D6 /end MEASUREMENT
/begin MEASUREMENT DINH_xFIDObsvRls_mp "" UWORD DFCDSQ_Verb 1 100 0.00 65535. FORMAT "%2.0" ARRAY_SIZE 10 ECU_ADDRESS 0xD00052E0 /end MEASUREMENT
/begin MEASUREMENT ehlpks_max "" UBYTE dez 1 100 0.00 255.0 FORMAT "%5.1" ECU_ADDRESS 0xD0000C50 /end MEASUREMENT
/begin MEASUREMENT ehlpks_maxold "" UBYTE dez 1 100 0.00 255.0 FORMAT "%5.1" ECU_ADDRESS 0xD0000C51 /end MEASUREMENT
/begin MEASUREMENT ehlpks_min "" UBYTE dez 1 100 0.00 255.0 FORMAT "%5.1" ECU_ADDRESS 0xD0000C52 /end MEASUREMENT
/begin MEASUREMENT rkrnv6_w "" UWORD spg_uw_q0p00488 1 100 0.00 319.9951 FORMAT "%8.4" ARRAY_SIZE 3 ECU_ADDRESS 0xD0000514 /end MEASUREMENT
/begin MEASUREMENT udksv6oa_w "" UWORD spg_uw_q0p00488 1 100 0.00 319.9951 FORMAT "%8.4" ECU_ADDRESS 0xD0000510 /end MEASUREMENT
/begin MEASUREMENT udksv6ua_w "" UWORD spg_uw_q0p00488 1 100 0.00 319.9951 FORMAT "%8.4" ECU_ADDRESS 0xD0000512 /end MEASUREMENT
/begin MEASUREMENT xzheil "" UBYTE dez 1 100 0.00 255.0 FORMAT "%5.1" ARRAY_SIZE 1 ECU_ADDRESS 0xD0000C53 /end MEASUREMENT
/begin MEASUREMENT xzsen "" UBYTE dez 1 100 0.00 255.0 FORMAT "%5.1" ARRAY_SIZE 1 ECU_ADDRESS 0xD0000C54 /end MEASUREMENT
/begin FUNCTION DFES "2.9.0"
 /begin DEF_CHARACTERISTIC DFES_FaultTyp.DFC_TMPmin_C DFES_FaultTyp.DFC_TMPnpl_C DFES_FaultTyp.DFC_TMmax_C DFES_FaultTyp.DFC_TUMmax_C DFES_FaultTyp.DFC_TWCCTrimMaxB1_C DFES_FaultTyp.DFC_TWCCTrimMinB1_C DFES_FaultTyp.DFC_TWCDPriCatB1_C DFES_FaultTyp.DFC_UBRmax_C DFES_FaultTyp.DFC_UBmax_C DFES_FaultTyp.DFC_UBmin_C DFES_FaultTyp.DFC_UBnpl_C DFES_GrpRpr.DFC_Unused_C DFES_GrpRpr.DFC_AltMaxPwr_C DFES_GrpRpr.DFC_BrkNpl_C DFES_GrpRpr.DFC_Cj930SSp1Mon_C DFES_GrpRpr.DFC_Cj930SSp2Mon_C DFES_GrpRpr.DFC_Cj930SSp3Mon_C DFES_GrpRpr.DFC_IdleChrgActrAMax_C DFES_GrpRpr.DFC_IdleChrgActrAMin_C DFES_GrpRpr.DFC_IdleChrgActrASig_C DFES_GrpRpr.DFC_IdleChrgActrBMax_C DFES_GrpRpr.DFC_IdleChrgActrBMin_C DFES_GrpRpr.DFC_IdleChrgActrBSig_C DFES_GrpRpr.DFC_IdleChrgActrGovDeCold_C DFES_GrpRpr.DFC_IdleChrgActrGovDeMax_C DFES_GrpRpr.DFC_IdleChrgActrGovDeMin_C DFES_GrpRpr.DFC_IdleChrgActrNAMax_C DFES_GrpRpr.DFC_IdleChrgActrNAMin_C DFES_GrpRpr.DFC_IdleChrgActrNASig_C DFES_GrpRpr.DFC_IdleChrgActrNBMax_C DFES_GrpRpr.DFC_IdleChrgActrNBMin_C DFES_GrpRpr.DFC_IdleChrgActrNBSig_C DFES_GrpRpr.DFC_IdleChrgActrOverTmp_C DFES_GrpRpr.DFC_MonUMaxSupply1_C DFES_GrpRpr.DFC_MonUMinSupply1_C DFES_GrpRpr.DFC_ClthNplClsd_C DFES_GrpRpr.DFC_ClthNplOpn_C DFES_GrpRpr.DFC_IgnClPsDevComErr1_C DFES_GrpRpr.DFC_IgnClPsOpenLoad0_C DFES_GrpRpr.DFC_IgnClPsOpenLoad1_C DFES_GrpRpr.DFC_IgnClPsOpenLoad2_C DFES_GrpRpr.DFC_IgnClPsShCirBatt0_C DFES_GrpRpr.DFC_IgnClPsShCirBatt1_C DFES_GrpRpr.DFC_IgnClPsShCirBatt2_C DFES_GrpRpr.DFC_IgnClPsShCirGnd0_C DFES_GrpRpr.DFC_IgnClPsShCirGnd1_C DFES_GrpRpr.DFC_IgnClPsShCirGnd2_C DFES_GrpRpr.DFC_KnDetSens1PortAMax_C DFES_GrpRpr.DFC_KnDetSens1PortAMin_C DFES_GrpRpr.DFC_KnDetSens1PortBMax_C DFES_GrpRpr.DFC_KnDetSens1PortBMin_C DFES_GrpRpr.DFC_VehVWhlErr_C DFES_GrpRpr.DFC_AirCCmprOL_C DFES_GrpRpr.DFC_AirCCmprOvrTemp_C DFES_GrpRpr.DFC_AirCCmprSCB_C DFES_GrpRpr.DFC_AirCCmprSCG_C DFES_GrpRpr.DFC_AltIOLdSRCMin_C DFES_GrpRpr.DFC_AltIOOL_C DFES_GrpRpr.DFC_AltIOOvrTemp_C DFES_GrpRpr.DFC_AltIOSCB_C DFES_GrpRpr.DFC_AltIOSCG_C DFES_GrpRpr.DFC_DevLibBattUHi_C DFES_GrpRpr.DFC_DevLibBattULo_C DFES_GrpRpr.DFC_FanDIOOL_C DFES_GrpRpr.DFC_FanDIOOvrTemp_C DFES_GrpRpr.DFC_FanDIOSCB_C DFES_GrpRpr.DFC_FanDIOSCG_C DFES_GrpRpr.DFC_FanPWMOL_C DFES_GrpRpr.DFC_FanPWMOvrTemp_C DFES_GrpRpr.DFC_FanPWMSCB_C DFES_GrpRpr.DFC_FanPWMSCG_C DFES_GrpRpr.DFC_AirCClntPAnaSRCMax_C DFES_GrpRpr.DFC_AirCClntPAnaSRCMin_C DFES_GrpRpr.DFC_AirCSwtNpl_C DFES_GrpRpr.DFC_AirCSwtSig_C DFES_GrpRpr.DFC_AltIOLdSRCMax_C DFES_GrpRpr.DFC_BrkSig_C DFES_GrpRpr.DFC_ClthEPBNpl_C DFES_GrpRpr.DFC_ClthEPBSensErr_C DFES_GrpRpr.DFC_ClthErr_C DFES_GrpRpr.DFC_ClthSig_C DFES_GrpRpr.DFC_MILLmpOL_C DFES_GrpRpr.DFC_MILLmpSCB_C DFES_GrpRpr.DFC_MILLmpSCG_C DFES_GrpRpr.DFC_SRCHighAPP1_C DFES_GrpRpr.DFC_SRCHighAPP2_C DFES_GrpRpr.DFC_SRCLowAPP1_C DFES_GrpRpr.DFC_SRCLowAPP2_C DFES_GrpRpr.DFC_SyncAPP_C DFES_GrpRpr.DFC_VehVMax_C DFES_GrpRpr.DFC_VehVPlaus_C DFES_GrpRpr.DFC_VehVSig_C DFES_GrpRpr.DFC_BusDiagBusOffNodeA_C DFES_GrpRpr.DFC_ComACSensTO_C DFES_GrpRpr.DFC_ComAWD1TO_C DFES_GrpRpr.DFC_ComBRK10TO_C DFES_GrpRpr.DFC_ComGW11TO_C DFES_GrpRpr.DFC_ComLVL1TO_C DFES_GrpRpr.DFC_ComPRKA01TO_C DFES_GrpRpr.DFC_ComPRKH01TO_C DFES_GrpRpr.DFC_ComPRKH1TO_C DFES_GrpRpr.DFC_ComTRBCH1TO_C DFES_GrpRpr.DFC_ComTRBCH2TO_C DFES_GrpRpr.DFC_DK_C DFES_GrpRpr.DFC_DKRSA_C DFES_GrpRpr.DFC_DKVSmax_C DFES_GrpRpr.DFC_DKmax_C DFES_GrpRpr.DFC_DKmin_C DFES_GrpRpr.DFC_DSSmax_C DFES_GrpRpr.DFC_EEPEraseErr_C DFES_GrpRpr.DFC_EEPRdErr_C DFES_GrpRpr.DFC_EEPWrErr_C DFES_GrpRpr.DFC_EV1max_C DFES_GrpRpr.DFC_EV1min_C DFES_GrpRpr.DFC_EV1sig_C DFES_GrpRpr.DFC_EV2max_C DFES_GrpRpr.DFC_EV2min_C DFES_GrpRpr.DFC_EV2sig_C DFES_GrpRpr.DFC_EV3max_C DFES_GrpRpr.DFC_EV3min_C DFES_GrpRpr.DFC_EV3sig_C DFES_GrpRpr.DFC_EpmCaSI1ErrSig_C DFES_GrpRpr.DFC_EpmCaSI1NoSig_C DFES_GrpRpr.DFC_EpmCaSI1NoSigMax_C DFES_GrpRpr.DFC_EpmCaSI1NoSigMin_C DFES_GrpRpr.DFC_EpmCaSI1OfsErr_C DFES_GrpRpr.DFC_EpmCrSErrSig_C DFES_GrpRpr.DFC_EpmCrSNoSig_C DFES_GrpRpr.DFC_FRAmax_C DFES_GrpRpr.DFC_FRAmin_C DFES_GrpRpr.DFC_HEGOS1B1ElecMax_C DFES_GrpRpr.DFC_HEGOS1B1ElecMin_C DFES_GrpRpr.DFC_HEGOS1B1ElecNpl_C DFES_GrpRpr.DFC_HEGOS1B1ElecSig_C DFES_GrpRpr.DFC_HEGOS1B1HtgNpl_C DFES_GrpRpr.DFC_HEGOS1B1HtrPsMax_C DFES_GrpRpr.DFC_HEGOS1B1HtrPsMin_C DFES_GrpRpr.DFC_HEGOS1B1HtrPsSig_C DFES_GrpRpr.DFC_HEGOS1B1StkMax_C DFES_GrpRpr.DFC_HEGOS1B1StkMin_C DFES_GrpRpr.DFC_HEGOS2B1RstrcnLean_C DFES_GrpRpr.DFC_HEGOS2B1RstrcnRich_C DFES_GrpRpr.DFC_IdleChrgActrJamVlvClsd_C DFES_GrpRpr.DFC_IdleChrgActrJamVlvOpn_C DFES_GrpRpr.DFC_IgnClPsDevOscErr1_C DFES_GrpRpr.DFC_KPEmax_C DFES_GrpRpr.DFC_KPEmin_C DFES_GrpRpr.DFC_KPEsig_C DFES_GrpRpr.DFC_KS1max_C DFES_GrpRpr.DFC_KS1min_C DFES_GrpRpr.DFC_LLRKHmax_C DFES_GrpRpr.DFC_LLRKHmin_C DFES_GrpRpr.DFC_LLRKHnpl_C DFES_GrpRpr.DFC_LLRmax_C DFES_GrpRpr.DFC_LLRmin_C DFES_GrpRpr.DFC_LLRnpl_C DFES_GrpRpr.DFC_LMmax_C DFES_GrpRpr.DFC_LZSRnpl_C DFES_GrpRpr.DFC_MD_C DFES_GrpRpr.DFC_MD00min_C DFES_GrpRpr.DFC_MD00npl_C DFES_GrpRpr.DFC_MD01min_C DFES_GrpRpr.DFC_MD01npl_C DFES_GrpRpr.DFC_MD02min_C DFES_GrpRpr.DFC_MD02npl_C DFES_GrpRpr.DFC_MD03min_C DFES_GrpRpr.DFC_MD03npl_C DFES_GrpRpr.DFC_MD04min_C DFES_GrpRpr.DFC_MD04npl_C DFES_GrpRpr.DFC_MDCyl_0_C DFES_GrpRpr.DFC_MDCyl_1_C DFES_GrpRpr.DFC_MDCyl_2_C DFES_GrpRpr.DFC_MDFC_C DFES_GrpRpr.DFC_MDmin_C DFES_GrpRpr.DFC_MDnpl_C DFES_GrpRpr.DFC_MoCADCNTP_C DFES_GrpRpr.DFC_MoCADCTst_C DFES_GrpRpr.DFC_MoCComctErrMM_C DFES_GrpRpr.DFC_OCWDAActv_C DFES_GrpRpr.DFC_OCWDACom_C DFES_GrpRpr.DFC_ORAmax_C DFES_GrpRpr.DFC_ORAmin_C DFES_GrpRpr.DFC_PSR1max_C DFES_GrpRpr.DFC_PSRBmax_C DFES_GrpRpr.DFC_PSRBmin_C DFES_GrpRpr.DFC_PSREmax_C DFES_GrpRpr.DFC_PSREmin_C DFES_GrpRpr.DFC_PSRPmax_C DFES_GrpRpr.DFC_PSRPmin_C DFES_GrpRpr.DFC_PSRPsig_C DFES_GrpRpr.DFC_PSRmax_C DFES_GrpRpr.DFC_SSpMon1_C DFES_GrpRpr.DFC_SSpMon2_C DFES_GrpRpr.DFC_SSpMon3_C DFES_GrpRpr.DFC_SWReset_0_C DFES_GrpRpr.DFC_SWReset_1_C DFES_GrpRpr.DFC_SWReset_2_C DFES_GrpRpr.DFC_TASREmax_C DFES_GrpRpr.DFC_TASREmin_C DFES_GrpRpr.DFC_TASREnpl_C DFES_GrpRpr.DFC_TASRmax_C DFES_GrpRpr.DFC_TAmax_C DFES_GrpRpr.DFC_TEVEmax_C DFES_GrpRpr.DFC_TEVEmin_C DFES_GrpRpr.DFC_TEVEsig_C DFES_GrpRpr.DFC_TMCSmax_C DFES_GrpRpr.DFC_TMCSmin_C DFES_GrpRpr.DFC_TMEmax_C DFES_GrpRpr.DFC_TMEmin_C DFES_GrpRpr.DFC_TMEnpl_C DFES_GrpRpr.DFC_TMEsig_C DFES_GrpRpr.DFC_TMPmax_C DFES_GrpRpr.DFC_TMPmin_C DFES_GrpRpr.DFC_TMPnpl_C DFES_GrpRpr.DFC_TMmax_C DFES_GrpRpr.DFC_TUMmax_C DFES_GrpRpr.DFC_TWCCTrimMaxB1_C DFES_GrpRpr.DFC_TWCCTrimMinB1_C DFES_GrpRpr.DFC_TWCDPriCatB1_C DFES_GrpRpr.DFC_UBRmax_C DFES_GrpRpr.DFC_UBmax_C DFES_GrpRpr.DFC_UBmin_C DFES_GrpRpr.DFC_UBnpl_C DFES_MonEvtMSK0_C DFES_MonEvtMSK1_C DFES_MonRepeat_C DFES_numClsDlt_CA DFES_numClsFaultCycl_CA DFES_numClsHealCycl_CA DFES_numClsPndDlt_CA DFES_numClsSvcDlt_CA DFES_numClsSVSFaultCycl_CA DFES_numClsSVSHealCycl_CA DFES_ThresSimCond.t_C DFES_ThresSimCond.r_C DFES_ThresSimCond.n_C DFES_xAsgnExtdFrzFrSig_CA DFES_xAsgnFrzFrSig_CA DFES_xClsDltTrg_CA DFES_xClsFaultTrg_CA DFES_xClsFltMIL_CA DFES_xClsFltSVS_CA DFES_xClsHealTrg_CA DFES_xClsPndDltTrg_CA DFES_xClsPrio_CA DFES_xClsSvcDltTrg_CA DFES_xClsSVSFaultTrg_CA DFES_xClsSVSHealTrg_CA /end DEF_CHARACTERISTIC
 FUNCTION_VERSION "2.9.0" /end FUNCTION
/begin FUNCTION DFP "2.1.0" FUNCTION_VERSION "2.1.0" /end FUNCTION
/begin FUNCTION DfpCl "2.0.0" FUNCTION_VERSION "2.0.0" /end FUNCTION
/begin FUNCTION Diag "1.7.0" FUNCTION_VERSION "1.7.0" /end FUNCTION
/begin FUNCTION DiagAppl "10.0.0" /begin DEF_CHARACTERISTIC Diag_stOBDPtcol_C /end DEF_CHARACTERISTIC FUNCTION_VERSION "10.0.0" /end FUNCTION
/begin FUNCTION DiagCom "1.5.0" FUNCTION_VERSION "1.5.0" /end FUNCTION
/begin FUNCTION DiagComAppl "23.0.0" FUNCTION_VERSION "23.0.0" /end FUNCTION
/begin FUNCTION Diag_Session "9.0.0" FUNCTION_VERSION "9.0.0" /end FUNCTION
/begin FUNCTION Diag_Util "1.6.0" FUNCTION_VERSION "1.6.0" /end FUNCTION
/begin FUNCTION DigOut "" /begin IN_MEASUREMENT B_ekp HEGO_bS1B1HtgOn /end IN_MEASUREMENT /end FUNCTION
/begin FUNCTION DINH "2.10.0"
 /begin DEF_CHARACTERISTIC DINH_FId.DFC_AltMaxPwr_CA DINH_FId.DFC_BrkNpl_CA DINH_FId.DFC_Cj930SSp1Mon_CA DINH_FId.DFC_Cj930SSp2Mon_CA DINH_FId.DFC_Cj930SSp3Mon_CA DINH_FId.DFC_IdleChrgActrAMax_CA DINH_FId.DFC_IdleChrgActrAMin_CA DINH_FId.DFC_IdleChrgActrASig_CA DINH_FId.DFC_IdleChrgActrBMax_CA DINH_FId.DFC_IdleChrgActrBMin_CA DINH_FId.DFC_IdleChrgActrBSig_CA DINH_FId.DFC_IdleChrgActrGovDeCold_CA DINH_FId.DFC_IdleChrgActrGovDeMax_CA DINH_FId.DFC_IdleChrgActrGovDeMin_CA DINH_FId.DFC_IdleChrgActrNAMax_CA DINH_FId.DFC_IdleChrgActrNAMin_CA DINH_FId.DFC_IdleChrgActrNASig_CA DINH_FId.DFC_IdleChrgActrNBMax_CA DINH_FId.DFC_IdleChrgActrNBMin_CA DINH_FId.DFC_IdleChrgActrNBSig_CA DINH_FId.DFC_IdleChrgActrOverTmp_CA DINH_FId.DFC_MonUMaxSupply1_CA DINH_FId.DFC_MonUMinSupply1_CA DINH_FId.DFC_ClthNplClsd_CA DINH_FId.DFC_ClthNplOpn_CA DINH_FId.DFC_IgnClPsDevComErr1_CA DINH_FId.DFC_IgnClPsOpenLoad0_CA DINH_FId.DFC_IgnClPsOpenLoad1_CA DINH_FId.DFC_IgnClPsOpenLoad2_CA DINH_FId.DFC_IgnClPsShCirBatt0_CA DINH_FId.DFC_IgnClPsShCirBatt1_CA DINH_FId.DFC_IgnClPsShCirBatt2_CA DINH_FId.DFC_IgnClPsShCirGnd0_CA DINH_FId.DFC_IgnClPsShCirGnd1_CA DINH_FId.DFC_IgnClPsShCirGnd2_CA DINH_FId.DFC_KnDetSens1PortAMax_CA DINH_FId.DFC_KnDetSens1PortAMin_CA DINH_FId.DFC_KnDetSens1PortBMax_CA DINH_FId.DFC_KnDetSens1PortBMin_CA DINH_FId.DFC_VehVWhlErr_CA DINH_FId.DFC_AirCCmprOL_CA DINH_FId.DFC_AirCCmprOvrTemp_CA DINH_FId.DFC_AirCCmprSCB_CA DINH_FId.DFC_AirCCmprSCG_CA DINH_FId.DFC_AltIOLdSRCMin_CA DINH_FId.DFC_AltIOOL_CA DINH_FId.DFC_AltIOOvrTemp_CA DINH_FId.DFC_AltIOSCB_CA DINH_FId.DFC_AltIOSCG_CA DINH_FId.DFC_DevLibBattUHi_CA DINH_FId.DFC_DevLibBattULo_CA DINH_FId.DFC_FanDIOOL_CA DINH_FId.DFC_FanDIOOvrTemp_CA DINH_FId.DFC_FanDIOSCB_CA DINH_FId.DFC_FanDIOSCG_CA DINH_FId.DFC_FanPWMOL_CA DINH_FId.DFC_FanPWMOvrTemp_CA DINH_FId.DFC_FanPWMSCB_CA DINH_FId.DFC_FanPWMSCG_CA DINH_FId.DFC_AirCClntPAnaSRCMax_CA DINH_FId.DFC_AirCClntPAnaSRCMin_CA DINH_FId.DFC_AirCSwtNpl_CA DINH_FId.DFC_AirCSwtSig_CA DINH_FId.DFC_AltIOLdSRCMax_CA DINH_FId.DFC_BrkSig_CA DINH_FId.DFC_ClthEPBNpl_CA DINH_FId.DFC_ClthEPBSensErr_CA DINH_FId.DFC_ClthErr_CA DINH_FId.DFC_ClthSig_Enf_CA DINH_FId.DFC_ClthSig_CA DINH_FId.DFC_MILLmpOL_CA DINH_FId.DFC_MILLmpSCB_CA DINH_FId.DFC_MILLmpSCG_CA DINH_FId.DFC_SRCHighAPP1_CA DINH_FId.DFC_SRCHighAPP2_CA DINH_FId.DFC_SRCLowAPP1_CA DINH_FId.DFC_SRCLowAPP2_CA DINH_FId.DFC_SyncAPP_CA DINH_FId.DFC_VehVMax_CA DINH_FId.DFC_VehVPlaus_CA DINH_FId.DFC_VehVSig_CA DINH_FId.DFC_BusDiagBusOffNodeA_CA DINH_FId.DFC_ComACSensTO_CA DINH_FId.DFC_ComAWD1TO_CA DINH_FId.DFC_ComBRK10TO_CA DINH_FId.DFC_ComGW11TO_CA DINH_FId.DFC_ComLVL1TO_CA DINH_FId.DFC_ComPRKA01TO_CA DINH_FId.DFC_ComPRKH01TO_CA DINH_FId.DFC_ComPRKH1TO_CA DINH_FId.DFC_ComTRBCH1TO_CA DINH_FId.DFC_ComTRBCH2TO_CA DINH_FId.DFC_DK_CA DINH_FId.DFC_DKRSA_CA DINH_FId.DFC_DKVSmax_CA DINH_FId.DFC_DKmax_CA DINH_FId.DFC_DKmin_CA DINH_FId.DFC_DSSmax_CA DINH_FId.DFC_EEPEraseErr_CA DINH_FId.DFC_EEPRdErr_CA DINH_FId.DFC_EEPWrErr_CA DINH_FId.DFC_EV1max_CA DINH_FId.DFC_EV1min_CA DINH_FId.DFC_EV1sig_CA DINH_FId.DFC_EV2max_CA DINH_FId.DFC_EV2min_CA DINH_FId.DFC_EV2sig_CA DINH_FId.DFC_EV3max_CA DINH_FId.DFC_EV3min_CA DINH_FId.DFC_EV3sig_CA DINH_FId.DFC_EpmCaSI1ErrSig_CA DINH_FId.DFC_EpmCaSI1NoSig_CA DINH_FId.DFC_EpmCaSI1NoSigMax_CA DINH_FId.DFC_EpmCaSI1NoSigMin_CA DINH_FId.DFC_EpmCaSI1OfsErr_CA DINH_FId.DFC_EpmCrSErrSig_Enf_CA DINH_FId.DFC_EpmCrSErrSig_CA DINH_FId.DFC_EpmCrSNoSig_Enf_CA DINH_FId.DFC_EpmCrSNoSig_CA DINH_FId.DFC_FRAmax_CA DINH_FId.DFC_FRAmin_CA DINH_FId.DFC_HEGOS1B1ElecMax_CA DINH_FId.DFC_HEGOS1B1ElecMin_CA DINH_FId.DFC_HEGOS1B1ElecNpl_CA DINH_FId.DFC_HEGOS1B1ElecSig_CA DINH_FId.DFC_HEGOS1B1HtgNpl_CA DINH_FId.DFC_HEGOS1B1HtrPsMax_CA DINH_FId.DFC_HEGOS1B1HtrPsMin_CA DINH_FId.DFC_HEGOS1B1HtrPsSig_CA DINH_FId.DFC_HEGOS1B1StkMax_CA DINH_FId.DFC_HEGOS1B1StkMin_CA DINH_FId.DFC_HEGOS2B1RstrcnLean_CA DINH_FId.DFC_HEGOS2B1RstrcnRich_CA DINH_FId.DFC_IdleChrgActrJamVlvClsd_CA DINH_FId.DFC_IdleChrgActrJamVlvOpn_CA DINH_FId.DFC_IgnClPsDevOscErr1_CA DINH_FId.DFC_KPEmax_CA DINH_FId.DFC_KPEmin_CA DINH_FId.DFC_KPEsig_CA DINH_FId.DFC_KS1max_CA DINH_FId.DFC_KS1min_CA DINH_FId.DFC_LLRKHmax_CA DINH_FId.DFC_LLRKHmin_CA DINH_FId.DFC_LLRKHnpl_CA DINH_FId.DFC_LLRmax_CA DINH_FId.DFC_LLRmin_CA DINH_FId.DFC_LLRnpl_CA DINH_FId.DFC_LMmax_CA DINH_FId.DFC_LZSRnpl_CA DINH_FId.DFC_MD_CA DINH_FId.DFC_MD00min_CA DINH_FId.DFC_MD00npl_CA DINH_FId.DFC_MD01min_CA DINH_FId.DFC_MD01npl_CA DINH_FId.DFC_MD02min_CA DINH_FId.DFC_MD02npl_CA DINH_FId.DFC_MD03min_CA DINH_FId.DFC_MD03npl_CA DINH_FId.DFC_MD04min_CA DINH_FId.DFC_MD04npl_CA DINH_FId.DFC_MDCyl_0_CA DINH_FId.DFC_MDCyl_1_CA DINH_FId.DFC_MDCyl_2_CA DINH_FId.DFC_MDFC_CA DINH_FId.DFC_MDmin_CA DINH_FId.DFC_MDnpl_CA DINH_FId.DFC_MoCADCNTP_CA DINH_FId.DFC_MoCADCTst_CA DINH_FId.DFC_MoCComctErrMM_CA DINH_FId.DFC_OCWDAActv_CA DINH_FId.DFC_OCWDACom_CA DINH_FId.DFC_ORAmax_CA DINH_FId.DFC_ORAmin_CA DINH_FId.DFC_PSR1max_CA DINH_FId.DFC_PSRBmax_CA DINH_FId.DFC_PSRBmin_CA DINH_FId.DFC_PSREmax_CA DINH_FId.DFC_PSREmin_CA DINH_FId.DFC_PSRPmax_CA DINH_FId.DFC_PSRPmin_CA DINH_FId.DFC_PSRPsig_CA DINH_FId.DFC_PSRmax_CA DINH_FId.DFC_SSpMon1_Enf_CA DINH_FId.DFC_SSpMon1_CA DINH_FId.DFC_SSpMon2_Enf_CA DINH_FId.DFC_SSpMon2_CA DINH_FId.DFC_SSpMon3_Enf_CA DINH_FId.DFC_SSpMon3_CA DINH_FId.DFC_SWReset_0_CA DINH_FId.DFC_SWReset_1_CA DINH_FId.DFC_SWReset_2_CA DINH_FId.DFC_TASREmax_CA DINH_FId.DFC_TASREmin_CA DINH_FId.DFC_TASREnpl_CA DINH_FId.DFC_TASRmax_CA DINH_FId.DFC_TAmax_CA DINH_FId.DFC_TEVEmax_CA DINH_FId.DFC_TEVEmin_CA DINH_FId.DFC_TEVEsig_CA DINH_FId.DFC_TMCSmax_CA DINH_FId.DFC_TMCSmin_CA DINH_FId.DFC_TMEmax_CA DINH_FId.DFC_TMEmin_CA DINH_FId.DFC_TMEnpl_CA DINH_FId.DFC_TMEsig_CA DINH_FId.DFC_TMPmax_CA DINH_FId.DFC_TMPmin_CA DINH_FId.DFC_TMPnpl_CA DINH_FId.DFC_TMmax_CA DINH_FId.DFC_TUMmax_CA DINH_FId.DFC_TWCCTrimMaxB1_CA DINH_FId.DFC_TWCCTrimMinB1_CA DINH_FId.DFC_TWCDPriCatB1_CA DINH_FId.DFC_UBRmax_CA DINH_FId.DFC_UBmax_CA DINH_FId.DFC_UBmin_CA DINH_FId.DFC_UBnpl_CA DINH_FId.DSQ_ACClntP_CA DINH_FId.DSQ_AirCCmprActr_CA DINH_FId.DSQ_AltIOActr_CA DINH_FId.DSQ_AltIOLoad_CA DINH_FId.DSQ_AltTrqDes_CA DINH_FId.DSQ_BattUSSpThrVlv_CA DINH_FId.DSQ_CEngDsT_CA DINH_FId.DSQ_Clth_CA DINH_FId.DSQ_DSMInhibitAlways_CA DINH_FId.DSQ_EpmReverseRun_CA DINH_FId.DSQ_FanDIO_CA DINH_FId.DSQ_FanPWM_CA DINH_FId.DSQ_IdleChrgActMod_CA DINH_FId.DSQ_VehV_CA DINH_FId.DSQ_stAPP_CA DINH_FId.DSQ_stAPP1_CA DINH_FId.DSQ_stAPP2_CA DINH_Lim.DFC_AltMaxPwr_CA DINH_Lim.DFC_BrkNpl_CA DINH_Lim.DFC_Cj930SSp1Mon_CA DINH_Lim.DFC_Cj930SSp2Mon_CA DINH_Lim.DFC_Cj930SSp3Mon_CA DINH_Lim.DFC_IdleChrgActrAMax_CA DINH_Lim.DFC_IdleChrgActrAMin_CA DINH_Lim.DFC_IdleChrgActrASig_CA DINH_Lim.DFC_IdleChrgActrBMax_CA DINH_Lim.DFC_IdleChrgActrBMin_CA DINH_Lim.DFC_IdleChrgActrBSig_CA DINH_Lim.DFC_IdleChrgActrGovDeCold_CA DINH_Lim.DFC_IdleChrgActrGovDeMax_CA DINH_Lim.DFC_IdleChrgActrGovDeMin_CA DINH_Lim.DFC_IdleChrgActrNAMax_CA DINH_Lim.DFC_IdleChrgActrNAMin_CA DINH_Lim.DFC_IdleChrgActrNASig_CA DINH_Lim.DFC_IdleChrgActrNBMax_CA DINH_Lim.DFC_IdleChrgActrNBMin_CA DINH_Lim.DFC_IdleChrgActrNBSig_CA DINH_Lim.DFC_IdleChrgActrOverTmp_CA DINH_Lim.DFC_MonUMaxSupply1_CA DINH_Lim.DFC_MonUMinSupply1_CA DINH_Lim.DFC_ClthNplClsd_CA DINH_Lim.DFC_ClthNplOpn_CA DINH_Lim.DFC_IgnClPsDevComErr1_CA DINH_Lim.DFC_IgnClPsOpenLoad0_CA DINH_Lim.DFC_IgnClPsOpenLoad1_CA DINH_Lim.DFC_IgnClPsOpenLoad2_CA DINH_Lim.DFC_IgnClPsShCirBatt0_CA DINH_Lim.DFC_IgnClPsShCirBatt1_CA DINH_Lim.DFC_IgnClPsShCirBatt2_CA DINH_Lim.DFC_IgnClPsShCirGnd0_CA DINH_Lim.DFC_IgnClPsShCirGnd1_CA DINH_Lim.DFC_IgnClPsShCirGnd2_CA DINH_Lim.DFC_KnDetSens1PortAMax_CA DINH_Lim.DFC_KnDetSens1PortAMin_CA DINH_Lim.DFC_KnDetSens1PortBMax_CA DINH_Lim.DFC_KnDetSens1PortBMin_CA DINH_Lim.DFC_VehVWhlErr_CA DINH_Lim.DFC_AirCCmprOL_CA DINH_Lim.DFC_AirCCmprOvrTemp_CA DINH_Lim.DFC_AirCCmprSCB_CA DINH_Lim.DFC_AirCCmprSCG_CA DINH_Lim.DFC_AltIOLdSRCMin_CA DINH_Lim.DFC_AltIOOL_CA DINH_Lim.DFC_AltIOOvrTemp_CA DINH_Lim.DFC_AltIOSCB_CA DINH_Lim.DFC_AltIOSCG_CA DINH_Lim.DFC_DevLibBattUHi_CA DINH_Lim.DFC_DevLibBattULo_CA DINH_Lim.DFC_FanDIOOL_CA DINH_Lim.DFC_FanDIOOvrTemp_CA DINH_Lim.DFC_FanDIOSCB_CA DINH_Lim.DFC_FanDIOSCG_CA DINH_Lim.DFC_FanPWMOL_CA DINH_Lim.DFC_FanPWMOvrTemp_CA DINH_Lim.DFC_FanPWMSCB_CA DINH_Lim.DFC_FanPWMSCG_CA DINH_Lim.DFC_AirCClntPAnaSRCMax_CA DINH_Lim.DFC_AirCClntPAnaSRCMin_CA DINH_Lim.DFC_AirCSwtNpl_CA DINH_Lim.DFC_AirCSwtSig_CA DINH_Lim.DFC_AltIOLdSRCMax_CA DINH_Lim.DFC_BrkSig_CA DINH_Lim.DFC_ClthEPBNpl_CA DINH_Lim.DFC_ClthEPBSensErr_CA DINH_Lim.DFC_ClthErr_CA DINH_Lim.DFC_ClthSig_Enf_CA DINH_Lim.DFC_ClthSig_CA DINH_Lim.DFC_MILLmpOL_CA DINH_Lim.DFC_MILLmpSCB_CA DINH_Lim.DFC_MILLmpSCG_CA DINH_Lim.DFC_SRCHighAPP1_CA DINH_Lim.DFC_SRCHighAPP2_CA DINH_Lim.DFC_SRCLowAPP1_CA DINH_Lim.DFC_SRCLowAPP2_CA DINH_Lim.DFC_SyncAPP_CA DINH_Lim.DFC_VehVMax_CA DINH_Lim.DFC_VehVPlaus_CA DINH_Lim.DFC_VehVSig_CA DINH_Lim.DFC_BusDiagBusOffNodeA_CA DINH_Lim.DFC_ComACSensTO_CA DINH_Lim.DFC_ComAWD1TO_CA DINH_Lim.DFC_ComBRK10TO_CA DINH_Lim.DFC_ComGW11TO_CA DINH_Lim.DFC_ComLVL1TO_CA DINH_Lim.DFC_ComPRKA01TO_CA DINH_Lim.DFC_ComPRKH01TO_CA DINH_Lim.DFC_ComPRKH1TO_CA DINH_Lim.DFC_ComTRBCH1TO_CA DINH_Lim.DFC_ComTRBCH2TO_CA DINH_Lim.DFC_DK_CA DINH_Lim.DFC_DKRSA_CA DINH_Lim.DFC_DKVSmax_CA DINH_Lim.DFC_DKmax_CA DINH_Lim.DFC_DKmin_CA DINH_Lim.DFC_DSSmax_CA DINH_Lim.DFC_EEPEraseErr_CA DINH_Lim.DFC_EEPRdErr_CA DINH_Lim.DFC_EEPWrErr_CA DINH_Lim.DFC_EV1max_CA DINH_Lim.DFC_EV1min_CA DINH_Lim.DFC_EV1sig_CA DINH_Lim.DFC_EV2max_CA DINH_Lim.DFC_EV2min_CA DINH_Lim.DFC_EV2sig_CA DINH_Lim.DFC_EV3max_CA DINH_Lim.DFC_EV3min_CA DINH_Lim.DFC_EV3sig_CA DINH_Lim.DFC_EpmCaSI1ErrSig_CA DINH_Lim.DFC_EpmCaSI1NoSig_CA DINH_Lim.DFC_EpmCaSI1NoSigMax_CA DINH_Lim.DFC_EpmCaSI1NoSigMin_CA DINH_Lim.DFC_EpmCaSI1OfsErr_CA DINH_Lim.DFC_EpmCrSErrSig_Enf_CA DINH_Lim.DFC_EpmCrSErrSig_CA DINH_Lim.DFC_EpmCrSNoSig_Enf_CA DINH_Lim.DFC_EpmCrSNoSig_CA DINH_Lim.DFC_FRAmax_CA DINH_Lim.DFC_FRAmin_CA DINH_Lim.DFC_HEGOS1B1ElecMax_CA DINH_Lim.DFC_HEGOS1B1ElecMin_CA DINH_Lim.DFC_HEGOS1B1ElecNpl_CA DINH_Lim.DFC_HEGOS1B1ElecSig_CA DINH_Lim.DFC_HEGOS1B1HtgNpl_CA DINH_Lim.DFC_HEGOS1B1HtrPsMax_CA DINH_Lim.DFC_HEGOS1B1HtrPsMin_CA DINH_Lim.DFC_HEGOS1B1HtrPsSig_CA DINH_Lim.DFC_HEGOS1B1StkMax_CA DINH_Lim.DFC_HEGOS1B1StkMin_CA DINH_Lim.DFC_HEGOS2B1RstrcnLean_CA DINH_Lim.DFC_HEGOS2B1RstrcnRich_CA DINH_Lim.DFC_IdleChrgActrJamVlvClsd_CA DINH_Lim.DFC_IdleChrgActrJamVlvOpn_CA DINH_Lim.DFC_IgnClPsDevOscErr1_CA DINH_Lim.DFC_KPEmax_CA DINH_Lim.DFC_KPEmin_CA DINH_Lim.DFC_KPEsig_CA DINH_Lim.DFC_KS1max_CA DINH_Lim.DFC_KS1min_CA DINH_Lim.DFC_LLRKHmax_CA DINH_Lim.DFC_LLRKHmin_CA DINH_Lim.DFC_LLRKHnpl_CA DINH_Lim.DFC_LLRmax_CA DINH_Lim.DFC_LLRmin_CA DINH_Lim.DFC_LLRnpl_CA DINH_Lim.DFC_LMmax_CA DINH_Lim.DFC_LZSRnpl_CA DINH_Lim.DFC_MD_CA DINH_Lim.DFC_MD00min_CA DINH_Lim.DFC_MD00npl_CA DINH_Lim.DFC_MD01min_CA DINH_Lim.DFC_MD01npl_CA DINH_Lim.DFC_MD02min_CA DINH_Lim.DFC_MD02npl_CA DINH_Lim.DFC_MD03min_CA DINH_Lim.DFC_MD03npl_CA DINH_Lim.DFC_MD04min_CA DINH_Lim.DFC_MD04npl_CA DINH_Lim.DFC_MDCyl_0_CA DINH_Lim.DFC_MDCyl_1_CA DINH_Lim.DFC_MDCyl_2_CA DINH_Lim.DFC_MDFC_CA DINH_Lim.DFC_MDmin_CA DINH_Lim.DFC_MDnpl_CA DINH_Lim.DFC_MoCADCNTP_CA DINH_Lim.DFC_MoCADCTst_CA DINH_Lim.DFC_MoCComctErrMM_CA DINH_Lim.DFC_OCWDAActv_CA DINH_Lim.DFC_OCWDACom_CA DINH_Lim.DFC_ORAmax_CA DINH_Lim.DFC_ORAmin_CA DINH_Lim.DFC_PSR1max_CA DINH_Lim.DFC_PSRBmax_CA DINH_Lim.DFC_PSRBmin_CA DINH_Lim.DFC_PSREmax_CA DINH_Lim.DFC_PSREmin_CA DINH_Lim.DFC_PSRPmax_CA DINH_Lim.DFC_PSRPmin_CA DINH_Lim.DFC_PSRPsig_CA DINH_Lim.DFC_PSRmax_CA DINH_Lim.DFC_SSpMon1_Enf_CA DINH_Lim.DFC_SSpMon1_CA DINH_Lim.DFC_SSpMon2_Enf_CA DINH_Lim.DFC_SSpMon2_CA DINH_Lim.DFC_SSpMon3_Enf_CA DINH_Lim.DFC_SSpMon3_CA DINH_Lim.DFC_SWReset_0_CA DINH_Lim.DFC_SWReset_1_CA DINH_Lim.DFC_SWReset_2_CA DINH_Lim.DFC_TASREmax_CA DINH_Lim.DFC_TASREmin_CA DINH_Lim.DFC_TASREnpl_CA DINH_Lim.DFC_TASRmax_CA DINH_Lim.DFC_TAmax_CA DINH_Lim.DFC_TEVEmax_CA DINH_Lim.DFC_TEVEmin_CA DINH_Lim.DFC_TEVEsig_CA DINH_Lim.DFC_TMCSmax_CA DINH_Lim.DFC_TMCSmin_CA DINH_Lim.DFC_TMEmax_CA DINH_Lim.DFC_TMEmin_CA DINH_Lim.DFC_TMEnpl_CA DINH_Lim.DFC_TMEsig_CA DINH_Lim.DFC_TMPmax_CA DINH_Lim.DFC_TMPmin_CA DINH_Lim.DFC_TMPnpl_CA DINH_Lim.DFC_TMmax_CA DINH_Lim.DFC_TUMmax_CA DINH_Lim.DFC_TWCCTrimMaxB1_CA DINH_Lim.DFC_TWCCTrimMinB1_CA DINH_Lim.DFC_TWCDPriCatB1_CA DINH_Lim.DFC_UBRmax_CA DINH_Lim.DFC_UBmax_CA DINH_Lim.DFC_UBmin_CA DINH_Lim.DFC_UBnpl_CA DINH_Lim.DSQ_ACClntP_CA DINH_Lim.DSQ_AirCCmprActr_CA DINH_Lim.DSQ_AltIOActr_CA DINH_Lim.DSQ_AltIOLoad_CA DINH_Lim.DSQ_AltTrqDes_CA DINH_Lim.DSQ_BattUSSpThrVlv_CA DINH_Lim.DSQ_CEngDsT_CA DINH_Lim.DSQ_Clth_CA DINH_Lim.DSQ_DSMInhibitAlways_CA DINH_Lim.DSQ_EpmReverseRun_CA DINH_Lim.DSQ_FanDIO_CA DINH_Lim.DSQ_FanPWM_CA DINH_Lim.DSQ_IdleChrgActMod_CA DINH_Lim.DSQ_VehV_CA DINH_Lim.DSQ_stAPP_CA DINH_Lim.DSQ_stAPP1_CA DINH_Lim.DSQ_stAPP2_CA DINH_tiUpdObsv_C DINH_xFIDObsv_C /end DEF_CHARACTERISTIC
 /begin OUT_MEASUREMENT DINH_stFId.FId_Unused DINH_stFId.FID_AFRA DINH_stFId.FID_AORA DINH_stFId.FID_ATEH DINH_stFId.FID_ATEL DINH_stFId.FID_ATEN DINH_stFId.FId_InhibitAlways DINH_stFId.FID_BLLRH DINH_stFId.FID_BLLRKH DINH_stFId.FID_BMDFON DINH_stFId.FId_TWCCTrimB1 DINH_stFId.FId_TWCDPriCatB1 DINH_stFId.FID_CEKPVL DINH_stFId.FID_CFONFO DINH_stFId.FID_CKTWTM DINH_stFId.FID_CLFONF DINH_stFId.FID_CMDMIL DINH_stFId.FID_CMDTSB_VFZG DINH_stFId.FID_CNSAD DINH_stFId.FID_CNSAD2 DINH_stFId.FID_CPSRB DINH_stFId.FID_CPSRE DINH_stFId.FID_CPSRP DINH_stFId.FID_CSAFG DINH_stFId.FID_CTM DINH_stFId.FID_CTMCS DINH_stFId.FID_CTMCSMS DINH_stFId.FID_CTMEMS DINH_stFId.FID_CTMMS DINH_stFId.FID_CTMPMS DINH_stFId.FID_DKRSA DINH_stFId.FID_DMDMIL_EevMin01 DINH_stFId.FID_DMDMIL_EevMin02 DINH_stFId.FID_DMDMIL_EevMin03 DINH_stFId.FID_LnKS1 DINH_stFId.FID_NSOLGEN DINH_stFId.FID_PNDKCn DINH_stFId.FID_PNDKCx DINH_stFId.FID_PSL DINH_stFId.FID_PSR2Cn DINH_stFId.FID_PSR2Cx DINH_stFId.FID_PSRCn DINH_stFId.FID_PSRCx DINH_stFId.FId_ACCtl_AcOff DINH_stFId.FId_ACCtl_VehSpd DINH_stFId.FId_APP1FinalDef DINH_stFId.FId_APP1ProvDef DINH_stFId.FId_APP1SRCHigh DINH_stFId.FId_APP1SigPath DINH_stFId.FId_APP2FinalDef DINH_stFId.FId_APP2ProvDef DINH_stFId.FId_APP2SRCHigh DINH_stFId.FId_APP2SigPath DINH_stFId.FId_APPBrkDef DINH_stFId.FId_APPNTP DINH_stFId.FId_APPSyncChk DINH_stFId.FId_APPSyncDef DINH_stFId.FId_APPSyncProvDef DINH_stFId.FId_APPSyncSigProv DINH_stFId.FId_APPVel DINH_stFId.FId_APProvDef DINH_stFId.FId_AirCClntPFrzVal DINH_stFId.FId_AirCClntPRplVal DINH_stFId.FId_AirCSwt DINH_stFId.FId_AltIOFrzVal DINH_stFId.FId_AltIORplVal DINH_stFId.FId_AltIOT15 DINH_stFId.FId_Alt_TrqCan DINH_stFId.FId_Alt_TrqHw DINH_stFId.FId_BrkSwtErr DINH_stFId.FId_CEngDsTtmot DINH_stFId.FId_Clth DINH_stFId.FId_ClthCAN DINH_stFId.FId_ClthEPB DINH_stFId.FId_ClthEPBPlaus DINH_stFId.FId_ClthEPBSensErr DINH_stFId.FId_ClthErr DINH_stFId.FId_ClthSigErr DINH_stFId.FId_CoEngNrml2Strt DINH_stFId.FId_CoTS_SwtOff DINH_stFId.FId_DSMWarmUpCycle DINH_stFId.FId_DSSDK DINH_stFId.FId_EpmBCr DINH_stFId.FId_EpmCaSAdapCaSI1 DINH_stFId.FId_EpmCaSDiagI1 DINH_stFId.FId_EpmCaSErrCaSI1 DINH_stFId.FId_EpmCaSOfsDiagCaSI1 DINH_stFId.FId_EpmCaSOfsErrCaSI1 DINH_stFId.FId_EpmCaSSegI1 DINH_stFId.FId_EpmCrSDiag DINH_stFId.FId_EpmCrSDiagVeh DINH_stFId.FId_EpmCrSErr DINH_stFId.FId_EpmOpMode_InjLock DINH_stFId.FId_EpmRRSCrSFaultCheck DINH_stFId.FId_EpmRRSVehVFaultChck DINH_stFId.FId_ErrBinSens1Bnk1 DINH_stFId.FId_FanCtlCooltT DINH_stFId.FId_FanCtlEnvT DINH_stFId.FId_GangiVehV DINH_stFId.FId_GlbDaLSumvXPtd DINH_stFId.FId_HEGOS1B1DElec DINH_stFId.FId_HEGOS1B1DHtg DINH_stFId.FId_HEGOS1B1Htg DINH_stFId.FId_HEGOS1B1PolarRedPls DINH_stFId.FId_IdleChrgActrDeCold DINH_stFId.FId_IdleChrgActrDeMon DINH_stFId.FId_IdleChrgActrPos DINH_stFId.FId_IdleChrgActrShOff DINH_stFId.FId_IdleChrgActrSysErr DINH_stFId.FId_InhibitNever DINH_stFId.FId_KnDetSens1 DINH_stFId.FId_MSDKG DINH_stFId.FId_PSR DINH_stFId.FId_SHPOTDK DINH_stFId.FId_TOSPM DINH_stFId.FId_TWCDPriCatVldnB1 DINH_stFId.FId_VehVCANFrzVal DINH_stFId.FId_VehVCANReplVal DINH_stFId.FId_VehVFrzVal DINH_stFId.FId_VehVMon DINH_stFId.FId_VehVReplVal DINH_stFId.FId_VehVWhlErrDet DINH_stFId.FId_ZOEZSE DINH_stFId.FId_nmaxmd DINH_stFId.FId_vfzg DINH_stFId.FId_vmaxmd /end OUT_MEASUREMENT
 /begin LOC_MEASUREMENT DINH_ctMonCorr DINH_xFIDObsvInh_mp DINH_xFIDObsvRls_mp /end LOC_MEASUREMENT
 FUNCTION_VERSION "2.10.0" /end FUNCTION
/begin FUNCTION Dio "1.9.0" FUNCTION_VERSION "1.9.0" /end FUNCTION
/begin FUNCTION Distab "1.13.0" FUNCTION_VERSION "1.13.0" /end FUNCTION
/begin FUNCTION DIUMPR "2.7.0" FUNCTION_VERSION "2.7.0" /end FUNCTION
/begin FUNCTION DKRS "5.0.0" /begin DEF_CHARACTERISTIC CWDKS NDKSO NDKSU UDKSV6ON UDKSV6UN /end DEF_CHARACTERISTIC /begin REF_CHARACTERISTIC SENZZYL SNMKRA /end REF_CHARACTERISTIC /begin IN_MEASUREMENT B_kr B_krfdks B_krldy B_krndy krevz_atot nmot rkr_w vkr /end IN_MEASUREMENT /begin OUT_MEASUREMENT B_ds rkrnv6_w /end OUT_MEASUREMENT
 /begin LOC_MEASUREMENT B_ds2 ehlpks_max ehlpks_maxold ehlpks_min udksv6oa_w udksv6ua_w xzheil xzsen /end LOC_MEASUREMENT
 FUNCTION_VERSION "5.0.0" /end FUNCTION
/begin COMPU_METHOD B_TRUE "" TAB_VERB "%6.3" "" COMPU_TAB_REF B_TRUE /end COMPU_METHOD
/begin COMPU_VTAB B_TRUE "" TAB_VERB 2 0 "----" 1 "TRUE" /end COMPU_VTAB
/begin COMPU_METHOD dez "" RAT_FUNC "%6.2" "" COEFFS 0 1 0 0 0 1 /end COMPU_METHOD
/begin COMPU_METHOD DFCDSQ_Verb "" TAB_VERB "%2.1" "-" COMPU_TAB_REF DFCDSQ_Verb /end COMPU_METHOD
/begin COMPU_VTAB DFCDSQ_Verb "" TAB_VERB 230 0 "NoInhibit" 1 "DFC_AltMaxPwr" 2 "DFC_BrkNpl" 3 "DFC_Cj930SSp1Mon" 4 "DFC_Cj930SSp2Mon" 5 "DFC_Cj930SSp3Mon" 6 "DFC_IdleChrgActrAMax" 7 "DFC_IdleChrgActrAMin" 8 "DFC_IdleChrgActrASig" 9 "DFC_IdleChrgActrBMax" 10 "DFC_IdleChrgActrBMin" 11 "DFC_IdleChrgActrBSig" 12 "DFC_IdleChrgActrGovDeCold" 13 "DFC_IdleChrgActrGovDeMax" 14 "DFC_IdleChrgActrGovDeMin" 15 "DFC_IdleChrgActrNAMax" 16 "DFC_IdleChrgActrNAMin" 17 "DFC_IdleChrgActrNASig" 18 "DFC_IdleChrgActrNBMax" 19 "DFC_IdleChrgActrNBMin" 20 "DFC_IdleChrgActrNBSig" 21 "DFC_IdleChrgActrOverTmp" 22 "DFC_MonUMaxSupply1" 23 "DFC_MonUMinSupply1" 24 "DFC_ClthNplClsd" 25 "DFC_ClthNplOpn" 26 "DFC_IgnClPsDevComErr1" 27 "DFC_IgnClPsOpenLoad0" 28 "DFC_IgnClPsOpenLoad1" 29 "DFC_IgnClPsOpenLoad2" 30 "DFC_IgnClPsShCirBatt0" 31 "DFC_IgnClPsShCirBatt1" 32 "DFC_IgnClPsShCirBatt2" 33 "DFC_IgnClPsShCirGnd0" 34 "DFC_IgnClPsShCirGnd1" 35 "DFC_IgnClPsShCirGnd2" 36 "DFC_KnDetSens1PortAMax" 37 "DFC_KnDetSens1PortAMin" 38 "DFC_KnDetSens1PortBMax" 39 "DFC_KnDetSens1PortBMin" 40 "DFC_VehVWhlErr" 41 "DFC_AirCCmprOL" 42 "DFC_AirCCmprOvrTemp" 43 "DFC_AirCCmprSCB" 44 "DFC_AirCCmprSCG" 45 "DFC_AltIOLdSRCMin" 46 "DFC_AltIOOL" 47 "DFC_AltIOOvrTemp" 48 "DFC_AltIOSCB" 49 "DFC_AltIOSCG" 50 "DFC_DevLibBattUHi" 51 "DFC_DevLibBattULo" 52 "DFC_FanDIOOL" 53 "DFC_FanDIOOvrTemp" 54 "DFC_FanDIOSCB" 55 "DFC_FanDIOSCG" 56 "DFC_FanPWMOL" 57 "DFC_FanPWMOvrTemp" 58 "DFC_FanPWMSCB" 59 "DFC_FanPWMSCG" 60 "DFC_AirCClntPAnaSRCMax" 61 "DFC_AirCClntPAnaSRCMin" 62 "DFC_AirCSwtNpl" 63 "DFC_AirCSwtSig" 64 "DFC_AltIOLdSRCMax" 65 "DFC_BrkSig" 66 "DFC_ClthEPBNpl" 67 "DFC_ClthEPBSensErr" 68 "DFC_ClthErr" 69 "DFC_ClthSig" 70 "DFC_MILLmpOL" 71 "DFC_MILLmpSCB" 72 "DFC_MILLmpSCG" 73 "DFC_SRCHighAPP1" 74 "DFC_SRCHighAPP2" 75 "DFC_SRCLowAPP1" 76 "DFC_SRCLowAPP2" 77 "DFC_SyncAPP" 78 "DFC_VehVMax" 79 "DFC_VehVPlaus" 80 "DFC_VehVSig" 81 "DFC_BusDiagBusOffNodeA" 82 "DFC_ComACSensTO" 83 "DFC_ComAWD1TO" 84 "DFC_ComBRK10TO" 85 "DFC_ComGW11TO" 86 "DFC_ComLVL1TO" 87 "DFC_ComPRKA01TO" 88 "DFC_ComPRKH01TO" 89 "DFC_ComPRKH1TO" 90 "DFC_ComTRBCH1TO" 91 "DFC_ComTRBCH2TO" 92 "DFC_DK" 93 "DFC_DKRSA" 94 "DFC_DKVSmax" 95 "DFC_DKmax" 96 "DFC_DKmin" 97 "DFC_DSSmax" 98 "DFC_EEPEraseErr" 99 "DFC_EEPRdErr" 100 "DFC_EEPWrErr" 101 "DFC_EV1max" 102 "DFC_EV1min" 103 "DFC_EV1sig" 104 "DFC_EV2max" 105 "DFC_EV2min" 106 "DFC_EV2sig" 107 "DFC_EV3max" 108 "DFC_EV3min" 109 "DFC_EV3sig" 110 "DFC_EpmCaSI1ErrSig" 111 "DFC_EpmCaSI1NoSig" 112 "DFC_EpmCaSI1NoSigMax" 113 "DFC_EpmCaSI1NoSigMin" 114 "DFC_EpmCaSI1OfsErr" 115 "DFC_EpmCrSErrSig" 116 "DFC_EpmCrSNoSig" 117 "DFC_FRAmax" 118 "DFC_FRAmin" 119 "DFC_HEGOS1B1ElecMax" 120 "DFC_HEGOS1B1ElecMin" 121 "DFC_HEGOS1B1ElecNpl" 122 "DFC_HEGOS1B1ElecSig" 123 "DFC_HEGOS1B1HtgNpl" 124 "DFC_HEGOS1B1HtrPsMax" 125 "DFC_HEGOS1B1HtrPsMin" 126 "DFC_HEGOS1B1HtrPsSig" 127 "DFC_HEGOS1B1StkMax" 128 "DFC_HEGOS1B1StkMin" 129 "DFC_HEGOS2B1RstrcnLean" 130 "DFC_HEGOS2B1RstrcnRich" 131 "DFC_IdleChrgActrJamVlvClsd" 132 "DFC_IdleChrgActrJamVlvOpn" 133 "DFC_IgnClPsDevOscErr1" 134 "DFC_KPEmax" 135 "DFC_KPEmin" 136 "DFC_KPEsig" 137 "DFC_KS1max" 138 "DFC_KS1min" 139 "DFC_LLRKHmax" 140 "DFC_LLRKHmin" 141 "DFC_LLRKHnpl" 142 "DFC_LLRmax" 143 "DFC_LLRmin" 144 "DFC_LLRnpl" 145 "DFC_LMmax" 146 "DFC_LZSRnpl" 147 "DFC_MD" 148 "DFC_MD00min" 149 "DFC_MD00npl" 150 "DFC_MD01min" 151 "DFC_MD01npl" 152 "DFC_MD02min" 153 "DFC_MD02npl" 154 "DFC_MD03min" 155 "DFC_MD03npl" 156 "DFC_MD04min" 157 "DFC_MD04npl" 158 "DFC_MDCyl_0" 159 "DFC_MDCyl_1" 160 "DFC_MDCyl_2" 161 "DFC_MDFC" 162 "DFC_MDmin" 163 "DFC_MDnpl" 164 "DFC_MoCADCNTP" 165 "DFC_MoCADCTst" 166 "DFC_MoCComctErrMM" 167 "DFC_OCWDAActv" 168 "DFC_OCWDACom" 169 "DFC_ORAmax" 170 "DFC_ORAmin" 171 "DFC_PSR1max" 172 "DFC_PSRBmax" 173 "DFC_PSRBmin" 174 "DFC_PSREmax" 175 "DFC_PSREmin" 176 "DFC_PSRPmax" 177 "DFC_PSRPmin" 178 "DFC_PSRPsig" 179 "DFC_PSRmax" 180 "DFC_SSpMon1" 181 "DFC_SSpMon2" 182 "DFC_SSpMon3" 183 "DFC_SWReset_0" 184 "DFC_SWReset_1" 185 "DFC_SWReset_2" 186 "DFC_TASREmax" 187 "DFC_TASREmin" 188 "DFC_TASREnpl" 189 "DFC_TASRmax" 190 "DFC_TAmax" 191 "DFC_TEVEmax" 192 "DFC_TEVEmin" 193 "DFC_TEVEsig" 194 "DFC_TMCSmax" 195 "DFC_TMCSmin" 196 "DFC_TMEmax" 197 "DFC_TMEmin" 198 "DFC_TMEnpl" 199 "DFC_TMEsig" 200 "DFC_TMPmax" 201 "DFC_TMPmin" 202 "DFC_TMPnpl" 203 "DFC_TMmax" 204 "DFC_TUMmax" 205 "DFC_TWCCTrimMaxB1" 206 "DFC_TWCCTrimMinB1" 207 "DFC_TWCDPriCatB1" 208 "DFC_UBRmax" 209 "DFC_UBmax" 210 "DFC_UBmin" 211 "DFC_UBnpl" 212 "DSQ_ACClntP" 213 "DSQ_AirCCmprActr" 214 "DSQ_AltIOActr" 215 "DSQ_AltIOLoad" 216 "DSQ_AltTrqDes" 217 "DSQ_BattUSSpThrVlv" 218 "DSQ_CEngDsT" 219 "DSQ_Clth" 220 "DSQ_DSMInhibitAlways" 221 "DSQ_EpmReverseRun" 222 "DSQ_FanDIO" 223 "DSQ_FanPWM" 224 "DSQ_IdleChrgActMod" 225 "DSQ_VehV" 226 "DSQ_stAPP" 227 "DSQ_stAPP1" 228 "DSQ_stAPP2" 65535 "Inhibited_Trip" DEFAULT_VALUE "---" /end COMPU_VTAB
/begin COMPU_METHOD DFC_OneToOne "" RAT_FUNC "%6.2" "-" COEFFS 0 1 0 0 0 1 /end COMPU_METHOD
/begin COMPU_METHOD DFC_Verb "" TAB_VERB "%2.1" "-" COMPU_TAB_REF DFC_Verb /end COMPU_METHOD
/begin COMPU_VTAB DFC_Verb "" TAB_VERB 212 0 "DFC_Unused" 60 "DFC_AirCClntPAnaSRCMax" 61 "DFC_AirCClntPAnaSRCMin" 41 "DFC_AirCCmprOL" 42 "DFC_AirCCmprOvrTemp" 43 "DFC_AirCCmprSCB" 44 "DFC_AirCCmprSCG" 62 "DFC_AirCSwtNpl" 63 "DFC_AirCSwtSig" 64 "DFC_AltIOLdSRCMax" 45 "DFC_AltIOLdSRCMin" 46 "DFC_AltIOOL" 47 "DFC_AltIOOvrTemp" 48 "DFC_AltIOSCB" 49 "DFC_AltIOSCG" 1 "DFC_AltMaxPwr" 2 "DFC_BrkNpl" 65 "DFC_BrkSig" 81 "DFC_BusDiagBusOffNodeA" 3 "DFC_Cj930SSp1Mon" 4 "DFC_Cj930SSp2Mon" 5 "DFC_Cj930SSp3Mon" 66 "DFC_ClthEPBNpl" 67 "DFC_ClthEPBSensErr" 68 "DFC_ClthErr" 24 "DFC_ClthNplClsd" 25 "DFC_ClthNplOpn" 69 "DFC_ClthSig" 82 "DFC_ComACSensTO" 83 "DFC_ComAWD1TO" 84 "DFC_ComBRK10TO" 85 "DFC_ComGW11TO" 86 "DFC_ComLVL1TO" 87 "DFC_ComPRKA01TO" 88 "DFC_ComPRKH01TO" 89 "DFC_ComPRKH1TO" 90 "DFC_ComTRBCH1TO" 91 "DFC_ComTRBCH2TO" 50 "DFC_DevLibBattUHi" 51 "DFC_DevLibBattULo" 92 "DFC_DK" 95 "DFC_DKmax" 96 "DFC_DKmin" 93 "DFC_DKRSA" 94 "DFC_DKVSmax" 97 "DFC_DSSmax" 98 "DFC_EEPEraseErr" 99 "DFC_EEPRdErr" 100 "DFC_EEPWrErr" 110 "DFC_EpmCaSI1ErrSig" 111 "DFC_EpmCaSI1NoSig" 112 "DFC_EpmCaSI1NoSigMax" 113 "DFC_EpmCaSI1NoSigMin" 114 "DFC_EpmCaSI1OfsErr" 115 "DFC_EpmCrSErrSig" 116 "DFC_EpmCrSNoSig" 101 "DFC_EV1max" 102 "DFC_EV1min" 103 "DFC_EV1sig" 104 "DFC_EV2max" 105 "DFC_EV2min" 106 "DFC_EV2sig" 107 "DFC_EV3max" 108 "DFC_EV3min" 109 "DFC_EV3sig" 52 "DFC_FanDIOOL" 53 "DFC_FanDIOOvrTemp" 54 "DFC_FanDIOSCB" 55 "DFC_FanDIOSCG" 56 "DFC_FanPWMOL" 57 "DFC_FanPWMOvrTemp" 58 "DFC_FanPWMSCB" 59 "DFC_FanPWMSCG" 117 "DFC_FRAmax" 118 "DFC_FRAmin" 119 "DFC_HEGOS1B1ElecMax" 120 "DFC_HEGOS1B1ElecMin" 121 "DFC_HEGOS1B1ElecNpl" 122 "DFC_HEGOS1B1ElecSig" 123 "DFC_HEGOS1B1HtgNpl" 124 "DFC_HEGOS1B1HtrPsMax" 125 "DFC_HEGOS1B1HtrPsMin" 126 "DFC_HEGOS1B1HtrPsSig" 127 "DFC_HEGOS1B1StkMax" 128 "DFC_HEGOS1B1StkMin" 129 "DFC_HEGOS2B1RstrcnLean" 130 "DFC_HEGOS2B1RstrcnRich" 6 "DFC_IdleChrgActrAMax" 7 "DFC_IdleChrgActrAMin" 8 "DFC_IdleChrgActrASig" 9 "DFC_IdleChrgActrBMax" 10 "DFC_IdleChrgActrBMin" 11 "DFC_IdleChrgActrBSig" 12 "DFC_IdleChrgActrGovDeCold" 13 "DFC_IdleChrgActrGovDeMax" 14 "DFC_IdleChrgActrGovDeMin" 131 "DFC_IdleChrgActrJamVlvClsd" 132 "DFC_IdleChrgActrJamVlvOpn" 15 "DFC_IdleChrgActrNAMax" 16 "DFC_IdleChrgActrNAMin" 17 "DFC_IdleChrgActrNASig" 18 "DFC_IdleChrgActrNBMax" 19 "DFC_IdleChrgActrNBMin" 20 "DFC_IdleChrgActrNBSig" 21 "DFC_IdleChrgActrOverTmp" 26 "DFC_IgnClPsDevComErr1" 133 "DFC_IgnClPsDevOscErr1" 27 "DFC_IgnClPsOpenLoad0" 28 "DFC_IgnClPsOpenLoad1" 29 "DFC_IgnClPsOpenLoad2" 30 "DFC_IgnClPsShCirBatt0" 31 "DFC_IgnClPsShCirBatt1" 32 "DFC_IgnClPsShCirBatt2" 33 "DFC_IgnClPsShCirGnd0" 34 "DFC_IgnClPsShCirGnd1" 35 "DFC_IgnClPsShCirGnd2" 36 "DFC_KnDetSens1PortAMax" 37 "DFC_KnDetSens1PortAMin" 38 "DFC_KnDetSens1PortBMax" 39 "DFC_KnDetSens1PortBMin" 134 "DFC_KPEmax" 135 "DFC_KPEmin" 136 "DFC_KPEsig" 137 "DFC_KS1max" 138 "DFC_KS1min" 139 "DFC_LLRKHmax" 140 "DFC_LLRKHmin" 141 "DFC_LLRKHnpl" 142 "DFC_LLRmax" 143 "DFC_LLRmin" 144 "DFC_LLRnpl" 145 "DFC_LMmax" 146 "DFC_LZSRnpl" 147 "DFC_MD" 148 "DFC_MD00min" 149 "DFC_MD00npl" 150 "DFC_MD01min" 151 "DFC_MD01npl" 152 "DFC_MD02min" 153 "DFC_MD02npl" 154 "DFC_MD03min" 155 "DFC_MD03npl" 156 "DFC_MD04min" 157 "DFC_MD04npl" 158 "DFC_MDCyl_0" 159 "DFC_MDCyl_1" 160 "DFC_MDCyl_2" 161 "DFC_MDFC" 162 "DFC_MDmin" 163 "DFC_MDnpl" 70 "DFC_MILLmpOL" 71 "DFC_MILLmpSCB" 72 "DFC_MILLmpSCG" 164 "DFC_MoCADCNTP" 165 "DFC_MoCADCTst" 166 "DFC_MoCComctErrMM" 22 "DFC_MonUMaxSupply1" 23 "DFC_MonUMinSupply1" 167 "DFC_OCWDAActv" 168 "DFC_OCWDACom" 169 "DFC_ORAmax" 170 "DFC_ORAmin" 171 "DFC_PSR1max" 172 "DFC_PSRBmax" 173 "DFC_PSRBmin" 174 "DFC_PSREmax" 175 "DFC_PSREmin" 179 "DFC_PSRmax" 176 "DFC_PSRPmax" 177 "DFC_PSRPmin" 178 "DFC_PSRPsig" 73 "DFC_SRCHighAPP1" 74 "DFC_SRCHighAPP2" 75 "DFC_SRCLowAPP1" 76 "DFC_SRCLowAPP2" 180 "DFC_SSpMon1" 181 "DFC_SSpMon2" 182 "DFC_SSpMon3" 183 "DFC_SWReset_0" 184 "DFC_SWReset_1" 185 "DFC_SWReset_2" 77 "DFC_SyncAPP" 190 "DFC_TAmax" 186 "DFC_TASREmax" 187 "DFC_TASREmin" 188 "DFC_TASREnpl" 189 "DFC_TASRmax" 191 "DFC_TEVEmax" 192 "DFC_TEVEmin" 193 "DFC_TEVEsig" 194 "DFC_TMCSmax" 195 "DFC_TMCSmin" 196 "DFC_TMEmax" 197 "DFC_TMEmin" 198 "DFC_TMEnpl" 199 "DFC_TMEsig" 203 "DFC_TMmax" 200 "DFC_TMPmax" 201 "DFC_TMPmin" 202 "DFC_TMPnpl" 204 "DFC_TUMmax" 205 "DFC_TWCCTrimMaxB1" 206 "DFC_TWCCTrimMinB1" 207 "DFC_TWCDPriCatB1" 209 "DFC_UBmax" 210 "DFC_UBmin" 211 "DFC_UBnpl" 208 "DFC_UBRmax" 78 "DFC_VehVMax" 79 "DFC_VehVPlaus" 80 "DFC_VehVSig" 40 "DFC_VehVWhlErr" DEFAULT_VALUE "---" /end COMPU_VTAB
/begin COMPU_METHOD DFES_LampFlt "" TAB_VERB "%6.3" "-" COMPU_TAB_REF DFES_LampFlt /end COMPU_METHOD
/begin COMPU_VTAB DFES_LampFlt "" TAB_VERB 6 0 "NO_Lamp_Activation" 1 "Continous_Lamp_Support" 2 "Blinking_Lamp_Support" 3 "Blinking_and_Continous_Lamp_Supp" 4 "Continuous_SVS_Support_LDF" 8 "Continuous_SVS_Support_LDF_FLC" /end COMPU_VTAB
/begin COMPU_METHOD DFES_nPID0C "" RAT_FUNC "%6.3" "rpm" COEFFS 0 4 0 0 0 1 /end COMPU_METHOD
/begin COMPU_METHOD DFES_OneToOne "" RAT_FUNC "%6.2" "-" COEFFS 0 1 0 0 0 1 /end COMPU_METHOD
/begin COMPU_METHOD DFES_rPID04 "" RAT_FUNC "%6.3" "%" COEFFS 0 2.55 0 0 0 1 /end COMPU_METHOD
/begin COMPU_METHOD DFES_tPID05 "" RAT_FUNC "%6.2" "deg C" COEFFS 0 1 40 0 0 1 /end COMPU_METHOD
/begin COMPU_METHOD DFES_TstVisAndPrio "" TAB_VERB "%6.3" "-" COMPU_TAB_REF DFES_TstVisAndPrio /end COMPU_METHOD
/begin COMPU_VTAB DFES_TstVisAndPrio "" TAB_VERB 8 4 "invisible_for_all_Testers" 32 "ServiceLow" 40 "ServiceHigh" 96 "OBDLow" 104 "OBDHigh" 168 "ServiceHigh_MaxPrio" 224 "ServiceHigh_OBDLow_MaxPrio" 232 "ServiceHigh_OBDHigh_MaxPrio" /end COMPU_VTAB
/begin COMPU_METHOD Diag_OBDPtcol_Val "" TAB_VERB "%6.3" "" COMPU_TAB_REF Diag_OBDPtcol_Val /end COMPU_METHOD
/begin COMPU_VTAB Diag_OBDPtcol_Val "" TAB_VERB 4 0 "INACTIVE" 1 "CAN_15765" 2 "KLINE_CARB_9141" 3 "KLINE_14230" /end COMPU_VTAB
/begin COMPU_METHOD DINH_FIdVerb "" TAB_VERB "%2.1" "-" COMPU_TAB_REF DINH_FIdVerb /end COMPU_METHOD
/begin COMPU_VTAB DINH_FIdVerb "" TAB_VERB 126 0 "FId_Unused" 1 "FID_AFRA" 2 "FID_AORA" 3 "FID_ATEH" 4 "FID_ATEL" 5 "FID_ATEN" 6 "FId_InhibitAlways" 7 "FID_BLLRH" 8 "FID_BLLRKH" 9 "FID_BMDFON" 10 "FId_TWCCTrimB1" 11 "FId_TWCDPriCatB1" 12 "FID_CEKPVL" 13 "FID_CFONFO" 14 "FID_CKTWTM" 15 "FID_CLFONF" 16 "FID_CMDMIL" 17 "FID_CMDTSB_VFZG" 18 "FID_CNSAD" 19 "FID_CNSAD2" 20 "FID_CPSRB" 21 "FID_CPSRE" 22 "FID_CPSRP" 23 "FID_CSAFG" 24 "FID_CTM" 25 "FID_CTMCS" 26 "FID_CTMCSMS" 27 "FID_CTMEMS" 28 "FID_CTMMS" 29 "FID_CTMPMS" 30 "FID_DKRSA" 31 "FID_DMDMIL_EevMin01" 32 "FID_DMDMIL_EevMin02" 33 "FID_DMDMIL_EevMin03" 34 "FID_LnKS1" 35 "FID_NSOLGEN" 36 "FID_PNDKCn" 37 "FID_PNDKCx" 38 "FID_PSL" 39 "FID_PSR2Cn" 40 "FID_PSR2Cx" 41 "FID_PSRCn" 42 "FID_PSRCx" 43 "FId_ACCtl_AcOff" 44 "FId_ACCtl_VehSpd" 45 "FId_APP1FinalDef" 46 "FId_APP1ProvDef" 47 "FId_APP1SRCHigh" 48 "FId_APP1SigPath" 49 "FId_APP2FinalDef" 50 "FId_APP2ProvDef" 51 "FId_APP2SRCHigh" 52 "FId_APP2SigPath" 53 "FId_APPBrkDef" 54 "FId_APPNTP" 55 "FId_APPSyncChk" 56 "FId_APPSyncDef" 57 "FId_APPSyncProvDef" 58 "FId_APPSyncSigProv" 59 "FId_APPVel" 60 "FId_APProvDef" 61 "FId_AirCClntPFrzVal" 62 "FId_AirCClntPRplVal" 63 "FId_AirCSwt" 64 "FId_AltIOFrzVal" 65 "FId_AltIORplVal" 66 "FId_AltIOT15" 67 "FId_Alt_TrqCan" 68 "FId_Alt_TrqHw" 69 "FId_BrkSwtErr" 70 "FId_CEngDsTtmot" 71 "FId_Clth" 72 "FId_ClthCAN" 73 "FId_ClthEPB" 74 "FId_ClthEPBPlaus" 75 "FId_ClthEPBSensErr" 76 "FId_ClthErr" 77 "FId_ClthSigErr" 78 "FId_CoEngNrml2Strt" 79 "FId_CoTS_SwtOff" 80 "FId_DSMWarmUpCycle" 81 "FId_DSSDK" 82 "FId_EpmBCr" 83 "FId_EpmCaSAdapCaSI1" 84 "FId_EpmCaSDiagI1" 85 "FId_EpmCaSErrCaSI1" 86 "FId_EpmCaSOfsDiagCaSI1" 87 "FId_EpmCaSOfsErrCaSI1" 88 "FId_EpmCaSSegI1" 89 "FId_EpmCrSDiag" 90 "FId_EpmCrSDiagVeh" 91 "FId_EpmCrSErr" 92 "FId_EpmOpMode_InjLock" 93 "FId_EpmRRSCrSFaultCheck" 94 "FId_EpmRRSVehVFaultChck" 95 "FId_ErrBinSens1Bnk1" 96 "FId_FanCtlCooltT" 97 "FId_FanCtlEnvT" 98 "FId_GangiVehV" 99 "FId_GlbDaLSumvXPtd" 100 "FId_HEGOS1B1DElec" 101 "FId_HEGOS1B1DHtg" 102 "FId_HEGOS1B1Htg" 103 "FId_HEGOS1B1PolarRedPls" 104 "FId_IdleChrgActrDeCold" 105 "FId_IdleChrgActrDeMon" 106 "FId_IdleChrgActrPos" 107 "FId_IdleChrgActrShOff" 108 "FId_IdleChrgActrSysErr" 109 "FId_InhibitNever" 110 "FId_KnDetSens1" 111 "FId_MSDKG" 112 "FId_PSR" 113 "FId_SHPOTDK" 114 "FId_TOSPM" 115 "FId_TWCDPriCatVldnB1" 116 "FId_VehVCANFrzVal" 117 "FId_VehVCANReplVal" 118 "FId_VehVFrzVal" 119 "FId_VehVMon" 120 "FId_VehVReplVal" 121 "FId_VehVWhlErrDet" 122 "FId_ZOEZSE" 123 "FId_nmaxmd" 124 "FId_vfzg" 125 "FId_vmaxmd" DEFAULT_VALUE "---" /end COMPU_VTAB
/begin COMPU_METHOD DINH_LimDFCVerb "" TAB_VERB "%6.3" "-" COMPU_TAB_REF DINH_LimDFCVerb /end COMPU_METHOD
/begin COMPU_VTAB DINH_LimDFCVerb "" TAB_VERB 15 0 "No_Inhibit" 1 "Def50_Deb100" 2 "Def100_Deb100" 3 "Def50_Deb100_Tst" 4 "Def100_Deb100_Tst" 5 "Def50_Deb100_or_NTst" 6 "Def100_Deb100_or_NTst" 7 "Tested" 8 "NotTested" 9 "Def100_Deb0" 10 "Def50_Deb0" 11 "Def25_Deb0" 12 "Def0_Deb0" 13 "Def50_Deb100_Tst_Trip" 14 "Def100_Deb100_Tst_Trip" /end COMPU_VTAB
/begin COMPU_METHOD DINH_LimDSQVerb "" TAB_VERB "%6.3" "-" COMPU_TAB_REF DINH_LimDSQVerb /end COMPU_METHOD
/begin COMPU_VTAB DINH_LimDSQVerb "" TAB_VERB 16 0 "Qual_AllOk_0" 1 "Qual_1" 2 "Qual_Meas_2" 3 "Qual_PremFrozen_3" 4 "Qual_Model_4" 5 "Qual_5" 6 "Qual_6" 7 "Qual_7" 8 "Qual_Frozen_8" 9 "Qual_9" 10 "Qual_10" 11 "Qual_Tester_11" 12 "Qual_Default_12" 13 "Qual_13" 14 "Qual_14" 15 "Qual_Invalid_15" /end COMPU_VTAB
/begin COMPU_METHOD DSMAUX_DTRGVerb "" TAB_VERB "%2.1" "-" COMPU_TAB_REF DSMAUX_DTRGVerb /end COMPU_METHOD
/begin COMPU_VTAB DSMAUX_DTRGVerb "" TAB_VERB 9 7 "bbsp1_17" 6 "bbsp2_17" 4 "DTRG_AlwaysTrue" 3 "DTRG_DrivingCycleFLC" 5 "DTRG_DrivingCycleHLC" 8 "DTRG_NoTrigger" 1 "DTRG_SimilarCondHLC" 0 "DTRG_Time200ms" 2 "DTRG_WarmUpCycle" DEFAULT_VALUE "---" /end COMPU_VTAB
/begin COMPU_METHOD MILLMP_SUPRT_ATS_SY_Compu "" TAB_VERB "%6.3" "" COMPU_TAB_REF MILLMP_SUPRT_ATS_SY_Compu /end COMPU_METHOD
/begin COMPU_VTAB MILLMP_SUPRT_ATS_SY_Compu "" TAB_VERB 2 0 "False" 1 "True" /end COMPU_VTAB
/begin COMPU_METHOD MIXADPNACTVPSETI_SC_Compu "" TAB_VERB "%6.3" "" COMPU_TAB_REF MIXADPNACTVPSETI_SC_Compu /end COMPU_METHOD
/begin COMPU_VTAB MIXADPNACTVPSETI_SC_Compu "" TAB_VERB 2 0 "False" 1 "True" /end COMPU_VTAB
/begin COMPU_METHOD MIXADPNLOADHI_SC_Compu "" TAB_VERB "%6.3" "" COMPU_TAB_REF MIXADPNLOADHI_SC_Compu /end COMPU_METHOD
/begin COMPU_VTAB MIXADPNLOADHI_SC_Compu "" TAB_VERB 2 0 "False" 1 "True" /end COMPU_VTAB
/begin COMPU_METHOD MIXADPNSPDVBL_SC_Compu "" TAB_VERB "%6.3" "" COMPU_TAB_REF MIXADPNSPDVBL_SC_Compu /end COMPU_METHOD
/begin COMPU_VTAB MIXADPNSPDVBL_SC_Compu "" TAB_VERB 2 0 "False" 1 "True" /end COMPU_VTAB
/begin COMPU_METHOD MMSBKVSR_SY_Compu "" TAB_VERB "%6.3" "" COMPU_TAB_REF MMSBKVSR_SY_Compu /end COMPU_METHOD
/begin COMPU_VTAB MMSBKVSR_SY_Compu "" TAB_VERB 2 0 "False" 1 "True" /end COMPU_VTAB
/begin COMPU_METHOD MNA_SY_Compu "" TAB_VERB "%6.3" "" COMPU_TAB_REF MNA_SY_Compu /end COMPU_METHOD
/begin COMPU_VTAB MNA_SY_Compu "" TAB_VERB 2 0 "False" 1 "True" /end COMPU_VTAB
/begin COMPU_METHOD MO_INJCTOFFPTINACTV_SY_Compu "" TAB_VERB "%6.3" "" COMPU_TAB_REF MO_INJCTOFFPTINACTV_SY_Compu /end COMPU_METHOD
/begin COMPU_VTAB MO_INJCTOFFPTINACTV_SY_Compu "" TAB_VERB 2 0 "False" 1 "True" /end COMPU_VTAB
/begin COMPU_METHOD MRLY_DIAG_ELEC_SY_Compu "" TAB_VERB "%6.3" "" COMPU_TAB_REF MRLY_DIAG_ELEC_SY_Compu /end COMPU_METHOD
/begin COMPU_VTAB MRLY_DIAG_ELEC_SY_Compu "" TAB_VERB 2 0 "False" 1 "True" /end COMPU_VTAB
/begin COMPU_METHOD MRLY_DIAG_MECH_SY_Compu "" TAB_VERB "%6.3" "" COMPU_TAB_REF MRLY_DIAG_MECH_SY_Compu /end COMPU_METHOD
/begin COMPU_VTAB MRLY_DIAG_MECH_SY_Compu "" TAB_VERB 2 0 "False" 1 "True" /end COMPU_VTAB
/begin COMPU_METHOD MSAPP1_SY_Compu "" TAB_VERB "%6.3" "" COMPU_TAB_REF MSAPP1_SY_Compu /end COMPU_METHOD
/begin COMPU_VTAB MSAPP1_SY_Compu "" TAB_VERB 3 0 "Switch connected to master" 1 "Switch connected to slave1" 2 "Switch connected to slave2" /end COMPU_VTAB
/begin COMPU_METHOD MSAPP2_SY_Compu "" TAB_VERB "%6.3" "" COMPU_TAB_REF MSAPP2_SY_Compu /end COMPU_METHOD
/begin COMPU_VTAB MSAPP2_SY_Compu "" TAB_VERB 3 0 "Switch connected to master" 1 "Switch connected to slave1" 2 "Switch connected to slave2" /end COMPU_VTAB
/begin COMPU_METHOD MSI_SY_Compu "" TAB_VERB "%6.3" "" COMPU_TAB_REF MSI_SY_Compu /end COMPU_METHOD
/begin COMPU_VTAB MSI_SY_Compu "" TAB_VERB 2 0 "0" 1 "1" /end COMPU_VTAB
/begin COMPU_METHOD MSI_TMPR_SY_Compu "" TAB_VERB "%6.3" "" COMPU_TAB_REF MSI_TMPR_SY_Compu /end COMPU_METHOD
/begin COMPU_VTAB MSI_TMPR_SY_Compu "" TAB_VERB 2 0 "False" 1 "True" /end COMPU_VTAB
/begin COMPU_METHOD MSTSHFT_SY_Compu "" TAB_VERB "%6.3" "" COMPU_TAB_REF MSTSHFT_SY_Compu /end COMPU_METHOD
/begin COMPU_VTAB MSTSHFT_SY_Compu "" TAB_VERB 2 0 "False" 1 "True" /end COMPU_VTAB
/begin COMPU_METHOD m_q0p0031 "" RAT_FUNC "%6.4" "kg/h" COEFFS 0 320 0 0 0 1 /end COMPU_METHOD
/begin COMPU_METHOD m_q0p017778_g "" RAT_FUNC "%6.4" "g" COEFFS 0 225 0 0 0 4 /end COMPU_METHOD
/begin COMPU_METHOD m_q5p4253Em7_g "" RAT_FUNC "%9.8" "g" COEFFS 0 1843200 0 0 0 1 /end COMPU_METHOD
/begin COMPU_METHOD NENGIND_ENA_SY_Compu "" TAB_VERB "%6.3" "" COMPU_TAB_REF NENGIND_ENA_SY_Compu /end COMPU_METHOD
/begin COMPU_VTAB NENGIND_ENA_SY_Compu "" TAB_VERB 2 0 "False" 1 "True" /end COMPU_VTAB
/begin COMPU_METHOD NMAXDSPL_SY_Compu "" TAB_VERB "%6.3" "" COMPU_TAB_REF NMAXDSPL_SY_Compu /end COMPU_METHOD
/begin COMPU_VTAB NMAXDSPL_SY_Compu "" TAB_VERB 3 0 "0" 1 "1" 2 "2" /end COMPU_VTAB
/begin COMPU_METHOD NMHIGH_SY_Compu "" TAB_VERB "%6.3" "" COMPU_TAB_REF NMHIGH_SY_Compu /end COMPU_METHOD
/begin COMPU_VTAB NMHIGH_SY_Compu "" TAB_VERB 2 0 "False" 1 "True" /end COMPU_VTAB
/begin COMPU_METHOD nmot_q0p15625 "" RAT_FUNC "%6.3" "U/min" COEFFS 0 1 0 0 0 0.15625 /end COMPU_METHOD
/begin COMPU_METHOD nmot_q7p6294Em6 "" RAT_FUNC "%8.7" "U/min" COEFFS 0 131072 0 0 0 1 /end COMPU_METHOD
/begin COMPU_METHOD nmot_ub_q40 "" RAT_FUNC "%6.1" "1/min" COEFFS 0 1 0 0 0 40 /end COMPU_METHOD
/begin COMPU_METHOD NmPerSec "" RAT_FUNC "%6.3" "Nm/s" COEFFS 0 10 0 0 0 1 /end COMPU_METHOD
/begin COMPU_METHOD NMTYP_SY_Compu "" TAB_VERB "%6.3" "" COMPU_TAB_REF NMTYP_SY_Compu /end COMPU_METHOD
/begin COMPU_VTAB NMTYP_SY_Compu "" TAB_VERB 5 0 "NO_NM" 1 "INM" 2 "DNM" 3 "NMHigh" 4 "AUTOSAR_NM" /end COMPU_VTAB
/begin COMPU_METHOD NOMIDLSPD_ATS_SY_Compu "" RAT_FUNC "%6.2" "" COEFFS 0 1 0 0 0 1 /end COMPU_METHOD
/begin COMPU_METHOD NOSTSPSWT_SY_Compu "" TAB_VERB "%6.3" "" COMPU_TAB_REF NOSTSPSWT_SY_Compu /end COMPU_METHOD
/begin COMPU_VTAB NOSTSPSWT_SY_Compu "" TAB_VERB 2 0 "False" 1 "True" /end COMPU_VTAB
/begin COMPU_METHOD nox "" RAT_FUNC "%6.2" "ppm" COEFFS 0 1 0 0 0 1 /end COMPU_METHOD
/begin COMPU_METHOD NOXCAN_SY_Compu "" TAB_VERB "%6.3" "" COMPU_TAB_REF NOXCAN_SY_Compu /end COMPU_METHOD
/begin COMPU_VTAB NOXCAN_SY_Compu "" TAB_VERB 4 0 "NOXCAN_A" 1 "NOXCAN_B" 2 "NOXCAN_C" 3 "NOXCAN_D" /end COMPU_VTAB
/begin COMPU_METHOD NOXSENS_SY_Compu "" TAB_VERB "%6.3" "" COMPU_TAB_REF NOXSENS_SY_Compu /end COMPU_METHOD
/begin COMPU_VTAB NOXSENS_SY_Compu "" TAB_VERB 2 0 "NO_AVL" 1 "ONE" /end COMPU_VTAB
/begin COMPU_METHOD NSC_CT_SENSORS_SY_Compu "" TAB_VERB "%6.3" "" COMPU_TAB_REF NSC_CT_SENSORS_SY_Compu /end COMPU_METHOD
/begin COMPU_VTAB NSC_CT_SENSORS_SY_Compu "" TAB_VERB 5 0 "ZERO" 1 "ONE" 2 "TWO" 4 "FOUR" 3 "THREE" /end COMPU_VTAB
/begin COMPU_METHOD NUMCYLACT_SY_Compu "" TAB_VERB "%6.3" "" COMPU_TAB_REF NUMCYLACT_SY_Compu /end COMPU_METHOD
/begin COMPU_VTAB NUMCYLACT_SY_Compu "" TAB_VERB 11 3 "THREE_CYL" 5 "FIVE_CYL" 12 "TWELVE_CYL" 8 "EIGHT_CYL" 2 "TWO_CYL" 4 "FOUR_CYL" 6 "SIX_CYL" 10 "TEN_CYL" 1 "ONE_CLYL" 7 "SEVEN_CYL" 16 "SIXTEEN_CYL" /end COMPU_VTAB
/begin COMPU_METHOD NUMCYLCAL_SY_Compu "" TAB_VERB "%6.3" "" COMPU_TAB_REF NUMCYLCAL_SY_Compu /end COMPU_METHOD
/begin COMPU_VTAB NUMCYLCAL_SY_Compu "" TAB_VERB 2 0 "FIX" 1 "CAL" /end COMPU_VTAB
/begin COMPU_METHOD NUMCYLMAX_SY_Compu "" TAB_VERB "%6.3" "" COMPU_TAB_REF NUMCYLMAX_SY_Compu /end COMPU_METHOD
/begin COMPU_VTAB NUMCYLMAX_SY_Compu "" TAB_VERB 11 3 "THREE_CYL" 4 "FOUR_CYL" 5 "FIVE_CYL" 6 "SIX_CYL" 8 "EIGHT_CYL" 10 "TEN_CYL" 12 "TWELVE_CYL" 2 "TWO_CYL" 1 "ONE_CLYL" 7 "SEVEN_CYL" 16 "SIXTEEN_CYL" /end COMPU_VTAB
/begin COMPU_METHOD NUMFANS_SY_Compu "" TAB_VERB "%6.3" "" COMPU_TAB_REF NUMFANS_SY_Compu /end COMPU_METHOD
/begin COMPU_VTAB NUMFANS_SY_Compu "" TAB_VERB 5 3 "3" 12 "12" 2 "2" 0 "0" 1 "1" /end COMPU_VTAB
/begin COMPU_METHOD NUM_WAHT_SY_Compu "" RAT_FUNC "%6.2" "" COEFFS 0 1 0 0 0 1 /end COMPU_METHOD
/begin COMPU_METHOD OBDMINTRP_SY_Compu "" TAB_VERB "%6.3" "" COMPU_TAB_REF OBDMINTRP_SY_Compu /end COMPU_METHOD
/begin COMPU_VTAB OBDMINTRP_SY_Compu "" TAB_VERB 2 0 "False" 1 "True" /end COMPU_VTAB
/begin COMPU_METHOD OBD_PHYSMEDM_SY_Compu "" TAB_VERB "%6.3" "" COMPU_TAB_REF OBD_PHYSMEDM_SY_Compu /end COMPU_METHOD
/begin COMPU_VTAB OBD_PHYSMEDM_SY_Compu "" TAB_VERB 2 0 "OBD_PHYSMEDM_CAN" 1 "OBD_PHYSMEDM_KLINE" /end COMPU_VTAB
/begin COMPU_METHOD OBS_SY_Compu "" TAB_VERB "%6.3" "" COMPU_TAB_REF OBS_SY_Compu /end COMPU_METHOD
/begin COMPU_VTAB OBS_SY_Compu "" TAB_VERB 2 0 "NOOBS" 1 "SMP480" /end COMPU_VTAB
/begin COMPU_METHOD OILTADC_SY_Compu "" TAB_VERB "%6.3" "" COMPU_TAB_REF OILTADC_SY_Compu /end COMPU_METHOD
/begin COMPU_VTAB OILTADC_SY_Compu "" TAB_VERB 2 0 "False" 1 "True" /end COMPU_VTAB
/begin COMPU_METHOD OILTPULS_SY_Compu "" TAB_VERB "%6.3" "" COMPU_TAB_REF OILTPULS_SY_Compu /end COMPU_METHOD
/begin COMPU_VTAB OILTPULS_SY_Compu "" TAB_VERB 2 0 "False" 1 "True" /end COMPU_VTAB
/begin COMPU_METHOD Oil_lvl_mm_q0p004 "" RAT_FUNC "%6.4" "mm" COEFFS 0 250 0 0 0 1 /end COMPU_METHOD
/begin COMPU_METHOD OneToOne "" RAT_FUNC "%6.2" "-" COEFFS 0 1 0 0 0 1 /end COMPU_METHOD
/begin COMPU_METHOD OVRRUNINHB_PT_SY_Compu "" TAB_VERB "%6.3" "" COMPU_TAB_REF OVRRUNINHB_PT_SY_Compu /end COMPU_METHOD
/begin COMPU_VTAB OVRRUNINHB_PT_SY_Compu "" TAB_VERB 2 0 "False" 1 "True" /end COMPU_VTAB
/begin COMPU_METHOD OXSENSDYNADAP_SY_Compu "" TAB_VERB "%6.3" "" COMPU_TAB_REF OXSENSDYNADAP_SY_Compu /end COMPU_METHOD
/begin COMPU_VTAB OXSENSDYNADAP_SY_Compu "" TAB_VERB 2 0 "False" 1 "True" /end COMPU_VTAB
/begin COMPU_METHOD PART_PROG_SY_Compu "" TAB_VERB "%6.3" "" COMPU_TAB_REF PART_PROG_SY_Compu /end COMPU_METHOD
/begin COMPU_VTAB PART_PROG_SY_Compu "" TAB_VERB 2 0 "False" 1 "True" /end COMPU_VTAB
/begin COMPU_METHOD Signals_IntSigNumVerb "" TAB_VERB "%6.3" "" COMPU_TAB_REF Signals_IntSigNumVerb /end COMPU_METHOD
/begin COMPU_VTAB Signals_IntSigNumVerb "" TAB_VERB 60 0 "SIGNALS_Signals_Default" 1 "SIGNALS_APP_rUnFlt" 2 "SIGNALS_Brk_st" 3 "SIGNALS_Brk_stRed" 4 "SIGNALS_EpmCaS_phiOfsCorr" 5 "SIGNALS_Epm_nEng" 6 "SIGNALS_Epm_stOpMode" 7 "SIGNALS_Epm_stSync" 8 "SIGNALS_I15031_FILLSIG1h" 9 "SIGNALS_I15031_FILLSIG2h" 10 "SIGNALS_I15031_FILLSIG4h" 11 "SIGNALS_PID01h" 12 "SIGNALS_PID03h_0" 13 "SIGNALS_PID03h_1" 14 "SIGNALS_PID04h" 15 "SIGNALS_PID05h" 16 "SIGNALS_PID06h_0" 17 "SIGNALS_PID07h_0" 18 "SIGNALS_PID0D_VehV_vSens" 19 "SIGNALS_PID0Eh" 20 "SIGNALS_PID0bh" 21 "SIGNALS_PID14h_0" 22 "SIGNALS_PID14h_1" 23 "SIGNALS_PID15h_1" 24 "SIGNALS_PID1Ch" 25 "SIGNALS_PID1Fh" 26 "SIGNALS_PID21h" 27 "SIGNALS_PID2Eh" 28 "SIGNALS_PID30h" 29 "SIGNALS_PID31h" 30 "SIGNALS_PID3Ch" 31 "SIGNALS_PID42h" 32 "SIGNALS_PID43h" 33 "SIGNALS_PID44h" 34 "SIGNALS_PID49_APP_uRaw1unLim" 35 "SIGNALS_PID4A_APP_uRaw2unLimWoNTP" 36 "SIGNALS_PID4FAh" 37 "SIGNALS_PID4FBh" 38 "SIGNALS_PID4FCh" 39 "SIGNALS_PID4FDh" 40 "SIGNALS_PID50Ah" 41 "SIGNALS_PID50Bh" 42 "SIGNALS_PID50Ch" 43 "SIGNALS_PID50Dh" 44 "SIGNALS_PID56h_0" 45 "SIGNALS_PID5A_APP_rOBDPID5A" 46 "SIGNALS_PID5Fh" 47 "SIGNALS_Signals_FillSig_1Bit" 48 "SIGNALS_Signals_FillSig_1Byte" 49 "SIGNALS_Signals_FillSig_2Bit" 50 "SIGNALS_Signals_FillSig_2Byte" 51 "SIGNALS_Signals_FillSig_3Bit" 52 "SIGNALS_Signals_FillSig_4Bit" 53 "SIGNALS_Signals_FillSig_4Byte" 54 "SIGNALS_Signals_FillSig_5Bit" 55 "SIGNALS_Signals_FillSig_6Bit" 56 "SIGNALS_Signals_FillSig_7Bit" 57 "SIGNALS_T15_stRaw" 58 "SIGNALS_VehV_a" 59 "SIGNALS_VehV_v" /end COMPU_VTAB
/begin COMPU_METHOD spg_uw_q0p00488 "" RAT_FUNC "%6.4" "V" COEFFS 0 1024 0 0 0 5 /end COMPU_METHOD
/begin COMPU_METHOD Time_s "" RAT_FUNC "%6.4" "s" COEFFS 0 100 0 0 0 1 /end COMPU_METHOD
/begin RECORD_LAYOUT GklWU16 FNC_VALUES 1 UWORD COLUMN_DIR DIRECT /end RECORD_LAYOUT
/begin RECORD_LAYOUT KwWU8 FNC_VALUES 1 UBYTE COLUMN_DIR DIRECT /end RECORD_LAYOUT
/begin RECORD_LAYOUT SstAU8SstU8 NO_AXIS_PTS_X 1 UBYTE AXIS_PTS_X 2 UBYTE INDEX_INCR DIRECT /end RECORD_LAYOUT
/begin RECORD_LAYOUT ValA_Wu16 FNC_VALUES 1 UWORD COLUMN_DIR DIRECT /end RECORD_LAYOUT
/begin RECORD_LAYOUT ValA_Wu8 FNC_VALUES 1 UBYTE COLUMN_DIR DIRECT /end RECORD_LAYOUT
/begin RECORD_LAYOUT Val_Wu16 FNC_VALUES 1 UWORD COLUMN_DIR DIRECT /end RECORD_LAYOUT
/begin RECORD_LAYOUT Val_Wu8 FNC_VALUES 1 UBYTE COLUMN_DIR DIRECT /end RECORD_LAYOUT
/end MODULE
/end PROJECT
