/* Erstellt von DAMOS++ V4.12.3 WinServer 2003 "R2" */
ASAP2_VERSION 1 4
/begin PROJECT M17955S3CC411_110Y0320 "M17955S3CC411_110Y0320"
/begin HEADER "" VERSION "M17955S3CC411_110Y0320" PROJECT_NO M17955S3CC411_110Y0320 /end HEADER
/begin MODULE DIM ""
/begin MOD_PAR "M17955S3CC411_110Y0320" VERSION "MED17" CUSTOMER_NO "3" USER "joy2si" PHONE_NO "" ECU "MED17" CPU_TYPE "TriCore"
 /begin MEMORY_SEGMENT Pst80004000 "" RESERVED FLASH INTERN 0x80004000 0xAC78 -1 -1 -1 -1 -1 /end MEMORY_SEGMENT
 /begin MEMORY_SEGMENT Pst8000EC78 "" RESERVED FLASH INTERN 0x8000EC78 0x8C -1 -1 -1 -1 -1 /end MEMORY_SEGMENT
 /begin MEMORY_SEGMENT Pst80080000 "" CODE FLASH INTERN 0x80080000 0x17FE78 -1 -1 -1 -1 -1 /end MEMORY_SEGMENT
 /begin MEMORY_SEGMENT Pst801FFE78 "" RESERVED FLASH INTERN 0x801FFE78 0x8C -1 -1 -1 -1 -1 /end MEMORY_SEGMENT
 /begin MEMORY_SEGMENT Pst8007FE78 "" RESERVED FLASH INTERN 0x8007FE78 0x8C -1 -1 -1 -1 -1 /end MEMORY_SEGMENT
 /begin MEMORY_SEGMENT Pst80020000 "" CODE FLASH INTERN 0x80020000 0x1FE74 -1 -1 -1 -1 -1 /end MEMORY_SEGMENT
 /begin MEMORY_SEGMENT Pst8003FE74 "" RESERVED FLASH INTERN 0x8003FE74 0x8C -1 -1 -1 -1 -1 /end MEMORY_SEGMENT
 /begin MEMORY_SEGMENT Pst80014000 "" RESERVED FLASH INTERN 0x80014000 0x3E74 -1 -1 -1 -1 -1 /end MEMORY_SEGMENT
 /begin MEMORY_SEGMENT Pst80017E74 "" RESERVED FLASH INTERN 0x80017E74 0x18C -1 -1 -1 -1 -1 /end MEMORY_SEGMENT
 /begin MEMORY_SEGMENT Pst80018000 "" RESERVED FLASH INTERN 0x80018000 0x7E74 -1 -1 -1 -1 -1 /end MEMORY_SEGMENT
 /begin MEMORY_SEGMENT Pst8001FE74 "" RESERVED FLASH INTERN 0x8001FE74 0x18C -1 -1 -1 -1 -1 /end MEMORY_SEGMENT
 /begin MEMORY_SEGMENT Pst8000ED04 "" RESERVED FLASH INTERN 0x8000ED04 0x12FC -1 -1 -1 -1 -1 /end MEMORY_SEGMENT
 /begin MEMORY_SEGMENT Pst8003FF00 "" RESERVED FLASH INTERN 0x8003FF00 0x100 -1 -1 -1 -1 -1 /end MEMORY_SEGMENT
 /begin MEMORY_SEGMENT Dst80040000 "" DATA FLASH INTERN 0x80040000 0x3FE78 -1 -1 -1 -1 -1
  /begin IF_DATA ETK ADDRESS_MAPPING /* origin addr */ 0x80040000 /* mapping addr */ 0x80040000 /* length */ 0x3FE78 /end IF_DATA
 /end MEMORY_SEGMENT
 /begin MEMORY_SEGMENT RamAFF00000 "" VARIABLES RAM INTERN 0xAFF00000 0x2000 -1 -1 -1 -1 -1 /end MEMORY_SEGMENT
 /begin MEMORY_SEGMENT RamAFF02000 "" CALIBRATION_VARIABLES RAM INTERN 0xAFF02000 0x2000 -1 -1 -1 -1 -1 /end MEMORY_SEGMENT
 /begin MEMORY_SEGMENT RamAFE70000 "" VARIABLES RAM INTERN 0xAFE70000 0x8000 -1 -1 -1 -1 -1 /end MEMORY_SEGMENT
 /begin MEMORY_SEGMENT RamAFE80000 "" VARIABLES RAM INTERN 0xAFE80000 0x2000 -1 -1 -1 -1 -1 /end MEMORY_SEGMENT
 /begin MEMORY_SEGMENT RamC0000000 "" VARIABLES RAM INTERN 0xC0000000 0x4000 -1 -1 -1 -1 -1 /end MEMORY_SEGMENT
 /begin MEMORY_SEGMENT RamD0000000 "" VARIABLES RAM INTERN 0xD0000000 0x12000 -1 -1 -1 -1 -1 /end MEMORY_SEGMENT
 /begin MEMORY_SEGMENT RamF0050000 "" VARIABLES RAM INTERN 0xF0050000 0x2000 -1 -1 -1 -1 -1 /end MEMORY_SEGMENT
 /begin MEMORY_SEGMENT RamF0060000 "" VARIABLES RAM INTERN 0xF0060000 0x3000 -1 -1 -1 -1 -1 /end MEMORY_SEGMENT
 /begin CALIBRATION_METHOD /* Method name */ "FixedSizeMoveableEmuRAM" /* Method version */ 1 /begin CALIBRATION_HANDLE 1 0xAFF04000 0x4000 /end CALIBRATION_HANDLE /begin CALIBRATION_HANDLE 2 0xAFF08000 0x4000 /end CALIBRATION_HANDLE /begin CALIBRATION_HANDLE 3 0xAFF0C000 0x4000 /end CALIBRATION_HANDLE /begin CALIBRATION_HANDLE 4 0xAFF10000 0x4000 /end CALIBRATION_HANDLE /begin CALIBRATION_HANDLE 5 0xAFF14000 0x4000 /end CALIBRATION_HANDLE /begin CALIBRATION_HANDLE 6 0xAFF18000 0x4000 /end CALIBRATION_HANDLE /begin CALIBRATION_HANDLE 7 0xAFF1C000 0x4000 /end CALIBRATION_HANDLE /begin CALIBRATION_HANDLE 8 0xAFF20000 0x4000 /end CALIBRATION_HANDLE /begin CALIBRATION_HANDLE 9 0xAFF24000 0x4000 /end CALIBRATION_HANDLE /begin CALIBRATION_HANDLE 10 0xAFF28000 0x4000 /end CALIBRATION_HANDLE /begin CALIBRATION_HANDLE 11 0xAFF2C000 0x4000 /end CALIBRATION_HANDLE /begin CALIBRATION_HANDLE 12 0xAFF30000 0x4000 /end CALIBRATION_HANDLE /begin CALIBRATION_HANDLE 13 0xAFF34000 0x4000 /end CALIBRATION_HANDLE /begin CALIBRATION_HANDLE 14 0xAFF38000 0x4000 /end CALIBRATION_HANDLE /begin CALIBRATION_HANDLE 15 0xAFF3C000 0x4000 /end CALIBRATION_HANDLE /end CALIBRATION_METHOD
 SYSTEM_CONSTANT "ABMMNM_SY" "0"
 SYSTEM_CONSTANT "ACCGRV_RES" "0.01"
 SYSTEM_CONSTANT "ACCGRV_RES_REV" "100"
 SYSTEM_CONSTANT "ACCGRV_ZERO" "0"
 SYSTEM_CONSTANT "ACCHI_RES" "0.0001"
 SYSTEM_CONSTANT "ACCHI_RES_REV" "10000"
 SYSTEM_CONSTANT "ACCHI_ZERO" "0"
 SYSTEM_CONSTANT "ACCI_CRCTLPLUS_ACTIVE" "1"
 SYSTEM_CONSTANT "ACCI_ECDBRK_SY" "0"
 SYSTEM_CONSTANT "ACCI_RLS_BP" "0"
 SYSTEM_CONSTANT "ACCI_RTRQDRGDES_SY" "0"
 SYSTEM_CONSTANT "ACCI_TRQBRK_SY" "0"
 SYSTEM_CONSTANT "ACCLNTP_ATS_SY" "0"
 SYSTEM_CONSTANT "ACCLNTP_SENSTYP_SY" "0"
 SYSTEM_CONSTANT "ACCOMP_TRQDYN_MAPX" "4"
 SYSTEM_CONSTANT "ACCOMP_TRQDYN_MAPY" "4"
 SYSTEM_CONSTANT "ACCOMP_TRQSTAT_MAPX" "4"
 SYSTEM_CONSTANT "ACCOMP_TRQSTAT_MAPY" "4"
 SYSTEM_CONSTANT "ACCPED_INTPOL_SY" "1"
 SYSTEM_CONSTANT "ACCPED_OVRRUNRMP_SY" "0"
 SYSTEM_CONSTANT "ACCPED_REVGEARMAP_SY" "0"
 SYSTEM_CONSTANT "ACCPED_VEL_INTPOL" "1"
 SYSTEM_CONSTANT "ACCPED_VN_INTPOL" "0"
 SYSTEM_CONSTANT "ACCPERSEC_RES_REV" "20"
 SYSTEM_CONSTANT "ACCPERSEC_ZERO" "0"
 SYSTEM_CONSTANT "ACCTL_NEPMNENG_AXISX" "4"
 SYSTEM_CONSTANT "ACCTL_TENGVEL_CURX" "4"
 SYSTEM_CONSTANT "ACCTL_TISYSERR_CURX" "4"
 SYSTEM_CONSTANT "ACCTRNVRS_ZERO" "0"
 SYSTEM_CONSTANT "ACC_GRAV" "9.81"
 SYSTEM_CONSTANT "ACC_NORM_FAC" "2777777.77777778"
 SYSTEM_CONSTANT "ACC_RES" "0.001"
 SYSTEM_CONSTANT "ACC_RES_INV" "1000"
 SYSTEM_CONSTANT "ACC_REV_RES" "1"
 SYSTEM_CONSTANT "ACC_SY" "0"
 SYSTEM_CONSTANT "ACC_ZERO" "0"
 SYSTEM_CONSTANT "ACHTRSWT_SY" "0"
 SYSTEM_CONSTANT "ACSWT_ATS_SY" "0"
 SYSTEM_CONSTANT "ACTRSTEP_RATACTVALTOLR_TX" "2"
 SYSTEM_CONSTANT "ACTRSTEP_RATDESACTR_TX" "8"
 SYSTEM_CONSTANT "ACTRSTEP_SNSRMOD_SC" "1"
 SYSTEM_CONSTANT "ACTRSTEP_SNSR_SC" "0"
 SYSTEM_CONSTANT "ACTRSTEP_TENGCLD_TX" "6"
 SYSTEM_CONSTANT "ACTRSTEP_TIDESVALFILD_TX" "8"
 SYSTEM_CONSTANT "ACTTRQCO_SY" "0"
 SYSTEM_CONSTANT "ACTYP_ELEC" "3"
 SYSTEM_CONSTANT "ACTYP_MECHELEC" "4"
 SYSTEM_CONSTANT "ACTYP_MECH_FIX" "1"
 SYSTEM_CONSTANT "ACTYP_MECH_VAR" "2"
 SYSTEM_CONSTANT "ACTYP_SY" "1"
 SYSTEM_CONSTANT "ACT_ANGLE_RES" "0.05"
 SYSTEM_CONSTANT "AC_DEMAND_DISBL" "0"
 SYSTEM_CONSTANT "AC_DEMAND_ENBL" "1"
 SYSTEM_CONSTANT "AC_DEMAND_SY" "0"
 SYSTEM_CONSTANT "AC_DMCLGACOFF_CURX" "4"
 SYSTEM_CONSTANT "AC_DMCLGACON_MAPX" "4"
 SYSTEM_CONSTANT "AC_DMCLGACON_MAPY" "4"
 SYSTEM_CONSTANT "AC_SWTHWORCAN_SY" "2"
 SYSTEM_CONSTANT "ADC_RES" "1023"
 SYSTEM_CONSTANT "ADDDYNCOMP_SY" "0"
 SYSTEM_CONSTANT "ADDHTR_CONST" "360"
 SYSTEM_CONSTANT "AFS_MAIRCONV" "66666"
 SYSTEM_CONSTANT "AG_CRS_REV_SY" "16383.999999996"
 SYSTEM_CONSTANT "AIRCTL_ADD" "0"
 SYSTEM_CONSTANT "AIRCTL_MUL" "1"
 SYSTEM_CONSTANT "AIRC_ATSINTVMODCMPR_SY" "0"
 SYSTEM_CONSTANT "AIRC_ATSINTVMODREDTRQ_SY" "0"
 SYSTEM_CONSTANT "AIRC_PCLNTTRANSF_CUR_X" "16"
 SYSTEM_CONSTANT "AIRC_REDTRQCMPRENA_SY" "0"
 SYSTEM_CONSTANT "AIRDVP_VAR_SY" "243"
 SYSTEM_CONSTANT "AIRMOD_VAR_SY" "243"
 SYSTEM_CONSTANT "AIR_MASS_NORM" "66666"
 SYSTEM_CONSTANT "ALTCRNT_LIM_RES" "0.25"
 SYSTEM_CONSTANT "ALTCRNT_OUT_RES" "0.125"
 SYSTEM_CONSTANT "ALTIO_CAN_SEL" "1"
 SYSTEM_CONSTANT "ALTIO_HWANDCAN_SEL" "0"
 SYSTEM_CONSTANT "ALTIO_HW_SEL" "2"
 SYSTEM_CONSTANT "ALTIO_RTRANSF_CUR_X" "16"
 SYSTEM_CONSTANT "ALTIO_SWTHWORCAN_SY" "2"
 SYSTEM_CONSTANT "ALTIO_TIDLY_MAP_X" "16"
 SYSTEM_CONSTANT "ALTIO_TIDLY_MAP_Y" "16"
 SYSTEM_CONSTANT "ALTIO_TILDRESP_CUR_X" "4"
 SYSTEM_CONSTANT "ALTLD_RES" "3.125"
 SYSTEM_CONSTANT "ALTVLTG_OFS" "10.6"
 SYSTEM_CONSTANT "ALTVLTG_RES_SY" "0.1"
 SYSTEM_CONSTANT "ALT_CHPTEMP_OFS" "-32"
 SYSTEM_CONSTANT "ALT_CHPTEMP_RES" "8"
 SYSTEM_CONSTANT "ALT_FACCORTEMP_CURX" "4"
 SYSTEM_CONSTANT "ALT_FACCORT_CURX" "4"
 SYSTEM_CONSTANT "ALT_TICLDSTRTDEL_MAP_X" "5"
 SYSTEM_CONSTANT "ALT_TICLDSTRTDEL_MAP_Y" "5"
 SYSTEM_CONSTANT "ALT_TILRALT_CUR_X" "4"
 SYSTEM_CONSTANT "ALT_TRQCALCVAR2_MAP_X" "8"
 SYSTEM_CONSTANT "ALT_TRQCALCVAR2_MAP_Y" "8"
 SYSTEM_CONSTANT "ALT_TRQCALCVAR3_MAP_X" "8"
 SYSTEM_CONSTANT "ALT_TRQCALCVAR3_MAP_Y" "8"
 SYSTEM_CONSTANT "ALT_TRQCALC_MAPX" "4"
 SYSTEM_CONSTANT "ALT_TRQCALC_MAPY" "4"
 SYSTEM_CONSTANT "ALT_TRQCALC_MAP_X" "8"
 SYSTEM_CONSTANT "ALT_TRQCALC_MAP_Y" "8"
 SYSTEM_CONSTANT "ALT_TRQCANERR_MAP_X" "4"
 SYSTEM_CONSTANT "ALT_TRQCANERR_MAP_Y" "8"
 SYSTEM_CONSTANT "AMPC_RES" "0.1"
 SYSTEM_CONSTANT "AMPC_ZERO" "0"
 SYSTEM_CONSTANT "AMPERE_Q0P1_RES" "0.1"
 SYSTEM_CONSTANT "AMPS_RES" "0.01"
 SYSTEM_CONSTANT "AMPS_RES_REV" "100"
 SYSTEM_CONSTANT "AMPT_2_AMPT_PT" "100000"
 SYSTEM_CONSTANT "AMPT_PT_RES" "1"
 SYSTEM_CONSTANT "AMPT_PT_RES_REV" "1"
 SYSTEM_CONSTANT "AMPT_RES" "0.1"
 SYSTEM_CONSTANT "AMPT_RES_REV" "10"
 SYSTEM_CONSTANT "AMPT_ZERO" "0"
 SYSTEM_CONSTANT "AMUENE_SY" "0"
 SYSTEM_CONSTANT "AM_RES" "0.01"
 SYSTEM_CONSTANT "ANGLERAD_RES" "0.0001"
 SYSTEM_CONSTANT "ANGLERAD_RES_REV" "10000"
 SYSTEM_CONSTANT "ANGLERAD_ZERO" "0"
 SYSTEM_CONSTANT "ANGLE_DER1" "16"
 SYSTEM_CONSTANT "ANGLE_DER1_ZERO" "0"
 SYSTEM_CONSTANT "ANGLE_DER2" "8"
 SYSTEM_CONSTANT "ANGLE_DER2_ZERO" "0"
 SYSTEM_CONSTANT "ANGLE_RES" "45.5111111111"
 SYSTEM_CONSTANT "ANGLE_RES_1" "32"
 SYSTEM_CONSTANT "ANGLE_RES_FL" "45.5111111111"
 SYSTEM_CONSTANT "ANGLE_RES_INV_FL" "0.0219726562500054"
 SYSTEM_CONSTANT "ANGLE_STWHL_RES" "0.03125"
 SYSTEM_CONSTANT "ANGLE_ZERO" "0"
 SYSTEM_CONSTANT "APPSWTECU_SY" "0"
 SYSTEM_CONSTANT "APP_BASADJ_COND_INCORRECT" "2"
 SYSTEM_CONSTANT "APP_BASADJ_OK" "1"
 SYSTEM_CONSTANT "APP_KDLRN_STATUS" "2"
 SYSTEM_CONSTANT "APP_KDLRN_TIP_NEXT" "1"
 SYSTEM_CONSTANT "APP_KDLRN_TIP_START" "0"
 SYSTEM_CONSTANT "APP_MOVDET_SY" "0"
 SYSTEM_CONSTANT "APP_NOIFLT_SY" "0"
 SYSTEM_CONSTANT "APP_PREFILGENA_SY" "0"
 SYSTEM_CONSTANT "ASDBYPCOR_SY" "0"
 SYSTEM_CONSTANT "ASDDC_CONTTRQINC_SY" "0"
 SYSTEM_CONSTANT "ASDDC_NENGSIZE_SY" "3"
 SYSTEM_CONSTANT "ASDDC_NRNG_SY" "0"
 SYSTEM_CONSTANT "ASDDC_STY_SY" "0"
 SYSTEM_CONSTANT "ASDRF_ENA_SC" "1"
 SYSTEM_CONSTANT "ASDRF_FACDESDYNSIZE_SY" "3"
 SYSTEM_CONSTANT "ASDRF_FCOPAR_SY" "0"
 SYSTEM_CONSTANT "ASDRF_NENGSIZE_SY" "3"
 SYSTEM_CONSTANT "ASDRF_NOGRIPPAR_SY" "0"
 SYSTEM_CONSTANT "ASDRF_RGRIP_SY" "0"
 SYSTEM_CONSTANT "ASDRF_RTRQSIZE_SY" "3"
 SYSTEM_CONSTANT "ASD_TIME_DT_RES_FL" "1e-006"
 SYSTEM_CONSTANT "ASTINTVENG_NO" "0"
 SYSTEM_CONSTANT "AUTOSTRT_SY" "0"
 SYSTEM_CONSTANT "AUTSHRTTRP_SY" "0"
 SYSTEM_CONSTANT "AVL" "2"
 SYSTEM_CONSTANT "AVPT_RES" "0.1"
 SYSTEM_CONSTANT "AVS_NUMADJVAL" "4"
 SYSTEM_CONSTANT "AWD_SY" "0"
 SYSTEM_CONSTANT "BASSVRAPPL_CPP" "0"
 SYSTEM_CONSTANT "BASSVRAPPL_PSC" "0"
 SYSTEM_CONSTANT "BATTSENS_SY" "0"
 SYSTEM_CONSTANT "BBSAFG_CESGEAR_MAX_SY" "7"
 SYSTEM_CONSTANT "BBSTVE_SY" "0"
 SYSTEM_CONSTANT "BGOSC_IPOL_SY" "2"
 SYSTEM_CONSTANT "BGTMPK_SY" "6"
 SYSTEM_CONSTANT "BKVP_SY" "0"
 SYSTEM_CONSTANT "BRKP_PHYSRNGCHK_SY" "0"
 SYSTEM_CONSTANT "BRKR_ADCPWM_ON" "3"
 SYSTEM_CONSTANT "BRKR_ADC_ON" "1"
 SYSTEM_CONSTANT "BRKR_ADC_SY" "0"
 SYSTEM_CONSTANT "BRKR_OFF" "0"
 SYSTEM_CONSTANT "BRKR_PWM_ON" "2"
 SYSTEM_CONSTANT "BRKR_PWM_SY" "0"
 SYSTEM_CONSTANT "BRK_ATS_SY" "0"
 SYSTEM_CONSTANT "BRK_BRKR_SY" "0"
 SYSTEM_CONSTANT "BRK_CANCHKENA_SC" "0"
 SYSTEM_CONSTANT "BRK_MNBRK_FLTENA_SY" "0"
 SYSTEM_CONSTANT "BRK_OPTNSWTSEL_SY" "0"
 SYSTEM_CONSTANT "BRK_REDBRK_FLTENA_SY" "0"
 SYSTEM_CONSTANT "BRK_ZEROLRNGENA_SC" "0"
 SYSTEM_CONSTANT "BSP742_SY" "0"
 SYSTEM_CONSTANT "BUEK_SY" "0"
 SYSTEM_CONSTANT "BYPASS_SY" "0"
 SYSTEM_CONSTANT "CALORY1_RES" "0.001"
 SYSTEM_CONSTANT "CALORY1_RES_REV" "1000"
 SYSTEM_CONSTANT "CALWUP_SY" "0"
 SYSTEM_CONSTANT "CANTXMUX_SY" "0"
 SYSTEM_CONSTANT "CANVER_MLB" "1"
 SYSTEM_CONSTANT "CANVER_MQB" "2"
 SYSTEM_CONSTANT "CANVER_SY" "0"
 SYSTEM_CONSTANT "CANVER_V4V5" "0"
 SYSTEM_CONSTANT "CAN_OFSTRQCOR_DISBL" "0"
 SYSTEM_CONSTANT "CAN_OFSTRQCOR_ENA" "1"
 SYSTEM_CONSTANT "CAN_OFSTRQCOR_SY" "0"
 SYSTEM_CONSTANT "CAN_SEL" "1"
 SYSTEM_CONSTANT "CAN_TRQLAMCOR_DISBL" "0"
 SYSTEM_CONSTANT "CAN_TRQLAMCOR_ENA" "1"
 SYSTEM_CONSTANT "CAN_TRQLAMCOR_SY" "0"
 SYSTEM_CONSTANT "CASI1_SSP_SY" "0"
 SYSTEM_CONSTANT "CASI2_SSP_SY" "0"
 SYSTEM_CONSTANT "CASO1_SSP_SY" "0"
 SYSTEM_CONSTANT "CASO2_SSP_SY" "0"
 SYSTEM_CONSTANT "CASTYP_SY" "1"
 SYSTEM_CONSTANT "CAS_ADAP_SY" "1"
 SYSTEM_CONSTANT "CAS_ANGLE_SY" "1"
 SYSTEM_CONSTANT "CAS_BACKUP_SY" "2"
 SYSTEM_CONSTANT "CAS_DIAG_SY" "1"
 SYSTEM_CONSTANT "CAS_FAC_ADAP_SY" "1000"
 SYSTEM_CONSTANT "CAS_FAC_PLAUS_SY" "1000"
 SYSTEM_CONSTANT "CAS_I1_SY" "1"
 SYSTEM_CONSTANT "CAS_I2_SY" "0"
 SYSTEM_CONSTANT "CAS_O1_SY" "0"
 SYSTEM_CONSTANT "CAS_O2_SY" "0"
 SYSTEM_CONSTANT "CAS_OUT_SY" "0"
 SYSTEM_CONSTANT "CAS_SEGCOR_SY" "0"
 SYSTEM_CONSTANT "CFG" "1"
 SYSTEM_CONSTANT "CHDT_SENS_SY" "0"
 SYSTEM_CONSTANT "CHDT_SY" "0"
 SYSTEM_CONSTANT "CHRGEXCHMDLCORDPDCHR_SC" "0"
 SYSTEM_CONSTANT "CHRSET_VAR_SY" "243"
 SYSTEM_CONSTANT "CH_Q0P5_RES" "2"
 SYSTEM_CONSTANT "CIC751_SY" "0"
 SYSTEM_CONSTANT "CIVVL_SY" "0"
 SYSTEM_CONSTANT "CJ930_NUMCHP_SY" "1"
 SYSTEM_CONSTANT "CJ930_SY" "1"
 SYSTEM_CONSTANT "CJ945_SY" "0"
 SYSTEM_CONSTANT "CLNTOUTSENS_SY" "0"
 SYSTEM_CONSTANT "CLNTVLV_SY" "0"
 SYSTEM_CONSTANT "CLTH_UDIAMIN" "6000"
 SYSTEM_CONSTANT "CMBENGSLFRUN_SY" "0"
 SYSTEM_CONSTANT "CMBTYP_DS" "0"
 SYSTEM_CONSTANT "CMBTYP_GS" "1"
 SYSTEM_CONSTANT "CMBTYP_SY" "1"
 SYSTEM_CONSTANT "CODT_SWTCOTYPE_MSFT" "1"
 SYSTEM_CONSTANT "COEFFA_MIN" "0"
 SYSTEM_CONSTANT "COEFFA_RES" "0.0048828125"
 SYSTEM_CONSTANT "COELM_COMSTART" "0"
 SYSTEM_CONSTANT "COELM_EMERGENCY" "16"
 SYSTEM_CONSTANT "COELM_ENAPRECHM" "3"
 SYSTEM_CONSTANT "COELM_INIT" "2"
 SYSTEM_CONSTANT "COELM_NOVLTGCTL" "15"
 SYSTEM_CONSTANT "COELM_RDYHVM" "15"
 SYSTEM_CONSTANT "COELM_SPDCTLPCHTOVLTG" "141"
 SYSTEM_CONSTANT "COELM_SPDCTLPICHTOVLTG" "136"
 SYSTEM_CONSTANT "COELM_STANDBY" "6"
 SYSTEM_CONSTANT "COELM_STANDBYCHTOVLTG" "134"
 SYSTEM_CONSTANT "COELM_STARTINITM" "0"
 SYSTEM_CONSTANT "COELM_STARTVLTGCTL" "14"
 SYSTEM_CONSTANT "COELM_STATEBIT7" "7"
 SYSTEM_CONSTANT "COELM_STMODE_0" "0"
 SYSTEM_CONSTANT "COELM_STMODE_1" "1"
 SYSTEM_CONSTANT "COELM_STMODE_13" "13"
 SYSTEM_CONSTANT "COELM_STMODE_15" "15"
 SYSTEM_CONSTANT "COELM_STMODE_3" "3"
 SYSTEM_CONSTANT "COELM_STMODE_5" "5"
 SYSTEM_CONSTANT "COELM_SYSTEMIO" "1"
 SYSTEM_CONSTANT "COELM_TRQCTLCHTOVLTG" "135"
 SYSTEM_CONSTANT "COELTS_IDLSHTDWN" "41"
 SYSTEM_CONSTANT "COELTS_MNCNTRRLS" "7"
 SYSTEM_CONSTANT "COELTS_SHTDWN" "7"
 SYSTEM_CONSTANT "COENGSTRT_SY" "0"
 SYSTEM_CONSTANT "COENG_STALFAILSTRT_BP" "1"
 SYSTEM_CONSTANT "COENG_STALSHOFF_BP" "3"
 SYSTEM_CONSTANT "COENG_STALSTRTSTOP_BP" "2"
 SYSTEM_CONSTANT "COENG_STALUNKWN_BP" "0"
 SYSTEM_CONSTANT "COENG_STALUNKWN_MSK" "12"
 SYSTEM_CONSTANT "COENG_TIMAX_ENGONOBD" "65535"
 SYSTEM_CONSTANT "COESS_DRVRLS" "15"
 SYSTEM_CONSTANT "COESS_ENASSE_SY" "0"
 SYSTEM_CONSTANT "COESS_IDLSHTDWN" "41"
 SYSTEM_CONSTANT "COESS_MNCNTRRLS" "7"
 SYSTEM_CONSTANT "COESS_PRECHABRT" "24"
 SYSTEM_CONSTANT "COESS_RCPTMNG_SY" "0"
 SYSTEM_CONSTANT "COESS_STRTUPRLS" "1"
 SYSTEM_CONSTANT "COETM_CLGDEM_DISBL" "0"
 SYSTEM_CONSTANT "COETM_CLGDEM_ENBL" "1"
 SYSTEM_CONSTANT "COETM_FACCLGAFTRUN_CURX" "3"
 SYSTEM_CONSTANT "COETM_RCLGAFTRUN_MAPX" "3"
 SYSTEM_CONSTANT "COETM_RCLGAFTRUN_MAPY" "3"
 SYSTEM_CONSTANT "COETM_RCLGDEMFAN_CURX" "5"
 SYSTEM_CONSTANT "COETM_RCLGDEMT_CURX" "5"
 SYSTEM_CONSTANT "COETM_RCLGKI_CURX" "3"
 SYSTEM_CONSTANT "COETM_RCLGKP_CURX" "3"
 SYSTEM_CONSTANT "COETM_TICLGAFTRUN2_MAPX" "3"
 SYSTEM_CONSTANT "COETM_TICLGAFTRUN2_MAPY" "3"
 SYSTEM_CONSTANT "COETM_TICLGAFTRUNCONS_MAPX" "4"
 SYSTEM_CONSTANT "COETM_TICLGAFTRUNCONS_MAPY" "4"
 SYSTEM_CONSTANT "COETM_TICLGAFTRUNOIL_CURX" "3"
 SYSTEM_CONSTANT "COETM_TICLGAFTRUNTENV_CURX" "3"
 SYSTEM_CONSTANT "COETM_TICLGAFTRUN_MAPX" "3"
 SYSTEM_CONSTANT "COETM_TICLGAFTRUN_MAPY" "3"
 SYSTEM_CONSTANT "COHVB_EMGENCY" "16"
 SYSTEM_CONSTANT "COHVB_MNCNTRPERMSN" "7"
 SYSTEM_CONSTANT "COHVB_PRECHABRT" "64"
 SYSTEM_CONSTANT "COHVB_SOCNOK" "15"
 SYSTEM_CONSTANT "COHVB_SOCOK" "0"
 SYSTEM_CONSTANT "COHVB_STOK" "0"
 SYSTEM_CONSTANT "COHVB_STRTUPPERMSN" "1"
 SYSTEM_CONSTANT "COHVB_SWTOFF" "128"
 SYSTEM_CONSTANT "COMCIL_WKUP_AVL" "1"
 SYSTEM_CONSTANT "COMCIL_WKUP_NOAVL" "0"
 SYSTEM_CONSTANT "COMCIL_WKUP_SY" "0"
 SYSTEM_CONSTANT "COMPACCPED_OFF" "0"
 SYSTEM_CONSTANT "COMPACCPED_ON" "1"
 SYSTEM_CONSTANT "COMPACCPED_SY" "0"
 SYSTEM_CONSTANT "COM_STAIRBG_ACTRTST" "5"
 SYSTEM_CONSTANT "COM_STAIRBG_DRVSIDE_CRSH" "2"
 SYSTEM_CONSTANT "COM_STAIRBG_FRT_CRSH" "0"
 SYSTEM_CONSTANT "COM_STAIRBG_PASSGRSIDE_CRSH" "3"
 SYSTEM_CONSTANT "COM_STAIRBG_ROLLOVR" "4"
 SYSTEM_CONSTANT "COM_STAIRBG_RR_CRSH" "1"
 SYSTEM_CONSTANT "COM_STCANVERMSK_SY" "2383"
 SYSTEM_CONSTANT "COM_STCANVERMSK_V4" "2383"
 SYSTEM_CONSTANT "COM_STCANVERMSK_V4HYB" "160"
 SYSTEM_CONSTANT "COM_STCANVERMSK_V6" "1552"
 SYSTEM_CONSTANT "COM_STCLTHMODLRNG_DEF" "255"
 SYSTEM_CONSTANT "COM_STCLTHMODLRNG_IN" "1"
 SYSTEM_CONSTANT "COM_STCLTHMODLRNG_INAC" "2"
 SYSTEM_CONSTANT "COM_STCLTHMODLRNG_OUT" "0"
 SYSTEM_CONSTANT "CONV_KD_16_TO_KD_32" "2.00006103701895"
 SYSTEM_CONSTANT "CONV_OVHPRT_SY" "0"
 SYSTEM_CONSTANT "CONV_T1_16_2_TO_1_T1_32" "562933"
 SYSTEM_CONSTANT "CONV_T1_16_TO_1_T1_32" "28146638.6776064"
 SYSTEM_CONSTANT "COPOM_CTLCNGMND" "4"
 SYSTEM_CONSTANT "COPOM_CTLSFTST" "5"
 SYSTEM_CONSTANT "COPOM_ELSTRT" "227"
 SYSTEM_CONSTANT "COPOM_NUMDESYNCSTRT" "6"
 SYSTEM_CONSTANT "COPOM_NUMIMPSTRT" "2"
 SYSTEM_CONSTANT "COPOM_NUMIMPSTRTDRV" "3"
 SYSTEM_CONSTANT "COPOM_NUMIMPSTRTDRV_EL" "23"
 SYSTEM_CONSTANT "COPOM_NUMIMPSTRT_EL" "22"
 SYSTEM_CONSTANT "COPOM_NUMNOSTOPREQU" "0"
 SYSTEM_CONSTANT "COPOM_NUMNOSTRTREQU" "0"
 SYSTEM_CONSTANT "COPOM_NUMSLIPSTRTPWR1" "10"
 SYSTEM_CONSTANT "COPOM_NUMSLIPSTRTPWR2" "13"
 SYSTEM_CONSTANT "COPOM_NUMSLIPSTRTSOFT1" "8"
 SYSTEM_CONSTANT "COPOM_NUMSLIPSTRTSOFT2" "11"
 SYSTEM_CONSTANT "COPOM_NUMSLIPSTRTTRQ1" "9"
 SYSTEM_CONSTANT "COPOM_NUMSLIPSTRTTRQ2" "12"
 SYSTEM_CONSTANT "COPOM_NUMSLIPSTRT_PWR" "10"
 SYSTEM_CONSTANT "COPOM_NUMSLIPSTRT_SOFT" "8"
 SYSTEM_CONSTANT "COPOM_NUMSLIPSTRT_TRQ" "9"
 SYSTEM_CONSTANT "COPOM_SHTOFF" "239"
 SYSTEM_CONSTANT "COPOM_STMNSTBIT_4" "4"
 SYSTEM_CONSTANT "COPOM_STOPENG" "238"
 SYSTEM_CONSTANT "COPOM_STOPENGEL" "238"
 SYSTEM_CONSTANT "COPOM_STRTENGEL" "228"
 SYSTEM_CONSTANT "COPOM_TRATGTELMDRV" "3"
 SYSTEM_CONSTANT "COPOM_TRATGTELMRDN" "4"
 SYSTEM_CONSTANT "COPOM_TRATGTENGIDL" "1"
 SYSTEM_CONSTANT "COPOM_TRATGTENGRDN" "5"
 SYSTEM_CONSTANT "COPOM_TRATGTERR" "7"
 SYSTEM_CONSTANT "COPOM_TRATGTHYBDRV" "2"
 SYSTEM_CONSTANT "COPOM_TRATGTINI" "0"
 SYSTEM_CONSTANT "COPT_DCS_BP" "1"
 SYSTEM_CONSTANT "COPT_STNSETP_TRA_FLT" "0"
 SYSTEM_CONSTANT "COPT_STNSETP_TRA_UNFLT" "0"
 SYSTEM_CONSTANT "COPT_TCS_BP" "0"
 SYSTEM_CONSTANT "COPT_TRADEC_BP" "3"
 SYSTEM_CONSTANT "COPT_TRAINC_BP" "2"
 SYSTEM_CONSTANT "COPT_TRAPRTEXT_BP" "1"
 SYSTEM_CONSTANT "COPT_TRAPRTINT_BP" "0"
 SYSTEM_CONSTANT "CORRZLRSTMOT_SY" "0"
 SYSTEM_CONSTANT "COTS_RHO_MAPX" "2"
 SYSTEM_CONSTANT "COTS_RHO_MAPY" "4"
 SYSTEM_CONSTANT "COTS_THERMDEM_DISBL" "0"
 SYSTEM_CONSTANT "COTS_THERMDEM_ENBL" "1"
 SYSTEM_CONSTANT "COVDDC_BOOST" "4"
 SYSTEM_CONSTANT "COVMD_ACCI" "2"
 SYSTEM_CONSTANT "COVMD_CRCTL" "1"
 SYSTEM_CONSTANT "COVOM_BPOSERR" "7"
 SYSTEM_CONSTANT "COVOM_BPOSSTRT" "5"
 SYSTEM_CONSTANT "COVOM_CTLABRT" "3"
 SYSTEM_CONSTANT "COVOM_CTLACTV" "1"
 SYSTEM_CONSTANT "COVOM_CTLCNGMND" "4"
 SYSTEM_CONSTANT "COVOM_CTLFIN" "2"
 SYSTEM_CONSTANT "COVOM_CTLRDY" "0"
 SYSTEM_CONSTANT "COVOM_DRGSTRT" "221"
 SYSTEM_CONSTANT "COVOM_ELDRV" "15"
 SYSTEM_CONSTANT "COVOM_ELMIDL" "13"
 SYSTEM_CONSTANT "COVOM_ELMRUN" "12"
 SYSTEM_CONSTANT "COVOM_ELMSTAND" "11"
 SYSTEM_CONSTANT "COVOM_ELMSVC" "19"
 SYSTEM_CONSTANT "COVOM_ENGDRV" "142"
 SYSTEM_CONSTANT "COVOM_ENGIDL" "141"
 SYSTEM_CONSTANT "COVOM_ENGSTAL" "143"
 SYSTEM_CONSTANT "COVOM_IMPSTRT" "222"
 SYSTEM_CONSTANT "COVOM_PRECTLSTRT" "1"
 SYSTEM_CONSTANT "COVOM_SHTDOWN" "4"
 SYSTEM_CONSTANT "COVOM_SHTOFF" "239"
 SYSTEM_CONSTANT "COVOM_SLIPSTRT" "223"
 SYSTEM_CONSTANT "COVOM_SOFTSTOP" "231"
 SYSTEM_CONSTANT "COVOM_STBY" "8"
 SYSTEM_CONSTANT "COVOM_STMNSTBIT_4" "4"
 SYSTEM_CONSTANT "COVOM_STUB_SY" "0"
 SYSTEM_CONSTANT "COVOM_SYSINIT" "5"
 SYSTEM_CONSTANT "COVOM_TRATRGELMDRV" "3"
 SYSTEM_CONSTANT "COVOM_TRATRGELMRDN" "4"
 SYSTEM_CONSTANT "COVOM_TRATRGENGIDL" "1"
 SYSTEM_CONSTANT "COVOM_TRATRGENGRDN" "5"
 SYSTEM_CONSTANT "COVOM_TRATRGERR" "7"
 SYSTEM_CONSTANT "COVOM_TRATRGHYBDRV" "2"
 SYSTEM_CONSTANT "COVOM_TRATRGINI" "0"
 SYSTEM_CONSTANT "CPP_HT_RLS_RATE_FLT_OFS" "-5"
 SYSTEM_CONSTANT "CPP_HT_RLS_RATE_FLT_ORD_MAX" "4"
 SYSTEM_CONSTANT "CPP_HT_RLS_RATE_OFS" "-1"
 SYSTEM_CONSTANT "CRCTL_STDIA_ACTIV_BP" "6"
 SYSTEM_CONSTANT "CRCTL_STDIA_OVERRIDE_BP" "7"
 SYSTEM_CONSTANT "CRCTL_STMCH_MAINSWITCHOFF" "0"
 SYSTEM_CONSTANT "CRCTL_SY" "0"
 SYSTEM_CONSTANT "CRSSENSTYP_SY" "0"
 SYSTEM_CONSTANT "CRSTYP_SY" "0"
 SYSTEM_CONSTANT "CRS_ALTPIN_SY" "0"
 SYSTEM_CONSTANT "CRS_ANGLECOR_SY" "0"
 SYSTEM_CONSTANT "CRS_BACKUP_CASTYP_SY" "2"
 SYSTEM_CONSTANT "CRS_BACKUP_DYN_SY" "0"
 SYSTEM_CONSTANT "CRS_BACKUP_SY" "1"
 SYSTEM_CONSTANT "CRS_CY30CONF_SY" "0"
 SYSTEM_CONSTANT "CRS_DIAG_DETAIL_SY" "0"
 SYSTEM_CONSTANT "CRS_DIAG_SYNCINJLOST_SY" "0"
 SYSTEM_CONSTANT "CRS_MIAP_SY" "0"
 SYSTEM_CONSTANT "CRS_SSP_SY" "0"
 SYSTEM_CONSTANT "CRS_TAA_SY" "0"
 SYSTEM_CONSTANT "CRS_TOOTHAVRG_SY" "1"
 SYSTEM_CONSTANT "CRS_TO_CAS" "2"
 SYSTEM_CONSTANT "CTTCTL_SY" "0"
 SYSTEM_CONSTANT "CTTMON_AIRMASS" "1"
 SYSTEM_CONSTANT "CTTMON_OFF" "0"
 SYSTEM_CONSTANT "CTTMON_TEMP_SY" "0"
 SYSTEM_CONSTANT "CTTMON_TYPE_AIRMASS" "1"
 SYSTEM_CONSTANT "CTTMON_TYPE_OFF" "255"
 SYSTEM_CONSTANT "CTTMON_TYPE_SY" "255"
 SYSTEM_CONSTANT "CTTMON_TYPE_TEMP" "0"
 SYSTEM_CONSTANT "CTT_DTENV_CURX" "15"
 SYSTEM_CONSTANT "CTT_DTPWRINCR_CURX" "5"
 SYSTEM_CONSTANT "CTT_FACDTDEC_CURX" "6"
 SYSTEM_CONSTANT "CT_ONE" "1"
 SYSTEM_CONSTANT "CT_REPLVALSRC_SY" "1"
 SYSTEM_CONSTANT "CT_ZERO" "0"
 SYSTEM_CONSTANT "CURR_A_Q0P03125_ZERO" "0"
 SYSTEM_CONSTANT "CURR_A_RES" "0.01"
 SYSTEM_CONSTANT "CURR_RES" "1"
 SYSTEM_CONSTANT "CVC_SY" "0"
 SYSTEM_CONSTANT "CVOCFG_SC" "0"
 SYSTEM_CONSTANT "CVT_SY" "0"
 SYSTEM_CONSTANT "CY100_SY" "0"
 SYSTEM_CONSTANT "CY141_SY" "0"
 SYSTEM_CONSTANT "CY146_SY" "0"
 SYSTEM_CONSTANT "CY320_SY" "0"
 SYSTEM_CONSTANT "CY327_SY" "0"
 SYSTEM_CONSTANT "CYLK1_RES" "0.0078125"
 SYSTEM_CONSTANT "CYLK1_RES_REV" "128"
 SYSTEM_CONSTANT "CYLK2_REC_NRM_EXP" "14"
 SYSTEM_CONSTANT "CYLK2_REC_RES" "16384"
 SYSTEM_CONSTANT "CYLPRES_NRM_EXP" "7"
 SYSTEM_CONSTANT "CYLPRES_RES" "0.0078125"
 SYSTEM_CONSTANT "CYLPRES_RES_REV" "128"
 SYSTEM_CONSTANT "CYL_FAC_NORM" "33333"
 SYSTEM_CONSTANT "DACC_RES_REV" "100"
 SYSTEM_CONSTANT "DACC_ZERO" "0"
 SYSTEM_CONSTANT "DCSOVRDSDFFTLPRT_SY" "1"
 SYSTEM_CONSTANT "DCSOVRDSENGPRT_SY" "0"
 SYSTEM_CONSTANT "DCSOVRDSTRAPRT_SY" "1"
 SYSTEM_CONSTANT "DCSOVRDSTSCDEC_SY" "1"
 SYSTEM_CONSTANT "DCS_OVRDS_DFFTLPRT" "1"
 SYSTEM_CONSTANT "DCS_OVRDS_ENGPRT" "1"
 SYSTEM_CONSTANT "DCS_OVRDS_TRAPRT" "1"
 SYSTEM_CONSTANT "DCS_OVRDS_TSCDEC" "1"
 SYSTEM_CONSTANT "DDRC_DTRFRZINFHEALDEB_SY" "0"
 SYSTEM_CONSTANT "DDRC_DTRUPDSUP_SY" "0"
 SYSTEM_CONSTANT "DDRC_NUM_DFC_EVTROW" "17"
 SYSTEM_CONSTANT "DDRC_NUM_DFC_EVTROW_SML" "0"
 SYSTEM_CONSTANT "DDRC_NUM_DFC_EVTUD" "0"
 SYSTEM_CONSTANT "DDRC_NUM_DFC_EVTUD_SML" "0"
 SYSTEM_CONSTANT "DDRC_NUM_DFC_TIROW" "23"
 SYSTEM_CONSTANT "DDRC_NUM_DFC_TIROW_SML" "1"
 SYSTEM_CONSTANT "DDRC_NUM_DFC_TIUD" "19"
 SYSTEM_CONSTANT "DDRC_NUM_DFC_TIUD_SML" "21"
 SYSTEM_CONSTANT "DDVOL_RES" "10"
 SYSTEM_CONSTANT "DECOMP_SY" "0"
 SYSTEM_CONSTANT "DEDIA_VRNTCONF_SY" "0"
 SYSTEM_CONSTANT "DEVLIB_4WINDIACMPNENA_SY" "0"
 SYSTEM_CONSTANT "DEVLIB_4WINDIA_TYP_CTLLN" "0"
 SYSTEM_CONSTANT "DEVLIB_4WINDIA_TYP_DIGIN" "1"
 SYSTEM_CONSTANT "DEVLIB_4WINDIA_TYP_EXT" "2"
 SYSTEM_CONSTANT "DEVLIB_4WINDIA_TYP_NONE" "3"
 SYSTEM_CONSTANT "DEVLIB_ACTRPRTCMPNENA_SY" "0"
 SYSTEM_CONSTANT "DEVLIB_DBG_SY" "0"
 SYSTEM_CONSTANT "DEVLIB_DIACTLLINECMPNENA_SY" "0"
 SYSTEM_CONSTANT "DEVLIB_HBRGENA_SY" "0"
 SYSTEM_CONSTANT "DEVLIB_PHYSRNGCHK_SY" "0"
 SYSTEM_CONSTANT "DEVLIB_PSOFFOPNLD_SY" "0"
 SYSTEM_CONSTANT "DE_ATSINTVMOD_NOSHOFFBYP" "0"
 SYSTEM_CONSTANT "DE_ATSINTVMOD_SHOFFBYP" "1"
 SYSTEM_CONSTANT "DFC_CTLDISBLLAYOUT_SY" "1"
 SYSTEM_CONSTANT "DFC_CTLMSKBYTES_SY" "1"
 SYSTEM_CONSTANT "DFC_CTLMSK_RESCANCMSK" "1"
 SYSTEM_CONSTANT "DFC_CTLMSK_RESINIMSK" "1"
 SYSTEM_CONSTANT "DFC_DISBLMSKBYTES_SY" "1"
 SYSTEM_CONSTANT "DFES_AGINGCTR_VAR1" "0"
 SYSTEM_CONSTANT "DFES_BLKENTRY_SY" "0"
 SYSTEM_CONSTANT "DFES_COMMILDEB_SY" "1"
 SYSTEM_CONSTANT "DFES_DTC_TSTFAIL_SY" "0"
 SYSTEM_CONSTANT "DFES_EOBDCV_SY" "0"
 SYSTEM_CONSTANT "DFES_EOLCLR_SY" "1"
 SYSTEM_CONSTANT "DFES_EXTDFLT_SY" "1"
 SYSTEM_CONSTANT "DFES_IRV_SY" "0"
 SYSTEM_CONSTANT "DFES_MONITORING_LEN_SY" "1"
 SYSTEM_CONSTANT "DFES_NUMENTRIES_SY" "10"
 SYSTEM_CONSTANT "DFES_NUM_ENV_BLK" "2"
 SYSTEM_CONSTANT "DFES_NUM_ENV_BYT" "2"
 SYSTEM_CONSTANT "DFES_NUM_EXFRZFR_BYT" "0"
 SYSTEM_CONSTANT "DFES_NUM_FRZFR_BYT" "23"
 SYSTEM_CONSTANT "DFES_PDTC_SY" "0"
 SYSTEM_CONSTANT "DFES_PRVTSTRDLT_SY" "0"
 SYSTEM_CONSTANT "DFES_SIMCOND_READONLY" "0"
 SYSTEM_CONSTANT "DFES_SIMCOND_SY" "0"
 SYSTEM_CONSTANT "DFES_VIS_BUF_SY" "0"
 SYSTEM_CONSTANT "DFFTLPRTOVRDSTSCINC_SY" "1"
 SYSTEM_CONSTANT "DFFTLPRT_OVRDS_DCS" "0"
 SYSTEM_CONSTANT "DFFTLPRT_OVRDS_TSCINC" "1"
 SYSTEM_CONSTANT "DFFV_SY" "0"
 SYSTEM_CONSTANT "DFPNUM_FLMA_SY" "2"
 SYSTEM_CONSTANT "DIABAS_ATSTST_SY" "0"
 SYSTEM_CONSTANT "DIABAS_AVSSTD_SY" "2"
 SYSTEM_CONSTANT "DIABAS_AVSTST_SY" "0"
 SYSTEM_CONSTANT "DIABAS_AVS_SY" "1"
 SYSTEM_CONSTANT "DIABAS_CRCTAB_SY" "1"
 SYSTEM_CONSTANT "DIABAS_ETCTST_SY" "0"
 SYSTEM_CONSTANT "DIABAS_I15031TST_SY" "0"
 SYSTEM_CONSTANT "DIABAS_NODIAP_SY" "1"
 SYSTEM_CONSTANT "DIABAS_SCRCTL_RCNT_RESET_SY" "0"
 SYSTEM_CONSTANT "DIABAS_SIGNALSTST_SY" "0"
 SYSTEM_CONSTANT "DIABAS_VAR_SY" "243"
 SYSTEM_CONSTANT "DIACPV_SY" "0"
 SYSTEM_CONSTANT "DIAGCOM_BOOTPART_SY" "0"
 SYSTEM_CONSTANT "DIAGCOM_RDPI_SY" "0"
 SYSTEM_CONSTANT "DIAGCOM_RESPONEVT_SY" "0"
 SYSTEM_CONSTANT "DIAGCOM_RINGBUF_SY" "0"
 SYSTEM_CONSTANT "DIAGSRV_LTCV_SY" "0"
 SYSTEM_CONSTANT "DIAG_SVRPTCOL_SY" "0"
 SYSTEM_CONSTANT "DIA_RES" "0.0001"
 SYSTEM_CONSTANT "DIA_RES_REV" "10000"
 SYSTEM_CONSTANT "DIBOX_SY" "0"
 SYSTEM_CONSTANT "DIFFPRT_SY" "0"
 SYSTEM_CONSTANT "DINH_MONINHBCNT_SC" "3"
 SYSTEM_CONSTANT "DIPO_SY" "0"
 SYSTEM_CONSTANT "DISTAB_SY" "1"
 SYSTEM_CONSTANT "DIUMPR_500MD_SY" "0"
 SYSTEM_CONSTANT "DIUMPR_EVAPDEN_SY" "0"
 SYSTEM_CONSTANT "DIUMPR_NUMDENOMIDXGRP_SY" "0"
 SYSTEM_CONSTANT "DIUMPR_NUMMSGGRPS" "0"
 SYSTEM_CONSTANT "DIUMPR_NUMRATCFG" "0"
 SYSTEM_CONSTANT "DIUMPR_NUMRATCLB" "0"
 SYSTEM_CONSTANT "DIUMPR_NUMSIGCLB" "0"
 SYSTEM_CONSTANT "DIUMPR_NUM_GROUPS_SY" "0"
 SYSTEM_CONSTANT "DIV_INJTIME_US" "2"
 SYSTEM_CONSTANT "DKVSTDFC_SC" "0"
 SYSTEM_CONSTANT "DLSASV06_SY" "1"
 SYSTEM_CONSTANT "DMDMIL_DFCINF_SY" "3"
 SYSTEM_CONSTANT "DMDMIL_LMPINF_SY" "1"
 SYSTEM_CONSTANT "DOGOVENA_SY" "0"
 SYSTEM_CONSTANT "DOGOVTYP_SY" "0"
 SYSTEM_CONSTANT "DOGOV_SY" "0"
 SYSTEM_CONSTANT "DPDIFFTMP_RES" "100"
 SYSTEM_CONSTANT "DPDIFF_RES" "0.1"
 SYSTEM_CONSTANT "DPS_EV1E" "0"
 SYSTEM_CONSTANT "DPS_EV2E" "1"
 SYSTEM_CONSTANT "DPS_EV3E" "2"
 SYSTEM_CONSTANT "DPS_KPE" "0"
 SYSTEM_CONSTANT "DPS_TEVE" "0"
 SYSTEM_CONSTANT "DRAGTORQUELIM" "1"
 SYSTEM_CONSTANT "DRCTSTRT_SY" "0"
 SYSTEM_CONSTANT "DRVPRGLMP_HWSEL_SY" "0"
 SYSTEM_CONSTANT "DRVPRGSWT_NUMMODE" "0"
 SYSTEM_CONSTANT "DRVPRGSWT_NUMWNTR" "0"
 SYSTEM_CONSTANT "DSCHED_COEOM_SY" "0"
 SYSTEM_CONSTANT "DSCHED_FIDMAXPRIOLST_SY" "0"
 SYSTEM_CONSTANT "DSCHED_FTI_SY" "1"
 SYSTEM_CONSTANT "DSCHED_PRIOACTVJMP_SY" "1"
 SYSTEM_CONSTANT "DSCHED_PRIODFCSTLDF_SY" "0"
 SYSTEM_CONSTANT "DSCHED_PRIODFCSTTST_SY" "1"
 SYSTEM_CONSTANT "DSCHED_PRIOPHYSURGENCY_SY" "1"
 SYSTEM_CONSTANT "DSCHED_PRIORMPCALC_SY" "0"
 SYSTEM_CONSTANT "DSCHED_RATECALC_SY" "1"
 SYSTEM_CONSTANT "DSCHED_WTT_SY" "1"
 SYSTEM_CONSTANT "DSM2AUTOSAR_SC" "0"
 SYSTEM_CONSTANT "DSM2SG_ASCETINF_SC" "0"
 SYSTEM_CONSTANT "DSM2SG_DFC_SY" "0"
 SYSTEM_CONSTANT "DSM2SG_DSQ_SY" "0"
 SYSTEM_CONSTANT "DSM2SG_FID_SY" "0"
 SYSTEM_CONSTANT "DSMAUX_READONLY" "0"
 SYSTEM_CONSTANT "DSMAUX_ROEBUFLEN" "0"
 SYSTEM_CONSTANT "DSMAUX_ROEBUFUSEENVRAM" "0"
 SYSTEM_CONSTANT "DSMAUX_TCSORT_SY" "1"
 SYSTEM_CONSTANT "DSMBAS_VAR_SY" "243"
 SYSTEM_CONSTANT "DSMBDEP_SY" "0"
 SYSTEM_CONSTANT "DSMCONF_DFCCTTSTD" "0"
 SYSTEM_CONSTANT "DSMCONF_DTCTABLE_DTCM" "1"
 SYSTEM_CONSTANT "DSMCONF_DTCTABLE_DTCX" "0"
 SYSTEM_CONSTANT "DSMCONF_NUM_CLASSES" "20"
 SYSTEM_CONSTANT "DSMCONF_SUPGLBCTLMSK" "0"
 SYSTEM_CONSTANT "DSMCONF_SUPGLBDBLV" "0"
 SYSTEM_CONSTANT "DSMCONF_SUPGLBDISBLMSK" "0"
 SYSTEM_CONSTANT "DSMCONF_SUPGLBENVREF" "0"
 SYSTEM_CONSTANT "DSMCONF_SUPGLBFAULTTYP" "0"
 SYSTEM_CONSTANT "DSMCONF_SUPGLBFLTCLS" "0"
 SYSTEM_CONSTANT "DSMCONF_SUP_TNPSCPU" "0"
 SYSTEM_CONSTANT "DSMCONF_SUP_TNPSDTCC" "0"
 SYSTEM_CONSTANT "DSMDUR_MIL_GLB_SY" "0"
 SYSTEM_CONSTANT "DSMRDY_ENGSPEC_SY" "1"
 SYSTEM_CONSTANT "DSMRDY_ENVCOND_SUP" "0"
 SYSTEM_CONSTANT "DSMRDY_FIDINH_SUP" "0"
 SYSTEM_CONSTANT "DSMRDY_FLSYSNONCONT" "0"
 SYSTEM_CONSTANT "DSMRDY_INHP41_SY" "0"
 SYSTEM_CONSTANT "DSMRDY_READONLY" "0"
 SYSTEM_CONSTANT "DSMRDY_READONLYGRP" "0"
 SYSTEM_CONSTANT "DSMRDY_SIZE_LST_AC" "1"
 SYSTEM_CONSTANT "DSMRDY_SIZE_LST_Cat" "15"
 SYSTEM_CONSTANT "DSMRDY_SIZE_LST_ComprCmpnt" "1"
 SYSTEM_CONSTANT "DSMRDY_SIZE_LST_EGR" "15"
 SYSTEM_CONSTANT "DSMRDY_SIZE_LST_EvpSys" "15"
 SYSTEM_CONSTANT "DSMRDY_SIZE_LST_FlSys" "15"
 SYSTEM_CONSTANT "DSMRDY_SIZE_LST_HtCat" "15"
 SYSTEM_CONSTANT "DSMRDY_SIZE_LST_Misf" "1"
 SYSTEM_CONSTANT "DSMRDY_SIZE_LST_O2Sens" "15"
 SYSTEM_CONSTANT "DSMRDY_SIZE_LST_O2SensHt" "15"
 SYSTEM_CONSTANT "DSMRDY_SIZE_LST_SecAirSys" "15"
 SYSTEM_CONSTANT "DSMRDY_STDCONFIG" "1"
 SYSTEM_CONSTANT "DSMRDY_SUPPID41_SY" "0"
 SYSTEM_CONSTANT "DSMRDY_VERS_SC" "1"
 SYSTEM_CONSTANT "DSM_CONF_READONLY_DINH_SY" "0"
 SYSTEM_CONSTANT "DSM_CONF_READONLY_EXCLU_SY" "0"
 SYSTEM_CONSTANT "DSM_CONF_SUP_DSMRDY_CT" "0"
 SYSTEM_CONSTANT "DSM_CONF_SUP_DSMRDY_XWHY" "0"
 SYSTEM_CONSTANT "DSM_DISBLGRPSIZE_SY" "0"
 SYSTEM_CONSTANT "DSM_DSM2SG_SY" "0"
 SYSTEM_CONSTANT "DSM_FAILCNT_SY" "0"
 SYSTEM_CONSTANT "DSM_FAULTSEQ_SY" "0"
 SYSTEM_CONSTANT "DSM_HDOBD_SY" "0"
 SYSTEM_CONSTANT "DSM_INHRLS_SY" "0"
 SYSTEM_CONSTANT "DSM_MDOBD_SY" "0"
 SYSTEM_CONSTANT "DSM_NUMDFC" "212"
 SYSTEM_CONSTANT "DSM_NUMFID" "126"
 SYSTEM_CONSTANT "DSM_PDTCTSTRA_SY" "0"
 SYSTEM_CONSTANT "DSM_STDCONF_DSMRDY_SY" "0"
 SYSTEM_CONSTANT "DSM_WUCDET_SY" "1"
 SYSTEM_CONSTANT "DSM_XDI_ENA_SC" "0"
 SYSTEM_CONSTANT "DSS_SY" "1"
 SYSTEM_CONSTANT "DST1_RES" "500"
 SYSTEM_CONSTANT "DST1_RES_DIR" "500"
 SYSTEM_CONSTANT "DST_RES" "25"
 SYSTEM_CONSTANT "DST_RES_DIR" "25"
 SYSTEM_CONSTANT "DTEVAP_SC" "0"
 SYSTEM_CONSTANT "DTRQPRPHIGH_20MS_RES" "5"
 SYSTEM_CONSTANT "DTRQ_MAX" "2000"
 SYSTEM_CONSTANT "DTRQ_MIN" "-2000"
 SYSTEM_CONSTANT "DTRQ_RES" "0.1"
 SYSTEM_CONSTANT "DTRQ_RES_REV" "10"
 SYSTEM_CONSTANT "DTRQ_ZERO" "0"
 SYSTEM_CONSTANT "DTR_FACTKLINE" "13"
 SYSTEM_CONSTANT "DTR_FACT_RES_REV" "8192"
 SYSTEM_CONSTANT "DTR_LEGIFC_SY" "1"
 SYSTEM_CONSTANT "DTTEMP_RES" "0.01"
 SYSTEM_CONSTANT "DTTEMP_RES_REV" "100"
 SYSTEM_CONSTANT "DTTEMP_ZERO" "0"
 SYSTEM_CONSTANT "DTY_CYC_100" "100"
 SYSTEM_CONSTANT "DTY_CYC_5" "5"
 SYSTEM_CONSTANT "DTY_CYC_MAX" "100"
 SYSTEM_CONSTANT "DTY_CYC_MIN" "0"
 SYSTEM_CONSTANT "DTY_CYC_RES" "0.01"
 SYSTEM_CONSTANT "DTY_CYC_RES_REV" "100"
 SYSTEM_CONSTANT "DTY_CYC_ZERO" "0"
 SYSTEM_CONSTANT "DU_VBATFAC" "100"
 SYSTEM_CONSTANT "DVOL_RES" "0.1"
 SYSTEM_CONSTANT "DYN_TST_TIME_FACT" "256"
 SYSTEM_CONSTANT "ECLTYP_IMPCLTH" "1"
 SYSTEM_CONSTANT "ECLTYP_NOCLTH" "0"
 SYSTEM_CONSTANT "ECLTYP_PROPCLTH" "2"
 SYSTEM_CONSTANT "ECLTYP_SY" "0"
 SYSTEM_CONSTANT "ECL_ONE" "1"
 SYSTEM_CONSTANT "ECL_STOILFILGPROCDEACTV" "0"
 SYSTEM_CONSTANT "ECL_STOILFILGPROCEXT" "4"
 SYSTEM_CONSTANT "ECL_STOILFILGPROCINT1ACTV" "1"
 SYSTEM_CONSTANT "ECL_STOILFILGPROCINT2ACTV" "2"
 SYSTEM_CONSTANT "ECL_STOILFILGPROCINTFIN" "3"
 SYSTEM_CONSTANT "ECUIDECL_SY" "1"
 SYSTEM_CONSTANT "ECUNUM_SY" "1"
 SYSTEM_CONSTANT "ECUOFF_TMR_SY" "0"
 SYSTEM_CONSTANT "ECU_GENR_SY" "2"
 SYSTEM_CONSTANT "ECU_TRICORE_SY" "8"
 SYSTEM_CONSTANT "EECR_BLDPRC_SY" "0"
 SYSTEM_CONSTANT "EEOT_SY" "0"
 SYSTEM_CONSTANT "EEPKRA_SY" "0"
 SYSTEM_CONSTANT "EGRVLVLP_TYPAVL_SY" "0"
 SYSTEM_CONSTANT "EGRVLV_TYPAVL_SY" "0"
 SYSTEM_CONSTANT "EGR_SY" "0"
 SYSTEM_CONSTANT "EGT_P" "1"
 SYSTEM_CONSTANT "EGT_V" "0"
 SYSTEM_CONSTANT "ELM_AKS" "16"
 SYSTEM_CONSTANT "ELM_MASKAND" "127"
 SYSTEM_CONSTANT "ELM_MODEDESBIT7" "7"
 SYSTEM_CONSTANT "ELM_MODEDESMASK" "127"
 SYSTEM_CONSTANT "ELM_OFFCALIB" "85"
 SYSTEM_CONSTANT "ELM_SHORTSECU" "13"
 SYSTEM_CONSTANT "ELM_SPDCTLPCHTOVLTG" "132"
 SYSTEM_CONSTANT "ELM_SPDCTLPICHTOVLTG" "130"
 SYSTEM_CONSTANT "ELM_SPDCTL_P" "4"
 SYSTEM_CONSTANT "ELM_SPDCTL_PI" "2"
 SYSTEM_CONSTANT "ELM_STANDBYCHTOVLTG" "128"
 SYSTEM_CONSTANT "ELM_STMMASK" "128"
 SYSTEM_CONSTANT "ELM_TRQCTLCHTOVLTG" "129"
 SYSTEM_CONSTANT "ELM_TRQSECU" "12"
 SYSTEM_CONSTANT "ELM_VLTGCTLCHTOVLTG" "131"
 SYSTEM_CONSTANT "EMDMP_METH_1AND2" "3"
 SYSTEM_CONSTANT "EMDMP_METH_EDC16" "1"
 SYSTEM_CONSTANT "EMDMP_METH_HYDDMP1" "2"
 SYSTEM_CONSTANT "EMDMP_METH_NOTUSED" "0"
 SYSTEM_CONSTANT "EMDMP_NUMPS_FOUR" "4"
 SYSTEM_CONSTANT "EMDMP_NUMPS_ONE" "1"
 SYSTEM_CONSTANT "EMS_INIT" "15"
 SYSTEM_CONSTANT "EMS_MODE_5" "5"
 SYSTEM_CONSTANT "EMS_STMODE_5" "5"
 SYSTEM_CONSTANT "ENGOPMODE_SY" "0"
 SYSTEM_CONSTANT "ENGPRT_OVRDS_DCS" "0"
 SYSTEM_CONSTANT "ENGRESTRT_SY" "1"
 SYSTEM_CONSTANT "ENGSPD_LIMSTRT_SY" "1"
 SYSTEM_CONSTANT "ENGSPD_SWTENA_SY" "0"
 SYSTEM_CONSTANT "ENG_NMAX_GS" "10000"
 SYSTEM_CONSTANT "ENG_NMIN_GS" "20"
 SYSTEM_CONSTANT "ENG_NRGNIDLE_MAX" "1490"
 SYSTEM_CONSTANT "ENG_N_HIRES" "0.03125"
 SYSTEM_CONSTANT "ENG_N_HIRES_EXP" "5"
 SYSTEM_CONSTANT "ENG_N_IDL_RES" "10"
 SYSTEM_CONSTANT "ENG_N_L_RES" "40"
 SYSTEM_CONSTANT "ENG_N_MAX" "10000"
 SYSTEM_CONSTANT "ENG_N_MIN" "20"
 SYSTEM_CONSTANT "ENG_N_RES" "0.5"
 SYSTEM_CONSTANT "ENG_N_RES1" "0.5"
 SYSTEM_CONSTANT "ENG_N_RES_FL" "0.5"
 SYSTEM_CONSTANT "ENG_N_RES_REV" "2"
 SYSTEM_CONSTANT "ENG_N_ZERO" "0"
 SYSTEM_CONSTANT "ENRGPERMASS_RES" "0.1"
 SYSTEM_CONSTANT "ENRG_WH_RES" "1"
 SYSTEM_CONSTANT "ENRG_WH_RES_REV" "1"
 SYSTEM_CONSTANT "ENVT_HWANDCAN_SEL" "0"
 SYSTEM_CONSTANT "ENVT_HW_SEL" "2"
 SYSTEM_CONSTANT "EPMBCA_FAC_TSTINJ_SY" "1000"
 SYSTEM_CONSTANT "EPMBCR_NENG_DSTX" "5"
 SYSTEM_CONSTANT "EPMBCR_NUMSEGTEETH" "4"
 SYSTEM_CONSTANT "EPMCAS_DETECTBOTHEDGES" "2"
 SYSTEM_CONSTANT "EPMCAS_DETECTFALLINGEDGES" "0"
 SYSTEM_CONSTANT "EPMCAS_DETECTRISINGEDGES" "1"
 SYSTEM_CONSTANT "EPMCAS_FACPLAUS_DSTX" "3"
 SYSTEM_CONSTANT "EPMCAS_NUMSEG" "10"
 SYSTEM_CONSTANT "EPMCAS_NUMSEGLEN" "10"
 SYSTEM_CONSTANT "EPMCAS_PHINCOR_CURX" "6"
 SYSTEM_CONSTANT "EPMCAS_PHITEMPCOR05_DSTX" "3"
 SYSTEM_CONSTANT "EPMCRS_NUMTHRESH" "4"
 SYSTEM_CONSTANT "EPMCRS_NUMTTMEAS" "15"
 SYSTEM_CONSTANT "EPMCRS_NUMVAL" "4"
 SYSTEM_CONSTANT "EPMHCRS_NUMGAP" "1"
 SYSTEM_CONSTANT "EPMHCRS_NUMINC" "36"
 SYSTEM_CONSTANT "EPMHCRS_NUMINCGAP" "3"
 SYSTEM_CONSTANT "EPMHCRS_PHIINCR" "6"
 SYSTEM_CONSTANT "EPMHWE_RTM_SY" "0"
 SYSTEM_CONSTANT "EPMHWE_SWTCPU_SY" "0"
 SYSTEM_CONSTANT "EPMRRS_NUMPER" "16"
 SYSTEM_CONSTANT "EPMRRS_SY" "1"
 SYSTEM_CONSTANT "EPMRRS_TITEMP_CURX" "3"
 SYSTEM_CONSTANT "EPMRRS_TITOOTHPERTOL" "1000"
 SYSTEM_CONSTANT "EPMRVSROTYMETH_SY" "0"
 SYSTEM_CONSTANT "EPMSRV_FACAG" "144"
 SYSTEM_CONSTANT "EPMSYN_PHIINCCOR_CURX" "4"
 SYSTEM_CONSTANT "EPM_ATS_SY" "0"
 SYSTEM_CONSTANT "EPM_DIAGSPC_SY" "0"
 SYSTEM_CONSTANT "EPM_GTCRED_SY" "0"
 SYSTEM_CONSTANT "EPM_KEEPDGISYNC_SC" "0"
 SYSTEM_CONSTANT "EPM_MEASURE_SY" "2"
 SYSTEM_CONSTANT "EPM_NENG10MSMAX" "2550"
 SYSTEM_CONSTANT "EPM_NMAX" "10000"
 SYSTEM_CONSTANT "EPM_NMIN" "20"
 SYSTEM_CONSTANT "EPM_NUMCRSREVWCY" "2"
 SYSTEM_CONSTANT "EPM_NUMCRSREVWCY_SY" "2"
 SYSTEM_CONSTANT "EPM_NUMCYLMAX" "3"
 SYSTEM_CONSTANT "EPM_NZERO" "0"
 SYSTEM_CONSTANT "EPM_N_2_EPM_N_PT" "500000"
 SYSTEM_CONSTANT "EPM_N_6000" "6000"
 SYSTEM_CONSTANT "EPM_N_HIRES" "0.03125"
 SYSTEM_CONSTANT "EPM_N_HIRES_EXP" "5"
 SYSTEM_CONSTANT "EPM_N_IDL_RES" "10"
 SYSTEM_CONSTANT "EPM_N_L_RES" "40"
 SYSTEM_CONSTANT "EPM_N_MAX" "10000"
 SYSTEM_CONSTANT "EPM_N_MIN" "20"
 SYSTEM_CONSTANT "EPM_N_M_6000" "-6000"
 SYSTEM_CONSTANT "EPM_N_PT_RES" "1"
 SYSTEM_CONSTANT "EPM_N_PT_RES_REV" "1"
 SYSTEM_CONSTANT "EPM_N_RES" "0.5"
 SYSTEM_CONSTANT "EPM_N_RES_FL" "0.5"
 SYSTEM_CONSTANT "EPM_N_RES_REV" "2"
 SYSTEM_CONSTANT "EPM_N_ZERO" "0"
 SYSTEM_CONSTANT "EPM_PHICRSREV" "360"
 SYSTEM_CONSTANT "EPM_PHIMAX" "720"
 SYSTEM_CONSTANT "EPM_PHIMAXMSK" "32767"
 SYSTEM_CONSTANT "EPM_PHIMAX_SY" "32767"
 SYSTEM_CONSTANT "EPM_SPD_CALC_SY" "0"
 SYSTEM_CONSTANT "EPM_STRTALE_NENGMAX" "2000"
 SYSTEM_CONSTANT "EPM_SWTSRV_SY" "0"
 SYSTEM_CONSTANT "EPM_SYNCSLV_SY" "0"
 SYSTEM_CONSTANT "EPM_TDCDSTCLB_SC" "0"
 SYSTEM_CONSTANT "EPM_TIMING_SY" "0"
 SYSTEM_CONSTANT "EPM_TI_SHORTINT" "2500"
 SYSTEM_CONSTANT "EPM_VAR_SY" "243"
 SYSTEM_CONSTANT "ERRLMP_CUST_SY" "0"
 SYSTEM_CONSTANT "ERRREACHPINJVLVSTK_SY" "0"
 SYSTEM_CONSTANT "ERRVAL_S16" "32767"
 SYSTEM_CONSTANT "ERRVAL_S32" "2147483647"
 SYSTEM_CONSTANT "ERRVAL_S8" "127"
 SYSTEM_CONSTANT "ERRVAL_U16" "65535"
 SYSTEM_CONSTANT "ERRVAL_U32" "4294967295"
 SYSTEM_CONSTANT "ERRVAL_U8" "255"
 SYSTEM_CONSTANT "ESC_DT_NESTING_DEPTH" "10"
 SYSTEM_CONSTANT "ESNSAD_INHCUST_SY" "0"
 SYSTEM_CONSTANT "ETA1_EXP" "7"
 SYSTEM_CONSTANT "ETA1_RES" "0.0078125"
 SYSTEM_CONSTANT "ETA1_RES_REV" "128"
 SYSTEM_CONSTANT "ETA2_EXP" "7"
 SYSTEM_CONSTANT "ETA2_RES" "0.0078125"
 SYSTEM_CONSTANT "ETA2_RES_REV" "128"
 SYSTEM_CONSTANT "ETA_CORR_FACT_ONE" "1"
 SYSTEM_CONSTANT "ETA_COR_FACT_ONE" "1"
 SYSTEM_CONSTANT "ETA_EXP" "7"
 SYSTEM_CONSTANT "ETA_RES" "0.0078125"
 SYSTEM_CONSTANT "ETA_RES_REV" "128"
 SYSTEM_CONSTANT "ETA_THM_ENG_ONE" "1"
 SYSTEM_CONSTANT "ETC_Act_SY" "1"
 SYSTEM_CONSTANT "ETKS_SY" "1"
 SYSTEM_CONSTANT "EULER2PRES_EXP" "35"
 SYSTEM_CONSTANT "EULER2PRES_EXP1" "4"
 SYSTEM_CONSTANT "EULER2PRES_EXP2" "31"
 SYSTEM_CONSTANT "EULER_NUM_RES" "0.1"
 SYSTEM_CONSTANT "EVTYP_SY" "0"
 SYSTEM_CONSTANT "EXHBNKNUM_SY" "1"
 SYSTEM_CONSTANT "EXHMOD_NRCATB1_SC" "1"
 SYSTEM_CONSTANT "EXHMOD_NRCATB2_SC" "0"
 SYSTEM_CONSTANT "EXHMOD_NRCATUSS2B1_SC" "1"
 SYSTEM_CONSTANT "EXHMOD_VAR_SY" "243"
 SYSTEM_CONSTANT "EXHTEMP_CT_SENSORS1" "0"
 SYSTEM_CONSTANT "EXH_NUM_TFLDSIZE_SY" "0"
 SYSTEM_CONSTANT "FACT0002_RES" "0.0002"
 SYSTEM_CONSTANT "FACT0002_RES_REV" "5000"
 SYSTEM_CONSTANT "FACT100000_RES_REV" "100000"
 SYSTEM_CONSTANT "FACT1000_RES" "0.001"
 SYSTEM_CONSTANT "FACT1000_RES_REV" "1000"
 SYSTEM_CONSTANT "FACT100_RES" "0.01"
 SYSTEM_CONSTANT "FACT100_RES_REV" "100"
 SYSTEM_CONSTANT "FACT1_EXP" "7"
 SYSTEM_CONSTANT "FACT1_INV" "-0.0078125"
 SYSTEM_CONSTANT "FACT1_ONE" "1"
 SYSTEM_CONSTANT "FACT1_RES" "0.0078125"
 SYSTEM_CONSTANT "FACT1_RES_REV" "128"
 SYSTEM_CONSTANT "FACT256_RES" "0.00390625"
 SYSTEM_CONSTANT "FACT256_RES_REV" "256"
 SYSTEM_CONSTANT "FACT6_RES" "0.002"
 SYSTEM_CONSTANT "FACT6_RES_REV" "500"
 SYSTEM_CONSTANT "FACTLOW_ONE" "1"
 SYSTEM_CONSTANT "FACTOR_10" "10"
 SYSTEM_CONSTANT "FACTOR_100" "100"
 SYSTEM_CONSTANT "FACTOR_ONE" "1"
 SYSTEM_CONSTANT "FACT_20000_RES" "5e-005"
 SYSTEM_CONSTANT "FACT_20000_RES_REV" "20000"
 SYSTEM_CONSTANT "FACT_2PWR11_EXP" "11"
 SYSTEM_CONSTANT "FACT_2PWR11_RES" "0.00048828125"
 SYSTEM_CONSTANT "FACT_2PWR11_RES_REV" "2048"
 SYSTEM_CONSTANT "FACT_NRM_EXP" "13"
 SYSTEM_CONSTANT "FACT_NRM_EXP_LESS" "6"
 SYSTEM_CONSTANT "FACT_NRM_EXP_LOW" "10"
 SYSTEM_CONSTANT "FACT_OIL_VOLSNGLDIFF" "32000"
 SYSTEM_CONSTANT "FACT_ONE" "1"
 SYSTEM_CONSTANT "FACT_PRC_RES_REV" "100"
 SYSTEM_CONSTANT "FACT_PRES_HPA_BAR" "1000"
 SYSTEM_CONSTANT "FACT_RES" "0.0001220703125"
 SYSTEM_CONSTANT "FACT_RES_HIGH1" "0.0001"
 SYSTEM_CONSTANT "FACT_RES_LESS" "0.015625"
 SYSTEM_CONSTANT "FACT_RES_LOW" "0.0009765625"
 SYSTEM_CONSTANT "FACT_RES_LOW1" "0.0009765625"
 SYSTEM_CONSTANT "FACT_RES_REV" "8192"
 SYSTEM_CONSTANT "FACT_RES_REV_HIGH" "10000"
 SYSTEM_CONSTANT "FACT_RES_REV_LESS" "64"
 SYSTEM_CONSTANT "FACT_RES_REV_LOW" "1024"
 SYSTEM_CONSTANT "FACT_RTRQ_CAN_RES_REV" "3212.550144"
 SYSTEM_CONSTANT "FACT_TEMP" "-2731.4"
 SYSTEM_CONSTANT "FACT_TEMP1" "-27314"
 SYSTEM_CONSTANT "FACT_TIME2RMPTRQ" "6553.6"
 SYSTEM_CONSTANT "FACT_ZERO" "0"
 SYSTEM_CONSTANT "FAC_AG_CRS_HI_RESO" "128"
 SYSTEM_CONSTANT "FAC_DERIVATIVE" "500000"
 SYSTEM_CONSTANT "FAC_PLAUS" "16"
 SYSTEM_CONSTANT "FAC_T_INC_PER_DUR_HI_RESO" "256"
 SYSTEM_CONSTANT "FAC_USEC_TO_RPM" "60000000"
 SYSTEM_CONSTANT "FAC_WEARSOTIDX_RES" "2e-008"
 SYSTEM_CONSTANT "FAC_WEARSOTIDX_RES_REV" "50000000"
 SYSTEM_CONSTANT "FAC_WEARSOTIDX_ZERO" "0"
 SYSTEM_CONSTANT "FAC_WEARSOT_RES" "0.1"
 SYSTEM_CONSTANT "FADC_ADDL1_REGVAL" "0"
 SYSTEM_CONSTANT "FADC_ADDL2_REGVAL" "1"
 SYSTEM_CONSTANT "FADC_ADDL3_REGVAL" "2"
 SYSTEM_CONSTANT "FADC_ADDL4_REGVAL" "3"
 SYSTEM_CONSTANT "FADC_ADDL5_REGVAL" "4"
 SYSTEM_CONSTANT "FADC_ADDL6_REGVAL" "5"
 SYSTEM_CONSTANT "FADC_ADDL7_REGVAL" "6"
 SYSTEM_CONSTANT "FADC_ADDL8_REGVAL" "7"
 SYSTEM_CONSTANT "FADC_GN1_REGVAL" "0"
 SYSTEM_CONSTANT "FADC_GN2_REGVAL" "1"
 SYSTEM_CONSTANT "FADC_GN4_REGVAL" "2"
 SYSTEM_CONSTANT "FADC_GN8_REGVAL" "3"
 SYSTEM_CONSTANT "FADC_MAVL1_REGVAL" "0"
 SYSTEM_CONSTANT "FADC_MAVL2_REGVAL" "1"
 SYSTEM_CONSTANT "FADC_MAVL3_REGVAL" "2"
 SYSTEM_CONSTANT "FADC_MAVL4_REGVAL" "3"
 SYSTEM_CONSTANT "FANCTL_FACCORSPD2_MAPX" "5"
 SYSTEM_CONSTANT "FANCTL_FACCORSPD2_MAPY" "4"
 SYSTEM_CONSTANT "FANCTL_FACCORSPD_MAPX" "5"
 SYSTEM_CONSTANT "FANCTL_FACCORSPD_MAPY" "4"
 SYSTEM_CONSTANT "FANCTL_HOTLMP" "0"
 SYSTEM_CONSTANT "FANCTL_HOTLMPWRN" "1"
 SYSTEM_CONSTANT "FANCTL_NSPDDES2_MAPX" "4"
 SYSTEM_CONSTANT "FANCTL_NSPDDES2_MAPY" "4"
 SYSTEM_CONSTANT "FANCTL_NSPDDES_MAPX" "4"
 SYSTEM_CONSTANT "FANCTL_NSPDDES_MAPY" "4"
 SYSTEM_CONSTANT "FANCTL_OXICAT_SY" "0"
 SYSTEM_CONSTANT "FANCTL_SPD_DISBL" "0"
 SYSTEM_CONSTANT "FANCTL_SPD_ENBL" "1"
 SYSTEM_CONSTANT "FANCTL_STAR1" "3"
 SYSTEM_CONSTANT "FANCTL_STNORMAL" "2"
 SYSTEM_CONSTANT "FANCTL_STOFF" "0"
 SYSTEM_CONSTANT "FANCTL_STSTRT" "1"
 SYSTEM_CONSTANT "FANCTL_VARDET_SY" "0"
 SYSTEM_CONSTANT "FANS_ADDCLGDEM_DISBL" "0"
 SYSTEM_CONSTANT "FANS_ADDCLGDEM_ENBL" "1"
 SYSTEM_CONSTANT "FANS_FACVELCOR_CURX" "4"
 SYSTEM_CONSTANT "FANS_SWTAUTODETIO_DISBL" "0"
 SYSTEM_CONSTANT "FANS_SWTAUTODETIO_ENBL" "1"
 SYSTEM_CONSTANT "FAN_ATSINTVMOD_SY" "0"
 SYSTEM_CONSTANT "FAN_NUMDIGOUT_SY" "1"
 SYSTEM_CONSTANT "FAN_NUMPWMOUT_SY" "0"
 SYSTEM_CONSTANT "FCOCMF_SY" "0"
 SYSTEM_CONSTANT "FCONTHRES_SY" "0"
 SYSTEM_CONSTANT "FEA_ETS_MSG" "1"
 SYSTEM_CONSTANT "FEA_SY_CCP" "1"
 SYSTEM_CONSTANT "FEA_SY_ISO14229" "1"
 SYSTEM_CONSTANT "FEA_SY_MX17" "1"
 SYSTEM_CONSTANT "FID_PFLTRGNSHUTOFF" "12"
 SYSTEM_CONSTANT "FL2ASH_EXP" "16"
 SYSTEM_CONSTANT "FLASH_CONFIG_SY" "53"
 SYSTEM_CONSTANT "FLCONS2_RES" "1"
 SYSTEM_CONSTANT "FLCONS2_RES_HIGH" "0.05"
 SYSTEM_CONSTANT "FLCONS2_RES_REV" "1"
 SYSTEM_CONSTANT "FLCONS3_RES" "2.77777777777778e-006"
 SYSTEM_CONSTANT "FLCONS3_RES_REV" "360000"
 SYSTEM_CONSTANT "FLCONS_L_RES" "0.001"
 SYSTEM_CONSTANT "FLCPMPPRES_SY" "0"
 SYSTEM_CONSTANT "FLMNG_R_STOICH" "14.5"
 SYSTEM_CONSTANT "FLSYS_RUNDRYPRV_SY" "0"
 SYSTEM_CONSTANT "FLT_IALCK_SY" "1"
 SYSTEM_CONSTANT "FLT_IARLS_SY" "1"
 SYSTEM_CONSTANT "FLVOL_RES" "0.05"
 SYSTEM_CONSTANT "FLXR_SY" "0"
 SYSTEM_CONSTANT "FL_L_MIN" "0"
 SYSTEM_CONSTANT "FL_L_RES" "0.01"
 SYSTEM_CONSTANT "FL_L_RES_INV" "100"
 SYSTEM_CONSTANT "FPCMSLSU_SC" "0"
 SYSTEM_CONSTANT "FPCTS_SY" "0"
 SYSTEM_CONSTANT "FRICCOEFF_RES" "0.0001"
 SYSTEM_CONSTANT "FRICCOEFF_RES_REV" "10000"
 SYSTEM_CONSTANT "FRICTION_RES" "1"
 SYSTEM_CONSTANT "FRICTION_RES_REV" "1"
 SYSTEM_CONSTANT "FRICTION_ZERO" "0"
 SYSTEM_CONSTANT "FSNW_SY" "0"
 SYSTEM_CONSTANT "FUELT_FTS_NONE" "0"
 SYSTEM_CONSTANT "FUELT_TEMP_CTS" "1"
 SYSTEM_CONSTANT "FUELT_TEMP_DFL" "2"
 SYSTEM_CONSTANT "FUELT_TEMP_FTS" "0"
 SYSTEM_CONSTANT "FUEVAPOIL_SC" "0"
 SYSTEM_CONSTANT "FULCOMP_SY" "0"
 SYSTEM_CONSTANT "GBXCSC_SY" "0"
 SYSTEM_CONSTANT "GBXNPOS_SY" "0"
 SYSTEM_CONSTANT "GBXPRTVAR_SY" "0"
 SYSTEM_CONSTANT "GBXPTPS_SY" "0"
 SYSTEM_CONSTANT "GBXSPD_CLTHPRT_SY" "0"
 SYSTEM_CONSTANT "GDI_SY" "0"
 SYSTEM_CONSTANT "GEAR0" "0"
 SYSTEM_CONSTANT "GEAR1" "1"
 SYSTEM_CONSTANT "GEAR2" "2"
 SYSTEM_CONSTANT "GEAR3" "3"
 SYSTEM_CONSTANT "GEAR4" "4"
 SYSTEM_CONSTANT "GEAR5" "5"
 SYSTEM_CONSTANT "GEAR6" "6"
 SYSTEM_CONSTANT "GEAR7" "7"
 SYSTEM_CONSTANT "GEAR8" "8"
 SYSTEM_CONSTANT "GEAR9" "9"
 SYSTEM_CONSTANT "GEARBX_TYPE_MT" "0"
 SYSTEM_CONSTANT "GLBDA_NUMTRIPRCRDMAX_SY" "0"
 SYSTEM_CONSTANT "GLBDA_NUMTRIPRCRDMIN_SY" "0"
 SYSTEM_CONSTANT "GLBDA_STTRQDEM_ACCPED_BP" "8"
 SYSTEM_CONSTANT "GLBDA_STTRQDEM_ACCPED_MSK" "256"
 SYSTEM_CONSTANT "GLBDA_STTRQDEM_CRCTL_BP" "7"
 SYSTEM_CONSTANT "GLBDA_STTRQDEM_CRCTL_MSK" "128"
 SYSTEM_CONSTANT "GLBDA_STTRQDEM_DCS_BP" "5"
 SYSTEM_CONSTANT "GLBDA_STTRQDEM_DCS_MSK" "32"
 SYSTEM_CONSTANT "GLBDA_STTRQDEM_LLIM_BP" "6"
 SYSTEM_CONSTANT "GLBDA_STTRQDEM_LLIM_MSK" "64"
 SYSTEM_CONSTANT "GLBDA_STTRQDEM_NODEM_BP" "10"
 SYSTEM_CONSTANT "GLBDA_STTRQDEM_NODEM_MSK" "1024"
 SYSTEM_CONSTANT "GLBDA_STTRQDEM_SPDGOV_BP" "9"
 SYSTEM_CONSTANT "GLBDA_STTRQDEM_SPDGOV_MSK" "512"
 SYSTEM_CONSTANT "GLBDA_STTRQDEM_TCS_BP" "4"
 SYSTEM_CONSTANT "GLBDA_STTRQDEM_TCS_MSK" "16"
 SYSTEM_CONSTANT "GLBDA_STTRQDEM_TRADEC_BP" "2"
 SYSTEM_CONSTANT "GLBDA_STTRQDEM_TRADEC_MSK" "4"
 SYSTEM_CONSTANT "GLBDA_STTRQDEM_TRAINC_BP" "1"
 SYSTEM_CONSTANT "GLBDA_STTRQDEM_TRAINC_MSK" "2"
 SYSTEM_CONSTANT "GLBDA_STTRQDEM_TRAPRT_BP" "0"
 SYSTEM_CONSTANT "GLBDA_STTRQDEM_TRAPRT_MSK" "1"
 SYSTEM_CONSTANT "GLBDA_STTRQDEM_VMLIM_BP" "3"
 SYSTEM_CONSTANT "GLBDA_STTRQDEM_VMLIM_MSK" "8"
 SYSTEM_CONSTANT "GLBDA_TRQDEM_COVEH_BP" "2"
 SYSTEM_CONSTANT "GLBDA_TRQDEM_PT_BP" "1"
 SYSTEM_CONSTANT "GLBDA_TRQDEM_VEHMOT_BP" "0"
 SYSTEM_CONSTANT "GLWECU_GCU4_LIN_SY" "0"
 SYSTEM_CONSTANT "GPTA_CLC0_NS_RES" "50"
 SYSTEM_CONSTANT "GPTA_CLC6_NS_RES" "400"
 SYSTEM_CONSTANT "GRADTRQ_RES" "1"
 SYSTEM_CONSTANT "GRADTRQ_RES_REV" "1"
 SYSTEM_CONSTANT "GRADTRQ_ZERO" "0"
 SYSTEM_CONSTANT "GSH_INTVENG_SY" "0"
 SYSTEM_CONSTANT "GSSYS_TYPEEXHFLW_SY" "1"
 SYSTEM_CONSTANT "GSSYS_TYPINDVOL_SY" "0"
 SYSTEM_CONSTANT "H2CORS2_SY" "0"
 SYSTEM_CONSTANT "H2CORS3_SY" "0"
 SYSTEM_CONSTANT "HCI_INJ_MASS_MIN" "0"
 SYSTEM_CONSTANT "HCI_INJ_MASS_PER_SEC_RES" "0.1"
 SYSTEM_CONSTANT "HCI_INJ_MASS_PER_SEC_RES_REV" "10"
 SYSTEM_CONSTANT "HCI_INJ_MASS_RES" "0.01"
 SYSTEM_CONSTANT "HCI_INJ_MASS_RES_REV" "100"
 SYSTEM_CONSTANT "HCI_RES_DQPERSEC" "1000"
 SYSTEM_CONSTANT "HCI_RES_QPERMICROSEC" "50000"
 SYSTEM_CONSTANT "HDC_SY" "0"
 SYSTEM_CONSTANT "HEATCAPA_FINE_RES" "0.0001"
 SYSTEM_CONSTANT "HEGNS3B1_SC" "0"
 SYSTEM_CONSTANT "HEGODDYNSIMN_SY" "1"
 SYSTEM_CONSTANT "HEGODDYNUS_SY" "0"
 SYSTEM_CONSTANT "HEGODSYMCTLUS_SY" "0"
 SYSTEM_CONSTANT "HEGOFUELCOR_SY" "0"
 SYSTEM_CONSTANT "HEGOS1B1PSID_SY" "0"
 SYSTEM_CONSTANT "HEGOS1B1_SY" "1"
 SYSTEM_CONSTANT "HEGOS1B2_SY" "0"
 SYSTEM_CONSTANT "HEGOS1FET_SY" "0"
 SYSTEM_CONSTANT "HEGOS2B1PSID_SY" "1"
 SYSTEM_CONSTANT "HEGOS2B1_SY" "0"
 SYSTEM_CONSTANT "HEGOS2B2_SY" "0"
 SYSTEM_CONSTANT "HEGOS2FET_SY" "0"
 SYSTEM_CONSTANT "HEGOS3B1_SY" "0"
 SYSTEM_CONSTANT "HEGOS3B2_SY" "0"
 SYSTEM_CONSTANT "HEGOS3FET_SY" "0"
 SYSTEM_CONSTANT "HEM_SY" "0"
 SYSTEM_CONSTANT "HESRV_HETYP_SY" "255"
 SYSTEM_CONSTANT "HESRV_MASTER" "0"
 SYSTEM_CONSTANT "HESRV_MASTERSLAVE" "1"
 SYSTEM_CONSTANT "HESRV_ONEBOX" "255"
 SYSTEM_CONSTANT "HESRV_SLAVE" "1"
 SYSTEM_CONSTANT "HEVTYP_PARL" "4"
 SYSTEM_CONSTANT "HEVTYP_PWRSPLT" "3"
 SYSTEM_CONSTANT "HEVTYP_SER" "1"
 SYSTEM_CONSTANT "HEVTYP_SERPARL" "2"
 SYSTEM_CONSTANT "HEVTYP_SY" "0"
 SYSTEM_CONSTANT "HIRES_INJTIME_US" "3"
 SYSTEM_CONSTANT "HLN_SY" "0"
 SYSTEM_CONSTANT "HLSDEMERR1_SY" "0"
 SYSTEM_CONSTANT "HLSDEMERR2_SY" "0"
 SYSTEM_CONSTANT "HLSDEM_DPWRINT_MAP_X" "3"
 SYSTEM_CONSTANT "HLSDEM_DPWRINT_MAP_Y" "3"
 SYSTEM_CONSTANT "HLSDEM_FACAIROVHTPRV_MAP_X" "3"
 SYSTEM_CONSTANT "HLSDEM_FACAIROVHTPRV_MAP_Y" "3"
 SYSTEM_CONSTANT "HLSDEM_FACCTOVHTPRVMAX_MAP_X" "8"
 SYSTEM_CONSTANT "HLSDEM_FACCTOVHTPRVMAX_MAP_Y" "8"
 SYSTEM_CONSTANT "HLSDEM_FACFLTEMPLIMMAX_MAP_X" "8"
 SYSTEM_CONSTANT "HLSDEM_FACFLTEMPLIMMAX_MAP_Y" "8"
 SYSTEM_CONSTANT "HLSDEM_FACOILOVHTPRVMAX_MAP_X" "8"
 SYSTEM_CONSTANT "HLSDEM_FACOILOVHTPRVMAX_MAP_Y" "8"
 SYSTEM_CONSTANT "HLSDEM_FACPWRINT_CUR_X" "3"
 SYSTEM_CONSTANT "HLSDEM_FACTRBNOVHTPRV_MAP_X" "3"
 SYSTEM_CONSTANT "HLSDEM_FACTRBNOVHTPRV_MAP_Y" "3"
 SYSTEM_CONSTANT "HLSDEM_GEARLIM_SY" "0"
 SYSTEM_CONSTANT "HLSDEM_NCORRFAC" "7"
 SYSTEM_CONSTANT "HLSDEM_NENGMAXDSPL_MAP_X" "3"
 SYSTEM_CONSTANT "HLSDEM_NENGMAXDSPL_MAP_Y" "3"
 SYSTEM_CONSTANT "HLSDEM_NENGMAX_MAP_X" "8"
 SYSTEM_CONSTANT "HLSDEM_NENGMAX_MAP_Y" "8"
 SYSTEM_CONSTANT "HLSDEM_NHIALTDCORDSPL_CUR_X" "3"
 SYSTEM_CONSTANT "HLSDEM_NMAXENGDSPLDFL_CUR_X" "3"
 SYSTEM_CONSTANT "HLSDEM_NMAXENGSTRESS_CUR_X" "3"
 SYSTEM_CONSTANT "HLSDEM_NMAXHILNCHCTL_CUR_X" "3"
 SYSTEM_CONSTANT "HLSDEM_NMAXHISPRT_CUR_X" "3"
 SYSTEM_CONSTANT "HLSDEM_NMAXHITIPP_CUR_X" "3"
 SYSTEM_CONSTANT "HLSDEM_NMAXHI_CUR_X" "3"
 SYSTEM_CONSTANT "HLSDEM_NMAXOILT_MAP_X" "3"
 SYSTEM_CONSTANT "HLSDEM_NMAXOILT_MAP_Y" "3"
 SYSTEM_CONSTANT "HLSDEM_NMAXSTDSPRT_CUR_X" "3"
 SYSTEM_CONSTANT "HLSDEM_NMAXSTDTIPP_CUR_X" "3"
 SYSTEM_CONSTANT "HLSDEM_NMAXSTD_CUR_X" "3"
 SYSTEM_CONSTANT "HLSDEM_NMAXTENG_CUR_X" "3"
 SYSTEM_CONSTANT "HLSDEM_NMINWOTRAINTV_SY" "0"
 SYSTEM_CONSTANT "HLSDEM_NRGNPFLT_POINTS_CUR_X" "2"
 SYSTEM_CONSTANT "HLSDEM_STSETPFLT_PT1" "2"
 SYSTEM_CONSTANT "HLSDEM_STSETPFLT_RMP" "0"
 SYSTEM_CONSTANT "HLSDEM_STSETPFLT_STP" "3"
 SYSTEM_CONSTANT "HLSDEM_STSETPFLT_TIPIN" "1"
 SYSTEM_CONSTANT "HLSDEM_TIMAXNMAXHI_CUR_X" "3"
 SYSTEM_CONSTANT "HOUR_TO_SEC" "3600"
 SYSTEM_CONSTANT "HTGTSTRS1_SY" "0"
 SYSTEM_CONSTANT "HTGTSTRS2_SY" "0"
 SYSTEM_CONSTANT "HTGTSTRS3_SY" "0"
 SYSTEM_CONSTANT "HVDDC_ERRSHTOFF" "0"
 SYSTEM_CONSTANT "HVDDC_ERRVLTG" "1"
 SYSTEM_CONSTANT "HWANDCAN_SEL" "0"
 SYSTEM_CONSTANT "HW_SEL" "2"
 SYSTEM_CONSTANT "I14229_RDTCSEVERITY_SY" "0"
 SYSTEM_CONSTANT "I15031APPL_NUMSIZETEXHFLD_SY" "0"
 SYSTEM_CONSTANT "I15031_CUSVAR_SY" "0"
 SYSTEM_CONSTANT "I15031_OBD_CNTL_SC" "0"
 SYSTEM_CONSTANT "I15031_PID_RANGE_ARRAY_SIZE" "8"
 SYSTEM_CONSTANT "I15031_SRV8_SY" "0"
 SYSTEM_CONSTANT "I15031_SWTCODEXHVAR_ARRAY_SIZE" "8"
 SYSTEM_CONSTANT "I2CEMU_SY" "0"
 SYSTEM_CONSTANT "IGNARCDURMONI_SY" "0"
 SYSTEM_CONSTANT "IGNARC_NUMTIM_SY" "1"
 SYSTEM_CONSTANT "IGNCLPS_STADIAENBL_SY" "1"
 SYSTEM_CONSTANT "IGNCL_CLCRNTMON_SY" "0"
 SYSTEM_CONSTANT "IGNCL_INTCALCNXTCHL_SC" "0"
 SYSTEM_CONSTANT "IGNCL_QAG_SY" "1"
 SYSTEM_CONSTANT "IGNINCIR_SY" "0"
 SYSTEM_CONSTANT "IGNMDLRRI_SC" "0"
 SYSTEM_CONSTANT "IMAISA_ACTIVE" "0"
 SYSTEM_CONSTANT "INJSYS_FUCNSHWPIN_SC" "0"
 SYSTEM_CONSTANT "INJSYS_INJCRVSHOFFTST_SY" "0"
 SYSTEM_CONSTANT "INJSYS_INJMODCOR_SY" "0"
 SYSTEM_CONSTANT "INJSYS_IVPLAUSCOMPRTST_SY" "0"
 SYSTEM_CONSTANT "INJSYS_IVPLAUSCYLFBCTST_SY" "0"
 SYSTEM_CONSTANT "INJSYS_IVPLAUSRUNUPTST_SY" "0"
 SYSTEM_CONSTANT "INJSYS_MEUNACTRTST_SY" "0"
 SYSTEM_CONSTANT "INJSYS_PCVACTRTST_SY" "0"
 SYSTEM_CONSTANT "INJSYS_RAILHIPRESTST_SY" "0"
 SYSTEM_CONSTANT "INJVLVPS_DIASMALLTI_SY" "0"
 SYSTEM_CONSTANT "INJVLV_ATS_SY" "0"
 SYSTEM_CONSTANT "INJVLV_FSTRCVAFTFCO_SY" "0"
 SYSTEM_CONSTANT "INJVLV_IVLD_SY" "0"
 SYSTEM_CONSTANT "INJ_MASS_2_INJ_MASS_PT" "100000"
 SYSTEM_CONSTANT "INJ_MASS_HCI_RES" "0.1"
 SYSTEM_CONSTANT "INJ_MASS_HCI_RES_REV" "10"
 SYSTEM_CONSTANT "INJ_MASS_PT_RES" "0.1"
 SYSTEM_CONSTANT "INJ_MASS_PT_RES_REV" "10"
 SYSTEM_CONSTANT "INJ_MASS_RES" "0.01"
 SYSTEM_CONSTANT "INRTTRQ_EXP" "10"
 SYSTEM_CONSTANT "INRTTRQ_RES" "0.0009765625"
 SYSTEM_CONSTANT "INRTTRQ_RES_REV" "1024"
 SYSTEM_CONSTANT "INTERLOCK_CAN_SY" "0"
 SYSTEM_CONSTANT "IUMPR_SY" "0"
 SYSTEM_CONSTANT "IUMPR_VERS_SY" "0"
 SYSTEM_CONSTANT "KDINJMASS32TO15_FACT" "6"
 SYSTEM_CONSTANT "KD_1_MAX" "50"
 SYSTEM_CONSTANT "KD_1_NRM" "7"
 SYSTEM_CONSTANT "KD_AST_RES_REV" "6553"
 SYSTEM_CONSTANT "KD_LIN_16_RES" "32767"
 SYSTEM_CONSTANT "KD_RES16_REV" "1024"
 SYSTEM_CONSTANT "KD_RES_LOW_REV" "256"
 SYSTEM_CONSTANT "KD_RES_REV" "65536"
 SYSTEM_CONSTANT "KD_RPM2NM_2_NRM" "4"
 SYSTEM_CONSTANT "KFACT_MAX" "1"
 SYSTEM_CONSTANT "KFACT_MIN" "0"
 SYSTEM_CONSTANT "KG_TO_G" "1000"
 SYSTEM_CONSTANT "KG_TO_MG" "1000000"
 SYSTEM_CONSTANT "KIAMPC32TO15_FACT" "3"
 SYSTEM_CONSTANT "KI_1_MAX" "250"
 SYSTEM_CONSTANT "KI_1_NRM" "5"
 SYSTEM_CONSTANT "KI_BPA1_RES_REV" "1"
 SYSTEM_CONSTANT "KI_BPA_RES_REV" "65"
 SYSTEM_CONSTANT "KI_RES_REV" "2147.483648"
 SYSTEM_CONSTANT "KI_RPM2NM_2_NRM" "4"
 SYSTEM_CONSTANT "KL87DIAG_SY" "0"
 SYSTEM_CONSTANT "KnSigPrep_SY" "0"
 SYSTEM_CONSTANT "KPAMPC32TO15_FACT" "8"
 SYSTEM_CONSTANT "KP_1_MAX" "300"
 SYSTEM_CONSTANT "KP_1_NRM" "9"
 SYSTEM_CONSTANT "KP_ACC_RES_REV" "8192"
 SYSTEM_CONSTANT "KP_RES_LOW_REV" "128"
 SYSTEM_CONSTANT "KP_RES_REV" "32768"
 SYSTEM_CONSTANT "KP_RPM2NM_2_NRM" "5"
 SYSTEM_CONSTANT "KRREG_SY" "1"
 SYSTEM_CONSTANT "L9929_SY" "0"
 SYSTEM_CONSTANT "LAMBDAREC_RES" "0.0001"
 SYSTEM_CONSTANT "LAMBDAREC_RES_REV" "10000"
 SYSTEM_CONSTANT "LAMBDAREC_ZERO" "0"
 SYSTEM_CONSTANT "LAMBDA_RES" "0.001"
 SYSTEM_CONSTANT "LAMBDA_RES2LAMBDAREC_RES" "10"
 SYSTEM_CONSTANT "LAMBDA_RES_REV" "1000"
 SYSTEM_CONSTANT "LAMBTS_SY" "1"
 SYSTEM_CONSTANT "LAMCTLAGSYN_SY" "0"
 SYSTEM_CONSTANT "LAMDGNSCMPNPROTNACTV_SC" "0"
 SYSTEM_CONSTANT "LASP_SY" "0"
 SYSTEM_CONSTANT "LAS_ASHFT_MIN" "0"
 SYSTEM_CONSTANT "LAS_CT_ASHFT" "10"
 SYSTEM_CONSTANT "LENGTHKM1_RES" "1"
 SYSTEM_CONSTANT "LENGTH_KM_ZERO" "0"
 SYSTEM_CONSTANT "LENGTH_LOWRES_KM" "10"
 SYSTEM_CONSTANT "LENGTH_MM_RES" "1"
 SYSTEM_CONSTANT "LENGTH_MM_RES_REV" "1"
 SYSTEM_CONSTANT "LENGTH_RES" "1"
 SYSTEM_CONSTANT "LENGTH_RES_FINE" "0.001"
 SYSTEM_CONSTANT "LENGTH_RES_FINE_REV" "1000"
 SYSTEM_CONSTANT "LENGTH_RES_INV" "1"
 SYSTEM_CONSTANT "LENGTH_RES_KM" "1"
 SYSTEM_CONSTANT "LENGTH_RES_REV" "1"
 SYSTEM_CONSTANT "LENGTH_RES_REV_KM" "1"
 SYSTEM_CONSTANT "LENGTH_ZERO" "0"
 SYSTEM_CONSTANT "LIGOV_CHGEAR_SY" "0"
 SYSTEM_CONSTANT "LIGOV_CHSTRT_SY" "0"
 SYSTEM_CONSTANT "LIGOV_HDC_SY" "0"
 SYSTEM_CONSTANT "LIGOV_INCTRQMAXCH_SY" "0"
 SYSTEM_CONSTANT "LIGOV_NUMIPAR_SY" "3"
 SYSTEM_CONSTANT "LIGOV_NUMPPAR_SY" "0"
 SYSTEM_CONSTANT "LIGOV_PRECTLD_SY" "0"
 SYSTEM_CONSTANT "LIGOV_SEPPRECTL_SY" "0"
 SYSTEM_CONSTANT "LIMENGTEMP_SY" "0"
 SYSTEM_CONSTANT "LIMEXHTEMP_SY" "0"
 SYSTEM_CONSTANT "LIN_SY" "0"
 SYSTEM_CONSTANT "LLIM_SPDLIMEEP_SY" "0"
 SYSTEM_CONSTANT "LLIM_SPDLIM_SY" "0"
 SYSTEM_CONSTANT "LLKE_SY" "0"
 SYSTEM_CONSTANT "LLRNSNF_FZNSMGASIZE_SY" "6"
 SYSTEM_CONSTANT "LORNGTYP_SY" "0"
 SYSTEM_CONSTANT "LORNG_SY" "0"
 SYSTEM_CONSTANT "LOTEMPEGR_SY" "0"
 SYSTEM_CONSTANT "LRFSSV06_SY" "1"
 SYSTEM_CONSTANT "LRSSSV06_SY" "1"
 SYSTEM_CONSTANT "LRTSSV06_SY" "1"
 SYSTEM_CONSTANT "LSFX4_SY" "1"
 SYSTEM_CONSTANT "LSM_SY" "0"
 SYSTEM_CONSTANT "LSUADV_SY" "0"
 SYSTEM_CONSTANT "LSUDYNMONINTR_SY" "0"
 SYSTEM_CONSTANT "LSU_CT_SENSORS" "0"
 SYSTEM_CONSTANT "LSU_CT_SENSORS_SY" "0"
 SYSTEM_CONSTANT "LVL_SY" "0"
 SYSTEM_CONSTANT "MAF_SY" "0"
 SYSTEM_CONSTANT "MAP_SY" "1"
 SYSTEM_CONSTANT "MASSLENGTH_RES" "0.2"
 SYSTEM_CONSTANT "MASS_RES" "1"
 SYSTEM_CONSTANT "MASS_RES_REV" "1"
 SYSTEM_CONSTANT "MAXRNGREQVEHOFF" "0"
 SYSTEM_CONSTANT "MAXRNGREQVEHON" "1"
 SYSTEM_CONSTANT "MAXRNGREQVEH_SY" "0"
 SYSTEM_CONSTANT "MAXSINT16" "32767"
 SYSTEM_CONSTANT "MAXSINT32" "2147483647"
 SYSTEM_CONSTANT "MAXSINT8" "127"
 SYSTEM_CONSTANT "MAXUINT16" "65535"
 SYSTEM_CONSTANT "MAXUINT32" "4294967295"
 SYSTEM_CONSTANT "MAXUINT8" "255"
 SYSTEM_CONSTANT "MAX_MAP" "6"
 SYSTEM_CONSTANT "MCTPMP_SY" "0"
 SYSTEM_CONSTANT "MGPERHUBSEC_RES" "0.1"
 SYSTEM_CONSTANT "MG_TO_G" "1000"
 SYSTEM_CONSTANT "MILLMP_PWRSTG_SY" "1"
 SYSTEM_CONSTANT "MILLMP_SUPRT_ATS_SY" "0"
 SYSTEM_CONSTANT "MINSINT16" "-32768"
 SYSTEM_CONSTANT "MINSINT32" "-2147483648"
 SYSTEM_CONSTANT "MINSINT8" "-128"
 SYSTEM_CONSTANT "MINUS_ONE" "-1"
 SYSTEM_CONSTANT "MIXADPNACTVPSETI_SC" "0"
 SYSTEM_CONSTANT "MIXADPNLOADHI_SC" "0"
 SYSTEM_CONSTANT "MIXADPNSPDVBL_SC" "0"
 SYSTEM_CONSTANT "MMSBKVSR_SY" "0"
 SYSTEM_CONSTANT "MNA_SY" "0"
 SYSTEM_CONSTANT "MOFEXTINT_DCSPTD_BP" "0"
 SYSTEM_CONSTANT "MOMENT_INERTIA_RES" "100"
 SYSTEM_CONSTANT "MO_INJCTOFFPTINACTV_SY" "0"
 SYSTEM_CONSTANT "MPA_TO_BAR" "10"
 SYSTEM_CONSTANT "MRLY_DIAG_ELEC_SY" "0"
 SYSTEM_CONSTANT "MRLY_DIAG_MECH_SY" "0"
 SYSTEM_CONSTANT "MSAPP1_SY" "0"
 SYSTEM_CONSTANT "MSAPP2_SY" "0"
 SYSTEM_CONSTANT "MSI_SY" "0"
 SYSTEM_CONSTANT "MSI_TMPR_SY" "0"
 SYSTEM_CONSTANT "MSTSHFT_SY" "0"
 SYSTEM_CONSTANT "MUL_INJTIME_US" "5"
 SYSTEM_CONSTANT "M_ASH_MAX" "300"
 SYSTEM_CONSTANT "M_ASH_RES" "1.52587890625e-007"
 SYSTEM_CONSTANT "M_ASH_RES1" "0.1"
 SYSTEM_CONSTANT "M_ASH_RES1_REV" "10"
 SYSTEM_CONSTANT "M_ASH_RES_REV" "6553600"
 SYSTEM_CONSTANT "NBUF_TNVKVHK_BGLAMABM" "26"
 SYSTEM_CONSTANT "NENGIND_ENA_SY" "0"
 SYSTEM_CONSTANT "NEUTVAL_S16" "-32768"
 SYSTEM_CONSTANT "NEUTVAL_S32" "-2147483648"
 SYSTEM_CONSTANT "NEUTVAL_S8" "-128"
 SYSTEM_CONSTANT "NEUTVAL_U16" "65534"
 SYSTEM_CONSTANT "NEUTVAL_U32" "4294967294"
 SYSTEM_CONSTANT "NEUTVAL_U8" "254"
 SYSTEM_CONSTANT "NMAXDSPL_SY" "0"
 SYSTEM_CONSTANT "NMHIGH_SY" "0"
 SYSTEM_CONSTANT "NMPERSEC_RES" "0.1"
 SYSTEM_CONSTANT "NMTYP_DNM" "2"
 SYSTEM_CONSTANT "NMTYP_INM" "1"
 SYSTEM_CONSTANT "NMTYP_NMCANWKUP" "4"
 SYSTEM_CONSTANT "NMTYP_NMDISBL" "0"
 SYSTEM_CONSTANT "NMTYP_NMHIGH" "3"
 SYSTEM_CONSTANT "NMTYP_SY" "0"
 SYSTEM_CONSTANT "NOMIDLSPD_ATS_SY" "0"
 SYSTEM_CONSTANT "NORM_ACC2FRIC" "10000"
 SYSTEM_CONSTANT "NORM_ACC2FRIC_ACCI" "1000"
 SYSTEM_CONSTANT "NORM_ACC2TRQPRPHIGH" "500"
 SYSTEM_CONSTANT "NORM_CALC_IVIR" "100000"
 SYSTEM_CONSTANT "NORM_CALC_MVMR" "10000"
 SYSTEM_CONSTANT "NORM_DTRQ2TRQPERSEC" "10"
 SYSTEM_CONSTANT "NORM_ENGN2RMPENGN" "3276.8"
 SYSTEM_CONSTANT "NORM_FAC_EQUIV" "10"
 SYSTEM_CONSTANT "NORM_FANSPD2RELFANSPD" "8192"
 SYSTEM_CONSTANT "NORM_INJ_MASS_PER_SEC_TO_INJ_MASS_RES" "100"
 SYSTEM_CONSTANT "NORM_LENGTH2LENGTHFINE" "1000"
 SYSTEM_CONSTANT "NORM_Q_BY_FAC" "8192"
 SYSTEM_CONSTANT "NORM_R_X_R" "100"
 SYSTEM_CONSTANT "NORM_R_X_TRQ" "100"
 SYSTEM_CONSTANT "NORM_SEC_US" "1000000"
 SYSTEM_CONSTANT "NORM_TEMPCONV_FACT" "10"
 SYSTEM_CONSTANT "NORM_TIME_MS_US" "10000"
 SYSTEM_CONSTANT "NORM_TRQ2PRC_CAN" "254.999910750031"
 SYSTEM_CONSTANT "NORM_TRQ2TRQPRP" "1600"
 SYSTEM_CONSTANT "NORM_TRQ2TRQPRPHIGH" "100"
 SYSTEM_CONSTANT "NORM_TRQACS" "1800"
 SYSTEM_CONSTANT "NORM_TRQPRPHIGH2ACC" "500"
 SYSTEM_CONSTANT "NORM_TRQTONSQR" "4000000"
 SYSTEM_CONSTANT "NORM_TRQTORMPTRQTIMEDT" "65536000"
 SYSTEM_CONSTANT "NORM_TRQ_BY_ETA" "1280"
 SYSTEM_CONSTANT "NORM_TRQ_BY_Q" "1280"
 SYSTEM_CONSTANT "NORM_TRQ_BY_R" "100"
 SYSTEM_CONSTANT "NORM_TRQ_INERTIA" "100"
 SYSTEM_CONSTANT "NORM_TRQ_INRT" "500"
 SYSTEM_CONSTANT "NORM_TRQ_X_FAC" "8192"
 SYSTEM_CONSTANT "NORM_VEL_LENGTH2ENGN" "50"
 SYSTEM_CONSTANT "NORM_VXT" "100000"
 SYSTEM_CONSTANT "NORM_VXT_SI" "360000"
 SYSTEM_CONSTANT "NORM_WHL_RADIUS" "200"
 SYSTEM_CONSTANT "NOSTSPSWT_SY" "1"
 SYSTEM_CONSTANT "NOT_AVL" "0"
 SYSTEM_CONSTANT "NOXCAN_SY" "0"
 SYSTEM_CONSTANT "NOXSENS_SY" "0"
 SYSTEM_CONSTANT "NOX_RES" "1"
 SYSTEM_CONSTANT "NOX_RES_REV" "1"
 SYSTEM_CONSTANT "NOX_ZERO" "0"
 SYSTEM_CONSTANT "NO_AC" "0"
 SYSTEM_CONSTANT "NRM_EXPO_AG_CRS_HI_RESO" "7"
 SYSTEM_CONSTANT "NRM_EXPO_T_INC_PER_DUR_HI_RESO" "8"
 SYSTEM_CONSTANT "NRM_EXP_RES_TRIGO_FUNC" "12"
 SYSTEM_CONSTANT "NSC_CT_SENSORS" "0"
 SYSTEM_CONSTANT "NSC_CT_SENSORS_SY" "0"
 SYSTEM_CONSTANT "NUMCASMAX" "1"
 SYSTEM_CONSTANT "NUMCYLACT_SY" "3"
 SYSTEM_CONSTANT "NUMCYLCAL_SY" "0"
 SYSTEM_CONSTANT "NUMCYLMAX_SY" "3"
 SYSTEM_CONSTANT "NUMFANS_SY" "1"
 SYSTEM_CONSTANT "NUM_EXH_SENSORS" "0"
 SYSTEM_CONSTANT "NUM_WAHT_SY" "0"
 SYSTEM_CONSTANT "OBDMINTRP_SY" "0"
 SYSTEM_CONSTANT "OBD_PHYSMEDM_SY" "0"
 SYSTEM_CONSTANT "OBS_SY" "0"
 SYSTEM_CONSTANT "OILLVL_MMQ0P004_RES" "0.004"
 SYSTEM_CONSTANT "OILLVL_MMQ0P004_RESREV" "250"
 SYSTEM_CONSTANT "OILTADC_SY" "0"
 SYSTEM_CONSTANT "OILTPULS_SY" "0"
 SYSTEM_CONSTANT "OIL_STTEMPTIME_INIT_BP" "0"
 SYSTEM_CONSTANT "OIL_STTEMPTIME_NOVALUE_BP" "1"
 SYSTEM_CONSTANT "OVRRUNINHB_PT_SY" "0"
 SYSTEM_CONSTANT "OXSENSDYNADAP_SY" "0"
 SYSTEM_CONSTANT "PART_PROG_SY" "0"
 SYSTEM_CONSTANT "PCA8565_SY" "0"
 SYSTEM_CONSTANT "PCP_SY" "1"
 SYSTEM_CONSTANT "PCSI_SY" "0"
 SYSTEM_CONSTANT "PDIFFEGRSENS_SY" "0"
 SYSTEM_CONSTANT "PERIOD_RES" "100"
 SYSTEM_CONSTANT "PERKM_RES" "1"
 SYSTEM_CONSTANT "PERMSPLYSYS_SY" "0"
 SYSTEM_CONSTANT "PER_CNT_MAX" "1000000"
 SYSTEM_CONSTANT "PER_DUR_RES" "1"
 SYSTEM_CONSTANT "PER_DUR_SHIFT" "256"
 SYSTEM_CONSTANT "PFLTRGN_LMP_BP" "0"
 SYSTEM_CONSTANT "PFLTRGN_TXTMSG_BP" "1"
 SYSTEM_CONSTANT "PFLT_FAST_INTR" "15"
 SYSTEM_CONSTANT "PFLT_INTR_DES" "14"
 SYSTEM_CONSTANT "PFLT_T_ADAPT" "11"
 SYSTEM_CONSTANT "PFLT_T_CLNT" "13"
 SYSTEM_CONSTANT "PFLT_T_MAX" "1000"
 SYSTEM_CONSTANT "PFLT_T_MIN" "-50"
 SYSTEM_CONSTANT "PFLT_VAGTESTER_NOT_WRITING" "0"
 SYSTEM_CONSTANT "PFLT_VAGTESTER_WRITING" "1"
 SYSTEM_CONSTANT "PHASE_DETECT_SY" "0"
 SYSTEM_CONSTANT "PHI_TIME_BY_N" "1831.05468750045"
 SYSTEM_CONSTANT "PI" "3.14159265359"
 SYSTEM_CONSTANT "PINTKVUS_INHOUSE_SY" "0"
 SYSTEM_CONSTANT "PINTVUS_SY" "1"
 SYSTEM_CONSTANT "POSTDRV_SOFTRST_SY" "1"
 SYSTEM_CONSTANT "PRCPERTIME_RES" "0.0001"
 SYSTEM_CONSTANT "PRCPERTIME_RES_REV" "10000"
 SYSTEM_CONSTANT "PRC_100" "100"
 SYSTEM_CONSTANT "PRC_130" "130"
 SYSTEM_CONSTANT "PRC_150" "150"
 SYSTEM_CONSTANT "PRC_50" "50"
 SYSTEM_CONSTANT "PRC_HIGH_RES" "0.001"
 SYSTEM_CONSTANT "PRC_HIGH_RES_REV" "1000"
 SYSTEM_CONSTANT "PRC_HIGH_ZERO" "0"
 SYSTEM_CONSTANT "PRC_NEG_125" "-125"
 SYSTEM_CONSTANT "PRC_Q0P01_RES" "0.01"
 SYSTEM_CONSTANT "PRC_Q0P01_RES_REV" "100"
 SYSTEM_CONSTANT "PRC_Q0P1_RES" "0.1"
 SYSTEM_CONSTANT "PRC_RES" "0.01220703125"
 SYSTEM_CONSTANT "PRC_RES_NRMTSTR" "8192"
 SYSTEM_CONSTANT "PRC_RES_REV" "81.92"
 SYSTEM_CONSTANT "PRC_RES_SINT8" "1.5625"
 SYSTEM_CONSTANT "PRC_ZERO" "0"
 SYSTEM_CONSTANT "PRES_AC_HPA_RES" "2"
 SYSTEM_CONSTANT "PRES_AIR_MAX" "3500"
 SYSTEM_CONSTANT "PRES_AIR_MIN" "0"
 SYSTEM_CONSTANT "PRES_FACT_BAR_2_HPA" "500"
 SYSTEM_CONSTANT "PRES_HPA_2_PRES_HPA_PT" "10000000"
 SYSTEM_CONSTANT "PRES_HPA_NORM" "1013"
 SYSTEM_CONSTANT "PRES_HPA_PT_RES" "0.1"
 SYSTEM_CONSTANT "PRES_HPA_PT_RES_REV" "10"
 SYSTEM_CONSTANT "PRES_HPA_RES" "1"
 SYSTEM_CONSTANT "PRES_HPA_RES_INV" "1"
 SYSTEM_CONSTANT "PRES_HPA_RES_REV" "1"
 SYSTEM_CONSTANT "PRES_HPA_ZERO" "0"
 SYSTEM_CONSTANT "PRES_LORES_RES" "0.01"
 SYSTEM_CONSTANT "PRES_LORES_ZERO" "0"
 SYSTEM_CONSTANT "PRES_RES" "0.1"
 SYSTEM_CONSTANT "PRES_SI_RES" "100"
 SYSTEM_CONSTANT "PRODMODE_SY" "0"
 SYSTEM_CONSTANT "PRTSHFTUPREQ_SY" "0"
 SYSTEM_CONSTANT "PTHRESCUS_SY" "0"
 SYSTEM_CONSTANT "PTLHC_SY" "0"
 SYSTEM_CONSTANT "PTO_SY" "0"
 SYSTEM_CONSTANT "PTPRTOVRDSSPDGOV_SY" "0"
 SYSTEM_CONSTANT "PTPRT_OVRDS_SPDGOV" "1"
 SYSTEM_CONSTANT "PT_GRIP_BP" "0"
 SYSTEM_CONSTANT "PT_SWGRIP_SY" "0"
 SYSTEM_CONSTANT "PWR2_RES" "18.84955592154"
 SYSTEM_CONSTANT "PWRINTENGNLIM_SY" "0"
 SYSTEM_CONSTANT "PWR_J_SEC_RES" "10"
 SYSTEM_CONSTANT "PWR_KW_RES" "0.01"
 SYSTEM_CONSTANT "PWR_KW_RES_INV" "100"
 SYSTEM_CONSTANT "PWR_Q4_MAX" "131068"
 SYSTEM_CONSTANT "PWR_RES" "9.42477796077"
 SYSTEM_CONSTANT "PWR_W_ZERO" "0"
 SYSTEM_CONSTANT "PWR_ZERO" "0"
 SYSTEM_CONSTANT "QNTADJ_IMAISA" "1"
 SYSTEM_CONSTANT "QNTR_EXP" "10"
 SYSTEM_CONSTANT "QNTR_RES" "0.0009765625"
 SYSTEM_CONSTANT "QNTR_RES_REV" "1024"
 SYSTEM_CONSTANT "QNTSTMOT_SY" "0"
 SYSTEM_CONSTANT "R2S2_SY" "0"
 SYSTEM_CONSTANT "RADSHT_SY" "0"
 SYSTEM_CONSTANT "RAIL_MEUN" "1"
 SYSTEM_CONSTANT "RAIL_PCV" "0"
 SYSTEM_CONSTANT "RAMPTIME_SLOPE" "6553.6"
 SYSTEM_CONSTANT "RATAM_RES" "0.01"
 SYSTEM_CONSTANT "RCSSTRT_SY" "0"
 SYSTEM_CONSTANT "RESIST_RES" "0.1"
 SYSTEM_CONSTANT "RESO_T_INC_PER_DUR_TTH_ADAP" "10"
 SYSTEM_CONSTANT "RES_ZERO" "0"
 SYSTEM_CONSTANT "REVCNT_RES" "16"
 SYSTEM_CONSTANT "REVCNT_RES_EXP" "4"
 SYSTEM_CONSTANT "REVGEAR1" "-1"
 SYSTEM_CONSTANT "RLXBF_SC" "0"
 SYSTEM_CONSTANT "RMPTRQ_ZERO" "0"
 SYSTEM_CONSTANT "RMP_INTMIN_DT10" "6554"
 SYSTEM_CONSTANT "RMP_INTMIN_DT100" "656"
 SYSTEM_CONSTANT "RMP_INTMIN_DT20" "3277"
 SYSTEM_CONSTANT "RMP_NRM_EXP" "16"
 SYSTEM_CONSTANT "RMP_NRM_EXP16" "9"
 SYSTEM_CONSTANT "RMP_NRM_FACT" "65536"
 SYSTEM_CONSTANT "RMP_NRM_FACT16" "512"
 SYSTEM_CONSTANT "RMP_RES" "0.0152587890625"
 SYSTEM_CONSTANT "RMP_RES16" "1.953125"
 SYSTEM_CONSTANT "RMP_RES_HLSDEM" "0.00217982700892857"
 SYSTEM_CONSTANT "RMP_RES_INV" "65.536"
 SYSTEM_CONSTANT "RNGMOD_ADAP" "1"
 SYSTEM_CONSTANT "RNGMOD_FRCSURE" "0"
 SYSTEM_CONSTANT "RNGMOD_FRC_SWT_DISABLED" "0"
 SYSTEM_CONSTANT "RNGMOD_FRC_SWT_ENABLED" "1"
 SYSTEM_CONSTANT "ROOFOPN_SY" "0"
 SYSTEM_CONSTANT "RTRQ_CAN_RES" "0.392157"
 SYSTEM_CONSTANT "RTRQ_CAN_RES_LOW" "0.8"
 SYSTEM_CONSTANT "RTRQ_CAN_RES_REV" "2.54999910750031"
 SYSTEM_CONSTANT "RTRQ_ZERO" "0"
 SYSTEM_CONSTANT "SAIL_SY" "0"
 SYSTEM_CONSTANT "SCAV_INHOUSE_SY" "0"
 SYSTEM_CONSTANT "SCRLKM_RES" "1e-005"
 SYSTEM_CONSTANT "SCRLKM_RES_REV" "100000"
 SYSTEM_CONSTANT "SCR_FACT_RES" "1000"
 SYSTEM_CONSTANT "SEC_RES" "1"
 SYSTEM_CONSTANT "SG_INTVENG_SY" "0"
 SYSTEM_CONSTANT "SHFTR_SY" "0"
 SYSTEM_CONSTANT "SHTRP_MAPSIZE_SY" "70"
 SYSTEM_CONSTANT "SIA_CY150MEM_SY" "0"
 SYSTEM_CONSTANT "SIA_GENR_SY" "0"
 SYSTEM_CONSTANT "Signals_Mode1PidSize_SY" "36"
 SYSTEM_CONSTANT "Signals_NumberPID_SY" "28"
 SYSTEM_CONSTANT "Signals_NumberSigNumExt_SY" "3"
 SYSTEM_CONSTANT "Signals_NumberSigNumIntStd_SY" "59"
 SYSTEM_CONSTANT "Signals_NumberSigNumInt_SY" "59"
 SYSTEM_CONSTANT "Sig_I15031_LeanAppl_SY" "1"
 SYSTEM_CONSTANT "SIXTY" "600"
 SYSTEM_CONSTANT "SIX_MINUTES_DTOP" "360"
 SYSTEM_CONSTANT "SLMPCTL_ACTIVE_BP" "10"
 SYSTEM_CONSTANT "SLMPCTL_CHKOIL_BP" "1"
 SYSTEM_CONSTANT "SLMPCTL_ENGON_BP" "7"
 SYSTEM_CONSTANT "SLMPCTL_NOLVL_BP" "6"
 SYSTEM_CONSTANT "SLMPCTL_NOWP_BP" "8"
 SYSTEM_CONSTANT "SLMPCTL_OIL2H_BP" "5"
 SYSTEM_CONSTANT "SLMPCTL_OIL2L_BP" "4"
 SYSTEM_CONSTANT "SLMPCTL_OILLOW_BP" "3"
 SYSTEM_CONSTANT "SLMPCTL_OILOK_BP" "0"
 SYSTEM_CONSTANT "SLMPCTL_SENSERR_BP" "11"
 SYSTEM_CONSTANT "SLMPCTL_SWTTYP_WIV2" "0"
 SYSTEM_CONSTANT "SLMPCTL_SWTTYP_WIV3" "1"
 SYSTEM_CONSTANT "SLMPCTL_SWTTYP_WIV4" "2"
 SYSTEM_CONSTANT "SLMPCTL_SYSACT_BP" "2"
 SYSTEM_CONSTANT "SLMPCTL_VTILT_BP" "9"
 SYSTEM_CONSTANT "SLMPCTL_WIV_NOWIV" "0"
 SYSTEM_CONSTANT "SLMPCTL_WIV_SEL" "128"
 SYSTEM_CONSTANT "SLMPCTL_WIV_V2" "1"
 SYSTEM_CONSTANT "SLMPCTL_WIV_V3" "2"
 SYSTEM_CONSTANT "SLMPCTL_WIV_V4" "3"
 SYSTEM_CONSTANT "SPAF_SY" "0"
 SYSTEM_CONSTANT "SPC_SY" "0"
 SYSTEM_CONSTANT "SPDGOV_NSETP_ARRAY_HLSDEM_POS" "0"
 SYSTEM_CONSTANT "SPDGOV_OVRDS_PTPRT" "0"
 SYSTEM_CONSTANT "SPDGOV_TRQDEM" "4"
 SYSTEM_CONSTANT "SPDLIM_SY" "0"
 SYSTEM_CONSTANT "SPEC_HEAT_FLOW_RES" "0.01"
 SYSTEM_CONSTANT "SPEC_HEAT_FLOW_RES_REV" "100"
 SYSTEM_CONSTANT "SPRTEXTD_SY" "0"
 SYSTEM_CONSTANT "SPRTTYP_CHRSM" "0"
 SYSTEM_CONSTANT "SPRTTYP_SPRTSWT" "1"
 SYSTEM_CONSTANT "SPRTTYP_SY" "0"
 SYSTEM_CONSTANT "SPRT_SY" "0"
 SYSTEM_CONSTANT "SSPRITNUM_SY" "0"
 SYSTEM_CONSTANT "SSWTS_TYPE_DATASET" "2"
 SYSTEM_CONSTANT "STAACTVDET_SY" "2"
 SYSTEM_CONSTANT "STADAP_INHCUST_SY" "0"
 SYSTEM_CONSTANT "STAPMP_SY" "0"
 SYSTEM_CONSTANT "STBINTV_TRQINRTCSLEADOFS_CURX" "5"
 SYSTEM_CONSTANT "STEUSMNCAT_SY" "0"
 SYSTEM_CONSTANT "STF_SY" "0"
 SYSTEM_CONSTANT "STM_SY" "0"
 SYSTEM_CONSTANT "STNETH_SY" "0"
 SYSTEM_CONSTANT "STRGTYP_ELEC" "2"
 SYSTEM_CONSTANT "STRGTYP_HVELEC" "3"
 SYSTEM_CONSTANT "STRGTYP_LVELEC" "2"
 SYSTEM_CONSTANT "STRGTYP_MECH" "1"
 SYSTEM_CONSTANT "STRGTYP_NOSTRG" "0"
 SYSTEM_CONSTANT "STRGTYP_SY" "2"
 SYSTEM_CONSTANT "STRGWHL_AG_ACC_RES" "0.525"
 SYSTEM_CONSTANT "STRGWHL_AG_RES" "0.04375"
 SYSTEM_CONSTANT "STRGWHL_AG_VEL_RES" "0.04375"
 SYSTEM_CONSTANT "STRGWHL_AG_ZERO" "0"
 SYSTEM_CONSTANT "STRGWHL_ANGLE_ACC_RES" "1"
 SYSTEM_CONSTANT "STRGWHL_ANGLE_RES" "0.25"
 SYSTEM_CONSTANT "STRGWHL_ANGLE_VEL_RES" "0.5"
 SYSTEM_CONSTANT "STRGWHL_ANGLE_ZERO" "0"
 SYSTEM_CONSTANT "STRGWHL_SPD_ZERO" "0"
 SYSTEM_CONSTANT "STRTCTL_PRESTRTORD_BP" "7"
 SYSTEM_CONSTANT "STRTCTL_SC" "0"
 SYSTEM_CONSTANT "STRTCTL_SY" "2"
 SYSTEM_CONSTANT "STRTSWTECU_SY" "0"
 SYSTEM_CONSTANT "STRTTRQ_OFF" "0"
 SYSTEM_CONSTANT "STRTTRQ_ON" "1"
 SYSTEM_CONSTANT "STSPSWT_SY" "0"
 SYSTEM_CONSTANT "STSP_SY" "0"
 SYSTEM_CONSTANT "ST_EIGHT" "8"
 SYSTEM_CONSTANT "ST_FIVE" "5"
 SYSTEM_CONSTANT "ST_FOUR" "4"
 SYSTEM_CONSTANT "ST_ONE" "1"
 SYSTEM_CONSTANT "ST_SEVEN" "7"
 SYSTEM_CONSTANT "ST_SIX" "6"
 SYSTEM_CONSTANT "ST_THREE" "3"
 SYSTEM_CONSTANT "ST_TWO" "2"
 SYSTEM_CONSTANT "ST_ZERO" "0"
 SYSTEM_CONSTANT "SUPCH_SY" "0"
 SYSTEM_CONSTANT "SVSLMP_PWRSTG_SY" "0"
 SYSTEM_CONSTANT "SVSLMP_SUPRT_ATS_SY" "0"
 SYSTEM_CONSTANT "SVS_SY" "0"
 SYSTEM_CONSTANT "SWAPMP_PMP1_SY" "0"
 SYSTEM_CONSTANT "SWAPMP_PMP2_SY" "0"
 SYSTEM_CONSTANT "SWAPMP_PMP3_SY" "0"
 SYSTEM_CONSTANT "SWAPMP_PMP4_SY" "0"
 SYSTEM_CONSTANT "SWAPMP_PMP5_SY" "0"
 SYSTEM_CONSTANT "SWSVW_ADAP_SY" "0"
 SYSTEM_CONSTANT "SWSVW_AIRMNG_SY" "0"
 SYSTEM_CONSTANT "SWSVW_ANTITRMP_SY" "0"
 SYSTEM_CONSTANT "SWSVW_CHAELGDIAG_SY" "0"
 SYSTEM_CONSTANT "SWSVW_COMEMMNGAUXENGCMPN_SY" "0"
 SYSTEM_CONSTANT "SWSVW_COMEMMNGAUXENGCMPN_V1" "1"
 SYSTEM_CONSTANT "SWSVW_COPSPDDRVOFF_SY" "0"
 SYSTEM_CONSTANT "SWSVW_CS_SY" "0"
 SYSTEM_CONSTANT "SWSVW_DTEV_SY" "0"
 SYSTEM_CONSTANT "SWSVW_ENGNDISPOPTM_SY" "0"
 SYSTEM_CONSTANT "SWSVW_ENGSTRESS_SY" "0"
 SYSTEM_CONSTANT "SWSVW_FADD_SY" "0"
 SYSTEM_CONSTANT "SWSVW_GEARADV_SY" "0"
 SYSTEM_CONSTANT "SWSVW_MLB_PT_HYB_SY" "0"
 SYSTEM_CONSTANT "SWSVW_PTTQCLURED_SY" "0"
 SYSTEM_CONSTANT "SWSVW_STRTSTOP_SY" "0"
 SYSTEM_CONSTANT "SWSVW_THMMNG_SY" "0"
 SYSTEM_CONSTANT "SWSVW_TRAGRIPDET_SY" "0"
 SYSTEM_CONSTANT "SWSVW_VEHMESTIM_SY" "0"
 SYSTEM_CONSTANT "SWT_DISABLED" "0"
 SYSTEM_CONSTANT "SWT_ENABLED" "1"
 SYSTEM_CONSTANT "SYC_FSTSWOFF_SY" "0"
 SYSTEM_CONSTANT "SYC_T15POSTPREDRV_SWRST_SY" "0"
 SYSTEM_CONSTANT "SYC_T15RSTSIM_SY" "0"
 SYSTEM_CONSTANT "SYC_UNLIMNWM_SY" "0"
 SYSTEM_CONSTANT "SYC_WREEPBLK_SY" "0"
 SYSTEM_CONSTANT "SY_2HDP2" "0"
 SYSTEM_CONSTANT "SY_2LBK" "0"
 SYSTEM_CONSTANT "SY_2SG" "0"
 SYSTEM_CONSTANT "SY_2SGHST" "0"
 SYSTEM_CONSTANT "SY_2VD" "0"
 SYSTEM_CONSTANT "SY_AAU" "0"
 SYSTEM_CONSTANT "SY_AAV" "0"
 SYSTEM_CONSTANT "SY_ABGKL" "0"
 SYSTEM_CONSTANT "SY_ABGY" "0"
 SYSTEM_CONSTANT "SY_ABGYVBP" "0"
 SYSTEM_CONSTANT "SY_ABMZND" "0"
 SYSTEM_CONSTANT "SY_ACCSSRY" "0"
 SYSTEM_CONSTANT "SY_ACTRQCM" "0"
 SYSTEM_CONSTANT "SY_ADANZMI" "3"
 SYSTEM_CONSTANT "SY_ADANZNM" "8"
 SYSTEM_CONSTANT "SY_ADFPGA" "2"
 SYSTEM_CONSTANT "SY_ADTESK" "0"
 SYSTEM_CONSTANT "SY_AEKPBI" "0"
 SYSTEM_CONSTANT "SY_AFIMVAR" "0"
 SYSTEM_CONSTANT "SY_AFR" "0"
 SYSTEM_CONSTANT "SY_AGR" "0"
 SYSTEM_CONSTANT "SY_AGR2" "0"
 SYSTEM_CONSTANT "SY_AGREDK" "0"
 SYSTEM_CONSTANT "SY_AGRKOMP" "0"
 SYSTEM_CONSTANT "SY_AGR_DSS" "0"
 SYSTEM_CONSTANT "SY_AIRBAG" "0"
 SYSTEM_CONSTANT "SY_ALTSC" "0"
 SYSTEM_CONSTANT "SY_AMSHFMP" "0"
 SYSTEM_CONSTANT "SY_ANST" "0"
 SYSTEM_CONSTANT "SY_ANZEKP" "0"
 SYSTEM_CONSTANT "SY_ANZLUE" "1"
 SYSTEM_CONSTANT "SY_ANZPSLS" "0"
 SYSTEM_CONSTANT "SY_ANZSFST" "0"
 SYSTEM_CONSTANT "SY_ARC" "0"
 SYSTEM_CONSTANT "SY_ARSTAT" "1"
 SYSTEM_CONSTANT "SY_ASEEPR" "2"
 SYSTEM_CONSTANT "SY_ASG" "0"
 SYSTEM_CONSTANT "SY_ASGLC" "0"
 SYSTEM_CONSTANT "SY_ASM" "0"
 SYSTEM_CONSTANT "SY_ASR" "0"
 SYSTEM_CONSTANT "SY_ASTIKR" "0"
 SYSTEM_CONSTANT "SY_ASTIKR2" "0"
 SYSTEM_CONSTANT "SY_ASTNVK" "0"
 SYSTEM_CONSTANT "SY_ASTNVK2" "0"
 SYSTEM_CONSTANT "SY_ASTSWTINTEGNEG" "0"
 SYSTEM_CONSTANT "SY_ASTVHK" "0"
 SYSTEM_CONSTANT "SY_ASTVHK2" "0"
 SYSTEM_CONSTANT "SY_ASTVVK" "0"
 SYSTEM_CONSTANT "SY_ASTVVK2" "0"
 SYSTEM_CONSTANT "SY_ASV" "0"
 SYSTEM_CONSTANT "SY_ATLB" "0"
 SYSTEM_CONSTANT "SY_ATMAMB" "0"
 SYSTEM_CONSTANT "SY_ATMAVDY" "0"
 SYSTEM_CONSTANT "SY_ATMBR" "4"
 SYSTEM_CONSTANT "SY_ATMBR2" "0"
 SYSTEM_CONSTANT "SY_ATMBRA" "0"
 SYSTEM_CONSTANT "SY_ATMBRA2" "0"
 SYSTEM_CONSTANT "SY_ATMBRB" "0"
 SYSTEM_CONSTANT "SY_ATMBRB2" "0"
 SYSTEM_CONSTANT "SY_ATMBRC" "0"
 SYSTEM_CONSTANT "SY_ATMCACA" "0"
 SYSTEM_CONSTANT "SY_ATMELE" "13"
 SYSTEM_CONSTANT "SY_ATMELE2" "0"
 SYSTEM_CONSTANT "SY_ATMEXFB" "0"
 SYSTEM_CONSTANT "SY_ATMEXO" "0"
 SYSTEM_CONSTANT "SY_ATMFAN" "0"
 SYSTEM_CONSTANT "SY_ATMGD" "0"
 SYSTEM_CONSTANT "SY_ATMHOOK" "0"
 SYSTEM_CONSTANT "SY_ATMISEC" "0"
 SYSTEM_CONSTANT "SY_ATMOFFS" "0"
 SYSTEM_CONSTANT "SY_ATMPI" "7"
 SYSTEM_CONSTANT "SY_ATMPI2" "0"
 SYSTEM_CONSTANT "SY_ATMPIA" "7"
 SYSTEM_CONSTANT "SY_ATMPIA2" "0"
 SYSTEM_CONSTANT "SY_ATMPIB" "0"
 SYSTEM_CONSTANT "SY_ATMPIB2" "0"
 SYSTEM_CONSTANT "SY_ATMPIC" "0"
 SYSTEM_CONSTANT "SY_ATMSY" "0"
 SYSTEM_CONSTANT "SY_ATMTURB" "0"
 SYSTEM_CONSTANT "SY_ATR" "0"
 SYSTEM_CONSTANT "SY_ATSPWM" "0"
 SYSTEM_CONSTANT "SY_ATURB" "0"
 SYSTEM_CONSTANT "SY_AUFLAD" "0"
 SYSTEM_CONSTANT "SY_AUFLAD2" "0"
 SYSTEM_CONSTANT "SY_AVS" "0"
 SYSTEM_CONSTANT "SY_AWUE" "0"
 SYSTEM_CONSTANT "SY_BATTSG" "0"
 SYSTEM_CONSTANT "SY_BBBO" "0"
 SYSTEM_CONSTANT "SY_BBKOPT" "0"
 SYSTEM_CONSTANT "SY_BBPHSYN" "0"
 SYSTEM_CONSTANT "SY_BBSAWE" "0"
 SYSTEM_CONSTANT "SY_BDE" "0"
 SYSTEM_CONSTANT "SY_BELA" "0"
 SYSTEM_CONSTANT "SY_BGD3PK" "0"
 SYSTEM_CONSTANT "SY_BGLWEM" "0"
 SYSTEM_CONSTANT "SY_BGSF" "0"
 SYSTEM_CONSTANT "SY_BGVMX" "0"
 SYSTEM_CONSTANT "SY_BH" "0"
 SYSTEM_CONSTANT "SY_BIRE" "0"
 SYSTEM_CONSTANT "SY_BKS" "0"
 SYSTEM_CONSTANT "SY_BKV" "0"
 SYSTEM_CONSTANT "SY_BKVP" "0"
 SYSTEM_CONSTANT "SY_BKVSRV" "0"
 SYSTEM_CONSTANT "SY_BLDPRCE" "0"
 SYSTEM_CONSTANT "SY_BLOOP" "0"
 SYSTEM_CONSTANT "SY_BOADAP" "0"
 SYSTEM_CONSTANT "SY_BOGALIM" "0"
 SYSTEM_CONSTANT "SY_BPEZEK" "0"
 SYSTEM_CONSTANT "SY_C167" "0"
 SYSTEM_CONSTANT "SY_CANAC" "0"
 SYSTEM_CONSTANT "SY_CANALL" "0"
 SYSTEM_CONSTANT "SY_CANBSG" "1"
 SYSTEM_CONSTANT "SY_CANFLP" "0"
 SYSTEM_CONSTANT "SY_CANNIV" "0"
 SYSTEM_CONSTANT "SY_CANNOHK" "0"
 SYSTEM_CONSTANT "SY_CANZAS" "1"
 SYSTEM_CONSTANT "SY_CASECU" "0"
 SYSTEM_CONSTANT "SY_CATACT" "0"
 SYSTEM_CONSTANT "SY_CC195" "0"
 SYSTEM_CONSTANT "SY_CC196" "0"
 SYSTEM_CONSTANT "SY_CC650" "0"
 SYSTEM_CONSTANT "SY_CFGKSE" "1"
 SYSTEM_CONSTANT "SY_CFMST" "0"
 SYSTEM_CONSTANT "SY_CHSPLMI" "0"
 SYSTEM_CONSTANT "SY_CICSERS" "0"
 SYSTEM_CONSTANT "SY_CJ110" "0"
 SYSTEM_CONSTANT "SY_CJ120" "0"
 SYSTEM_CONSTANT "SY_CJ125" "0"
 SYSTEM_CONSTANT "SY_CJ230" "0"
 SYSTEM_CONSTANT "SY_CJ230DM" "1"
 SYSTEM_CONSTANT "SY_CJ840" "0"
 SYSTEM_CONSTANT "SY_CJ840AT" "0"
 SYSTEM_CONSTANT "SY_CJ841" "0"
 SYSTEM_CONSTANT "SY_CJ870" "0"
 SYSTEM_CONSTANT "SY_CK200" "0"
 SYSTEM_CONSTANT "SY_CK200LS" "0"
 SYSTEM_CONSTANT "SY_CK200MO" "0"
 SYSTEM_CONSTANT "SY_CK240" "0"
 SYSTEM_CONSTANT "SY_CKA" "0"
 SYSTEM_CONSTANT "SY_CNG" "0"
 SYSTEM_CONSTANT "SY_COPOTI" "0"
 SYSTEM_CONSTANT "SY_CPRDYL" "0"
 SYSTEM_CONSTANT "SY_CPRLAOX" "0"
 SYSTEM_CONSTANT "SY_CPRLG" "0"
 SYSTEM_CONSTANT "SY_CPRSCV" "0"
 SYSTEM_CONSTANT "SY_CVT" "0"
 SYSTEM_CONSTANT "SY_CY370" "0"
 SYSTEM_CONSTANT "SY_D2CTRFLT" "20"
 SYSTEM_CONSTANT "SY_DCPV" "0"
 SYSTEM_CONSTANT "SY_DCPVAIR" "0"
 SYSTEM_CONSTANT "SY_DCPVLD" "0"
 SYSTEM_CONSTANT "SY_DCPVLRR" "0"
 SYSTEM_CONSTANT "SY_DCPVOUT" "0"
 SYSTEM_CONSTANT "SY_DCPVPAS" "0"
 SYSTEM_CONSTANT "SY_DCPVSPL" "0"
 SYSTEM_CONSTANT "SY_DCPVTUM" "0"
 SYSTEM_CONSTANT "SY_DCV" "0"
 SYSTEM_CONSTANT "SY_DCYLIMB" "0"
 SYSTEM_CONSTANT "SY_DDPKAT" "0"
 SYSTEM_CONSTANT "SY_DDS2A3" "0"
 SYSTEM_CONSTANT "SY_DDTLSFK" "0"
 SYSTEM_CONSTANT "SY_DDTLSHK" "0"
 SYSTEM_CONSTANT "SY_DECOS" "0"
 SYSTEM_CONSTANT "SY_DEGFE" "0"
 SYSTEM_CONSTANT "SY_DESOK" "0"
 SYSTEM_CONSTANT "SY_DEVAL" "0"
 SYSTEM_CONSTANT "SY_DFKTAV" "0"
 SYSTEM_CONSTANT "SY_DFKTAV2" "0"
 SYSTEM_CONSTANT "SY_DFKTKA" "0"
 SYSTEM_CONSTANT "SY_DFKTKA2" "0"
 SYSTEM_CONSTANT "SY_DFKTSA" "0"
 SYSTEM_CONSTANT "SY_DFKTSA2" "0"
 SYSTEM_CONSTANT "SY_DFKTSP" "0"
 SYSTEM_CONSTANT "SY_DFKTSP2" "0"
 SYSTEM_CONSTANT "SY_DFP16BT" "1"
 SYSTEM_CONSTANT "SY_DFPMFFR" "1"
 SYSTEM_CONSTANT "SY_DFRAVUE" "0"
 SYSTEM_CONSTANT "SY_DFRST" "0"
 SYSTEM_CONSTANT "SY_DHDEVOE" "0"
 SYSTEM_CONSTANT "SY_DHKTAV" "1"
 SYSTEM_CONSTANT "SY_DHKTAV2" "0"
 SYSTEM_CONSTANT "SY_DHKTKA" "0"
 SYSTEM_CONSTANT "SY_DHKTKA2" "0"
 SYSTEM_CONSTANT "SY_DHKTSA" "0"
 SYSTEM_CONSTANT "SY_DHKTSA2" "0"
 SYSTEM_CONSTANT "SY_DHKTSP" "0"
 SYSTEM_CONSTANT "SY_DHKTSP2" "0"
 SYSTEM_CONSTANT "SY_DHR" "0"
 SYSTEM_CONSTANT "SY_DIONDE" "0"
 SYSTEM_CONSTANT "SY_DIRST" "0"
 SYSTEM_CONSTANT "SY_DISDPLT" "0"
 SYSTEM_CONSTANT "SY_DKADANL" "0"
 SYSTEM_CONSTANT "SY_DKATDPL" "0"
 SYSTEM_CONSTANT "SY_DKATEF" "0"
 SYSTEM_CONSTANT "SY_DKATGES" "0"
 SYSTEM_CONSTANT "SY_DKATLRS" "0"
 SYSTEM_CONSTANT "SY_DKATNO" "0"
 SYSTEM_CONSTANT "SY_DKATQP" "0"
 SYSTEM_CONSTANT "SY_DKATSP" "0"
 SYSTEM_CONSTANT "SY_DKATTE" "0"
 SYSTEM_CONSTANT "SY_DKATZP" "1"
 SYSTEM_CONSTANT "SY_DKHZ" "0"
 SYSTEM_CONSTANT "SY_DKLRIKL" "0"
 SYSTEM_CONSTANT "SY_DKPDF" "0"
 SYSTEM_CONSTANT "SY_DKTEVAL" "0"
 SYSTEM_CONSTANT "SY_DKTEWMA" "0"
 SYSTEM_CONSTANT "SY_DKTSPFK" "0"
 SYSTEM_CONSTANT "SY_DKTSPHK" "0"
 SYSTEM_CONSTANT "SY_DKVFTAL" "0"
 SYSTEM_CONSTANT "SY_DKVSCMB" "1"
 SYSTEM_CONSTANT "SY_DKVSFFC" "0"
 SYSTEM_CONSTANT "SY_DKVSSC" "0"
 SYSTEM_CONSTANT "SY_DKZEROP" "0"
 SYSTEM_CONSTANT "SY_DLBTSZW" "0"
 SYSTEM_CONSTANT "SY_DLDP" "0"
 SYSTEM_CONSTANT "SY_DLDPATC" "0"
 SYSTEM_CONSTANT "SY_DLEAKNO" "0"
 SYSTEM_CONSTANT "SY_DLLRNPL" "0"
 SYSTEM_CONSTANT "SY_DLSFV" "0"
 SYSTEM_CONSTANT "SY_DLSHV" "0"
 SYSTEM_CONSTANT "SY_DLSHVTO" "0"
 SYSTEM_CONSTANT "SY_DLSUV" "0"
 SYSTEM_CONSTANT "SY_DLUTVAR" "0"
 SYSTEM_CONSTANT "SY_DMDADAP" "1"
 SYSTEM_CONSTANT "SY_DMDATEH" "0"
 SYSTEM_CONSTANT "SY_DMDBTGT" "0"
 SYSTEM_CONSTANT "SY_DMDCYLID" "0"
 SYSTEM_CONSTANT "SY_DMDFCER" "1"
 SYSTEM_CONSTANT "SY_DMDHSC" "0"
 SYSTEM_CONSTANT "SY_DMDMODE" "0"
 SYSTEM_CONSTANT "SY_DMDPAT" "0"
 SYSTEM_CONSTANT "SY_DMDSEGV" "1"
 SYSTEM_CONSTANT "SY_DMDSTQ" "50"
 SYSTEM_CONSTANT "SY_DMDTAL" "0"
 SYSTEM_CONSTANT "SY_DMDVAR" "3"
 SYSTEM_CONSTANT "SY_DMDZAG" "1"
 SYSTEM_CONSTANT "SY_DMDZAGVAR" "2"
 SYSTEM_CONSTANT "SY_DMDZMS" "0"
 SYSTEM_CONSTANT "SY_DMKATS" "0"
 SYSTEM_CONSTANT "SY_DMREXKL" "0"
 SYSTEM_CONSTANT "SY_DMTL" "0"
 SYSTEM_CONSTANT "SY_DMTLAF" "0"
 SYSTEM_CONSTANT "SY_DNSTAT" "0"
 SYSTEM_CONSTANT "SY_DNWKW" "1"
 SYSTEM_CONSTANT "SY_DNWVPSA" "0"
 SYSTEM_CONSTANT "SY_DNWVPSE" "0"
 SYSTEM_CONSTANT "SY_DOPZW" "1"
 SYSTEM_CONSTANT "SY_DPCS" "0"
 SYSTEM_CONSTANT "SY_DPLTCWL" "0"
 SYSTEM_CONSTANT "SY_DSBKV" "0"
 SYSTEM_CONSTANT "SY_DSKNO" "0"
 SYSTEM_CONSTANT "SY_DSKVND" "0"
 SYSTEM_CONSTANT "SY_DSLS" "0"
 SYSTEM_CONSTANT "SY_DSLSLS" "0"
 SYSTEM_CONSTANT "SY_DSLSPS" "0"
 SYSTEM_CONSTANT "SY_DSLSZP" "1"
 SYSTEM_CONSTANT "SY_DSM" "1"
 SYSTEM_CONSTANT "SY_DSNDK" "0"
 SYSTEM_CONSTANT "SY_DSPACE" "0"
 SYSTEM_CONSTANT "SY_DSS" "1"
 SYSTEM_CONSTANT "SY_DSS2" "0"
 SYSTEM_CONSTANT "SY_DSU" "0"
 SYSTEM_CONSTANT "SY_DSV2V" "0"
 SYSTEM_CONSTANT "SY_DSVDK" "0"
 SYSTEM_CONSTANT "SY_DSVDK2" "0"
 SYSTEM_CONSTANT "SY_DSVV" "0"
 SYSTEM_CONSTANT "SY_DSVV2" "0"
 SYSTEM_CONSTANT "SY_DTCWCS" "2"
 SYSTEM_CONSTANT "SY_DTCWHSC" "0"
 SYSTEM_CONSTANT "SY_DTDW" "0"
 SYSTEM_CONSTANT "SY_DTHM" "0"
 SYSTEM_CONSTANT "SY_DUZND" "0"
 SYSTEM_CONSTANT "SY_DVEADA" "0"
 SYSTEM_CONSTANT "SY_DVEAIF" "0"
 SYSTEM_CONSTANT "SY_DVEAMP" "0"
 SYSTEM_CONSTANT "SY_DVEANZ" "1"
 SYSTEM_CONSTANT "SY_DVEATT" "0"
 SYSTEM_CONSTANT "SY_DVEFO" "0"
 SYSTEM_CONSTANT "SY_DVEKOMP" "1"
 SYSTEM_CONSTANT "SY_DVEKOOR" "0"
 SYSTEM_CONSTANT "SY_DWVNWKW" "0"
 SYSTEM_CONSTANT "SY_DYCOP" "0"
 SYSTEM_CONSTANT "SY_DYLSEVAL" "0"
 SYSTEM_CONSTANT "SY_DYLSF" "0"
 SYSTEM_CONSTANT "SY_DYLSH" "0"
 SYSTEM_CONSTANT "SY_DZWB2" "0"
 SYSTEM_CONSTANT "SY_DZWBS" "0"
 SYSTEM_CONSTANT "SY_DZWK" "0"
 SYSTEM_CONSTANT "SY_DZWKS" "1"
 SYSTEM_CONSTANT "SY_EAOMSDK" "0"
 SYSTEM_CONSTANT "SY_EBFMOD" "0"
 SYSTEM_CONSTANT "SY_ECUGENR" "2"
 SYSTEM_CONSTANT "SY_EDMMILA" "0"
 SYSTEM_CONSTANT "SY_EEPACC" "3"
 SYSTEM_CONSTANT "SY_EGAS" "0"
 SYSTEM_CONSTANT "SY_EGFE" "2"
 SYSTEM_CONSTANT "SY_EKPRMK" "0"
 SYSTEM_CONSTANT "SY_EKPTSOF" "0"
 SYSTEM_CONSTANT "SY_EOLT" "0"
 SYSTEM_CONSTANT "SY_EPRFSB" "0"
 SYSTEM_CONSTANT "SY_ESNSNA" "0"
 SYSTEM_CONSTANT "SY_ESNWS" "0"
 SYSTEM_CONSTANT "SY_ESUKA" "0"
 SYSTEM_CONSTANT "SY_ESUKNGN" "0"
 SYSTEM_CONSTANT "SY_ETADZWF" "0"
 SYSTEM_CONSTANT "SY_ETAKHZW" "0"
 SYSTEM_CONSTANT "SY_ETHSENS" "0"
 SYSTEM_CONSTANT "SY_ETKBYP" "0"
 SYSTEM_CONSTANT "SY_ETR" "0"
 SYSTEM_CONSTANT "SY_EVABEEP" "1"
 SYSTEM_CONSTANT "SY_EXCWM" "0"
 SYSTEM_CONSTANT "SY_FABE" "0"
 SYSTEM_CONSTANT "SY_FAEVZUE" "0"
 SYSTEM_CONSTANT "SY_FAFSTKH" "0"
 SYSTEM_CONSTANT "SY_FAGALS" "0"
 SYSTEM_CONSTANT "SY_FALRAMW" "0"
 SYSTEM_CONSTANT "SY_FANT" "0"
 SYSTEM_CONSTANT "SY_FAPAFG" "0"
 SYSTEM_CONSTANT "SY_FAWULA" "1"
 SYSTEM_CONSTANT "SY_FCOTSTR" "0"
 SYSTEM_CONSTANT "SY_FELMR" "0"
 SYSTEM_CONSTANT "SY_FEPB" "1"
 SYSTEM_CONSTANT "SY_FEPBAL" "0"
 SYSTEM_CONSTANT "SY_FFV" "0"
 SYSTEM_CONSTANT "SY_FFZ" "0"
 SYSTEM_CONSTANT "SY_FKAT" "0"
 SYSTEM_CONSTANT "SY_FKAT2" "0"
 SYSTEM_CONSTANT "SY_FLAFH" "0"
 SYSTEM_CONSTANT "SY_FLASHON" "0"
 SYSTEM_CONSTANT "SY_FLUQ" "45"
 SYSTEM_CONSTANT "SY_FLUTVAR" "0"
 SYSTEM_CONSTANT "SY_FMAELSV" "0"
 SYSTEM_CONSTANT "SY_FNSK" "0"
 SYSTEM_CONSTANT "SY_FNSWLK" "0"
 SYSTEM_CONSTANT "SY_FOFHEV" "0"
 SYSTEM_CONSTANT "SY_FOFSMPN" "11"
 SYSTEM_CONSTANT "SY_FONAZNM" "8"
 SYSTEM_CONSTANT "SY_FPCES" "2"
 SYSTEM_CONSTANT "SY_FPCGWRK" "0"
 SYSTEM_CONSTANT "SY_FPCIMV" "0"
 SYSTEM_CONSTANT "SY_FPCLRBN" "0"
 SYSTEM_CONSTANT "SY_FPCMW" "0"
 SYSTEM_CONSTANT "SY_FPCPIN" "0"
 SYSTEM_CONSTANT "SY_FPCPR" "0"
 SYSTEM_CONSTANT "SY_FPCSSP" "0"
 SYSTEM_CONSTANT "SY_FPCSTP" "0"
 SYSTEM_CONSTANT "SY_FPCSTRQ" "0"
 SYSTEM_CONSTANT "SY_FPCTKTM" "0"
 SYSTEM_CONSTANT "SY_FPCTR" "0"
 SYSTEM_CONSTANT "SY_FSGFS" "0"
 SYSTEM_CONSTANT "SY_FSGM" "1"
 SYSTEM_CONSTANT "SY_FSTCAN" "0"
 SYSTEM_CONSTANT "SY_FSTK" "0"
 SYSTEM_CONSTANT "SY_FSTSTPL" "0"
 SYSTEM_CONSTANT "SY_FTIV" "0"
 SYSTEM_CONSTANT "SY_FTIVDM" "0"
 SYSTEM_CONSTANT "SY_FTOFSLS" "0"
 SYSTEM_CONSTANT "SY_FUELVAP" "0"
 SYSTEM_CONSTANT "SY_FWLK" "0"
 SYSTEM_CONSTANT "SY_FZAGK" "0"
 SYSTEM_CONSTANT "SY_FZCVC" "0"
 SYSTEM_CONSTANT "SY_FZEATK" "0"
 SYSTEM_CONSTANT "SY_GAUSD" "1"
 SYSTEM_CONSTANT "SY_GP" "0"
 SYSTEM_CONSTANT "SY_GRDWOF" "0"
 SYSTEM_CONSTANT "SY_GRDWRT" "65"
 SYSTEM_CONSTANT "SY_GRDWRTB" "72"
 SYSTEM_CONSTANT "SY_H2COFK" "0"
 SYSTEM_CONSTANT "SY_H2COHK" "0"
 SYSTEM_CONSTANT "SY_HDP" "0"
 SYSTEM_CONSTANT "SY_HDST" "0"
 SYSTEM_CONSTANT "SY_HEV" "0"
 SYSTEM_CONSTANT "SY_HFM" "0"
 SYSTEM_CONSTANT "SY_HFMKOMP" "0"
 SYSTEM_CONSTANT "SY_HKAT" "1"
 SYSTEM_CONSTANT "SY_HKAT2" "0"
 SYSTEM_CONSTANT "SY_HKS" "0"
 SYSTEM_CONSTANT "SY_HLSFFET" "0"
 SYSTEM_CONSTANT "SY_HLSHFET" "0"
 SYSTEM_CONSTANT "SY_HLSHRTP" "0"
 SYSTEM_CONSTANT "SY_HLSVFET" "0"
 SYSTEM_CONSTANT "SY_HMB" "0"
 SYSTEM_CONSTANT "SY_HMBMBA" "0"
 SYSTEM_CONSTANT "SY_HMM" "0"
 SYSTEM_CONSTANT "SY_HOS" "0"
 SYSTEM_CONSTANT "SY_HSG" "0"
 SYSTEM_CONSTANT "SY_HSP" "0"
 SYSTEM_CONSTANT "SY_HSPMD" "0"
 SYSTEM_CONSTANT "SY_HSPNWS" "0"
 SYSTEM_CONSTANT "SY_IATPS11" "0"
 SYSTEM_CONSTANT "SY_IATPS12" "0"
 SYSTEM_CONSTANT "SY_IATPS13" "0"
 SYSTEM_CONSTANT "SY_IATPS21" "0"
 SYSTEM_CONSTANT "SY_IATPS22" "0"
 SYSTEM_CONSTANT "SY_IATPS23" "0"
 SYSTEM_CONSTANT "SY_IFOTMEN" "0"
 SYSTEM_CONSTANT "SY_IFTCWRP" "0"
 SYSTEM_CONSTANT "SY_IGICCH1" "0"
 SYSTEM_CONSTANT "SY_IGICCH2" "0"
 SYSTEM_CONSTANT "SY_IGICCH3" "0"
 SYSTEM_CONSTANT "SY_IGICCH4" "0"
 SYSTEM_CONSTANT "SY_IGICCH5" "0"
 SYSTEM_CONSTANT "SY_IGIFLAG" "0"
 SYSTEM_CONSTANT "SY_IGNCHN1" "0"
 SYSTEM_CONSTANT "SY_IGNCHN2" "1"
 SYSTEM_CONSTANT "SY_IGNCHN3" "2"
 SYSTEM_CONSTANT "SY_IGNCHN4" "3"
 SYSTEM_CONSTANT "SY_IGNCHN5" "4"
 SYSTEM_CONSTANT "SY_IGSWR" "0"
 SYSTEM_CONSTANT "SY_INHIBIT" "1"
 SYSTEM_CONSTANT "SY_INI_OBD" "5"
 SYSTEM_CONSTANT "SY_INJADKM" "0"
 SYSTEM_CONSTANT "SY_IPRCRSH" "0"
 SYSTEM_CONSTANT "SY_ISG" "0"
 SYSTEM_CONSTANT "SY_IUMPR" "0"
 SYSTEM_CONSTANT "SY_KBAWGAA" "0"
 SYSTEM_CONSTANT "SY_KDHFM" "0"
 SYSTEM_CONSTANT "SY_KFLRA" "0"
 SYSTEM_CONSTANT "SY_KHETA" "1"
 SYSTEM_CONSTANT "SY_KHTMSFH" "0"
 SYSTEM_CONSTANT "SY_KLDF" "4"
 SYSTEM_CONSTANT "SY_KMTR" "0"
 SYSTEM_CONSTANT "SY_KOLBSC" "0"
 SYSTEM_CONSTANT "SY_KONWDK" "0"
 SYSTEM_CONSTANT "SY_KOP" "0"
 SYSTEM_CONSTANT "SY_KORRZ" "1"
 SYSTEM_CONSTANT "SY_KRADPZI" "0"
 SYSTEM_CONSTANT "SY_KRK" "0"
 SYSTEM_CONSTANT "SY_KRLZ" "1"
 SYSTEM_CONSTANT "SY_KRSAINT" "0"
 SYSTEM_CONSTANT "SY_KRSASW" "1"
 SYSTEM_CONSTANT "SY_KRZMF" "0"
 SYSTEM_CONSTANT "SY_KS1" "0"
 SYSTEM_CONSTANT "SY_KS2" "1"
 SYSTEM_CONSTANT "SY_KS3" "2"
 SYSTEM_CONSTANT "SY_KS4" "3"
 SYSTEM_CONSTANT "SY_KSE" "1"
 SYSTEM_CONSTANT "SY_KSEINTS" "0"
 SYSTEM_CONSTANT "SY_KSENCHN" "1"
 SYSTEM_CONSTANT "SY_KSENFLT" "5"
 SYSTEM_CONSTANT "SY_KSZA" "1"
 SYSTEM_CONSTANT "SY_KT" "0"
 SYSTEM_CONSTANT "SY_KTIGNBI" "0"
 SYSTEM_CONSTANT "SY_KUPOT" "0"
 SYSTEM_CONSTANT "SY_KWFOSC" "0"
 SYSTEM_CONSTANT "SY_LAGENDI" "0"
 SYSTEM_CONSTANT "SY_LALIM" "0"
 SYSTEM_CONSTANT "SY_LAMKAPP" "0"
 SYSTEM_CONSTANT "SY_LAMNSWLP" "0"
 SYSTEM_CONSTANT "SY_LAMOBC" "0"
 SYSTEM_CONSTANT "SY_LBK" "0"
 SYSTEM_CONSTANT "SY_LBKMD" "0"
 SYSTEM_CONSTANT "SY_LCSS" "0"
 SYSTEM_CONSTANT "SY_LEITMOD" "0"
 SYSTEM_CONSTANT "SY_LENKH" "0"
 SYSTEM_CONSTANT "SY_LF2B" "0"
 SYSTEM_CONSTANT "SY_LFSPWM" "0"
 SYSTEM_CONSTANT "SY_LLKEO" "0"
 SYSTEM_CONSTANT "SY_LLS" "0"
 SYSTEM_CONSTANT "SY_LLSGSTA" "0"
 SYSTEM_CONSTANT "SY_LOWRA" "0"
 SYSTEM_CONSTANT "SY_LR2PAR" "0"
 SYSTEM_CONSTANT "SY_LRAT" "0"
 SYSTEM_CONSTANT "SY_LRATKG" "0"
 SYSTEM_CONSTANT "SY_LRDPAR" "0"
 SYSTEM_CONSTANT "SY_LREBMD" "1"
 SYSTEM_CONSTANT "SY_LREBPS" "0"
 SYSTEM_CONSTANT "SY_LRFK" "0"
 SYSTEM_CONSTANT "SY_LRFK2" "0"
 SYSTEM_CONSTANT "SY_LRFKEF" "0"
 SYSTEM_CONSTANT "SY_LRHK" "0"
 SYSTEM_CONSTANT "SY_LRHK2" "0"
 SYSTEM_CONSTANT "SY_LRHKEF" "0"
 SYSTEM_CONSTANT "SY_LRLAIF" "1"
 SYSTEM_CONSTANT "SY_LRNK" "0"
 SYSTEM_CONSTANT "SY_LRSEZ" "0"
 SYSTEM_CONSTANT "SY_LS" "0"
 SYSTEM_CONSTANT "SY_LSAGETR" "0"
 SYSTEM_CONSTANT "SY_LSFHV" "0"
 SYSTEM_CONSTANT "SY_LSFIKR" "1"
 SYSTEM_CONSTANT "SY_LSFIKR2" "0"
 SYSTEM_CONSTANT "SY_LSFNHK" "0"
 SYSTEM_CONSTANT "SY_LSFNHK2" "0"
 SYSTEM_CONSTANT "SY_LSFNTL" "0"
 SYSTEM_CONSTANT "SY_LSFNTL2" "0"
 SYSTEM_CONSTANT "SY_LSFNVK" "0"
 SYSTEM_CONSTANT "SY_LSFNVK2" "0"
 SYSTEM_CONSTANT "SY_LSFV" "0"
 SYSTEM_CONSTANT "SY_LSFVHK" "0"
 SYSTEM_CONSTANT "SY_LSFVHK2" "0"
 SYSTEM_CONSTANT "SY_LSFVVK" "0"
 SYSTEM_CONSTANT "SY_LSFVVK2" "0"
 SYSTEM_CONSTANT "SY_LSHSTA" "0"
 SYSTEM_CONSTANT "SY_LSHV" "0"
 SYSTEM_CONSTANT "SY_LSUIKR" "0"
 SYSTEM_CONSTANT "SY_LSUIKR2" "0"
 SYSTEM_CONSTANT "SY_LSUMRS" "0"
 SYSTEM_CONSTANT "SY_LSUNHK" "0"
 SYSTEM_CONSTANT "SY_LSUNHK2" "0"
 SYSTEM_CONSTANT "SY_LSUNTL" "0"
 SYSTEM_CONSTANT "SY_LSUNTL2" "0"
 SYSTEM_CONSTANT "SY_LSUNVK" "0"
 SYSTEM_CONSTANT "SY_LSUNVK2" "0"
 SYSTEM_CONSTANT "SY_LSUVHK" "0"
 SYSTEM_CONSTANT "SY_LSUVHK2" "0"
 SYSTEM_CONSTANT "SY_LSUVVK" "0"
 SYSTEM_CONSTANT "SY_LSUVVK2" "0"
 SYSTEM_CONSTANT "SY_LSVSTA" "0"
 SYSTEM_CONSTANT "SY_LSVV" "0"
 SYSTEM_CONSTANT "SY_LSZYVER" "0"
 SYSTEM_CONSTANT "SY_LUARMN" "1"
 SYSTEM_CONSTANT "SY_LUART" "0"
 SYSTEM_CONSTANT "SY_LUEKONF" "0"
 SYSTEM_CONSTANT "SY_LUEX" "0"
 SYSTEM_CONSTANT "SY_LUFAK" "219.9023255552"
 SYSTEM_CONSTANT "SY_LUFIKL" "0"
 SYSTEM_CONSTANT "SY_LUSRKR" "0"
 SYSTEM_CONSTANT "SY_M8TE" "0"
 SYSTEM_CONSTANT "SY_MAGER" "0"
 SYSTEM_CONSTANT "SY_MDBASOG" "0"
 SYSTEM_CONSTANT "SY_MDBGAGR" "0"
 SYSTEM_CONSTANT "SY_MDBGAT" "0"
 SYSTEM_CONSTANT "SY_MDBGHS" "0"
 SYSTEM_CONSTANT "SY_MDBGTI" "0"
 SYSTEM_CONSTANT "SY_MDBGTM" "0"
 SYSTEM_CONSTANT "SY_MDBGV" "0"
 SYSTEM_CONSTANT "SY_MDI" "0"
 SYSTEM_CONSTANT "SY_MDISTM" "1"
 SYSTEM_CONSTANT "SY_MDKAR" "1"
 SYSTEM_CONSTANT "SY_MDMXEXC" "1"
 SYSTEM_CONSTANT "SY_MDSRL" "0"
 SYSTEM_CONSTANT "SY_MISAFON" "1"
 SYSTEM_CONSTANT "SY_MISAKOR" "3"
 SYSTEM_CONSTANT "SY_MOROM" "0"
 SYSTEM_CONSTANT "SY_MSDKN" "0"
 SYSTEM_CONSTANT "SY_MSGRED" "0"
 SYSTEM_CONSTANT "SY_MSVKOMP" "0"
 SYSTEM_CONSTANT "SY_MTRXBLR" "0"
 SYSTEM_CONSTANT "SY_MULCATI" "0"
 SYSTEM_CONSTANT "SY_NG" "0"
 SYSTEM_CONSTANT "SY_NLDG" "0"
 SYSTEM_CONSTANT "SY_NLLKHFH" "0"
 SYSTEM_CONSTANT "SY_NLZOFF" "1"
 SYSTEM_CONSTANT "SY_NMAXEXT" "0"
 SYSTEM_CONSTANT "SY_NMAXR" "0"
 SYSTEM_CONSTANT "SY_NMTYP" "0"
 SYSTEM_CONSTANT "SY_NMXELBK" "0"
 SYSTEM_CONSTANT "SY_NOHK" "0"
 SYSTEM_CONSTANT "SY_NOHK2" "0"
 SYSTEM_CONSTANT "SY_NOKT" "0"
 SYSTEM_CONSTANT "SY_NOXKAT" "0"
 SYSTEM_CONSTANT "SY_NOXKAT2" "0"
 SYSTEM_CONSTANT "SY_NSAC" "2"
 SYSTEM_CONSTANT "SY_NSAD" "1"
 SYSTEM_CONSTANT "SY_NSALT" "0"
 SYSTEM_CONSTANT "SY_NSARC" "0"
 SYSTEM_CONSTANT "SY_NSASG" "0"
 SYSTEM_CONSTANT "SY_NSBLP" "1"
 SYSTEM_CONSTANT "SY_NSCAM" "0"
 SYSTEM_CONSTANT "SY_NSCAT" "1"
 SYSTEM_CONSTANT "SY_NSCDE" "0"
 SYSTEM_CONSTANT "SY_NSCRP" "0"
 SYSTEM_CONSTANT "SY_NSCVT" "0"
 SYSTEM_CONSTANT "SY_NSGEN" "2"
 SYSTEM_CONSTANT "SY_NSHTD" "1"
 SYSTEM_CONSTANT "SY_NSHTI" "0"
 SYSTEM_CONSTANT "SY_NSKO" "0"
 SYSTEM_CONSTANT "SY_NSLPH" "2"
 SYSTEM_CONSTANT "SY_NSLWR" "0"
 SYSTEM_CONSTANT "SY_NSPST" "1"
 SYSTEM_CONSTANT "SY_NSPTS" "0"
 SYSTEM_CONSTANT "SY_NSPWG" "0"
 SYSTEM_CONSTANT "SY_NSREC" "2"
 SYSTEM_CONSTANT "SY_NSRNG" "0"
 SYSTEM_CONSTANT "SY_NSSTR" "0"
 SYSTEM_CONSTANT "SY_NSTCU" "0"
 SYSTEM_CONSTANT "SY_NSTST" "0"
 SYSTEM_CONSTANT "SY_NSVSP" "0"
 SYSTEM_CONSTANT "SY_NSWIH" "1"
 SYSTEM_CONSTANT "SY_NTV" "0"
 SYSTEM_CONSTANT "SY_NVLD" "0"
 SYSTEM_CONSTANT "SY_NVRAMBK" "1"
 SYSTEM_CONSTANT "SY_NWFH" "0"
 SYSTEM_CONSTANT "SY_NWGA" "0"
 SYSTEM_CONSTANT "SY_NWGA2" "0"
 SYSTEM_CONSTANT "SY_NWGE" "1"
 SYSTEM_CONSTANT "SY_NWGE2" "0"
 SYSTEM_CONSTANT "SY_NWRA" "0"
 SYSTEM_CONSTANT "SY_NWRE" "1"
 SYSTEM_CONSTANT "SY_NWS" "0"
 SYSTEM_CONSTANT "SY_NWSA" "0"
 SYSTEM_CONSTANT "SY_NWSBE" "0"
 SYSTEM_CONSTANT "SY_NWSCL" "0"
 SYSTEM_CONSTANT "SY_NWSGVNW" "0"
 SYSTEM_CONSTANT "SY_NWSHSS" "0"
 SYSTEM_CONSTANT "SY_NWSKR" "0"
 SYSTEM_CONSTANT "SY_NWSSTA" "0"
 SYSTEM_CONSTANT "SY_NWSV" "0"
 SYSTEM_CONSTANT "SY_NWVPE" "0"
 SYSTEM_CONSTANT "SY_NXKFATM" "11"
 SYSTEM_CONSTANT "SY_NYKFATM" "11"
 SYSTEM_CONSTANT "SY_OBDBR05" "0"
 SYSTEM_CONSTANT "SY_OBMD" "0"
 SYSTEM_CONSTANT "SY_OSTERST" "1"
 SYSTEM_CONSTANT "SY_OSTEXMD" "0"
 SYSTEM_CONSTANT "SY_OSTNOFF" "0"
 SYSTEM_CONSTANT "SY_OTMERST" "0"
 SYSTEM_CONSTANT "SY_OVHP" "0"
 SYSTEM_CONSTANT "SY_PABMODU" "0"
 SYSTEM_CONSTANT "SY_PAFGBE" "0"
 SYSTEM_CONSTANT "SY_PBKVSEO" "0"
 SYSTEM_CONSTANT "SY_PEMDIA" "1"
 SYSTEM_CONSTANT "SY_PGRAD" "4"
 SYSTEM_CONSTANT "SY_PGRAD2" "0"
 SYSTEM_CONSTANT "SY_PGRAD3" "0"
 SYSTEM_CONSTANT "SY_PGRAD4" "0"
 SYSTEM_CONSTANT "SY_PID41" "0"
 SYSTEM_CONSTANT "SY_PID41A" "0"
 SYSTEM_CONSTANT "SY_PLNGFIL" "0"
 SYSTEM_CONSTANT "SY_PNWGTYP" "0"
 SYSTEM_CONSTANT "SY_POEL" "0"
 SYSTEM_CONSTANT "SY_PREDRV" "0"
 SYSTEM_CONSTANT "SY_PSF" "0"
 SYSTEM_CONSTANT "SY_PSMXAPP" "0"
 SYSTEM_CONSTANT "SY_PSR2SYN" "0"
 SYSTEM_CONSTANT "SY_PSTDRST" "1"
 SYSTEM_CONSTANT "SY_PSUV" "0"
 SYSTEM_CONSTANT "SY_PSWDASW" "0"
 SYSTEM_CONSTANT "SY_PTL" "0"
 SYSTEM_CONSTANT "SY_PTLHC" "0"
 SYSTEM_CONSTANT "SY_PTO" "0"
 SYSTEM_CONSTANT "SY_RDE" "1"
 SYSTEM_CONSTANT "SY_REDEX" "0"
 SYSTEM_CONSTANT "SY_REDMI" "0"
 SYSTEM_CONSTANT "SY_REDMX" "3"
 SYSTEM_CONSTANT "SY_REDSTAR" "0"
 SYSTEM_CONSTANT "SY_RHMLS" "0"
 SYSTEM_CONSTANT "SY_RLAPP" "1"
 SYSTEM_CONSTANT "SY_RLMDSRP" "0"
 SYSTEM_CONSTANT "SY_RLMXKV" "0"
 SYSTEM_CONSTANT "SY_RLRK" "1"
 SYSTEM_CONSTANT "SY_RLXDZW" "0"
 SYSTEM_CONSTANT "SY_RLXRED" "0"
 SYSTEM_CONSTANT "SY_RQMNUGA" "0"
 SYSTEM_CONSTANT "SY_RVS" "0"
 SYSTEM_CONSTANT "SY_RZSZ" "0"
 SYSTEM_CONSTANT "SY_SAGS" "0"
 SYSTEM_CONSTANT "SY_SALSU" "0"
 SYSTEM_CONSTANT "SY_SCG" "0"
 SYSTEM_CONSTANT "SY_SCH" "0"
 SYSTEM_CONSTANT "SY_SCHICHT" "0"
 SYSTEM_CONSTANT "SY_SCHUMZW" "0"
 SYSTEM_CONSTANT "SY_SCIO" "0"
 SYSTEM_CONSTANT "SY_SDFP" "0"
 SYSTEM_CONSTANT "SY_SGANLBS" "1"
 SYSTEM_CONSTANT "SY_SGANMTR" "0"
 SYSTEM_CONSTANT "SY_SGANZ" "1"
 SYSTEM_CONSTANT "SY_SGANZFR" "1"
 SYSTEM_CONSTANT "SY_SKH" "0"
 SYSTEM_CONSTANT "SY_SKR" "0"
 SYSTEM_CONSTANT "SY_SLPANZ" "0"
 SYSTEM_CONSTANT "SY_SLS" "0"
 SYSTEM_CONSTANT "SY_SLSHK" "0"
 SYSTEM_CONSTANT "SY_SLVANZ" "0"
 SYSTEM_CONSTANT "SY_SLVEST" "0"
 SYSTEM_CONSTANT "SY_SLVHW" "1"
 SYSTEM_CONSTANT "SY_SOOTBAL" "0"
 SYSTEM_CONSTANT "SY_SOTUN" "0"
 SYSTEM_CONSTANT "SY_SPRSTRT" "1"
 SYSTEM_CONSTANT "SY_SSPDKP" "1"
 SYSTEM_CONSTANT "SY_SSPPSR" "2"
 SYSTEM_CONSTANT "SY_SSPPSR2" "0"
 SYSTEM_CONSTANT "SY_SSTNW" "0"
 SYSTEM_CONSTANT "SY_ST10" "0"
 SYSTEM_CONSTANT "SY_STA" "0"
 SYSTEM_CONSTANT "SY_STADAP" "1"
 SYSTEM_CONSTANT "SY_STAEVAB" "0"
 SYSTEM_CONSTANT "SY_STARTDK" "1"
 SYSTEM_CONSTANT "SY_STASTO" "0"
 SYSTEM_CONSTANT "SY_STELRHE" "0"
 SYSTEM_CONSTANT "SY_STERBTS" "0"
 SYSTEM_CONSTANT "SY_STERFK" "0"
 SYSTEM_CONSTANT "SY_STERHK" "0"
 SYSTEM_CONSTANT "SY_STERSY" "0"
 SYSTEM_CONSTANT "SY_STERVK" "0"
 SYSTEM_CONSTANT "SY_STETLR" "0"
 SYSTEM_CONSTANT "SY_SU" "0"
 SYSTEM_CONSTANT "SY_SUKS" "0"
 SYSTEM_CONSTANT "SY_SUV" "0"
 SYSTEM_CONSTANT "SY_SVBB" "0"
 SYSTEM_CONSTANT "SY_SWE_B" "0"
 SYSTEM_CONSTANT "SY_SWE_C" "0"
 SYSTEM_CONSTANT "SY_SWE_K" "0"
 SYSTEM_CONSTANT "SY_SWE_S" "0"
 SYSTEM_CONSTANT "SY_TAHEVCH" "0"
 SYSTEM_CONSTANT "SY_TAKH" "0"
 SYSTEM_CONSTANT "SY_TANDK" "1"
 SYSTEM_CONSTANT "SY_TANSPOS" "1"
 SYSTEM_CONSTANT "SY_TASR" "1"
 SYSTEM_CONSTANT "SY_TAVDK" "0"
 SYSTEM_CONSTANT "SY_TAVDK2" "0"
 SYSTEM_CONSTANT "SY_TCNS" "0"
 SYSTEM_CONSTANT "SY_TCWJEC" "0"
 SYSTEM_CONSTANT "SY_TEBF" "0"
 SYSTEM_CONSTANT "SY_TEETH" "36"
 SYSTEM_CONSTANT "SY_TEKP" "0"
 SYSTEM_CONSTANT "SY_TEV5" "0"
 SYSTEM_CONSTANT "SY_TFA" "2"
 SYSTEM_CONSTANT "SY_TFA1CSD" "0"
 SYSTEM_CONSTANT "SY_TFA1HSC" "0"
 SYSTEM_CONSTANT "SY_TFA1PLD" "0"
 SYSTEM_CONSTANT "SY_TFA1POS" "1"
 SYSTEM_CONSTANT "SY_TFA1W" "0"
 SYSTEM_CONSTANT "SY_TFA2CSD" "0"
 SYSTEM_CONSTANT "SY_TFA2PLD" "0"
 SYSTEM_CONSTANT "SY_TFA2POS" "0"
 SYSTEM_CONSTANT "SY_TFA3POS" "0"
 SYSTEM_CONSTANT "SY_TFAJEC" "0"
 SYSTEM_CONSTANT "SY_TFAKON" "0"
 SYSTEM_CONSTANT "SY_TFAOPL" "1"
 SYSTEM_CONSTANT "SY_TFAST" "0"
 SYSTEM_CONSTANT "SY_TFATSTR" "0"
 SYSTEM_CONSTANT "SY_TFBA" "0"
 SYSTEM_CONSTANT "SY_TFLTKCD" "0"
 SYSTEM_CONSTANT "SY_TFLTNK" "0"
 SYSTEM_CONSTANT "SY_TFMO" "0"
 SYSTEM_CONSTANT "SY_TFNS" "0"
 SYSTEM_CONSTANT "SY_TFRK" "0"
 SYSTEM_CONSTANT "SY_TFST" "0"
 SYSTEM_CONSTANT "SY_TFUEL" "0"
 SYSTEM_CONSTANT "SY_TFUELCN" "0"
 SYSTEM_CONSTANT "SY_TFVA" "0"
 SYSTEM_CONSTANT "SY_TFWL" "0"
 SYSTEM_CONSTANT "SY_THMTUM" "0"
 SYSTEM_CONSTANT "SY_TKA" "0"
 SYSTEM_CONSTANT "SY_TKAA" "0"
 SYSTEM_CONSTANT "SY_TKKH" "0"
 SYSTEM_CONSTANT "SY_TKKHCN" "0"
 SYSTEM_CONSTANT "SY_TKKHCSD" "0"
 SYSTEM_CONSTANT "SY_TLAM" "0"
 SYSTEM_CONSTANT "SY_TLR" "0"
 SYSTEM_CONSTANT "SY_TLRARES" "0"
 SYSTEM_CONSTANT "SY_TMDR" "0"
 SYSTEM_CONSTANT "SY_TMKI" "0"
 SYSTEM_CONSTANT "SY_TMO2KA" "0"
 SYSTEM_CONSTANT "SY_TMOEZWS" "0"
 SYSTEM_CONSTANT "SY_TMOHKS" "0"
 SYSTEM_CONSTANT "SY_TMOHSST" "0"
 SYSTEM_CONSTANT "SY_TMOLAM" "0"
 SYSTEM_CONSTANT "SY_TMOLAMH" "0"
 SYSTEM_CONSTANT "SY_TMOLB" "0"
 SYSTEM_CONSTANT "SY_TMOMDI" "0"
 SYSTEM_CONSTANT "SY_TMORRI" "0"
 SYSTEM_CONSTANT "SY_TMOTFIL" "1"
 SYSTEM_CONSTANT "SY_TMRWEX" "0"
 SYSTEM_CONSTANT "SY_TMTTMON" "0"
 SYSTEM_CONSTANT "SY_TNLS" "0"
 SYSTEM_CONSTANT "SY_TOCH" "1"
 SYSTEM_CONSTANT "SY_TOSP" "1"
 SYSTEM_CONSTANT "SY_TOSPCN" "0"
 SYSTEM_CONSTANT "SY_TOSPCSD" "0"
 SYSTEM_CONSTANT "SY_TOSPMAI" "0"
 SYSTEM_CONSTANT "SY_TOSPPLD" "0"
 SYSTEM_CONSTANT "SY_TPEACNR" "0"
 SYSTEM_CONSTANT "SY_TPEFWG" "0"
 SYSTEM_CONSTANT "SY_TPEMF" "0"
 SYSTEM_CONSTANT "SY_TSPHK" "0"
 SYSTEM_CONSTANT "SY_TTEV" "0"
 SYSTEM_CONSTANT "SY_TUMG" "2"
 SYSTEM_CONSTANT "SY_TUMSIC" "0"
 SYSTEM_CONSTANT "SY_TURBO" "0"
 SYSTEM_CONSTANT "SY_TWDKS" "0"
 SYSTEM_CONSTANT "SY_TWSLP" "0"
 SYSTEM_CONSTANT "SY_UB1ADC" "1"
 SYSTEM_CONSTANT "SY_UBDEDIQ" "65"
 SYSTEM_CONSTANT "SY_UBDEEN" "79"
 SYSTEM_CONSTANT "SY_UBDEENQ" "75"
 SYSTEM_CONSTANT "SY_UBR" "1"
 SYSTEM_CONSTANT "SY_UBSQ_W" "965"
 SYSTEM_CONSTANT "SY_UHR" "0"
 SYSTEM_CONSTANT "SY_UKAT" "0"
 SYSTEM_CONSTANT "SY_UKAT2" "0"
 SYSTEM_CONSTANT "SY_UKAUFL" "0"
 SYSTEM_CONSTANT "SY_VAR" "0"
 SYSTEM_CONSTANT "SY_VARCODE" "0"
 SYSTEM_CONSTANT "SY_VARL" "0"
 SYSTEM_CONSTANT "SY_VARTEST" "0"
 SYSTEM_CONSTANT "SY_VD" "0"
 SYSTEM_CONSTANT "SY_VDEO" "0"
 SYSTEM_CONSTANT "SY_VHE" "0"
 SYSTEM_CONSTANT "SY_VS" "0"
 SYSTEM_CONSTANT "SY_VVT" "0"
 SYSTEM_CONSTANT "SY_WFP" "0"
 SYSTEM_CONSTANT "SY_WFS" "0"
 SYSTEM_CONSTANT "SY_WMIN" "-48"
 SYSTEM_CONSTANT "SY_WNWADM" "0"
 SYSTEM_CONSTANT "SY_ZAGPATTERNMX" "10"
 SYSTEM_CONSTANT "SY_ZAMSDK" "0"
 SYSTEM_CONSTANT "SY_ZAS" "0"
 SYSTEM_CONSTANT "SY_ZBLRELS" "0"
 SYSTEM_CONSTANT "SY_ZCSTCW" "1"
 SYSTEM_CONSTANT "SY_ZCSTES" "0"
 SYSTEM_CONSTANT "SY_ZCSTFA1" "0"
 SYSTEM_CONSTANT "SY_ZCSTFA2" "0"
 SYSTEM_CONSTANT "SY_ZCSTFLT" "0"
 SYSTEM_CONSTANT "SY_ZCSTKKH" "0"
 SYSTEM_CONSTANT "SY_ZCSTOSP" "0"
 SYSTEM_CONSTANT "SY_ZCSTUM" "0"
 SYSTEM_CONSTANT "SY_ZEL" "0"
 SYSTEM_CONSTANT "SY_ZGST" "0"
 SYSTEM_CONSTANT "SY_ZMS" "0"
 SYSTEM_CONSTANT "SY_ZNDAUS" "1"
 SYSTEM_CONSTANT "SY_ZYLOFFH" "0"
 SYSTEM_CONSTANT "SY_ZYLOFFS" "0"
 SYSTEM_CONSTANT "SY_ZYLZA" "3"
 SYSTEM_CONSTANT "SY_ZYLZG" "3"
 SYSTEM_CONSTANT "SY_ZZBANK" "0"
 SYSTEM_CONSTANT "SY_ZZBANKB" "0"
 SYSTEM_CONSTANT "SY_ZZBANKC" "0"
 SYSTEM_CONSTANT "SY_ZZLAM" "0"
 SYSTEM_CONSTANT "SY_ZZRL" "0"
 SYSTEM_CONSTANT "SY_ZZSG" "0"
 SYSTEM_CONSTANT "SY_ZZYLB1" "3"
 SYSTEM_CONSTANT "SY_ZZYLB2" "0"
 SYSTEM_CONSTANT "T15_ATS_SY" "0"
 SYSTEM_CONSTANT "T15_DBGMD_DD_SY" "0"
 SYSTEM_CONSTANT "T15_DBGMD_VD_SY" "0"
 SYSTEM_CONSTANT "T15_ON_VLDT_COM_SY" "0"
 SYSTEM_CONSTANT "T50_STRTREQ_BP" "0"
 SYSTEM_CONSTANT "T50_ST_BP" "0"
 SYSTEM_CONSTANT "TCAT2DMDL_SC" "0"
 SYSTEM_CONSTANT "TCSOVRDSTSCINC_SY" "0"
 SYSTEM_CONSTANT "TCS_OVRDS_TSCINC" "1"
 SYSTEM_CONSTANT "TDC_ADAP_SY" "0"
 SYSTEM_CONSTANT "TDC_UNEQLGEOM_SY" "0"
 SYSTEM_CONSTANT "TEMPCELS_100MS_RES_REV" "1"
 SYSTEM_CONSTANT "TEMPCELS_FINE_RES" "0.001"
 SYSTEM_CONSTANT "TEMP_20_CELS" "20"
 SYSTEM_CONSTANT "TEMP_CELS_RES" "0.1"
 SYSTEM_CONSTANT "TEMP_CELS_ZERO" "0"
 SYSTEM_CONSTANT "TEMP_KELV_SEC_CTT_MON_RES" "0"
 SYSTEM_CONSTANT "TEMP_KELV_SEC_CTT_MON_RES_REV" "40960"
 SYSTEM_CONSTANT "TEMP_NULL_C" "-273.14"
 SYSTEM_CONSTANT "TEMP_NULL_F" "-459.652"
 SYSTEM_CONSTANT "TEMP_RES" "0.1"
 SYSTEM_CONSTANT "TEMP_RES1" "0.01"
 SYSTEM_CONSTANT "TEMP_RES_REV" "10"
 SYSTEM_CONSTANT "TEMP_WVCOR_MAX" "140"
 SYSTEM_CONSTANT "TEMP_WVCOR_MIN" "-40"
 SYSTEM_CONSTANT "TEMP_ZERO" "-273.14"
 SYSTEM_CONSTANT "THMMNG_SY" "0"
 SYSTEM_CONSTANT "THMPMP_SY" "0"
 SYSTEM_CONSTANT "THRVLV_SENSCAL_SY" "1"
 SYSTEM_CONSTANT "TIMEDELAY32TO15_FACT" "8"
 SYSTEM_CONSTANT "TIMEDELAY_S_2_MIN" "0.001"
 SYSTEM_CONSTANT "TIMEDELAY_S_2_NRM" "8"
 SYSTEM_CONSTANT "TIMEDELAY_S_LIN_16_2_MAX" "250"
 SYSTEM_CONSTANT "TIMEDELAY_S_LIN_16_2_RES" "0.0076296273689993"
 SYSTEM_CONSTANT "TIMEDELAY_S_LIN_16_MAX" "5"
 SYSTEM_CONSTANT "TIMEDELAY_S_LIN_16_MAX_ASDDC" "1.5"
 SYSTEM_CONSTANT "TIMEDELAY_S_LIN_16_MAX_ASDRF" "1.5"
 SYSTEM_CONSTANT "TIMEDELAY_S_LIN_16_REC_RES" "4294.967296"
 SYSTEM_CONSTANT "TIMEDELAY_S_LIN_16_RES" "0.000152592547379986"
 SYSTEM_CONSTANT "TIMEDELAY_S_NRM1" "4294967296"
 SYSTEM_CONSTANT "TIMEDELAY_S_NRM2" "100000"
 SYSTEM_CONSTANT "TIMEDT_RES" "1e-006"
 SYSTEM_CONSTANT "TIMEDT_RES_REV" "1000000"
 SYSTEM_CONSTANT "TIME_100ms_CYCLE" "100000"
 SYSTEM_CONSTANT "TIME_100US_RES" "100"
 SYSTEM_CONSTANT "TIME_10ms_CYCLE" "10000"
 SYSTEM_CONSTANT "TIME_20ms_CYCLE" "20000"
 SYSTEM_CONSTANT "TIME_4S_RES" "4"
 SYSTEM_CONSTANT "TIME_DEB_RES" "10"
 SYSTEM_CONSTANT "TIME_DEB_ZERO" "0"
 SYSTEM_CONSTANT "TIME_DT_100MS" "100000"
 SYSTEM_CONSTANT "TIME_DT_10MS" "10000"
 SYSTEM_CONSTANT "TIME_DT_1MS" "1000"
 SYSTEM_CONSTANT "TIME_DT_200MS" "200000"
 SYSTEM_CONSTANT "TIME_DT_20MS" "20000"
 SYSTEM_CONSTANT "TIME_DT_RES" "1"
 SYSTEM_CONSTANT "TIME_DT_S" "1000000"
 SYSTEM_CONSTANT "TIME_DT_ZERO" "0"
 SYSTEM_CONSTANT "TIME_ENG_ON_RES" "1"
 SYSTEM_CONSTANT "TIME_GPTA_CLOCK_50ns" "0.05"
 SYSTEM_CONSTANT "TIME_GT0_CLOCK_400ns" "0.0004"
 SYSTEM_CONSTANT "TIME_HI_RES" "0.125"
 SYSTEM_CONSTANT "TIME_HI_RES_REV" "8"
 SYSTEM_CONSTANT "TIME_MS_100MS_RES" "100"
 SYSTEM_CONSTANT "TIME_MS_10MS_RES" "10"
 SYSTEM_CONSTANT "TIME_MS_20MS_RES" "20"
 SYSTEM_CONSTANT "TIME_MS_MAX" "327460"
 SYSTEM_CONSTANT "TIME_MS_SMAX" "327460"
 SYSTEM_CONSTANT "TIME_MS_ZERO" "0"
 SYSTEM_CONSTANT "TIME_PWM_HIGH_RES" "5e-008"
 SYSTEM_CONSTANT "TIME_RED_MAX" "3600"
 SYSTEM_CONSTANT "TIME_RED_NRM" "4"
 SYSTEM_CONSTANT "TIME_RED_RES" "0.16"
 SYSTEM_CONSTANT "TIME_RED_RES_REV" "6.25"
 SYSTEM_CONSTANT "TIME_RED_ZERO" "0"
 SYSTEM_CONSTANT "TIME_RES_FL" "1e-006"
 SYSTEM_CONSTANT "TIME_RTMLO_RES" "0.1"
 SYSTEM_CONSTANT "TIME_RTMLO_RES_REV" "10"
 SYSTEM_CONSTANT "TIME_SAMPLING" "0.01"
 SYSTEM_CONSTANT "TIME_S_1_RES" "0.001"
 SYSTEM_CONSTANT "TIME_S_MAX" "327.46"
 SYSTEM_CONSTANT "TIME_S_MAXS32" "2147.483647"
 SYSTEM_CONSTANT "TIME_S_RES_REV" "100"
 SYSTEM_CONSTANT "TIME_S_ZERO" "0"
 SYSTEM_CONSTANT "TIME_TICK" "10"
 SYSTEM_CONSTANT "TIME_TICK_SEC_INV" "100"
 SYSTEM_CONSTANT "TIME_U16MAX" "655.35"
 SYSTEM_CONSTANT "TIME_U16MIN" "0"
 SYSTEM_CONSTANT "TIME_US_400NS_RES" "400"
 SYSTEM_CONSTANT "TIME_US_RES" "1"
 SYSTEM_CONSTANT "TIME_US_ZERO" "0"
 SYSTEM_CONSTANT "TIPIN_SY" "0"
 SYSTEM_CONSTANT "TI_DIFF_HYD_MAX" "5000"
 SYSTEM_CONSTANT "TI_DIFF_HYD_MIN" "-5000"
 SYSTEM_CONSTANT "TLE6232_SY" "1"
 SYSTEM_CONSTANT "TLE7209_SY" "0"
 SYSTEM_CONSTANT "TLE8209_SY" "1"
 SYSTEM_CONSTANT "TME_VAR_SY" "243"
 SYSTEM_CONSTANT "TMFWPRT_SY" "0"
 SYSTEM_CONSTANT "TmotQnts_SY" "0"
 SYSTEM_CONSTANT "TOTALNUMEXHBNK_SY" "1"
 SYSTEM_CONSTANT "TPROT_FINGERPRINT_SY" "0"
 SYSTEM_CONSTANT "TQRESL_SC" "0"
 SYSTEM_CONSTANT "TRANOIPRV_SY" "0"
 SYSTEM_CONSTANT "TRANSPTMODE_SY" "0"
 SYSTEM_CONSTANT "TRANS_R_MAX" "32767"
 SYSTEM_CONSTANT "TRANS_R_ONE" "1"
 SYSTEM_CONSTANT "TRANS_R_RES" "0.01"
 SYSTEM_CONSTANT "TRANS_R_RES_REV" "100"
 SYSTEM_CONSTANT "TRANS_R_ZERO" "0"
 SYSTEM_CONSTANT "TRAPRT_OVRDS_DCS" "0"
 SYSTEM_CONSTANT "TRATYPE_MT_SY" "0"
 SYSTEM_CONSTANT "TRA_AST" "2"
 SYSTEM_CONSTANT "TRA_AST_SY" "0"
 SYSTEM_CONSTANT "TRA_AT" "1"
 SYSTEM_CONSTANT "TRA_AT_SY" "0"
 SYSTEM_CONSTANT "TRA_CVT" "3"
 SYSTEM_CONSTANT "TRA_CVT_SY" "0"
 SYSTEM_CONSTANT "TRA_DCT" "4"
 SYSTEM_CONSTANT "TRA_DCT_SY" "0"
 SYSTEM_CONSTANT "TRA_INTERLOCK_SY" "0"
 SYSTEM_CONSTANT "TRA_MT" "0"
 SYSTEM_CONSTANT "TRA_MTNOGEARDET_CLB" "2"
 SYSTEM_CONSTANT "TRA_MTNOGEARDET_CUST" "1"
 SYSTEM_CONSTANT "TRA_MTNOGEARDET_STANDARD" "0"
 SYSTEM_CONSTANT "TRA_MT_SY" "1"
 SYSTEM_CONSTANT "TRA_STAST_PARTLY_BP" "11"
 SYSTEM_CONSTANT "TRA_STTII_PARTLY_BP" "0"
 SYSTEM_CONSTANT "TRA_STTSC_PARTLY_BP" "0"
 SYSTEM_CONSTANT "TRBCH_CAN_SY" "0"
 SYSTEM_CONSTANT "TRNVRSACC_RES" "0.01"
 SYSTEM_CONSTANT "TRQBRK_MIN" "0"
 SYSTEM_CONSTANT "TRQBS_WOINTV_SY" "0"
 SYSTEM_CONSTANT "TRQBS_WOTRAINTV_SY" "0"
 SYSTEM_CONSTANT "TRQCONV_SY" "0"
 SYSTEM_CONSTANT "TRQDHIGH_RES" "960"
 SYSTEM_CONSTANT "TRQDT_RES" "1"
 SYSTEM_CONSTANT "TRQINF_SY" "0"
 SYSTEM_CONSTANT "TRQINRFACT_RES" "256"
 SYSTEM_CONSTANT "TRQLIMCOORD2ECU_SY" "0"
 SYSTEM_CONSTANT "TRQPERFLQNT_RES" "0.01"
 SYSTEM_CONSTANT "TRQPRPHIGH_MAX" "50000"
 SYSTEM_CONSTANT "TRQPRPHIGH_MIN" "-50000"
 SYSTEM_CONSTANT "TRQPRPHIGH_RES" "0.1"
 SYSTEM_CONSTANT "TRQPRPHIGH_RES_REV" "10"
 SYSTEM_CONSTANT "TRQPRPHIGH_ZERO" "0"
 SYSTEM_CONSTANT "TRQPRP_NRM" "4"
 SYSTEM_CONSTANT "TRQPRP_RES" "1.6"
 SYSTEM_CONSTANT "TRQPRP_RMP_RES" "6553.6"
 SYSTEM_CONSTANT "TRQPRP_ZERO" "0"
 SYSTEM_CONSTANT "TRQRESV_CONST_SY" "0"
 SYSTEM_CONSTANT "TRQRESV_CP_SY" "0"
 SYSTEM_CONSTANT "TRQRESV_ETAREQ_SY" "1"
 SYSTEM_CONSTANT "TRQRESV_EXL_SY" "0"
 SYSTEM_CONSTANT "TRQRNG_EXL_SY" "0"
 SYSTEM_CONSTANT "TRQTONSQR_RES" "1e-007"
 SYSTEM_CONSTANT "TRQWHL_ZERO" "0"
 SYSTEM_CONSTANT "TRQXDHIGH_RES" "256"
 SYSTEM_CONSTANT "TRQ_50" "50"
 SYSTEM_CONSTANT "TRQ_FRC_INI" "-50"
 SYSTEM_CONSTANT "TRQ_INIT" "1022"
 SYSTEM_CONSTANT "TRQ_MAX" "1000"
 SYSTEM_CONSTANT "TRQ_MIN" "-3276.8"
 SYSTEM_CONSTANT "TRQ_MONLIM_CNT_SY" "0"
 SYSTEM_CONSTANT "TRQ_MONLIM_DIAG_SY" "0"
 SYSTEM_CONSTANT "TRQ_M_100" "-100"
 SYSTEM_CONSTANT "TRQ_RES" "0.1"
 SYSTEM_CONSTANT "TRQ_RES_FL" "0.1"
 SYSTEM_CONSTANT "TRQ_RES_REV" "10"
 SYSTEM_CONSTANT "TRQ_WOTRAINTV_SY" "0"
 SYSTEM_CONSTANT "TRQ_ZERO" "0"
 SYSTEM_CONSTANT "TSCDEC_OVRDS_DCS" "0"
 SYSTEM_CONSTANT "TSCINC_OVRDS_DFFTLPRT" "0"
 SYSTEM_CONSTANT "TSCINC_OVRDS_TCS" "0"
 SYSTEM_CONSTANT "TS_CTTMON_SY" "0"
 SYSTEM_CONSTANT "TS_HPPMPPRT_SY" "0"
 SYSTEM_CONSTANT "TS_INTRCLRCO_SY" "0"
 SYSTEM_CONSTANT "TS_LOTEMPRADCO_SY" "0"
 SYSTEM_CONSTANT "TS_LTCCIRMON_SY" "0"
 SYSTEM_CONSTANT "TURBODN_RES" "500"
 SYSTEM_CONSTANT "TURBON_RES" "10"
 SYSTEM_CONSTANT "TWCCBALUP_SY" "0"
 SYSTEM_CONSTANT "TWCCMODLNBAL_SY" "0"
 SYSTEM_CONSTANT "TWCCModlnBal_SY" "0"
 SYSTEM_CONSTANT "TWCCOBDFUELTRIM_SY" "1"
 SYSTEM_CONSTANT "TWCCPRIB1_SY" "2"
 SYSTEM_CONSTANT "TWCCPRIB2_SY" "0"
 SYSTEM_CONSTANT "TWCCPRINF_SY" "0"
 SYSTEM_CONSTANT "TWCCPriNF_SY" "0"
 SYSTEM_CONSTANT "TWCCSCNDB1_SY" "0"
 SYSTEM_CONSTANT "TWCCSCNDB2_SY" "0"
 SYSTEM_CONSTANT "TWCDCATHEATGREQ_SY" "0"
 SYSTEM_CONSTANT "TWCDEWMA_SY" "0"
 SYSTEM_CONSTANT "TWCDMODCMPPRIB1_SY" "1"
 SYSTEM_CONSTANT "TWCDMODCMPPRIB2_SY" "0"
 SYSTEM_CONSTANT "TWCDMODCMPSCNDB1_SY" "0"
 SYSTEM_CONSTANT "TWCDMODCMPSCNDB2_SY" "0"
 SYSTEM_CONSTANT "TWCDOSCPAPRIB1_SY" "0"
 SYSTEM_CONSTANT "TWCDOSCPAPRIB2_SY" "0"
 SYSTEM_CONSTANT "TWCDOSCPASCNDB1_SY" "0"
 SYSTEM_CONSTANT "TWCDOSCPASCNDB2_SY" "0"
 SYSTEM_CONSTANT "TWCDOSCPATST_SY" "0"
 SYSTEM_CONSTANT "TWCDOSCPRIB1_SY" "0"
 SYSTEM_CONSTANT "TWCDOSCPRIB2_SY" "0"
 SYSTEM_CONSTANT "TWCDOSCSCNDB1_SY" "0"
 SYSTEM_CONSTANT "TWCDOSCSCNDB2_SY" "0"
 SYSTEM_CONSTANT "TWCDPATST_SY" "0"
 SYSTEM_CONSTANT "TWCDRSCPATST_SY" "0"
 SYSTEM_CONSTANT "TWCDRSCPRIB1_SY" "0"
 SYSTEM_CONSTANT "TWCDRSCPRIB2_SY" "0"
 SYSTEM_CONSTANT "TWCDRSCSCNDB1_SY" "0"
 SYSTEM_CONSTANT "TWCDRSCSCNDB2_SY" "0"
 SYSTEM_CONSTANT "TWCDRSCTHRDB1_SY" "0"
 SYSTEM_CONSTANT "TWCDRSCTHRDB2_SY" "0"
 SYSTEM_CONSTANT "TWCD_STRATIUMPRSIMN_SC" "0"
 SYSTEM_CONSTANT "TWC_NmngCnvtn_SC" "1"
 SYSTEM_CONSTANT "TWC_VAR_SY" "243"
 SYSTEM_CONSTANT "TWO_PI" "314.159265359"
 SYSTEM_CONSTANT "TWO_PI_FACT" "6.2832"
 SYSTEM_CONSTANT "TWO_POW_KD_1_NRM" "128"
 SYSTEM_CONSTANT "TWO_POW_KI_1_NRM" "32"
 SYSTEM_CONSTANT "TWO_POW_KP_1_NRM" "512"
 SYSTEM_CONSTANT "TWO_POW_NRM_EXP_RES_TRIGO_FUNC" "4096"
 SYSTEM_CONSTANT "TWO_POW_TIMEDELAY_S_2_NRM" "256"
 SYSTEM_CONSTANT "T_1SEC_RESO_SY" "1000000"
 SYSTEM_CONSTANT "T_AIR_MAX" "199.86"
 SYSTEM_CONSTANT "T_AIR_MIN" "-50.14"
 SYSTEM_CONSTANT "T_CLNT_MAX" "149.86"
 SYSTEM_CONSTANT "T_CLNT_MIN" "-50.14"
 SYSTEM_CONSTANT "T_CLNT_MIN1" "-50.14"
 SYSTEM_CONSTANT "T_ENG_MAX" "199.86"
 SYSTEM_CONSTANT "T_ENG_MIN" "-50.14"
 SYSTEM_CONSTANT "T_FUEL_MAX" "149.86"
 SYSTEM_CONSTANT "T_FUEL_MIN" "-50.14"
 SYSTEM_CONSTANT "UART_SY" "0"
 SYSTEM_CONSTANT "UBATT_ADC_REF" "20000"
 SYSTEM_CONSTANT "UBFAILSRC_SY" "0"
 SYSTEM_CONSTANT "UEGO_S1B1_SY" "0"
 SYSTEM_CONSTANT "U_ADC_MAX" "5200"
 SYSTEM_CONSTANT "U_ADC_MIN" "0"
 SYSTEM_CONSTANT "U_ADC_REF" "5000"
 SYSTEM_CONSTANT "U_RATED" "14000"
 SYSTEM_CONSTANT "U_RATED_PASS" "14000"
 SYSTEM_CONSTANT "U_RATED_TRUCK" "28000"
 SYSTEM_CONSTANT "V2N_NORM" "2000"
 SYSTEM_CONSTANT "V2N_RES" "1e-005"
 SYSTEM_CONSTANT "V2N_ZERO" "0"
 SYSTEM_CONSTANT "VARCOD_SY" "0"
 SYSTEM_CONSTANT "VDDC_ERROR" "0"
 SYSTEM_CONSTANT "VDDC_MODE0" "0"
 SYSTEM_CONSTANT "VDDC_MODE1" "1"
 SYSTEM_CONSTANT "VDDC_MODE2" "2"
 SYSTEM_CONSTANT "VDDC_MODE3" "3"
 SYSTEM_CONSTANT "VDDC_SHUTDOWN" "9"
 SYSTEM_CONSTANT "VEHMOT_DCS_MSK" "0"
 SYSTEM_CONSTANT "VEHMOT_PI" "3.14159562"
 SYSTEM_CONSTANT "VEHMOT_TCS_MSK" "0"
 SYSTEM_CONSTANT "VEHM_VAR_SY" "243"
 SYSTEM_CONSTANT "VEHVBR3_SY" "0"
 SYSTEM_CONSTANT "VEHVPWMOUT_SC" "0"
 SYSTEM_CONSTANT "VEHVSRC_SY" "0"
 SYSTEM_CONSTANT "VEHV_CT_VRAW" "5"
 SYSTEM_CONSTANT "VEHV_CT_VRAW_MIN" "1"
 SYSTEM_CONSTANT "VEHV_FCOPLAUS_SY" "0"
 SYSTEM_CONSTANT "VEHV_NUMTTHWHL_SY" "4"
 SYSTEM_CONSTANT "VEHV_OBDPLAUS_SY" "0"
 SYSTEM_CONSTANT "VEHV_PHASE_VRAW" "10"
 SYSTEM_CONSTANT "VEHV_PHASE_VRAW_MIN" "0"
 SYSTEM_CONSTANT "VEHV_PHYSRNGCHK_SY" "0"
 SYSTEM_CONSTANT "VEHV_PWMCFG_SC" "1"
 SYSTEM_CONSTANT "VEHV_TIPER_MAX" "671088.6"
 SYSTEM_CONSTANT "VEH_MASS_RES" "0.1"
 SYSTEM_CONSTANT "VEH_MASS_RES_REV" "10"
 SYSTEM_CONSTANT "VEH_MASS_ZERO" "0"
 SYSTEM_CONSTANT "VEL_MAX" "300"
 SYSTEM_CONSTANT "VEL_MIN" "0"
 SYSTEM_CONSTANT "VEL_RES" "0.01"
 SYSTEM_CONSTANT "VEL_RES_REV" "100"
 SYSTEM_CONSTANT "VEL_RES_SI" "0.00277777777777778"
 SYSTEM_CONSTANT "VEL_ZERO" "0"
 SYSTEM_CONSTANT "VERSSTOPMISFGDETNBYINJ_SY" "0"
 SYSTEM_CONSTANT "VLVI_SY" "0"
 SYSTEM_CONSTANT "VMD_LEADPTHCALCENA_SY" "0"
 SYSTEM_CONSTANT "VMSI_DCS_BP" "0"
 SYSTEM_CONSTANT "VMSI_STDCS_PARTLY_BP" "11"
 SYSTEM_CONSTANT "VMSI_STTCS_PARTLY_BP" "11"
 SYSTEM_CONSTANT "VMSI_TCS_BP" "0"
 SYSTEM_CONSTANT "VOLCYL_RES" "1"
 SYSTEM_CONSTANT "VOLCYL_RES_REV" "1"
 SYSTEM_CONSTANT "VOLFILGLVL_ZERO" "0"
 SYSTEM_CONSTANT "VOLT_ADC_RES" "0.2"
 SYSTEM_CONSTANT "VOLT_ADC_RES_REV" "5"
 SYSTEM_CONSTANT "VOLT_ADC_ZERO" "0"
 SYSTEM_CONSTANT "VOLT_BATT_RES" "20"
 SYSTEM_CONSTANT "VOLT_BATT_RES_REV" "0.05"
 SYSTEM_CONSTANT "VOLT_BATT_ZERO" "0"
 SYSTEM_CONSTANT "VOLT_Q0P002_RES" "0.002"
 SYSTEM_CONSTANT "VOL_FILGLVL_RES" "1"
 SYSTEM_CONSTANT "VOL_FILGLVL_RES_REV" "1"
 SYSTEM_CONSTANT "VOL_FL_RES_FINE" "0.001"
 SYSTEM_CONSTANT "VOL_FL_RES_FINE_REV" "1000"
 SYSTEM_CONSTANT "VOL_RES" "0.01"
 SYSTEM_CONSTANT "VOL_RES_REV" "100"
 SYSTEM_CONSTANT "VS_SY" "0"
 SYSTEM_CONSTANT "WAHTEL_SWTHWORCAN_SY" "0"
 SYSTEM_CONSTANT "WAHTFL_SY" "0"
 SYSTEM_CONSTANT "WAHT_RALTLDHI_CURX" "6"
 SYSTEM_CONSTANT "WAHT_RALTLDLO_CURX" "6"
 SYSTEM_CONSTANT "WAHT_SY" "0"
 SYSTEM_CONSTANT "WAPMP_SY" "0"
 SYSTEM_CONSTANT "WNTR_SY" "0"
 SYSTEM_CONSTANT "XCP_SY" "0"
 SYSTEM_CONSTANT "XDI_SC" "0" /end MOD_PAR
/begin MOD_COMMON "" BYTE_ORDER MSB_LAST ALIGNMENT_BYTE 1 ALIGNMENT_WORD 2 ALIGNMENT_LONG 4 ALIGNMENT_FLOAT32_IEEE 4 /end MOD_COMMON
/begin IF_DATA ASAP1B_Bypass
 /begin TP_BLOB 0x100 /* Bypass version */ 0x100 /* Blob version */ /end TP_BLOB
/end IF_DATA
/begin IF_DATA ASAP1B_CCP
 /begin SOURCE "segment synchronous" 103 1 /begin QP_BLOB 0 LENGTH 10 CAN_ID_FIXED 0x7C7 FIRST_PID 0 RASTER 0 /end QP_BLOB /end SOURCE
 /begin SOURCE "10ms time synchronous" 4 1 /begin QP_BLOB 1 LENGTH 15 CAN_ID_FIXED 0x7C5 FIRST_PID 10 RASTER 1 /end QP_BLOB /end SOURCE
 /begin SOURCE "100ms time synchronous" 4 10 /begin QP_BLOB 2 LENGTH 15 CAN_ID_FIXED 0x7C6 FIRST_PID 25 RASTER 2 /end QP_BLOB /end SOURCE
 /begin RASTER "segment synchronous" "seg_sync" 0 103 1 /end RASTER
 /begin RASTER "10ms time synchronous" "10_ms" 1 4 1 /end RASTER
 /begin RASTER "100ms time synchronous" "100_ms" 2 4 10 /end RASTER
 /begin SEED_KEY /* seed&key dll for CAL */ "" /* seed&key dll for DAQ */ "" /* seed&key dll for PGM */ "" /end SEED_KEY
 /begin TP_BLOB /* CCP version */ 0x201 /* Blob version */ 0x204 /* CAN msg ID-send */ 0x7C3 /* CAN msg ID-recv */ 0x7C4 /* station address */ 0xAD01 /* byte order */ 2 BAUDRATE 1000000 /* in Hz */ SAMPLE_POINT 80 /* in % */ SAMPLE_RATE 1 /* 1 or 3 */ BTL_CYCLES 10 SJW 1 SYNC_EDGE SINGLE /* SINGLE or DUAL */ DAQ_MODE BURST CONSISTENCY DAQ
  /begin CHECKSUM_PARAM /* algorithm */ 0xC001 /* limit */ 0xFFFFFFFF CHECKSUM_CALCULATION ACTIVE_PAGE /end CHECKSUM_PARAM
  /begin DEFINED_PAGES /* page number */ 1 /* page name */ "reference page" /* address ext. */ 0x0 /* base address */ 0x80040000 /* page length */ 0x3FF04 ROM /end DEFINED_PAGES
  /begin DEFINED_PAGES /* page number */ 2 /* page name */ "working page" /* address ext. */ 0x0 /* base address */ 0x40000 /* page length */ 0x3FF04 RAM RAM_INIT_BY_ECU /end DEFINED_PAGES
  OPTIONAL_CMD 0x8 /* START_STOP_ALL */ OPTIONAL_CMD 0x9 /* GET_ACTIVE_CAL_PAGE */ OPTIONAL_CMD 0xC /* SET_S_STATUS */ OPTIONAL_CMD 0xD /* GET_S_STATUS */ OPTIONAL_CMD 0xE /* BUILD_CHKSUM */ OPTIONAL_CMD 0xF /* SHORT_UP */ OPTIONAL_CMD 0x11 /* SELECT_CAL_PAGE */ OPTIONAL_CMD 0x12 /* GET_SEED */ OPTIONAL_CMD 0x13 /* UNLOCK */ OPTIONAL_CMD 0x19 /* MOVE */ OPTIONAL_CMD 0x20 /* DIAG_SERVICE */ OPTIONAL_CMD 0x23 /* DNLOAD_6 */ /end TP_BLOB
/end IF_DATA
/begin IF_DATA ETK
 /begin SOURCE "segment synchronous" 103 1 QP_BLOB 0x102 1 DIRECT 32 MEASUREMENT 0x0 512 0xAFF00158 0xAFF00D78 0 0x0 0x0 1500 256 0 1 /end SOURCE
 /begin SOURCE "10ms time synchronous" 4 1 QP_BLOB 0x102 2 DIRECT 31 MEASUREMENT 0x0 512 0xAFF00560 0xAFF00F78 0 0x0 0x0 9000 256 0 2 /end SOURCE
 /begin SOURCE "100ms time synchronous" 5 1 QP_BLOB 0x102 3 DIRECT 30 MEASUREMENT 0x0 512 0xAFF00968 0xAFF01178 0 0x0 0x0 90000 256 0 3 /end SOURCE
 /begin TP_BLOB /* version */ 0x1000104 /* interface speed */ INTERFACE_SPEED_100MBIT /* reset_cfg - only MPC */ 0x7FFFFF07 /* not used for TriCore */ DISTAB_CFG /* Distab Type */ 13 /* Distab Data type */ 0x122 /* ByteOrder 1=LSB last */ 0x2 /* Trigger Segment Adr */ 0x0 /* Trigger Configuration*/ 0x01010100 TRG_MOD /*Id:*/ 0x0 /*trg_mod:*/ 0xFF 0x0 0x0 0x0 ETK_CFG 0x10 0x19 0x61 0x01 0x01 0xFF 0xFF 0x63 0xCD 0x7F 0x81 0x64 0x0B 0x65 0x8C 0x66 0xA0 0x67 0x91 0x68 0x9E 0x78 0x79 0x7C 0x79 RESERVED_DISTAB_MEMORY /* start_addr */ 0x80040078 /* length */ 0x0 /* location */ EXTERN /* application */ MEASUREMENT /* usage */ CHECKSUM_EXCLUDE_ONLY /* mirrors */ 0xFFFFFFFF 0xFFFFFFFF 0xFFFFFFFF 0xFFFFFFFF 0xFFFFFFFF
  /begin COLDSTART_HANDSHAKE /* Address of ETKS coldstart pattern */ 0xAFF00148 WAIT /* Dyn. length for wait pattern */ 0xE5 0xAD 0xEC 0x4D READY /* Dyn. length for ready pattern */ 0xDE 0xC0 0xED 0xFE /end COLDSTART_HANDSHAKE
  CAL_WAKEUP /* 1 = wake up enabled, 0=disabled */ CAL_WAKEUP_PIN 1 CAL_TOOL_PRESENT /* address for the pattern */ 0xAFF00150 /* CAL_TOOL_PRESENT_PATTERN */ 0x12345678 /* ECU timeout for shutdown in s */ 2 PAGE_SWITCH_METHOD 1 /* version */ MAILBOX 1 /* MBX_Version */ /* Version of mailbox */ 200 /* MBX_PageSetupTime */ /* max time the ECU needs to set up page in ms */ 0xAFF00060 /* MBX_StartAddress */ /* Start address of table */ AUTOSTART_BEHAVIOR LAST_ACTIVE_PAGE /* Table to be filled by INCA with info */ /* for the current active page */ OCT_WORKINGPAGE 0x400 /* OCT_Type Type of table */ 0xAFF00068 /* OCT_StartAddress Start address of table */ 0xDC /* OCT_Length max Length of table in byte */ /end TP_BLOB
/end IF_DATA
/begin CHARACTERISTIC ABMM3 "" VAL_BLK 0x80041FAE KwbWU8 255.0 dez 0.00 255.0 FORMAT "%5.1" NUMBER 3 /end CHARACTERISTIC
/begin CHARACTERISTIC ACComp_CalcDem_CW "" VALUE 0x8004B478 Val_Wu8 255.0 OneToOne 0.00 255.0 FORMAT "%5.1" /end CHARACTERISTIC
/begin CHARACTERISTIC ACComp_facTrqCAN_C "" VALUE 0x8004B47A Val_Ws16 511.9922 Fact1 -256.0000 255.9922 FORMAT "%8.4" /end CHARACTERISTIC
/begin CHARACTERISTIC ACComp_swtLdCAN_C "" VALUE 0x8004B47C Val_Wu8 255.0 OneToOne 0.00 255.0 FORMAT "%5.1" /end CHARACTERISTIC
/begin CHARACTERISTIC ACComp_swtLd_C "" VALUE 0x8004B47D Val_Wu8 255.0 OneToOne 0.00 255.0 FORMAT "%5.1" /end CHARACTERISTIC
/begin CHARACTERISTIC ACComp_tiTrqDes_C "" VALUE 0x8004B480 Val_Ws32 4294967295.00 TimeDT -2147483648.00 2147483647.00 FORMAT "%13.2" /end CHARACTERISTIC
/begin CHARACTERISTIC ACComp_tiTrqDyn_C "" VALUE 0x8004B484 Val_Wu32 4294.9672950 TimeDelay_s 0.000001000000000 4294.9672960 FORMAT "%12.7" /end CHARACTERISTIC
/begin CHARACTERISTIC ACComp_tiTrqResv_C "" VALUE 0x8004B488 Val_Ws32 4294967295.00 TimeDT -2147483648.00 2147483647.00 FORMAT "%13.2" /end CHARACTERISTIC
/begin CHARACTERISTIC ACComp_trqDyn_MAP "" MAP 0x8004B48C Map_Xs16Ys16Ws16 6553.500 Trq -3276.800 3276.700 FORMAT "%8.3"
 /begin AXIS_DESCR STD_AXIS Epm_nEng EngN 4 -16384.00 16383.50 FORMAT "%8.2" DEPOSIT ABSOLUTE /end AXIS_DESCR
 /begin AXIS_DESCR STD_AXIS AirC_pClnt PresAC_hPa 4 -65536.00 65534.00 FORMAT "%8.2" DEPOSIT ABSOLUTE /end AXIS_DESCR
/end CHARACTERISTIC
/begin CHARACTERISTIC ACComp_trqOffsFlt_C "" VALUE 0x8004B4C0 Val_Ws16 6553.500 Trq -3276.800 3276.700 FORMAT "%8.3" /end CHARACTERISTIC
/begin CHARACTERISTIC ACComp_trqStat_MAP "" MAP 0x8004B4C2 Map_Xs16Ys16Ws16 6553.500 Trq -3276.800 3276.700 FORMAT "%8.3"
 /begin AXIS_DESCR STD_AXIS Epm_nEng EngN 4 -16384.00 16383.50 FORMAT "%8.2" DEPOSIT ABSOLUTE /end AXIS_DESCR
 /begin AXIS_DESCR STD_AXIS AirC_pClnt PresAC_hPa 4 -65536.00 65534.00 FORMAT "%8.2" DEPOSIT ABSOLUTE /end AXIS_DESCR
/end CHARACTERISTIC
/begin CHARACTERISTIC ACCtl_AcOnOffCnt1Tmr_C "" VALUE 0x80041D54 Val_Ws32 429496729.500 t_q0p1 -214748364.800 214748364.700 FORMAT "%13.3" /end CHARACTERISTIC
/begin CHARACTERISTIC ACCtl_AcOnOffCnt1_C "" VALUE 0x80041D58 Val_Wu16 65535.00 OneToOne 0.00 65535.00 FORMAT "%8.2" /end CHARACTERISTIC
/begin CHARACTERISTIC ACCtl_AcOnOffCnt2Tmr_C "" VALUE 0x80041D5C Val_Ws32 429496729.500 t_q0p1 -214748364.800 214748364.700 FORMAT "%13.3" /end CHARACTERISTIC
/begin CHARACTERISTIC ACCtl_AcOnOffCnt2_C "" VALUE 0x80041D60 Val_Wu16 65535.00 OneToOne 0.00 65535.00 FORMAT "%8.2" /end CHARACTERISTIC
/begin CHARACTERISTIC ACCtl_AcOnOffCnt3Tmr_C "" VALUE 0x80041D64 Val_Ws32 429496729.500 t_q0p1 -214748364.800 214748364.700 FORMAT "%13.3" /end CHARACTERISTIC
/begin CHARACTERISTIC ACCtl_AcOnOffCnt3_C "" VALUE 0x80041D68 Val_Wu16 65535.00 OneToOne 0.00 65535.00 FORMAT "%8.2" /end CHARACTERISTIC
/begin CHARACTERISTIC ACCtl_AcOnOffCntTmr_C "" VALUE 0x80041D6A Val_Ws16 655.3500 Time_s -327.6800 327.6700 FORMAT "%8.4" /end CHARACTERISTIC
/begin CHARACTERISTIC ACCtl_AcpEvaTempTmr_C "" VALUE 0x80041D6C Val_Ws32 4294.96729500 Time_Dt -2147.48364800 2147.48364700 FORMAT "%13.8" /end CHARACTERISTIC
/begin CHARACTERISTIC ACCtl_AcpEvaTemp_C "" VALUE 0x80041D70 Val_Ws16 131070.0 PresAC_hPa -65536.00 65534.00 FORMAT "%8.2" /end CHARACTERISTIC
/begin CHARACTERISTIC ACCtl_AcShOffCdn_C "" VALUE 0x80041D72 Val_Wu16 65535.00 OneToOne 0.00 65535.00 FORMAT "%8.2" /end CHARACTERISTIC
/begin CHARACTERISTIC ACCtl_ClmbCutInhTmr_C "" VALUE 0x80041D74 Val_Ws16 655.3500 Time_s -327.6800 327.6700 FORMAT "%8.4" /end CHARACTERISTIC
/begin CHARACTERISTIC ACCtl_ClmbOffTmr_C "" VALUE 0x80041D78 Val_Ws32 42949672.9500 Time_s -21474836.4800 21474836.4700 FORMAT "%13.4" /end CHARACTERISTIC
/begin CHARACTERISTIC ACCtl_ClmbTmr_Crv "" CURVE 0x80041D7C CurG_Ws16 799.9878 Prc -400.0000 399.9878 FORMAT "%8.4"
 /begin AXIS_DESCR COM_AXIS GlbDa_vX Vel 26 -327.6800 327.6700 FORMAT "%8.4" AXIS_PTS_REF DrvRng_Distbn /end AXIS_DESCR
/end CHARACTERISTIC
/begin CHARACTERISTIC ACCtl_drThrValv_C "" VALUE 0x80041DB0 Val_Ws16 39999.39 PrcPerSec -20000.00 19999.39 FORMAT "%8.2" /end CHARACTERISTIC
/begin CHARACTERISTIC ACCtl_DrvRngDly_C "" VALUE 0x80041DB2 Val_Ws16 655.3500 Time_s -327.6800 327.6700 FORMAT "%8.4" /end CHARACTERISTIC
/begin CHARACTERISTIC ACCtl_flgBlwrAvl_C "" VALUE 0x80041DB4 Val_Wu8 1.000 OneToOne 0.00 1.000 FORMAT "%5.3" /end CHARACTERISTIC
/begin CHARACTERISTIC ACCtl_GlbDaBrkHi_C "" VALUE 0x80041DB6 Val_Ws16 655.3500 Vel -327.6800 327.6700 FORMAT "%8.4" /end CHARACTERISTIC
/begin CHARACTERISTIC ACCtl_GlbDaBrkLo_C "" VALUE 0x80041DB8 Val_Ws16 655.3500 Vel -327.6800 327.6700 FORMAT "%8.4" /end CHARACTERISTIC
/begin CHARACTERISTIC ACCtl_GlbDaPmpHi_C "" VALUE 0x80041DBA Val_Ws16 655.3500 Vel -327.6800 327.6700 FORMAT "%8.4" /end CHARACTERISTIC
/begin CHARACTERISTIC ACCtl_GlbDaPmpLo_C "" VALUE 0x80041DBC Val_Ws16 655.3500 Vel -327.6800 327.6700 FORMAT "%8.4" /end CHARACTERISTIC
/begin CHARACTERISTIC ACCtl_GlbEvaTempDly_C "" VALUE 0x80041DC0 Val_Ws32 4294.96729500 Time_Dt -2147.48364800 2147.48364700 FORMAT "%13.8" /end CHARACTERISTIC
/begin CHARACTERISTIC ACCtl_GlbEvaTempTmr_C "" VALUE 0x80041DC4 Val_Ws32 4294.96729500 Time_Dt -2147.48364800 2147.48364700 FORMAT "%13.8" /end CHARACTERISTIC
/begin CHARACTERISTIC ACCtl_GlbEvaTemp_C "" VALUE 0x80041DC8 Val_Ws16 655.3500 Vel -327.6800 327.6700 FORMAT "%8.4" /end CHARACTERISTIC
/begin CHARACTERISTIC ACCtl_HiLdCutInhTmr_C "" VALUE 0x80041DCA Val_Ws16 655.3500 Time_s -327.6800 327.6700 FORMAT "%8.4" /end CHARACTERISTIC
/begin CHARACTERISTIC ACCtl_HiOffTmr_C "" VALUE 0x80041DCC Val_Ws16 655.3500 Time_s -327.6800 327.6700 FORMAT "%8.4" /end CHARACTERISTIC
/begin CHARACTERISTIC ACCtl_HiTmr_Crv "" CURVE 0x80041DCE CurG_Ws16 799.9878 Prc -400.0000 399.9878 FORMAT "%8.4"
 /begin AXIS_DESCR COM_AXIS GlbDa_vX Vel 26 -327.6800 327.6700 FORMAT "%8.4" AXIS_PTS_REF DrvRng_Distbn /end AXIS_DESCR
/end CHARACTERISTIC
/begin CHARACTERISTIC ACCtl_LoLdCutInhTmr_C "" VALUE 0x80041E02 Val_Ws16 655.3500 Time_s -327.6800 327.6700 FORMAT "%8.4" /end CHARACTERISTIC
/begin CHARACTERISTIC ACCtl_LoOffTmr_C "" VALUE 0x80041E04 Val_Ws16 655.3500 Time_s -327.6800 327.6700 FORMAT "%8.4" /end CHARACTERISTIC
/begin CHARACTERISTIC ACCtl_LoTmr_Crv "" CURVE 0x80041E06 CurG_Ws16 799.9878 Prc -400.0000 399.9878 FORMAT "%8.4"
 /begin AXIS_DESCR COM_AXIS GlbDa_vX Vel 26 -327.6800 327.6700 FORMAT "%8.4" AXIS_PTS_REF DrvRng_Distbn /end AXIS_DESCR
/end CHARACTERISTIC
/begin CHARACTERISTIC ACCtl_nEngAccHi_C "" VALUE 0x80041E3A Val_Ws16 32767.50 EngN -16384.00 16383.50 FORMAT "%8.2" /end CHARACTERISTIC
/begin CHARACTERISTIC ACCtl_nEngAccLo_C "" VALUE 0x80041E3C Val_Ws16 32767.50 EngN -16384.00 16383.50 FORMAT "%8.2" /end CHARACTERISTIC
/begin CHARACTERISTIC ACCtl_nEngACOffHi_C "" VALUE 0x80041E3E Val_Ws16 32767.50 EngN -16384.00 16383.50 FORMAT "%8.2" /end CHARACTERISTIC
/begin CHARACTERISTIC ACCtl_nEngACOffLo_C "" VALUE 0x80041E40 Val_Ws16 32767.50 EngN -16384.00 16383.50 FORMAT "%8.2" /end CHARACTERISTIC
/begin CHARACTERISTIC ACCtl_nEngDrvOffHi_C "" VALUE 0x80041E42 Val_Ws16 32767.50 EngN -16384.00 16383.50 FORMAT "%8.2" /end CHARACTERISTIC
/begin CHARACTERISTIC ACCtl_nEngDrvOffLo_C "" VALUE 0x80041E44 Val_Ws16 32767.50 EngN -16384.00 16383.50 FORMAT "%8.2" /end CHARACTERISTIC
/begin CHARACTERISTIC ACCtl_nEngFallOffDly_C "" VALUE 0x80041E46 Val_Ws16 655.3500 Time_s -327.6800 327.6700 FORMAT "%8.4" /end CHARACTERISTIC
/begin CHARACTERISTIC ACCtl_nEngFallOff_C "" VALUE 0x80041E48 Val_Ws16 32767.50 EngN -16384.00 16383.50 FORMAT "%8.2" /end CHARACTERISTIC
/begin CHARACTERISTIC ACCtl_nEngFallOff_Crv "" CURVE 0x80041E4A Cur_Xs16Ws16 25599.94 nmotg_sw_q0p39 -12800.16 12799.77 FORMAT "%8.2"
 /begin AXIS_DESCR STD_AXIS Epm_nEng EngN 8 -16384.00 16383.50 FORMAT "%8.2" DEPOSIT ABSOLUTE /end AXIS_DESCR
/end CHARACTERISTIC
/begin CHARACTERISTIC ACCtl_nEngMaxHi_C "" VALUE 0x80041E6C Val_Ws16 32767.50 EngN -16384.00 16383.50 FORMAT "%8.2" /end CHARACTERISTIC
/begin CHARACTERISTIC ACCtl_nEngMaxLo_C "" VALUE 0x80041E6E Val_Ws16 32767.50 EngN -16384.00 16383.50 FORMAT "%8.2" /end CHARACTERISTIC
/begin CHARACTERISTIC ACCtl_nEngThrValv_C "" VALUE 0x80041E70 Val_Ws16 32767.50 EngN -16384.00 16383.50 FORMAT "%8.2" /end CHARACTERISTIC
/begin CHARACTERISTIC ACCtl_nMin_C "" VALUE 0x80041E72 Val_Ws16 32767.50 EngN -16384.00 16383.50 FORMAT "%8.2" /end CHARACTERISTIC
/begin CHARACTERISTIC ACCtl_nrGearAccMax_C "" VALUE 0x80041E74 Val_Ws8 255.0 OneToOne -128.0 127.0 FORMAT "%5.1" /end CHARACTERISTIC
/begin CHARACTERISTIC ACCtl_nrGearDrvOffMax_C "" VALUE 0x80041E75 Val_Ws8 255.0 OneToOne -128.0 127.0 FORMAT "%5.1" /end CHARACTERISTIC
/begin CHARACTERISTIC ACCtl_pACMaxHi_C "" VALUE 0x80041E76 Val_Ws16 131070.0 PresAC_hPa -65536.00 65534.00 FORMAT "%8.2" /end CHARACTERISTIC
/begin CHARACTERISTIC ACCtl_pACMaxLo_C "" VALUE 0x80041E78 Val_Ws16 131070.0 PresAC_hPa -65536.00 65534.00 FORMAT "%8.2" /end CHARACTERISTIC
/begin CHARACTERISTIC ACCtl_pACMinHi_C "" VALUE 0x80041E7A Val_Ws16 131070.0 PresAC_hPa -65536.00 65534.00 FORMAT "%8.2" /end CHARACTERISTIC
/begin CHARACTERISTIC ACCtl_pACMinLo_C "" VALUE 0x80041E7C Val_Ws16 131070.0 PresAC_hPa -65536.00 65534.00 FORMAT "%8.2" /end CHARACTERISTIC
/begin CHARACTERISTIC ACCtl_psThd_C "" VALUE 0x80041E7E Val_Wu16 2559.961 p_uw_q0p039 0.00 2559.961 FORMAT "%8.3" /end CHARACTERISTIC
/begin CHARACTERISTIC ACCtl_rAppAccHi_C "" VALUE 0x80041E80 Val_Ws16 799.9878 Prc -400.0000 399.9878 FORMAT "%8.4" /end CHARACTERISTIC
/begin CHARACTERISTIC ACCtl_rAppAccLo_C "" VALUE 0x80041E82 Val_Ws16 799.9878 Prc -400.0000 399.9878 FORMAT "%8.4" /end CHARACTERISTIC
/begin CHARACTERISTIC ACCtl_rAppDrvOffHi_C "" VALUE 0x80041E84 Val_Ws16 799.9878 Prc -400.0000 399.9878 FORMAT "%8.4" /end CHARACTERISTIC
/begin CHARACTERISTIC ACCtl_rAppDrvOffLo_C "" VALUE 0x80041E86 Val_Ws16 799.9878 Prc -400.0000 399.9878 FORMAT "%8.4" /end CHARACTERISTIC
/begin CHARACTERISTIC ACCtl_rThrValv_C "" VALUE 0x80041E88 Val_Ws16 799.9878 Prc -400.0000 399.9878 FORMAT "%8.4" /end CHARACTERISTIC
/begin CHARACTERISTIC ACCtl_swtAcECU_C "" VALUE 0x80041E8A Val_Wu8 1.000 OneToOne 0.00 1.000 FORMAT "%5.3" /end CHARACTERISTIC
/begin CHARACTERISTIC ACCtl_swtACOffCdn_C "" VALUE 0x80041E8B Val_Wu8 255.0 OneToOne 0.00 255.0 FORMAT "%5.1" /end CHARACTERISTIC
/begin CHARACTERISTIC ACCtl_swtResv_C "" VALUE 0x80041E8C Val_Wu8 1.000 OneToOne 0.00 1.000 FORMAT "%5.3" /end CHARACTERISTIC
/begin CHARACTERISTIC ACCtl_tAcVolR_C "" VALUE 0x80041E8E Val_Ws16 6553.500 fak_q0p1 -3276.800 3276.700 FORMAT "%8.3" /end CHARACTERISTIC
/begin CHARACTERISTIC ACCtl_tEngHiOffDly_C "" VALUE 0x80041E90 Val_Wu8 25.50 t_q0p1 0.00 25.50 FORMAT "%5.2" /end CHARACTERISTIC
/begin CHARACTERISTIC ACCtl_tEngHiOnDly_C "" VALUE 0x80041E91 Val_Wu8 25.50 t_q0p1 0.00 25.50 FORMAT "%5.2" /end CHARACTERISTIC
/begin CHARACTERISTIC ACCtl_tEngMaxHi_C "" VALUE 0x80041E92 Val_Ws16 6553.500 Temp_Cels -3549.940 3003.560 FORMAT "%8.3" /end CHARACTERISTIC
/begin CHARACTERISTIC ACCtl_tEngMaxLo_C "" VALUE 0x80041E94 Val_Ws16 6553.500 Temp_Cels -3549.940 3003.560 FORMAT "%8.3" /end CHARACTERISTIC
/begin CHARACTERISTIC ACCtl_tEnvMax_C "" VALUE 0x80041E96 Val_Ws16 6553.500 Temp_Cels -3549.940 3003.560 FORMAT "%8.3" /end CHARACTERISTIC
/begin CHARACTERISTIC ACCtl_tEnvMinHi_C "" VALUE 0x80041E98 Val_Ws16 6553.500 Temp_Cels -3549.940 3003.560 FORMAT "%8.3" /end CHARACTERISTIC
/begin CHARACTERISTIC ACCtl_tEnvMinLo_C "" VALUE 0x80041E9A Val_Ws16 6553.500 Temp_Cels -3549.940 3003.560 FORMAT "%8.3" /end CHARACTERISTIC
/begin CHARACTERISTIC ACCtl_tEvapHi_Crv "" CURVE 0x80041E9C Cur_Xs16Ws16 6553.500 Temp_Cels -3549.940 3003.560 FORMAT "%8.3"
 /begin AXIS_DESCR STD_AXIS ACCtl_tAcVolR fak_q0p1 2 -3276.800 3276.700 FORMAT "%8.3" DEPOSIT ABSOLUTE /end AXIS_DESCR
/end CHARACTERISTIC
/begin CHARACTERISTIC ACCtl_tEvapLo_Crv "" CURVE 0x80041EA6 Cur_Xs16Ws16 6553.500 Temp_Cels -3549.940 3003.560 FORMAT "%8.3"
 /begin AXIS_DESCR STD_AXIS ACCtl_tAcVolR fak_q0p1 2 -3276.800 3276.700 FORMAT "%8.3" DEPOSIT ABSOLUTE /end AXIS_DESCR
/end CHARACTERISTIC
/begin CHARACTERISTIC ACCtl_tEvapShOffHi_C "" VALUE 0x80041EB0 Val_Ws16 6553.500 Temp_Cels -3549.940 3003.560 FORMAT "%8.3" /end CHARACTERISTIC
/begin CHARACTERISTIC ACCtl_tEvapShOffLo_C "" VALUE 0x80041EB2 Val_Ws16 6553.500 Temp_Cels -3549.940 3003.560 FORMAT "%8.3" /end CHARACTERISTIC
/begin CHARACTERISTIC ACCtl_tEvaRcv1_C "" VALUE 0x80041EB4 Val_Ws16 6553.500 Temp_Cels -3549.940 3003.560 FORMAT "%8.3" /end CHARACTERISTIC
/begin CHARACTERISTIC ACCtl_tEvaRcv2_C "" VALUE 0x80041EB6 Val_Ws16 6553.500 Temp_Cels -3549.940 3003.560 FORMAT "%8.3" /end CHARACTERISTIC
/begin CHARACTERISTIC ACCtl_tEvaRcv3_C "" VALUE 0x80041EB8 Val_Ws16 6553.500 Temp_Cels -3549.940 3003.560 FORMAT "%8.3" /end CHARACTERISTIC
/begin CHARACTERISTIC ACCtl_tEvaShOff1_C "" VALUE 0x80041EBA Val_Ws16 6553.500 Temp_Cels -3549.940 3003.560 FORMAT "%8.3" /end CHARACTERISTIC
/begin CHARACTERISTIC ACCtl_tEvaShOff2_C "" VALUE 0x80041EBC Val_Ws16 6553.500 Temp_Cels -3549.940 3003.560 FORMAT "%8.3" /end CHARACTERISTIC
/begin CHARACTERISTIC ACCtl_tEvaShOff3_C "" VALUE 0x80041EBE Val_Ws16 6553.500 Temp_Cels -3549.940 3003.560 FORMAT "%8.3" /end CHARACTERISTIC
/begin CHARACTERISTIC ACCtl_tfaEvaTempTmr_C "" VALUE 0x80041EC0 Val_Ws32 4294.96729500 Time_Dt -2147.48364800 2147.48364700 FORMAT "%13.8" /end CHARACTERISTIC
/begin CHARACTERISTIC ACCtl_tfaEvaTemp_C "" VALUE 0x80041EC4 Val_Wu8 191.3 temp_q0p75_om48 -48.00 143.3 FORMAT "%5.1" /end CHARACTERISTIC
/begin CHARACTERISTIC ACCtl_tiDebIdlSpdSec_C "" VALUE 0x80041EC6 Val_Ws16 655.3500 Time_s -327.6800 327.6700 FORMAT "%8.4" /end CHARACTERISTIC
/begin CHARACTERISTIC ACCtl_tiDlyBrkLoPOff_C "" VALUE 0x80041EC8 Val_Ws16 655.3500 Time_s -327.6800 327.6700 FORMAT "%8.4" /end CHARACTERISTIC
/begin CHARACTERISTIC ACCtl_tiDlyBrkPmpOff_C "" VALUE 0x80041ECA Val_Ws16 655.3500 Time_s -327.6800 327.6700 FORMAT "%8.4" /end CHARACTERISTIC
/begin CHARACTERISTIC ACCtl_tiDlyBrkPmpOn_C "" VALUE 0x80041ECC Val_Ws16 655.3500 Time_s -327.6800 327.6700 FORMAT "%8.4" /end CHARACTERISTIC
/begin CHARACTERISTIC ACCtl_tiMinSwtOff_C "" VALUE 0x80041ECE Val_Ws16 655.3500 Time_s -327.6800 327.6700 FORMAT "%8.4" /end CHARACTERISTIC
/begin CHARACTERISTIC ACCtl_tiNormalDly_C "" VALUE 0x80041ED0 Val_Ws16 10485.60 TimeRed -5242.880 5242.720 FORMAT "%8.3" /end CHARACTERISTIC
/begin CHARACTERISTIC ACCtl_tiThrVlvCdnActv_C "" VALUE 0x80041ED2 Val_Ws16 655.3500 Time_s -327.6800 327.6700 FORMAT "%8.4" /end CHARACTERISTIC
/begin CHARACTERISTIC ACCtl_tiTrqResvSec_C "" VALUE 0x80041ED4 Val_Ws16 655.3500 Time_s -327.6800 327.6700 FORMAT "%8.4" /end CHARACTERISTIC
/begin CHARACTERISTIC ACCtl_TmrRstDly_C "" VALUE 0x80041ED6 Val_Ws16 655.3500 Time_s -327.6800 327.6700 FORMAT "%8.4" /end CHARACTERISTIC
/begin CHARACTERISTIC ACCtl_TmrRst_Crv "" CURVE 0x80041ED8 CurG_Ws16 799.9878 Prc -400.0000 399.9878 FORMAT "%8.4"
 /begin AXIS_DESCR COM_AXIS GlbDa_vX Vel 26 -327.6800 327.6700 FORMAT "%8.4" AXIS_PTS_REF DrvRng_Distbn /end AXIS_DESCR
/end CHARACTERISTIC
/begin CHARACTERISTIC ACCtl_trqMaxAC_C "" VALUE 0x80041F0C Val_Ws16 6553.500 Trq -3276.800 3276.700 FORMAT "%8.3" /end CHARACTERISTIC
/begin CHARACTERISTIC ACCtl_vVehAccHi_C "" VALUE 0x80041F0E Val_Ws16 655.3500 Vel -327.6800 327.6700 FORMAT "%8.4" /end CHARACTERISTIC
/begin CHARACTERISTIC ACCtl_vVehAccLo_C "" VALUE 0x80041F10 Val_Ws16 655.3500 Vel -327.6800 327.6700 FORMAT "%8.4" /end CHARACTERISTIC
/begin CHARACTERISTIC ACCtl_vVehDrvOffHi_C "" VALUE 0x80041F12 Val_Ws16 655.3500 Vel -327.6800 327.6700 FORMAT "%8.4" /end CHARACTERISTIC
/begin CHARACTERISTIC ACCtl_vVehDrvOffLo_C "" VALUE 0x80041F14 Val_Ws16 655.3500 Vel -327.6800 327.6700 FORMAT "%8.4" /end CHARACTERISTIC
/begin CHARACTERISTIC AirC_DigOutCmpr.tiBtwTstSCB_C "" VALUE 0x8004B468 Kw_Ws16 1000.000 Time_ms 0.00 1000.000 FORMAT "%8.3" /end CHARACTERISTIC
/begin CHARACTERISTIC AirC_DigOutCmpr.tiBtwTstOT_C "" VALUE 0x8004B46A Kw_Ws16 100.0000 Time_s 0.00 100.0000 FORMAT "%8.4" /end CHARACTERISTIC
/begin CHARACTERISTIC AirC_DigOutCmpr.numTstMax_C "" VALUE 0x8004B46C Kw_Wu16 65535.00 OneToOne 0.00 65535.00 FORMAT "%8.2" /end CHARACTERISTIC
/begin CHARACTERISTIC AirC_nEngLoLim_C "" VALUE 0x80041D0A Val_Ws16 32767.50 EngN -16384.00 16383.50 FORMAT "%8.2" /end CHARACTERISTIC
/begin CHARACTERISTIC AirC_pClntTransfAna_CUR "" CURVE 0x80041D0C Cur_Xs16Ws16 131070.0 PresAC_hPa -65536.00 65534.00 FORMAT "%8.2"
 /begin AXIS_DESCR STD_AXIS AirC_uAnaRawClnt Volt 16 -6553.600 6553.400 FORMAT "%8.3" DEPOSIT ABSOLUTE /end AXIS_DESCR
/end CHARACTERISTIC
/begin CHARACTERISTIC AirC_pDfl_C "" VALUE 0x8004B458 Kw_Ws16 131070.0 PresAC_hPa -65536.00 65534.00 FORMAT "%8.2" /end CHARACTERISTIC
/begin CHARACTERISTIC AirC_RmpSlpClntP.Pos_C "" VALUE 0x8004B45C Kw_Ws32 65535999.9695 RmpPresAC_hPa 0.00 65535999.9695 FORMAT "%13.4" /end CHARACTERISTIC
/begin CHARACTERISTIC AirC_RmpSlpClntP.Neg_C "" VALUE 0x8004B460 Kw_Ws32 131071999.969 RmpPresAC_hPa -65536000.0000 65535999.9695 FORMAT "%13.4" /end CHARACTERISTIC
/begin CHARACTERISTIC AirC_stCmprPsDiaDisbl_C "" VALUE 0x8004B46E Val_Wu16 65535.00 OneToOne 0.00 65535.00 FORMAT "%8.2" /end CHARACTERISTIC
/begin CHARACTERISTIC AirC_stCmprPsDisbl_C "" VALUE 0x8004B470 Val_Wu16 65535.00 OneToOne 0.00 65535.00 FORMAT "%8.2" /end CHARACTERISTIC
/begin CHARACTERISTIC AirC_stCmprTyp_CW "" VALUE 0x8004B472 Val_Wu8 255.0 OneToOne 0.00 255.0 FORMAT "%5.1" /end CHARACTERISTIC
/begin CHARACTERISTIC AirC_stSwtDfl_C "" VALUE 0x8004B4FE Val_Wu8 255.0 OneToOne 0.00 255.0 FORMAT "%5.1" /end CHARACTERISTIC
/begin CHARACTERISTIC AirC_SwtDeb.tiHiLo_C "" VALUE 0x8004B4F8 Kw_Ws16 655350.0 TimeDeb -327680.0 327670.0 FORMAT "%8.1" /end CHARACTERISTIC
/begin CHARACTERISTIC AirC_SwtDeb.tiLoHi_C "" VALUE 0x8004B4FA Kw_Ws16 655350.0 TimeDeb -327680.0 327670.0 FORMAT "%8.1" /end CHARACTERISTIC
/begin CHARACTERISTIC AirC_swtMnSwtSig_C "" VALUE 0x8004B4FC Val_Wu8 255.0 OneToOne 0.00 255.0 FORMAT "%5.1" /end CHARACTERISTIC
/begin CHARACTERISTIC AirC_tAirLoLim_C "" VALUE 0x80041D4E Val_Ws16 6553.500 Temp_Cels -3549.940 3003.560 FORMAT "%8.3" /end CHARACTERISTIC
/begin CHARACTERISTIC AirC_TransStgClntP.Dfl_C "" VALUE 0x8004B464 Kw_Ws16 131070.0 PresAC_hPa -65536.00 65534.00 FORMAT "%8.2" /end CHARACTERISTIC
/begin CHARACTERISTIC AirC_TransStgClntP.stSensId_C "" VALUE 0x8004B466 Kw_Wu8 255.0 OneToOne 0.00 255.0 FORMAT "%5.1" /end CHARACTERISTIC
/begin CHARACTERISTIC AirC_trqCmprMin_C "" VALUE 0x8004B474 Val_Ws16 4276.800 Trq -3276.800 1000.000 FORMAT "%8.3" /end CHARACTERISTIC
/begin CHARACTERISTIC AirC_uSRCMaxClntPres_C "" VALUE 0x80041D50 Val_Ws16 13107.00 Volt -6553.600 6553.400 FORMAT "%8.3" /end CHARACTERISTIC
/begin CHARACTERISTIC AirC_uSRCMinClntPres_C "" VALUE 0x80041D52 Val_Ws16 13107.00 Volt -6553.600 6553.400 FORMAT "%8.3" /end CHARACTERISTIC
/begin CHARACTERISTIC AltIO_DigOut.tiBtwTstSCB_C "" VALUE 0x8004B5E0 Kw_Ws16 1000.000 Time_ms 0.00 1000.000 FORMAT "%8.3" /end CHARACTERISTIC
/begin CHARACTERISTIC AltIO_DigOut.tiBtwTstOT_C "" VALUE 0x8004B5E2 Kw_Ws16 327.6700 Time_s 0.00 327.6700 FORMAT "%8.4" /end CHARACTERISTIC
/begin CHARACTERISTIC AltIO_DigOut.numTstMax_C "" VALUE 0x8004B5E4 Kw_Wu16 65535.00 OneToOne 0.00 65535.00 FORMAT "%8.2" /end CHARACTERISTIC
/begin CHARACTERISTIC AltIO_nThresErr_C "" VALUE 0x8004B634 Val_Ws16 10000.00 EngN 0.00 10000.00 FORMAT "%8.2" /end CHARACTERISTIC
/begin CHARACTERISTIC AltIO_RmpSlp.Pos_C "" VALUE 0x8004B638 Kw_Ws32 327679.999847 RmpDtyCyc 0.00 327679.999847 FORMAT "%13.6" /end CHARACTERISTIC
/begin CHARACTERISTIC AltIO_RmpSlp.Neg_C "" VALUE 0x8004B63C Kw_Ws32 327679.999847 RmpDtyCyc 0.00 327679.999847 FORMAT "%13.6" /end CHARACTERISTIC
/begin CHARACTERISTIC AltIO_rTransf_CUR "" CURVE 0x8004B5E6 Cur_Xs16Ws16 100.0000 DtyCyc 0.00 100.0000 FORMAT "%8.4"
 /begin AXIS_DESCR STD_AXIS AltIO_dcycFltLoad_mp DtyCyc 16 0.00 100.0000 FORMAT "%8.4" DEPOSIT ABSOLUTE /end AXIS_DESCR
/end CHARACTERISTIC
/begin CHARACTERISTIC AltIO_SRCData.uMin_C "" VALUE 0x8004B628 Kw_Ws16 100.0000 DtyCyc 0.00 100.0000 FORMAT "%8.4" /end CHARACTERISTIC
/begin CHARACTERISTIC AltIO_SRCData.uMax_C "" VALUE 0x8004B62A Kw_Ws16 100.0000 DtyCyc 0.00 100.0000 FORMAT "%8.4" /end CHARACTERISTIC
/begin CHARACTERISTIC AltIO_stPsDiaDisbl_C "" VALUE 0x8004B62C Val_Wu8 255.0 OneToOne 0.00 255.0 FORMAT "%5.1" /end CHARACTERISTIC
/begin CHARACTERISTIC AltIO_stPsDisbl_C "" VALUE 0x8004B62D Val_Wu8 255.0 OneToOne 0.00 255.0 FORMAT "%5.1" /end CHARACTERISTIC
/begin CHARACTERISTIC AltIO_tiDly_MAP "" MAP 0x8004B640 Map_Xs16Ys16Ws16 60000.00 Time_ms 0.00 60000.00 FORMAT "%8.2"
 /begin AXIS_DESCR STD_AXIS EnvP_p Pres_hPa 16 0.00 32767.00 FORMAT "%8.2" DEPOSIT ABSOLUTE /end AXIS_DESCR
 /begin AXIS_DESCR STD_AXIS EngDa_tEng Temp_Cels 16 -0.04000000 3003.560 FORMAT "%8.3" DEPOSIT ABSOLUTE /end AXIS_DESCR
/end CHARACTERISTIC
/begin CHARACTERISTIC AltIO_tiDur_C "" VALUE 0x8004B884 Val_Ws16 327670.0 Time_ms 0.00 327670.0 FORMAT "%8.1" /end CHARACTERISTIC
/begin CHARACTERISTIC AltIO_tiLdRespReqDur_C "" VALUE 0x8004B886 Val_Ws16 327670.0 Time_ms 0.00 327670.0 FORMAT "%8.1" /end CHARACTERISTIC
/begin CHARACTERISTIC AltIO_tiLdResp_CUR "" CURVE 0x8004B888 Cur_Xs16Ws16 163.7300 Time_s 0.00 163.7300 FORMAT "%8.4"
 /begin AXIS_DESCR STD_AXIS EngDa_tEng Temp_Cels 4 -50.14000 199.8600 FORMAT "%8.4" DEPOSIT ABSOLUTE /end AXIS_DESCR
/end CHARACTERISTIC
/begin CHARACTERISTIC AltIO_tiPT1_C "" VALUE 0x8004B630 Val_Ws32 4294967.2940 TimeDelay_ms 0.0020000000009 4294967.2960 FORMAT "%12.4" /end CHARACTERISTIC
/begin CHARACTERISTIC AltIO_TransStagePar.Dfl_C "" VALUE 0x8004B89A Kw_Ws16 100.0000 DtyCyc 0.00 100.0000 FORMAT "%8.4" /end CHARACTERISTIC
/begin CHARACTERISTIC AltIO_TransStagePar.stSensId_C "" VALUE 0x8004B89C Kw_Wu8 255.0 OneToOne 0.00 255.0 FORMAT "%5.1" /end CHARACTERISTIC
/begin CHARACTERISTIC AltIO_uBattThres_C "" VALUE 0x8004B89E Val_Ws16 655340.0 Volt_Batt 0.00 655340.0 FORMAT "%8.1" /end CHARACTERISTIC
/begin CHARACTERISTIC ANZEKPVLMX "" VALUE 0x80041F94 KwWU8 255.0 dez 0.00 255.0 FORMAT "%5.1" /end CHARACTERISTIC
/begin CHARACTERISTIC CWCAEKP "" VALUE 0x80041F95 KwWU8 255.0 dez 0.00 255.0 FORMAT "%5.1" /end CHARACTERISTIC
/begin CHARACTERISTIC CWEVAB "" VALUE 0x80041FB1 KwWU8 255.0 dez 0.00 255.0 FORMAT "%5.1" /end CHARACTERISTIC
/begin AXIS_PTS DrvRng_Distbn "" 0x80041F16 GlbDa_vX Axis_Xs16 655.3500 Vel 26 -327.6800 327.6700 FORMAT "%8.4" DEPOSIT ABSOLUTE /end AXIS_PTS
/begin CHARACTERISTIC PEKP "" VALUE 0x80041F96 KwWU8 25.50 vs_q0p1 0.00 25.50 FORMAT "%5.2" /end CHARACTERISTIC
/begin CHARACTERISTIC SF_DSS "" VAL_BLK 0x80041F8E KwbWU16 86. dfp_verbal 0.00 86. FORMAT "%2.0" READ_ONLY NUMBER 3 /end CHARACTERISTIC
/begin CHARACTERISTIC TAPVLTM "" CURVE 0x80041F98 KlAxU8SstxU8WU16 65535.00 t1sxs_uw_q1 0.00 65535.00 FORMAT "%8.2"
 /begin AXIS_DESCR STD_AXIS tmotab temp_ub_q0p75_o48 4 -48.00 143.3 FORMAT "%5.1" DEPOSIT ABSOLUTE /end AXIS_DESCR
/end CHARACTERISTIC
/begin CHARACTERISTIC TSTPVL "" VALUE 0x80041FA6 KwWU8 2.550 t10msxs_ub_b2p55 0.00 2.550 FORMAT "%5.3" /end CHARACTERISTIC
/begin CHARACTERISTIC TZMIN "" VALUE 0x80041FA7 KwWU8 2.550 t10msxs_ub_b2p55 0.00 2.550 FORMAT "%5.3" /end CHARACTERISTIC
/begin CHARACTERISTIC UBSTS "" VALUE 0x80041FA8 KwWU8 25.50 spg_q0p1 0.00 25.50 FORMAT "%5.2" /end CHARACTERISTIC
/begin CHARACTERISTIC VKSTEBF "" VALUE 0x80041FAA KwWU16 6553.500 vol_q0p1 0.00 6553.500 FORMAT "%8.3" /end CHARACTERISTIC
/begin CHARACTERISTIC VKSTPVL "" VALUE 0x80041FAC KwWU16 6553.500 vol_q0p1 0.00 6553.500 FORMAT "%8.3" /end CHARACTERISTIC
/begin MEASUREMENT abmf "" UBYTE dez 1 100 0.00 255.0 FORMAT "%5.1" ECU_ADDRESS 0xD0000B79 /end MEASUREMENT
/begin MEASUREMENT abmm "" UBYTE dez 1 100 0.00 255.0 FORMAT "%5.1" ECU_ADDRESS 0xD0000B76 /end MEASUREMENT
/begin MEASUREMENT ACComp_trqDesFltAbv_mp "" SWORD Trq 1 100 -3276.800 3276.700 FORMAT "%8.3" ECU_ADDRESS 0xD00052A0 /end MEASUREMENT
/begin MEASUREMENT ACComp_trqDesFlt_mp "" SWORD Trq 1 100 -3276.800 3276.700 FORMAT "%8.3" ECU_ADDRESS 0xD00052A2 /end MEASUREMENT
/begin MEASUREMENT ACComp_trqDyn_mp "" SWORD Trq 1 100 -3276.800 3276.700 FORMAT "%8.3" ECU_ADDRESS 0xD00052A4 /end MEASUREMENT
/begin MEASUREMENT ACComp_trqStat_mp "" SWORD Trq 1 100 -3276.800 3276.700 FORMAT "%8.3" ECU_ADDRESS 0xD00052A6 /end MEASUREMENT
/begin MEASUREMENT ACCtl_AccPedFlt "" SWORD Prc 1 100 -400.0000 399.9878 FORMAT "%8.4" ECU_ADDRESS 0xD0003258 /end MEASUREMENT
/begin MEASUREMENT ACCtl_AcOnOffCnt "" UWORD OneToOne 1 100 0.00 65535.00 FORMAT "%8.2" ECU_ADDRESS 0xD000325A /end MEASUREMENT
/begin MEASUREMENT ACCtl_AcOnOffCntTmp "" UWORD OneToOne 1 100 0.00 65535.00 FORMAT "%8.2" ECU_ADDRESS 0xD000325C /end MEASUREMENT
/begin MEASUREMENT ACCtl_AcOnOffCntTmr "" SWORD Time_s 1 100 -327.6800 327.6700 FORMAT "%8.4" ECU_ADDRESS 0xD000325E /end MEASUREMENT
/begin MEASUREMENT ACCtl_drAccPedUnFlt "" SWORD PrcPerSec 1 100 -20000.00 19999.39 FORMAT "%8.2" ECU_ADDRESS 0xD0003260 /end MEASUREMENT
/begin MEASUREMENT ACCtl_flgShOff "" UBYTE OneToOne 1 100 0.00 1.000 BIT_MASK 0x1 FORMAT "%5.3" ECU_ADDRESS 0xD0003AFC /end MEASUREMENT
/begin MEASUREMENT ACCtl_stAcOnOffCntCdn "" UBYTE OneToOne 1 100 0.00 1.000 BIT_MASK 0x1 FORMAT "%5.3" ECU_ADDRESS 0xD0003AFD /end MEASUREMENT
/begin MEASUREMENT ACCtl_stAcOnOffCntTmr "" UBYTE OneToOne 1 100 0.00 1.000 BIT_MASK 0x1 FORMAT "%5.3" ECU_ADDRESS 0xD0003AFE /end MEASUREMENT
/begin MEASUREMENT ACCtl_stAcOnOffCntTmrRst "" UBYTE OneToOne 1 100 0.00 1.000 BIT_MASK 0x1 FORMAT "%5.3" ECU_ADDRESS 0xD0003AFF /end MEASUREMENT
/begin MEASUREMENT ACCtl_stAcpEvaCdnTmr "" UBYTE OneToOne 1 100 0.00 1.000 BIT_MASK 0x1 FORMAT "%5.3" ECU_ADDRESS 0xD0003B00 /end MEASUREMENT
/begin MEASUREMENT ACCtl_stBrkPmpShOff "" UBYTE OneToOne 1 100 0.00 1.000 BIT_MASK 0x1 FORMAT "%5.3" ECU_ADDRESS 0xD0003B01 /end MEASUREMENT
/begin MEASUREMENT ACCtl_stBrkShOff "" UBYTE OneToOne 1 100 0.00 1.000 BIT_MASK 0x1 FORMAT "%5.3" ECU_ADDRESS 0xD0003B02 /end MEASUREMENT
/begin MEASUREMENT ACCtl_stClmbCutCdn "" UBYTE OneToOne 1 100 0.00 1.000 BIT_MASK 0x1 FORMAT "%5.3" ECU_ADDRESS 0xD0003B03 /end MEASUREMENT
/begin MEASUREMENT ACCtl_stClmbCutTmr "" UBYTE OneToOne 1 100 0.00 1.000 BIT_MASK 0x1 FORMAT "%5.3" ECU_ADDRESS 0xD0003B04 /end MEASUREMENT
/begin MEASUREMENT ACCtl_stDrvRngShOffCdn "" UBYTE OneToOne 1 100 0.00 1.000 BIT_MASK 0x1 FORMAT "%5.3" ECU_ADDRESS 0xD0003B05 /end MEASUREMENT
/begin MEASUREMENT ACCtl_stEngTempShOff "" UBYTE OneToOne 1 100 0.00 1.000 BIT_MASK 0x1 FORMAT "%5.3" ECU_ADDRESS 0xD0003B06 /end MEASUREMENT
/begin MEASUREMENT ACCtl_stEvapTempShOff "" UBYTE OneToOne 1 100 0.00 1.000 BIT_MASK 0x1 FORMAT "%5.3" ECU_ADDRESS 0xD0003B07 /end MEASUREMENT
/begin MEASUREMENT ACCtl_stGlbEvaCdn "" UBYTE OneToOne 1 100 0.00 1.000 BIT_MASK 0x1 FORMAT "%5.3" ECU_ADDRESS 0xD0003B08 /end MEASUREMENT
/begin MEASUREMENT ACCtl_stGlbEvaCdnTmr "" UBYTE OneToOne 1 100 0.00 1.000 BIT_MASK 0x1 FORMAT "%5.3" ECU_ADDRESS 0xD0003B09 /end MEASUREMENT
/begin MEASUREMENT ACCtl_stHiLdCutCdn "" UBYTE OneToOne 1 100 0.00 1.000 BIT_MASK 0x1 FORMAT "%5.3" ECU_ADDRESS 0xD0003B0A /end MEASUREMENT
/begin MEASUREMENT ACCtl_stHiLdCutTmr "" UBYTE OneToOne 1 100 0.00 1.000 BIT_MASK 0x1 FORMAT "%5.3" ECU_ADDRESS 0xD0003B0B /end MEASUREMENT
/begin MEASUREMENT ACCtl_stLoLdCutCdn "" UBYTE OneToOne 1 100 0.00 1.000 BIT_MASK 0x1 FORMAT "%5.3" ECU_ADDRESS 0xD0003B0C /end MEASUREMENT
/begin MEASUREMENT ACCtl_stLoLdCutOk "" UBYTE OneToOne 1 100 0.00 1.000 BIT_MASK 0x1 FORMAT "%5.3" ECU_ADDRESS 0xD0003B0D /end MEASUREMENT
/begin MEASUREMENT ACCtl_stLoLdCutRst "" UBYTE OneToOne 1 100 0.00 1.000 BIT_MASK 0x1 FORMAT "%5.3" ECU_ADDRESS 0xD0003B0E /end MEASUREMENT
/begin MEASUREMENT ACCtl_stLoLdCutTmr "" UBYTE OneToOne 1 100 0.00 1.000 BIT_MASK 0x1 FORMAT "%5.3" ECU_ADDRESS 0xD0003B0F /end MEASUREMENT
/begin MEASUREMENT ACCtl_stnEngFallShOff "" UBYTE OneToOne 1 100 0.00 1.000 BIT_MASK 0x1 FORMAT "%5.3" ECU_ADDRESS 0xD0003B10 /end MEASUREMENT
/begin MEASUREMENT ACCtl_stOut "" UBYTE OneToOne 1 100 0.00 255.0 FORMAT "%5.1" ECU_ADDRESS 0xD0003BF3 /end MEASUREMENT
/begin MEASUREMENT ACCtl_stOut_tmp "" UBYTE OneToOne 1 100 0.00 1.000 BIT_MASK 0x1 FORMAT "%5.3" ECU_ADDRESS 0xD0003B11 /end MEASUREMENT
/begin MEASUREMENT ACCtl_stShOffCdn "" UWORD OneToOne 1 100 0.00 65535.00 FORMAT "%8.2" ECU_ADDRESS 0xD0003262 /end MEASUREMENT
/begin MEASUREMENT ACCtl_stShOffCdnSlow "" UWORD OneToOne 1 100 0.00 65535.00 FORMAT "%8.2" ECU_ADDRESS 0xD0003264 /end MEASUREMENT
/begin MEASUREMENT ACCtl_stTrqResv "" UBYTE OneToOne 1 100 0.00 255.0 FORMAT "%5.1" ECU_ADDRESS 0xD0003BF4 /end MEASUREMENT
/begin MEASUREMENT ACCtl_stTrqResv_tmp "" UBYTE OneToOne 1 100 0.00 1.000 BIT_MASK 0x1 FORMAT "%5.3" ECU_ADDRESS 0xD0003B12 /end MEASUREMENT
/begin MEASUREMENT ACCtl_tEngCdnDetn "" UBYTE OneToOne 1 100 0.00 1.000 BIT_MASK 0x1 FORMAT "%5.3" ECU_ADDRESS 0xD0003B13 /end MEASUREMENT
/begin MEASUREMENT ACCtl_tEvaShOff "" SWORD Temp_Cels 1 100 -3549.940 3003.560 FORMAT "%8.3" ECU_ADDRESS 0xD0003266 /end MEASUREMENT
/begin MEASUREMENT ACCtl_tEvaShOffCdnSt "" UWORD OneToOne 1 100 0.00 65535.00 FORMAT "%8.2" ECU_ADDRESS 0xD0003268 /end MEASUREMENT
/begin MEASUREMENT ACCtl_tEvaShOffRcv "" SWORD Temp_Cels 1 100 -3549.940 3003.560 FORMAT "%8.3" ECU_ADDRESS 0xD000326A /end MEASUREMENT
/begin MEASUREMENT ACCtl_tfaEvaCdnTmr "" UBYTE OneToOne 1 100 0.00 1.000 BIT_MASK 0x1 FORMAT "%5.3" ECU_ADDRESS 0xD0003B14 /end MEASUREMENT
/begin MEASUREMENT AC_trqDes "" SWORD Trq 1 100 -3276.800 3276.700 FORMAT "%8.3" ECU_ADDRESS 0xD0003430 /end MEASUREMENT
/begin MEASUREMENT AC_trqMaxAC "" SWORD Trq 1 100 -3276.800 3276.700 FORMAT "%8.3" ECU_ADDRESS 0xD0003432 /end MEASUREMENT
/begin MEASUREMENT AC_trqResv "" SWORD Trq 1 100 -3276.800 3276.700 FORMAT "%8.3" ECU_ADDRESS 0xD0003434 /end MEASUREMENT
/begin MEASUREMENT AirC_pAnaClnt "" SWORD PresAC_hPa 1 100 -65536.00 65534.00 FORMAT "%8.2" ECU_ADDRESS 0xD000344A /end MEASUREMENT
/begin MEASUREMENT AirC_pClnt "" SWORD PresAC_hPa 1 100 -65536.00 65534.00 FORMAT "%8.2" ECU_ADDRESS 0xD000344C /end MEASUREMENT
/begin MEASUREMENT AirC_stCmprAct_tmp "" UBYTE OneToOne 1 100 0.00 1.000 BIT_MASK 0x1 FORMAT "%5.3" ECU_ADDRESS 0xD0003B15 /end MEASUREMENT
/begin MEASUREMENT AirC_stPsCmpr "" UBYTE OneToOne 1 100 0.00 255.0 FORMAT "%5.1" ECU_ADDRESS 0xD0003BFF /end MEASUREMENT
/begin MEASUREMENT AirC_stPsCmpr_mp "" UBYTE OneToOne 1 100 0.00 255.0 FORMAT "%5.1" ECU_ADDRESS 0xD00053B6 /end MEASUREMENT
/begin MEASUREMENT AirC_stSwt "" UBYTE OneToOne 1 100 0.00 255.0 FORMAT "%5.1" ECU_ADDRESS 0xD0003C00 /end MEASUREMENT
/begin MEASUREMENT AirC_stSwtPrs "" UBYTE OneToOne 1 100 0.00 255.0 FORMAT "%5.1" ECU_ADDRESS 0xD0003C01 /end MEASUREMENT
/begin MEASUREMENT AirC_stSwtRaw "" UBYTE OneToOne 1 100 0.00 255.0 FORMAT "%5.1" ECU_ADDRESS 0xD0003C02 /end MEASUREMENT
/begin MEASUREMENT AirC_trqCmprMax "" SWORD Trq 1 100 -3276.800 3276.700 FORMAT "%8.3" ECU_ADDRESS 0xD000344E /end MEASUREMENT
/begin MEASUREMENT AirC_uAnaRawClnt "" SWORD Volt 1 100 -6553.600 6553.400 FORMAT "%8.3" ECU_ADDRESS 0xD0003452 /end MEASUREMENT
/begin MEASUREMENT AltIO_dcycFltLoad_mp "" SWORD DtyCyc 1 100 -327.6800 327.6700 FORMAT "%8.4" ECU_ADDRESS 0xD00052A8 /end MEASUREMENT
/begin MEASUREMENT AltIO_dcycUnFltLoad_mp "" SWORD DtyCyc 1 100 -327.6800 327.6700 FORMAT "%8.4" ECU_ADDRESS 0xD00052AA /end MEASUREMENT
/begin MEASUREMENT AltIO_rAlt "" SWORD DtyCyc 1 100 -327.6800 327.6700 FORMAT "%8.4" ECU_ADDRESS 0xD000345E /end MEASUREMENT
/begin MEASUREMENT AltIO_rAltLoad "" SWORD DtyCyc 1 100 -327.6800 327.6700 FORMAT "%8.4" ECU_ADDRESS 0xD0003460 /end MEASUREMENT
/begin MEASUREMENT AltIO_st "" UBYTE OneToOne 1 100 0.00 255.0 FORMAT "%5.1" ECU_ADDRESS 0xD0003C06 /end MEASUREMENT
/begin MEASUREMENT AltIO_stAltExcSt "" UBYTE OneToOne 1 100 0.00 255.0 FORMAT "%5.1" ECU_ADDRESS 0xD0003C07 /end MEASUREMENT
/begin MEASUREMENT AltIO_stOn "" UBYTE OneToOne 1 100 0.00 255.0 FORMAT "%5.1" ECU_ADDRESS 0xD0003C08 /end MEASUREMENT
/begin MEASUREMENT AltIO_stPs "" UBYTE OneToOne 1 100 0.00 255.0 FORMAT "%5.1" ECU_ADDRESS 0xD0003C09 /end MEASUREMENT
/begin MEASUREMENT AltIO_tiExcDly_mp "" SWORD Time_ms 1 100 -327680.0 327670.0 FORMAT "%8.1" ECU_ADDRESS 0xD00052AC /end MEASUREMENT
/begin MEASUREMENT AltIO_tiLdResp "" SWORD Time_s 1 100 -327.6800 327.6700 FORMAT "%8.4" ECU_ADDRESS 0xD0003464 /end MEASUREMENT
/begin MEASUREMENT AltIO_tiLRAlt "" SWORD Time_s 1 100 -327.6800 327.6700 FORMAT "%8.4" ECU_ADDRESS 0xD0003462 /end MEASUREMENT
/begin MEASUREMENT anzekpvl "" UBYTE dez 1 100 0.00 255.0 FORMAT "%5.1" ECU_ADDRESS 0xAFE80152 /end MEASUREMENT
/begin MEASUREMENT anzsyn "" UBYTE dez 1 100 0.00 255.0 FORMAT "%5.1" ECU_ADDRESS 0xD0000B77 /end MEASUREMENT
/begin MEASUREMENT B_dmdevab "" UBYTE B_TRUE 1 100 0.00 1.00000000000 BIT_MASK 0x20 FORMAT "%13.11" ECU_ADDRESS 0xD0000022 /end MEASUREMENT
/begin MEASUREMENT B_dmdstop "" UBYTE B_TRUE 1 100 0.00 1.00000000000 BIT_MASK 0x8 FORMAT "%13.11" ECU_ADDRESS 0xD000005B /end MEASUREMENT
/begin MEASUREMENT B_dssakt "" UBYTE B_TRUE 1 100 0.00 1.00000000000 BIT_MASK 0x1 FORMAT "%13.11" ECU_ADDRESS 0xD0000056 /end MEASUREMENT
/begin MEASUREMENT B_ekp "" UBYTE B_TRUE 1 100 0.00 1.00000000000 BIT_MASK 0x8 FORMAT "%13.11" ECU_ADDRESS 0xD0000056 /end MEASUREMENT
/begin MEASUREMENT B_ekpd "" UBYTE B_TRUE 1 100 0.00 1.00000000000 BIT_MASK 0x4 FORMAT "%13.11" ECU_ADDRESS 0xD0000022 /end MEASUREMENT
/begin MEASUREMENT B_ekps "" UBYTE B_TRUE 1 100 0.00 1.00000000000 BIT_MASK 0x8 FORMAT "%13.11" ECU_ADDRESS 0xD0000022 /end MEASUREMENT
/begin MEASUREMENT B_ekpvl "" UBYTE B_TRUE 1 100 0.00 1.00000000000 BIT_MASK 0x4 FORMAT "%13.11" ECU_ADDRESS 0xD000009A /end MEASUREMENT
/begin MEASUREMENT B_ekpvla "" UBYTE B_TRUE 1 100 0.00 1.00000000000 BIT_MASK 0x1 FORMAT "%13.11" ECU_ADDRESS 0xD0000B73 /end MEASUREMENT
/begin MEASUREMENT B_ekpvlz "" UBYTE B_TRUE 1 100 0.00 1.00000000000 BIT_MASK 0x2 FORMAT "%13.11" ECU_ADDRESS 0xD0000B73 /end MEASUREMENT
/begin MEASUREMENT B_evasel "" UBYTE B_TRUE 1 100 0.00 1.00000000000 BIT_MASK 0x2 FORMAT "%13.11" ECU_ADDRESS 0xD0000096 /end MEASUREMENT
/begin MEASUREMENT B_fevab "" UBYTE B_TRUE 1 100 0.00 1.00000000000 BIT_MASK 0x40 FORMAT "%13.11" ECU_ADDRESS 0xD0000022 /end MEASUREMENT
/begin MEASUREMENT B_pvlab "" UBYTE B_TRUE 1 100 0.00 1.00000000000 BIT_MASK 0x4 FORMAT "%13.11" ECU_ADDRESS 0xD0000B73 /end MEASUREMENT
/begin MEASUREMENT B_redsol "" UBYTE B_TRUE 1 100 0.00 1.00000000000 BIT_MASK 0x10 FORMAT "%13.11" ECU_ADDRESS 0xD0000022 /end MEASUREMENT
/begin MEASUREMENT B_tapcm "" UBYTE B_TRUE 1 100 0.00 1.00000000000 BIT_MASK 0x2 FORMAT "%13.11" ECU_ADDRESS 0xD000007D /end MEASUREMENT
/begin MEASUREMENT dekpub "" UBYTE spg_q0p1 1 100 0.00 25.50 FORMAT "%5.2" ECU_ADDRESS 0xD0000B75 /end MEASUREMENT
/begin MEASUREMENT dmdevab "" UBYTE dez 1 100 0.00 255.0 FORMAT "%5.1" ECU_ADDRESS 0xD0000B78 /end MEASUREMENT
/begin MEASUREMENT dpsfg_w "" SWORD p_sw_q0p039 1 100 -1280.000 1279.961 FORMAT "%8.3" ECU_ADDRESS 0xD00000A8 /end MEASUREMENT
/begin MEASUREMENT eevx "" UBYTE dez 1 100 0.00 255.0 FORMAT "%5.1" ECU_ADDRESS 0xD0000B7A /end MEASUREMENT
/begin MEASUREMENT evrbgn_one "" UBYTE dez 1 100 0.00 255.0 FORMAT "%5.1" ECU_ADDRESS 0xD0000B7B /end MEASUREMENT
/begin MEASUREMENT evz_aus "" UBYTE dez 1 100 0.00 255.0 FORMAT "%5.1" ECU_ADDRESS 0xD0000B7C /end MEASUREMENT
/begin MEASUREMENT evz_auscpl "" UBYTE dez 1 100 0.00 255.0 FORMAT "%5.1" ECU_ADDRESS 0xD0000B7F /end MEASUREMENT
/begin MEASUREMENT evz_austot "" UBYTE dez 1 100 0.00 255.0 FORMAT "%5.1" ECU_ADDRESS 0xD0000B80 /end MEASUREMENT
/begin MEASUREMENT fevab "" UBYTE dez 1 100 0.00 255.0 FORMAT "%5.1" ECU_ADDRESS 0xD0000B7D /end MEASUREMENT
/begin MEASUREMENT ftvdk "" UBYTE fak_ub_b2 1 100 0.00 1.992188 FORMAT "%8.6" ECU_ADDRESS 0xD0000B72 /end MEASUREMENT
/begin MEASUREMENT fvisrm_w "" UWORD p_uw_b32 1 100 0.00 31.99951 FORMAT "%8.5" ECU_ADDRESS 0xD00000AA /end MEASUREMENT
/begin MEASUREMENT kldfpwm "" UBYTE rel_ub_b100 1 100 0.00 99.61 FORMAT "%5.2" ECU_ADDRESS 0xD0000B81 /end MEASUREMENT
/begin MEASUREMENT psfglm_w "" UWORD p_uw_q0p039 1 100 0.00 2559.961 FORMAT "%8.3" ECU_ADDRESS 0xD00000AC /end MEASUREMENT
/begin MEASUREMENT ps_w "" UWORD p_uw_q0p039 1 100 0.00 2559.961 FORMAT "%8.3" ECU_ADDRESS 0xD00000AE /end MEASUREMENT
/begin MEASUREMENT pvdkds_w "" UWORD p_uw_q0p039 1 100 0.00 2559.961 FORMAT "%8.3" ECU_ADDRESS 0xD00000B0 /end MEASUREMENT
/begin MEASUREMENT stateaevab "" UBYTE dez 1 100 0.00 255.0 FORMAT "%5.1" ECU_ADDRESS 0xD0000B7E /end MEASUREMENT
/begin MEASUREMENT TS_nMinAC "" SWORD EngN 1 100 -16384.00 16383.50 FORMAT "%8.2" ECU_ADDRESS 0xD00035A0 /end MEASUREMENT
/begin MEASUREMENT TS_stMnSwtAC "" UBYTE OneToOne 1 100 0.00 255.0 FORMAT "%5.1" ECU_ADDRESS 0xD0003CBB /end MEASUREMENT
/begin MEASUREMENT udkp1v_w "" UWORD spg_uw_q0p00488 1 100 0.00 319.9951 FORMAT "%8.4" ECU_ADDRESS 0xD0000B5C /end MEASUREMENT
/begin MEASUREMENT udkp2_w "" UWORD spg_uw_q0p001222 1 100 0.00 79.99878 FORMAT "%8.5" ECU_ADDRESS 0xD0000B5E /end MEASUREMENT
/begin MEASUREMENT udss_w "" UWORD spg_uw_q0p00488 1 100 0.00 319.9951 FORMAT "%8.4" ECU_ADDRESS 0xD0000B60 /end MEASUREMENT
/begin MEASUREMENT udsu_w "" UWORD spg_uw_q0p00488 1 100 0.00 319.9951 FORMAT "%8.4" ECU_ADDRESS 0xD0000B62 /end MEASUREMENT
/begin MEASUREMENT uwdk_w "" UWORD spg_uw_q0p001222 1 100 0.00 79.99878 FORMAT "%8.5" ECU_ADDRESS 0xD0000B64 /end MEASUREMENT
/begin MEASUREMENT vkst_w "" UWORD vol_q0p1 1 100 0.00 6553.500 FORMAT "%8.3" ECU_ADDRESS 0xD00000B2 /end MEASUREMENT
/begin MEASUREMENT wtfa1_w "" UWORD spg_uw_q0p00488 1 100 0.00 4.995117 FORMAT "%8.6" ECU_ADDRESS 0xD0000B66 /end MEASUREMENT
/begin MEASUREMENT wubr_w "" UWORD spg_ubatt_w 1 100 0.00 1543.349 FORMAT "%8.3" ECU_ADDRESS 0xD0000B68 /end MEASUREMENT
/begin MEASUREMENT wub_w "" UWORD spg_ubatt_w 1 100 0.00 1543.349 FORMAT "%8.3" ECU_ADDRESS 0xD0000B6A /end MEASUREMENT
/begin FUNCTION ACClntP_DD "2.10.0"
 /begin DEF_CHARACTERISTIC AirC_nEngLoLim_C AirC_pClntTransfAna_CUR AirC_tAirLoLim_C AirC_uSRCMaxClntPres_C AirC_uSRCMinClntPres_C /end DEF_CHARACTERISTIC
 /begin IN_MEASUREMENT EnvT_t Epm_nEng ESC_tiSampling /end IN_MEASUREMENT
 /begin OUT_MEASUREMENT AirC_pAnaClnt AirC_uAnaRawClnt /end OUT_MEASUREMENT
 FUNCTION_VERSION "2.10.0" /end FUNCTION
/begin FUNCTION ACClntP_VD "2.9.0"
 /begin DEF_CHARACTERISTIC AirC_pDfl_C AirC_RmpSlpClntP.Pos_C AirC_RmpSlpClntP.Neg_C AirC_TransStgClntP.Dfl_C AirC_TransStgClntP.stSensId_C /end DEF_CHARACTERISTIC
 /begin IN_MEASUREMENT AirC_pAnaClnt /end IN_MEASUREMENT
 /begin OUT_MEASUREMENT AirC_pClnt /end OUT_MEASUREMENT
 FUNCTION_VERSION "2.9.0" /end FUNCTION
/begin FUNCTION ACCmpr_DD "2.9.0"
 /begin DEF_CHARACTERISTIC AirC_DigOutCmpr.tiBtwTstSCB_C AirC_DigOutCmpr.tiBtwTstOT_C AirC_DigOutCmpr.numTstMax_C AirC_stCmprPsDiaDisbl_C AirC_stCmprPsDisbl_C AirC_stCmprTyp_CW AirC_trqCmprMin_C /end DEF_CHARACTERISTIC
 /begin IN_MEASUREMENT AC_trqMaxAC DevLib_stPwrStgEnaCond /end IN_MEASUREMENT
 /begin OUT_MEASUREMENT AirC_stPsCmpr AirC_trqCmprMax /end OUT_MEASUREMENT
 /begin LOC_MEASUREMENT AirC_stPsCmpr_mp /end LOC_MEASUREMENT
 FUNCTION_VERSION "2.9.0" /end FUNCTION
/begin FUNCTION ACComp_Demand "2.11.0"
 /begin DEF_CHARACTERISTIC ACComp_CalcDem_CW ACComp_facTrqCAN_C ACComp_swtLdCAN_C ACComp_swtLd_C ACComp_tiTrqDes_C ACComp_tiTrqDyn_C ACComp_tiTrqResv_C ACComp_trqDyn_MAP ACComp_trqOffsFlt_C ACComp_trqStat_MAP /end DEF_CHARACTERISTIC
 /begin IN_MEASUREMENT ACCtl_stOut ACCtl_stTrqResv AirC_pClnt AirC_trqDes Epm_nEng /end IN_MEASUREMENT
 /begin OUT_MEASUREMENT AC_trqDes AC_trqResv /end OUT_MEASUREMENT
 /begin LOC_MEASUREMENT ACComp_trqDesFltAbv_mp ACComp_trqDesFlt_mp ACComp_trqDyn_mp ACComp_trqStat_mp /end LOC_MEASUREMENT
 FUNCTION_VERSION "2.11.0" /end FUNCTION
/begin FUNCTION AccPr "2.6.0" FUNCTION_VERSION "2.6.0" /end FUNCTION
/begin FUNCTION AccPrAppl "13.0.0" FUNCTION_VERSION "13.0.0" /end FUNCTION
/begin FUNCTION ACCtl_Demand "14.0.3"
 /begin DEF_CHARACTERISTIC ACCtl_AcOnOffCnt1Tmr_C ACCtl_AcOnOffCnt1_C ACCtl_AcOnOffCnt2Tmr_C ACCtl_AcOnOffCnt2_C ACCtl_AcOnOffCnt3Tmr_C ACCtl_AcOnOffCnt3_C ACCtl_AcOnOffCntTmr_C ACCtl_AcpEvaTempTmr_C ACCtl_AcpEvaTemp_C ACCtl_AcShOffCdn_C ACCtl_ClmbCutInhTmr_C ACCtl_ClmbOffTmr_C ACCtl_ClmbTmr_Crv ACCtl_drThrValv_C ACCtl_DrvRngDly_C ACCtl_flgBlwrAvl_C ACCtl_GlbDaBrkHi_C ACCtl_GlbDaBrkLo_C ACCtl_GlbDaPmpHi_C ACCtl_GlbDaPmpLo_C ACCtl_GlbEvaTempDly_C ACCtl_GlbEvaTempTmr_C ACCtl_GlbEvaTemp_C ACCtl_HiLdCutInhTmr_C ACCtl_HiOffTmr_C ACCtl_HiTmr_Crv ACCtl_LoLdCutInhTmr_C ACCtl_LoOffTmr_C ACCtl_LoTmr_Crv ACCtl_nEngAccHi_C ACCtl_nEngAccLo_C ACCtl_nEngACOffHi_C ACCtl_nEngACOffLo_C ACCtl_nEngDrvOffHi_C ACCtl_nEngDrvOffLo_C ACCtl_nEngFallOffDly_C ACCtl_nEngFallOff_C ACCtl_nEngFallOff_Crv ACCtl_nEngMaxHi_C ACCtl_nEngMaxLo_C ACCtl_nEngThrValv_C ACCtl_nMin_C ACCtl_nrGearAccMax_C ACCtl_nrGearDrvOffMax_C ACCtl_pACMaxHi_C ACCtl_pACMaxLo_C ACCtl_pACMinHi_C ACCtl_pACMinLo_C ACCtl_psThd_C ACCtl_rAppAccHi_C ACCtl_rAppAccLo_C ACCtl_rAppDrvOffHi_C ACCtl_rAppDrvOffLo_C ACCtl_rThrValv_C ACCtl_swtAcECU_C ACCtl_swtACOffCdn_C ACCtl_swtResv_C ACCtl_tAcVolR_C ACCtl_tEngHiOffDly_C ACCtl_tEngHiOnDly_C ACCtl_tEngMaxHi_C ACCtl_tEngMaxLo_C ACCtl_tEnvMax_C ACCtl_tEnvMinHi_C ACCtl_tEnvMinLo_C ACCtl_tEvapHi_Crv ACCtl_tEvapLo_Crv ACCtl_tEvapShOffHi_C ACCtl_tEvapShOffLo_C ACCtl_tEvaRcv1_C ACCtl_tEvaRcv2_C ACCtl_tEvaRcv3_C ACCtl_tEvaShOff1_C ACCtl_tEvaShOff2_C ACCtl_tEvaShOff3_C ACCtl_tfaEvaTempTmr_C ACCtl_tfaEvaTemp_C ACCtl_tiDebIdlSpdSec_C ACCtl_tiDlyBrkLoPOff_C ACCtl_tiDlyBrkPmpOff_C ACCtl_tiDlyBrkPmpOn_C ACCtl_tiMinSwtOff_C ACCtl_tiNormalDly_C ACCtl_tiThrVlvCdnActv_C ACCtl_tiTrqResvSec_C ACCtl_TmrRstDly_C ACCtl_TmrRst_Crv ACCtl_trqMaxAC_C ACCtl_vVehAccHi_C ACCtl_vVehAccLo_C ACCtl_vVehDrvOffHi_C ACCtl_vVehDrvOffLo_C DrvRng_Distbn /end DEF_CHARACTERISTIC
 /begin IN_MEASUREMENT ACCtl_tAcVolR AC_tEvapT AirC_pClnt AirC_stCmprAct Blwr_flgActv Brk_bLoPres Brk_st B_ll CoEng_st CoEng_tiNormalRed dwdkba_w EngDa_tEng Epm_nEng ESC_tiSampling GlbDa_tEnv GlbDa_vX ngfil_w ps_w tfa1limf ThrVlv_rAct Tra_numGear TS_stMnSwtAC /end IN_MEASUREMENT
 /begin OUT_MEASUREMENT ACCtl_stOut ACCtl_stTrqResv AC_trqMaxAC TS_nMinAC /end OUT_MEASUREMENT
 /begin LOC_MEASUREMENT ACCtl_AccPedFlt ACCtl_AcOnOffCnt ACCtl_AcOnOffCntTmp ACCtl_AcOnOffCntTmr ACCtl_drAccPedUnFlt ACCtl_flgShOff ACCtl_stAcOnOffCntCdn ACCtl_stAcOnOffCntTmr ACCtl_stAcOnOffCntTmrRst ACCtl_stAcpEvaCdnTmr ACCtl_stBrkPmpShOff ACCtl_stBrkShOff ACCtl_stClmbCutCdn ACCtl_stClmbCutTmr ACCtl_stDrvRngShOffCdn ACCtl_stEngTempShOff ACCtl_stEvapTempShOff ACCtl_stGlbEvaCdn ACCtl_stGlbEvaCdnTmr ACCtl_stHiLdCutCdn ACCtl_stHiLdCutTmr ACCtl_stLoLdCutCdn ACCtl_stLoLdCutOk ACCtl_stLoLdCutRst ACCtl_stLoLdCutTmr ACCtl_stnEngFallShOff ACCtl_stOut_tmp ACCtl_stShOffCdn ACCtl_stShOffCdnSlow ACCtl_stTrqResv_tmp ACCtl_tEngCdnDetn ACCtl_tEvaShOff ACCtl_tEvaShOffCdnSt ACCtl_tEvaShOffRcv ACCtl_tfaEvaCdnTmr AirC_stCmprAct_tmp /end LOC_MEASUREMENT
 FUNCTION_VERSION "14.0.3" /end FUNCTION
/begin FUNCTION ACSwt_DD "2.0.0"
 /begin DEF_CHARACTERISTIC AirC_SwtDeb.tiHiLo_C AirC_SwtDeb.tiLoHi_C AirC_swtMnSwtSig_C /end DEF_CHARACTERISTIC
 /begin IN_MEASUREMENT Com_stAC /end IN_MEASUREMENT
 /begin OUT_MEASUREMENT AirC_stSwtRaw /end OUT_MEASUREMENT
 FUNCTION_VERSION "2.0.0" /end FUNCTION
/begin FUNCTION ACSwt_VD "2.0.0" /begin DEF_CHARACTERISTIC AirC_stSwtDfl_C /end DEF_CHARACTERISTIC /begin IN_MEASUREMENT AirC_stSwtRaw Com_stAC /end IN_MEASUREMENT /begin OUT_MEASUREMENT AirC_stSwt AirC_stSwtPrs /end OUT_MEASUREMENT FUNCTION_VERSION "2.0.0" /end FUNCTION
/begin FUNCTION AC_DataAcq "2.2.0" /begin IN_MEASUREMENT AirC_stSwt /end IN_MEASUREMENT /begin OUT_MEASUREMENT TS_stMnSwtAC /end OUT_MEASUREMENT FUNCTION_VERSION "2.2.0" /end FUNCTION
/begin FUNCTION ADCADAP "1.1.0" /begin DEF_CHARACTERISTIC SF_DSS /end DEF_CHARACTERISTIC
 /begin IN_MEASUREMENT B_fedssb B_nmin dpsrfg_w fisrm_w ftvdk_w psrfgmh_w psr_w pvd_w /end IN_MEASUREMENT
 /begin OUT_MEASUREMENT B_dssakt dpsfg_w ftvdk fvisrm_w psfglm_w ps_w pvdkds_w /end OUT_MEASUREMENT
 FUNCTION_VERSION "1.1.0" /end FUNCTION
/begin FUNCTION AdcHal "1.12.0" FUNCTION_VERSION "1.12.0" /end FUNCTION
/begin FUNCTION AdcI "1.12.0" FUNCTION_VERSION "1.12.0" /end FUNCTION
/begin FUNCTION ADCin "" /begin OUT_MEASUREMENT udkp1v_w udkp2_w udss_w udsu_w uwdk_w wtfa1_w wubr_w wub_w /end OUT_MEASUREMENT /end FUNCTION
/begin FUNCTION Ads7841 "1.12.0" FUNCTION_VERSION "1.12.0" /end FUNCTION
/begin FUNCTION AEKP "3.5.1"
 /begin DEF_CHARACTERISTIC ANZEKPVLMX CWCAEKP PEKP TAPVLTM TSTPVL TZMIN UBSTS VKSTEBF VKSTPVL /end DEF_CHARACTERISTIC
 /begin IN_MEASUREMENT B_nmot B_stend B_stprel MoCSOP_stActvMsg tengslst tengsq1_w tmotab ubsq /end IN_MEASUREMENT
 /begin OUT_MEASUREMENT B_ekp B_ekpvl B_tapcm /end OUT_MEASUREMENT
 /begin LOC_MEASUREMENT anzekpvl B_ekpd B_ekps B_ekpvla B_ekpvlz B_pvlab dekpub vkst_w /end LOC_MEASUREMENT
 FUNCTION_VERSION "3.5.1" /end FUNCTION
/begin FUNCTION AEVAB "1.12.0" /begin DEF_CHARACTERISTIC ABMM3 CWEVAB /end DEF_CHARACTERISTIC /begin IN_MEASUREMENT flgstinj_w flgtiab redsol zzyl /end IN_MEASUREMENT /begin OUT_MEASUREMENT abmf B_dmdstop eevx evrbgn_one evz_aus fevab stateaevab /end OUT_MEASUREMENT /begin LOC_MEASUREMENT abmm anzsyn B_dmdevab B_fevab B_redsol dmdevab /end LOC_MEASUREMENT FUNCTION_VERSION "1.12.0" /end FUNCTION
/begin FUNCTION AEVABZK "2.4.0"
 /begin IN_MEASUREMENT B_ausc_act B_dmdstop B_koevab B_nachlauf B_wdaactiv evz_aus /end IN_MEASUREMENT
 /begin OUT_MEASUREMENT B_evasel evz_auscpl evz_austot /end OUT_MEASUREMENT
 FUNCTION_VERSION "2.4.0" /end FUNCTION
/begin FUNCTION AirMod_LibMsFlwClg "1.2.1" FUNCTION_VERSION "1.2.1" /end FUNCTION
/begin FUNCTION AltIO2MED "1.1.0" /begin IN_MEASUREMENT AltIO_rAltLoad /end IN_MEASUREMENT /begin OUT_MEASUREMENT kldfpwm /end OUT_MEASUREMENT FUNCTION_VERSION "1.1.0" /end FUNCTION
/begin FUNCTION AltIO_DD "1.12.0"
 /begin DEF_CHARACTERISTIC AltIO_DigOut.tiBtwTstSCB_C AltIO_DigOut.tiBtwTstOT_C AltIO_DigOut.numTstMax_C AltIO_rTransf_CUR AltIO_SRCData.uMin_C AltIO_SRCData.uMax_C AltIO_stPsDiaDisbl_C AltIO_stPsDisbl_C AltIO_tiPT1_C /end DEF_CHARACTERISTIC
 /begin IN_MEASUREMENT Com_rAltLoadBEM Com_stAltLoadBEM DevLib_stPwrStgEnaCond /end IN_MEASUREMENT
 /begin OUT_MEASUREMENT AltIO_rAlt AltIO_stPs /end OUT_MEASUREMENT
 /begin LOC_MEASUREMENT AltIO_dcycFltLoad_mp AltIO_dcycUnFltLoad_mp /end LOC_MEASUREMENT
 FUNCTION_VERSION "1.12.0" /end FUNCTION
/begin FUNCTION AltIO_VD "1.13.0"
 /begin DEF_CHARACTERISTIC AltIO_nThresErr_C AltIO_RmpSlp.Pos_C AltIO_RmpSlp.Neg_C AltIO_tiDly_MAP AltIO_tiDur_C AltIO_tiLdRespReqDur_C AltIO_tiLdResp_CUR AltIO_TransStagePar.Dfl_C AltIO_TransStagePar.stSensId_C AltIO_uBattThres_C /end DEF_CHARACTERISTIC
 /begin IN_MEASUREMENT BattU_u CoEng_st EngDa_tEng EnvP_p Epm_nEng StSys_stStrt T15_st /end IN_MEASUREMENT
 /begin OUT_MEASUREMENT AltIO_rAltLoad AltIO_st AltIO_stAltExcSt AltIO_stOn AltIO_tiLdResp AltIO_tiLRAlt /end OUT_MEASUREMENT
 /begin LOC_MEASUREMENT AltIO_tiExcDly_mp /end LOC_MEASUREMENT
 FUNCTION_VERSION "1.13.0" /end FUNCTION
/begin COMPU_METHOD ABMMNM_SY_Compu "" TAB_VERB "%6.3" "" COMPU_TAB_REF ABMMNM_SY_Compu /end COMPU_METHOD
/begin COMPU_VTAB ABMMNM_SY_Compu "" TAB_VERB 2 0 "False" 1 "True" /end COMPU_VTAB
/begin COMPU_METHOD AccGrv "" RAT_FUNC "%6.4" "g" COEFFS 0 100 0 0 0 1 /end COMPU_METHOD
/begin COMPU_METHOD AccHi "" RAT_FUNC "%7.6" "m/s^2" COEFFS 0 10000 0 0 0 1 /end COMPU_METHOD
/begin COMPU_METHOD ACCI_ECDBRK_SY_Compu "" TAB_VERB "%6.3" "" COMPU_TAB_REF ACCI_ECDBRK_SY_Compu /end COMPU_METHOD
/begin COMPU_VTAB ACCI_ECDBRK_SY_Compu "" TAB_VERB 2 0 "FALSE" 1 "TRUE" /end COMPU_VTAB
/begin COMPU_METHOD ACCI_RTRQDRGDES_SY_Compu "" TAB_VERB "%6.3" "" COMPU_TAB_REF ACCI_RTRQDRGDES_SY_Compu /end COMPU_METHOD
/begin COMPU_VTAB ACCI_RTRQDRGDES_SY_Compu "" TAB_VERB 2 0 "False" 1 "True" /end COMPU_VTAB
/begin COMPU_METHOD ACCI_TRQBRK_SY_Compu "" TAB_VERB "%6.3" "" COMPU_TAB_REF ACCI_TRQBRK_SY_Compu /end COMPU_METHOD
/begin COMPU_VTAB ACCI_TRQBRK_SY_Compu "" TAB_VERB 2 0 "False" 1 "True" /end COMPU_VTAB
/begin COMPU_METHOD ACCLNTP_ATS_SY_Compu "" TAB_VERB "%6.3" "" COMPU_TAB_REF ACCLNTP_ATS_SY_Compu /end COMPU_METHOD
/begin COMPU_VTAB ACCLNTP_ATS_SY_Compu "" TAB_VERB 2 0 "False" 1 "True" /end COMPU_VTAB
/begin COMPU_METHOD ACCLNTP_SENSTYP_SY_Compu "" TAB_VERB "%6.3" "" COMPU_TAB_REF ACCLNTP_SENSTYP_SY_Compu /end COMPU_METHOD
/begin COMPU_VTAB ACCLNTP_SENSTYP_SY_Compu "" TAB_VERB 3 0 "ADCIN" 1 "PWMOUT" 2 "ADCIN_PWMOUT" /end COMPU_VTAB
/begin COMPU_METHOD ACCPED_INTPOL_SY_Compu "" TAB_VERB "%6.3" "" COMPU_TAB_REF ACCPED_INTPOL_SY_Compu /end COMPU_METHOD
/begin COMPU_VTAB ACCPED_INTPOL_SY_Compu "" TAB_VERB 2 1 "ACCPED_VEL_INTPOL" 0 "ACCPED_VN_INTPOL" /end COMPU_VTAB
/begin COMPU_METHOD ACCPED_OVRRUNRMP_SY_Compu "" TAB_VERB "%6.3" "" COMPU_TAB_REF ACCPED_OVRRUNRMP_SY_Compu /end COMPU_METHOD
/begin COMPU_VTAB ACCPED_OVRRUNRMP_SY_Compu "" TAB_VERB 2 1 "TRUE" 0 "FALSE" /end COMPU_VTAB
/begin COMPU_METHOD ACCPED_REVGEARMAP_SY_Compu "" TAB_VERB "%6.3" "" COMPU_TAB_REF ACCPED_REVGEARMAP_SY_Compu /end COMPU_METHOD
/begin COMPU_VTAB ACCPED_REVGEARMAP_SY_Compu "" TAB_VERB 2 0 "False" 1 "True" /end COMPU_VTAB
/begin COMPU_METHOD AccPerSec_20ms "" RAT_FUNC "%6.4" "m/s^2/s" COEFFS 0 20 0 0 0 1 /end COMPU_METHOD
/begin COMPU_METHOD ACC_SY_Compu "" TAB_VERB "%6.3" "" COMPU_TAB_REF ACC_SY_Compu /end COMPU_METHOD
/begin COMPU_VTAB ACC_SY_Compu "" TAB_VERB 2 0 "FALSE" 1 "TRUE" /end COMPU_VTAB
/begin COMPU_METHOD ACHTRSWT_SY_Compu "" TAB_VERB "%6.3" "" COMPU_TAB_REF ACHTRSWT_SY_Compu /end COMPU_METHOD
/begin COMPU_VTAB ACHTRSWT_SY_Compu "" TAB_VERB 2 0 "False" 1 "True" /end COMPU_VTAB
/begin COMPU_METHOD ACSWT_ATS_SY_Compu "" TAB_VERB "%6.3" "" COMPU_TAB_REF ACSWT_ATS_SY_Compu /end COMPU_METHOD
/begin COMPU_VTAB ACSWT_ATS_SY_Compu "" TAB_VERB 2 0 "False" 1 "True" /end COMPU_VTAB
/begin COMPU_METHOD ActAngle "" RAT_FUNC "%6.4" "deg" COEFFS 0 20 0 0 0 1 /end COMPU_METHOD
/begin COMPU_METHOD ACTRSTEP_SNSRMOD_SC_Compu "" TAB_VERB "%6.3" "" COMPU_TAB_REF ACTRSTEP_SNSRMOD_SC_Compu /end COMPU_METHOD
/begin COMPU_VTAB ACTRSTEP_SNSRMOD_SC_Compu "" TAB_VERB 2 0 "False" 1 "True" /end COMPU_VTAB
/begin COMPU_METHOD ACTRSTEP_SNSR_SC_Compu "" TAB_VERB "%6.3" "" COMPU_TAB_REF ACTRSTEP_SNSR_SC_Compu /end COMPU_METHOD
/begin COMPU_VTAB ACTRSTEP_SNSR_SC_Compu "" TAB_VERB 2 0 "False" 1 "True" /end COMPU_VTAB
/begin COMPU_METHOD ACTTRQCO_SY_Compu "" TAB_VERB "%6.3" "" COMPU_TAB_REF ACTTRQCO_SY_Compu /end COMPU_METHOD
/begin COMPU_VTAB ACTTRQCO_SY_Compu "" TAB_VERB 2 1 "TRUE" 0 "FALSE" /end COMPU_VTAB
/begin COMPU_METHOD ACTYP_SY_Compu "" TAB_VERB "%6.3" "" COMPU_TAB_REF ACTYP_SY_Compu /end COMPU_METHOD
/begin COMPU_VTAB ACTYP_SY_Compu "" TAB_VERB 5 0 "NO_AC" 1 "ACTYP_MECH_FIX" 2 "ACTYP_MECH_VAR" 3 "ACTYP_ELEC" 4 "ACTYP_MECHELEC" /end COMPU_VTAB
/begin COMPU_METHOD AC_DEMAND_SY_Compu "" TAB_VERB "%6.3" "" COMPU_TAB_REF AC_DEMAND_SY_Compu /end COMPU_METHOD
/begin COMPU_VTAB AC_DEMAND_SY_Compu "" TAB_VERB 2 0 "False" 1 "True" /end COMPU_VTAB
/begin COMPU_METHOD AC_SWTHWORCAN_SY_Compu "" TAB_VERB "%6.3" "" COMPU_TAB_REF AC_SWTHWORCAN_SY_Compu /end COMPU_METHOD
/begin COMPU_VTAB AC_SWTHWORCAN_SY_Compu "" TAB_VERB 3 0 "both CAN and Hardware" 1 "only CAN" 2 "only Hardware" /end COMPU_VTAB
/begin COMPU_METHOD ADDDYNCOMP_SY_Compu "" TAB_VERB "%6.3" "" COMPU_TAB_REF ADDDYNCOMP_SY_Compu /end COMPU_METHOD
/begin COMPU_VTAB ADDDYNCOMP_SY_Compu "" TAB_VERB 2 0 "False" 1 "True" /end COMPU_VTAB
/begin COMPU_METHOD AIRC_ATSINTVMODCMPR_SY_Compu "" RAT_FUNC "%6.2" "" COEFFS 0 1 0 0 0 1 /end COMPU_METHOD
/begin COMPU_METHOD AIRC_ATSINTVMODREDTRQ_SY_Compu "" RAT_FUNC "%6.2" "" COEFFS 0 1 0 0 0 1 /end COMPU_METHOD
/begin COMPU_METHOD AIRC_REDTRQCMPRENA_SY_Compu "" TAB_VERB "%6.3" "" COMPU_TAB_REF AIRC_REDTRQCMPRENA_SY_Compu /end COMPU_METHOD
/begin COMPU_VTAB AIRC_REDTRQCMPRENA_SY_Compu "" TAB_VERB 2 0 "FALSE" 1 "TRUE" /end COMPU_VTAB
/begin COMPU_METHOD AIRDVP_VAR_SY_Compu "" TAB_VERB "%6.3" "" COMPU_TAB_REF AIRDVP_VAR_SY_Compu /end COMPU_METHOD
/begin COMPU_VTAB AIRDVP_VAR_SY_Compu "" TAB_VERB 32 1 "DAI" 3 "VWW" 5 "AUD" 22 "FOR" 147 "HYU" 999 "ALL" 214 "AVT" 9 "FIA" 21 "GMU" 159 "HON" 160 "MAZ" 123 "MIT" 20 "NIS" 14 "PSA" 4 "POR" 15 "REN" 248 "SUZ" 308 "TAT" 72 "TOY" 6 "OPE" 19 "VOL" 55 "ROL" 18 "SAB" 69 "FER" 51 "SEA" 204 "VVW" 17 "ALF" 289 "AMG" 11 "BMW" 183 "CU" 385 "UAES" 243 "DMC" /end COMPU_VTAB
/begin COMPU_METHOD AirMass "" RAT_FUNC "%6.4" "g" COEFFS 0 100 0 0 0 1 /end COMPU_METHOD
/begin COMPU_METHOD AirMassPerCyl "" RAT_FUNC "%6.3" "mg/Hub" COEFFS 0 10 0 0 0 1 /end COMPU_METHOD
/begin COMPU_METHOD AirMassPerTime "" RAT_FUNC "%6.3" "Kg/h" COEFFS 0 10 0 0 0 1 /end COMPU_METHOD
/begin COMPU_METHOD AirMassPerTimePT "" RAT_FUNC "%6.2" "Kg/h/s" COEFFS 0 1 0 0 0 1 /end COMPU_METHOD
/begin COMPU_METHOD AIRMOD_VAR_SY_Compu "" TAB_VERB "%6.3" "" COMPU_TAB_REF AIRMOD_VAR_SY_Compu /end COMPU_METHOD
/begin COMPU_VTAB AIRMOD_VAR_SY_Compu "" TAB_VERB 32 1 "DAI" 3 "VWW" 5 "AUD" 22 "FOR" 147 "HYU" 999 "ALL" 214 "AVT" 9 "FIA" 21 "GMU" 159 "HON" 160 "MAZ" 123 "MIT" 20 "NIS" 14 "PSA" 4 "POR" 15 "REN" 248 "SUZ" 308 "TAT" 72 "TOY" 6 "OPE" 19 "VOL" 55 "ROL" 18 "SAB" 69 "FER" 51 "SEA" 204 "VVW" 17 "ALF" 289 "AMG" 11 "BMW" 183 "CU" 385 "UAES" 243 "DMC" /end COMPU_VTAB
/begin COMPU_METHOD AirVolPerTime "" RAT_FUNC "%6.3" "m^3/h" COEFFS 0 10 0 0 0 1 /end COMPU_METHOD
/begin COMPU_METHOD AltChpTemp_q8p0_COMPU "" RAT_FUNC "%6.2" "deg C" COEFFS 0 0.125 4 0 0 1 /end COMPU_METHOD
/begin COMPU_METHOD AltCrntLim_A_q0p25_COMPU "" RAT_FUNC "%6.3" "A" COEFFS 0 4 0 0 0 1 /end COMPU_METHOD
/begin COMPU_METHOD AltCrntOut_A_q0p125_COMPU "" RAT_FUNC "%6.3" "A" COEFFS 0 8 0 0 0 1 /end COMPU_METHOD
/begin COMPU_METHOD ALTIO_SWTHWORCAN_SY_Compu "" TAB_VERB "%6.3" "" COMPU_TAB_REF ALTIO_SWTHWORCAN_SY_Compu /end COMPU_METHOD
/begin COMPU_VTAB ALTIO_SWTHWORCAN_SY_Compu "" TAB_VERB 3 1 "CAN_SEL" 2 "HW_SEL" 0 "HWANDCAN_SEL" /end COMPU_VTAB
/begin COMPU_METHOD AltLd_q3p125_COMPU "" RAT_FUNC "%6.2" "%" COEFFS 0 0.32 0 0 0 1 /end COMPU_METHOD
/begin COMPU_METHOD AltVltg_V_q0p1_COMPU "" RAT_FUNC "%6.2" "V" COEFFS 0 10 -106 0 0 1 /end COMPU_METHOD
/begin COMPU_METHOD Ampere_q0p1_COMPU "" RAT_FUNC "%6.3" "uA" COEFFS 0 10 0 0 0 1 /end COMPU_METHOD
/begin COMPU_METHOD AMUENE_SY_Compu "" TAB_VERB "%6.3" "" COMPU_TAB_REF AMUENE_SY_Compu /end COMPU_METHOD
/begin COMPU_VTAB AMUENE_SY_Compu "" TAB_VERB 2 0 "False" 1 "True" /end COMPU_VTAB
/begin COMPU_METHOD AngleRad "" RAT_FUNC "%7.6" "rad" COEFFS 0 10000 0 0 0 1 /end COMPU_METHOD
/begin COMPU_METHOD AngleStWhl "" RAT_FUNC "%6.4" "deg StWhl" COEFFS 0 32 0 0 0 1 /end COMPU_METHOD
/begin COMPU_METHOD APPSWTECU_SY_Compu "" TAB_VERB "%6.3" "" COMPU_TAB_REF APPSWTECU_SY_Compu /end COMPU_METHOD
/begin COMPU_VTAB APPSWTECU_SY_Compu "" TAB_VERB 2 0 "FALSE" 1 "TRUE" /end COMPU_VTAB
/begin COMPU_METHOD APP_MOVDET_SY_Compu "" TAB_VERB "%6.3" "" COMPU_TAB_REF APP_MOVDET_SY_Compu /end COMPU_METHOD
/begin COMPU_VTAB APP_MOVDET_SY_Compu "" TAB_VERB 2 0 "0" 1 "1" /end COMPU_VTAB
/begin COMPU_METHOD APP_NOIFLT_SY_Compu "" TAB_VERB "%6.3" "" COMPU_TAB_REF APP_NOIFLT_SY_Compu /end COMPU_METHOD
/begin COMPU_VTAB APP_NOIFLT_SY_Compu "" TAB_VERB 2 0 "FALSE" 1 "TRUE" /end COMPU_VTAB
/begin COMPU_METHOD APP_PREFILGENA_SY_Compu "" TAB_VERB "%6.3" "" COMPU_TAB_REF APP_PREFILGENA_SY_Compu /end COMPU_METHOD
/begin COMPU_VTAB APP_PREFILGENA_SY_Compu "" TAB_VERB 2 0 "FALSE" 1 "TRUE" /end COMPU_VTAB
/begin COMPU_METHOD ASDBYPCOR_SY_Compu "" TAB_VERB "%6.3" "" COMPU_TAB_REF ASDBYPCOR_SY_Compu /end COMPU_METHOD
/begin COMPU_VTAB ASDBYPCOR_SY_Compu "" TAB_VERB 2 0 "False" 1 "True" /end COMPU_VTAB
/begin COMPU_METHOD ASDDC_CONTTRQINC_SY_Compu "" TAB_VERB "%6.3" "" COMPU_TAB_REF ASDDC_CONTTRQINC_SY_Compu /end COMPU_METHOD
/begin COMPU_VTAB ASDDC_CONTTRQINC_SY_Compu "" TAB_VERB 2 0 "0" 1 "1" /end COMPU_VTAB
/begin COMPU_METHOD ASDDC_NENGSIZE_SY_Compu "" RAT_FUNC "%6.2" "" COEFFS 0 1 0 0 0 1 /end COMPU_METHOD
/begin COMPU_METHOD ASDDC_NRNG_SY_Compu "" TAB_VERB "%6.3" "" COMPU_TAB_REF ASDDC_NRNG_SY_Compu /end COMPU_METHOD
/begin COMPU_VTAB ASDDC_NRNG_SY_Compu "" TAB_VERB 2 0 "0" 1 "1" /end COMPU_VTAB
/begin COMPU_METHOD ASDDC_STY_SY_Compu "" TAB_VERB "%6.3" "" COMPU_TAB_REF ASDDC_STY_SY_Compu /end COMPU_METHOD
/begin COMPU_VTAB ASDDC_STY_SY_Compu "" TAB_VERB 2 0 "0" 1 "1" /end COMPU_VTAB
/begin COMPU_METHOD ASDRF_ENA_SC_Compu "" TAB_VERB "%6.3" "" COMPU_TAB_REF ASDRF_ENA_SC_Compu /end COMPU_METHOD
/begin COMPU_VTAB ASDRF_ENA_SC_Compu "" TAB_VERB 2 0 "0" 1 "1" /end COMPU_VTAB
/begin COMPU_METHOD ASDRF_FACDESDYNSIZE_SY_Compu "" RAT_FUNC "%6.2" "" COEFFS 0 1 0 0 0 1 /end COMPU_METHOD
/begin COMPU_METHOD ASDRF_FCOPAR_SY_Compu "" TAB_VERB "%6.3" "" COMPU_TAB_REF ASDRF_FCOPAR_SY_Compu /end COMPU_METHOD
/begin COMPU_VTAB ASDRF_FCOPAR_SY_Compu "" TAB_VERB 2 0 "False" 1 "True" /end COMPU_VTAB
/begin COMPU_METHOD ASDRF_NENGSIZE_SY_Compu "" RAT_FUNC "%6.2" "" COEFFS 0 1 0 0 0 1 /end COMPU_METHOD
/begin COMPU_METHOD ASDRF_NOGRIPPAR_SY_Compu "" TAB_VERB "%6.3" "" COMPU_TAB_REF ASDRF_NOGRIPPAR_SY_Compu /end COMPU_METHOD
/begin COMPU_VTAB ASDRF_NOGRIPPAR_SY_Compu "" TAB_VERB 2 0 "False" 1 "True" /end COMPU_VTAB
/begin COMPU_METHOD ASDRF_RGRIP_SY_Compu "" TAB_VERB "%6.3" "" COMPU_TAB_REF ASDRF_RGRIP_SY_Compu /end COMPU_METHOD
/begin COMPU_VTAB ASDRF_RGRIP_SY_Compu "" TAB_VERB 2 0 "False" 1 "True" /end COMPU_VTAB
/begin COMPU_METHOD ASDRF_RTRQSIZE_SY_Compu "" RAT_FUNC "%6.2" "" COEFFS 0 1 0 0 0 1 /end COMPU_METHOD
/begin COMPU_METHOD AUTOSTRT_SY_Compu "" TAB_VERB "%6.3" "" COMPU_TAB_REF AUTOSTRT_SY_Compu /end COMPU_METHOD
/begin COMPU_VTAB AUTOSTRT_SY_Compu "" TAB_VERB 2 0 "no automatic start functionality" 1 "with automatic start functionality" /end COMPU_VTAB
/begin COMPU_METHOD AUTSHRTTRP_SY_Compu "" TAB_VERB "%6.3" "" COMPU_TAB_REF AUTSHRTTRP_SY_Compu /end COMPU_METHOD
/begin COMPU_VTAB AUTSHRTTRP_SY_Compu "" TAB_VERB 2 0 "False" 1 "True" /end COMPU_VTAB
/begin COMPU_METHOD AWD_SY_Compu "" TAB_VERB "%6.3" "" COMPU_TAB_REF AWD_SY_Compu /end COMPU_METHOD
/begin COMPU_VTAB AWD_SY_Compu "" TAB_VERB 2 0 "0" 1 "1" /end COMPU_VTAB
/begin COMPU_METHOD BASSVRAPPL_CPP_Compu "" TAB_VERB "%6.3" "" COMPU_TAB_REF BASSVRAPPL_CPP_Compu /end COMPU_METHOD
/begin COMPU_VTAB BASSVRAPPL_CPP_Compu "" TAB_VERB 2 0 "0" 1 "1" /end COMPU_VTAB
/begin COMPU_METHOD BASSVRAPPL_PSC_Compu "" TAB_VERB "%6.3" "" COMPU_TAB_REF BASSVRAPPL_PSC_Compu /end COMPU_METHOD
/begin COMPU_VTAB BASSVRAPPL_PSC_Compu "" TAB_VERB 2 0 "0" 1 "1" /end COMPU_VTAB
/begin COMPU_METHOD B_TRUE "" TAB_VERB "%6.3" "" COMPU_TAB_REF B_TRUE /end COMPU_METHOD
/begin COMPU_VTAB B_TRUE "" TAB_VERB 2 0 "----" 1 "TRUE" /end COMPU_VTAB
/begin COMPU_METHOD dez "" RAT_FUNC "%6.2" "" COEFFS 0 1 0 0 0 1 /end COMPU_METHOD
/begin COMPU_METHOD dfp_verbal "" TAB_VERB "%2.1" "-" COMPU_TAB_REF dfp_verbal /end COMPU_METHOD
/begin COMPU_VTAB dfp_verbal "" TAB_VERB 87 0 "DFP_AAA" 1 "DFP_BM" 2 "DFP_DK" 3 "DFP_DKVS" 4 "DFP_DSS" 5 "DFP_DVEV" 6 "DFP_DYLSU" 7 "DFP_DZKU0" 8 "DFP_DZKU1" 9 "DFP_DZKU2" 10 "DFP_EGFE" 11 "DFP_ENWS" 12 "DFP_ENWSE" 13 "DFP_EV1" 14 "DFP_EV2" 15 "DFP_EV3" 16 "DFP_FMAS" 17 "DFP_FP1P" 18 "DFP_FP2P" 19 "DFP_FRA" 20 "DFP_FRAU" 21 "DFP_FTDLA" 22 "DFP_HELSU" 23 "DFP_HRE" 24 "DFP_HSH" 25 "DFP_HSHE" 26 "DFP_HSV" 27 "DFP_HSVE" 28 "DFP_HSVSA" 29 "DFP_ICLSU" 30 "DFP_KAT" 31 "DFP_KATF" 32 "DFP_KPE" 33 "DFP_KRNT" 34 "DFP_KROF" 35 "DFP_KRTP" 36 "DFP_KUPPL" 37 "DFP_LASH" 38 "DFP_LLR" 39 "DFP_LLRKH" 40 "DFP_LM" 41 "DFP_LSH" 42 "DFP_LSUKS" 43 "DFP_LSUUN" 44 "DFP_LSV" 45 "DFP_LUES1E" 46 "DFP_LZSR" 47 "DFP_MD" 48 "DFP_N" 49 "DFP_NWKW" 50 "DFP_NWKWE" 51 "DFP_ORA" 52 "DFP_PH" 53 "DFP_PHE" 54 "DFP_PLLSU" 55 "DFP_PS1E" 56 "DFP_PS2E" 57 "DFP_PS3E" 58 "DFP_PSR" 59 "DFP_PSR1" 60 "DFP_PSRB" 61 "DFP_PSRE" 62 "DFP_PSRP" 63 "DFP_PVD" 64 "DFP_RKAT" 65 "DFP_RKAZ" 66 "DFP_STKLSV" 67 "DFP_TA" 68 "DFP_TACS" 69 "DFP_TAR" 70 "DFP_TASR" 71 "DFP_TASRE" 72 "DFP_TES" 73 "DFP_TEVE" 74 "DFP_THM" 75 "DFP_TM" 76 "DFP_TMCS" 77 "DFP_TME" 78 "DFP_TMKI" 79 "DFP_TMP" 80 "DFP_TUM" 81 "DFP_UB" 82 "DFP_UBR" 83 "DFP_ULSU" 84 "DFP_VFZ" 85 "DFP_VFZG" 86 "DFP_ZZZ" DEFAULT_VALUE "---" /end COMPU_VTAB
/begin COMPU_METHOD DtyCyc "" RAT_FUNC "%6.4" "%" COEFFS 0 100 0 0 0 1 /end COMPU_METHOD
/begin COMPU_METHOD EngN "" RAT_FUNC "%6.3" "rpm" COEFFS 0 2 0 0 0 1 /end COMPU_METHOD
/begin COMPU_METHOD Fact1 "" RAT_FUNC "%6.4" "-" COEFFS 0 128 0 0 0 1 /end COMPU_METHOD
/begin COMPU_METHOD fak_q0p1 "" RAT_FUNC "%6.3" "-" COEFFS 0 1 0 0 0 0.1 /end COMPU_METHOD
/begin COMPU_METHOD fak_ub_b2 "" RAT_FUNC "%8.5" "-" COEFFS 0 256 0 0 0 2 /end COMPU_METHOD
/begin COMPU_METHOD nmotg_sw_q0p39 "" RAT_FUNC "%6.3" "1/(min*s)" COEFFS 0 1 0 0 0 0.39063 /end COMPU_METHOD
/begin COMPU_METHOD OneToOne "" RAT_FUNC "%6.2" "-" COEFFS 0 1 0 0 0 1 /end COMPU_METHOD
/begin COMPU_METHOD Prc "" RAT_FUNC "%6.4" "%" COEFFS 0 81.92 0 0 0 1 /end COMPU_METHOD
/begin COMPU_METHOD PrcPerSec "" RAT_FUNC "%6.3" "%/s" COEFFS 0 1.6384 0 0 0 1 /end COMPU_METHOD
/begin COMPU_METHOD PresAC_hPa "" RAT_FUNC "%6.2" "hPa" COEFFS 0 0.5 0 0 0 1 /end COMPU_METHOD
/begin COMPU_METHOD Pres_hPa "" RAT_FUNC "%6.2" "hPa" COEFFS 0 1 0 0 0 1 /end COMPU_METHOD
/begin COMPU_METHOD p_sw_q0p039 "" RAT_FUNC "%6.4" "hPa" COEFFS 0 256 0 0 0 10 /end COMPU_METHOD
/begin COMPU_METHOD p_uw_b32 "" RAT_FUNC "%6.5" "hPa/%" COEFFS 0 65536 0 0 0 32 /end COMPU_METHOD
/begin COMPU_METHOD p_uw_q0p039 "" RAT_FUNC "%6.4" "hPa" COEFFS 0 256 0 0 0 10 /end COMPU_METHOD
/begin COMPU_METHOD rel_ub_b100 "" RAT_FUNC "%6.3" "%" COEFFS 0 256 0 0 0 100 /end COMPU_METHOD
/begin COMPU_METHOD RmpDtyCyc "" RAT_FUNC "%6.5" "%/s" COEFFS 0 6553.6 0 0 0 1 /end COMPU_METHOD
/begin COMPU_METHOD RmpPresAC_hPa "" RAT_FUNC "%6.4" "hPa/s" COEFFS 0 32.768 0 0 0 1 /end COMPU_METHOD
/begin COMPU_METHOD spg_q0p1 "" RAT_FUNC "%6.3" "V" COEFFS 0 1 0 0 0 0.1 /end COMPU_METHOD
/begin COMPU_METHOD spg_ubatt_w "" RAT_FUNC "%6.4" "V" COEFFS 0 1 0 0 0 0.02355 /end COMPU_METHOD
/begin COMPU_METHOD spg_uw_q0p001222 "" RAT_FUNC "%6.4" "V" COEFFS 0 65536 0 0 0 80 /end COMPU_METHOD
/begin COMPU_METHOD spg_uw_q0p00488 "" RAT_FUNC "%6.4" "V" COEFFS 0 1024 0 0 0 5 /end COMPU_METHOD
/begin COMPU_METHOD t10msxs_ub_b2p55 "" RAT_FUNC "%6.4" "s" COEFFS 0 1 0 0 0 0.01 /end COMPU_METHOD
/begin COMPU_METHOD t1sxs_uw_q1 "" RAT_FUNC "%6.2" "s" COEFFS 0 1 0 0 0 1 /end COMPU_METHOD
/begin COMPU_METHOD Temp_Cels "" RAT_FUNC "%6.1" "deg C" COEFFS 0 10 2731.4 0 0 1 /end COMPU_METHOD
/begin COMPU_METHOD temp_q0p75_om48 "" RAT_FUNC "%6.2" "Grad C" COEFFS 0 4 192 0 0 3 /end COMPU_METHOD
/begin COMPU_METHOD temp_ub_q0p75_o48 "" RAT_FUNC "%6.2" "Grad C" COEFFS 0 1 48 0 0 0.75 /end COMPU_METHOD
/begin COMPU_METHOD TimeDeb "" RAT_FUNC "%6.1" "ms" COEFFS 0 0.1 0 0 0 1 /end COMPU_METHOD
/begin COMPU_METHOD TimeDelay_ms "" RAT_FUNC "%12.1" "ms" COEFFS 0 0 1 0 2.3283064365387e-007 0 /end COMPU_METHOD
/begin COMPU_METHOD TimeDelay_s "" RAT_FUNC "%12.4" "s" COEFFS 0 0 1 0 0.00023283064365387 0 /end COMPU_METHOD
/begin COMPU_METHOD TimeDT "" RAT_FUNC "%6.2" "us" COEFFS 0 1 0 0 0 1 /end COMPU_METHOD
/begin COMPU_METHOD TimeRed "" RAT_FUNC "%6.3" "s" COEFFS 0 6.25 0 0 0 1 /end COMPU_METHOD
/begin COMPU_METHOD Time_Dt "" RAT_FUNC "%9.8" "s" COEFFS 0 1000000 0 0 0 1 /end COMPU_METHOD
/begin COMPU_METHOD Time_ms "" RAT_FUNC "%6.1" "ms" COEFFS 0 0.1 0 0 0 1 /end COMPU_METHOD
/begin COMPU_METHOD Time_s "" RAT_FUNC "%6.4" "s" COEFFS 0 100 0 0 0 1 /end COMPU_METHOD
/begin COMPU_METHOD Trq "" RAT_FUNC "%6.3" "Nm" COEFFS 0 10 0 0 0 1 /end COMPU_METHOD
/begin COMPU_METHOD t_q0p1 "" RAT_FUNC "%6.3" "s" COEFFS 0 10 0 0 0 1 /end COMPU_METHOD
/begin COMPU_METHOD Vel "" RAT_FUNC "%6.4" "km/h" COEFFS 0 100 0 0 0 1 /end COMPU_METHOD
/begin COMPU_METHOD Volt "" RAT_FUNC "%6.3" "mV" COEFFS 0 5 0 0 0 1 /end COMPU_METHOD
/begin COMPU_METHOD Volt_Batt "" RAT_FUNC "%6.1" "mV" COEFFS 0 0.05 0 0 0 1 /end COMPU_METHOD
/begin COMPU_METHOD vol_q0p1 "" RAT_FUNC "%6.3" "ml" COEFFS 0 1 0 0 0 0.1 /end COMPU_METHOD
/begin COMPU_METHOD vs_q0p1 "" RAT_FUNC "%6.3" "ml/dT" COEFFS 0 1 0 0 0 0.1 /end COMPU_METHOD
/begin RECORD_LAYOUT Axis_Xs16 NO_AXIS_PTS_X 1 SWORD AXIS_PTS_X 2 SWORD INDEX_INCR DIRECT /end RECORD_LAYOUT
/begin RECORD_LAYOUT CurG_Ws16 FNC_VALUES 1 SWORD COLUMN_DIR DIRECT /end RECORD_LAYOUT
/begin RECORD_LAYOUT Cur_Xs16Ws16 NO_AXIS_PTS_X 1 SWORD AXIS_PTS_X 2 SWORD INDEX_INCR DIRECT FNC_VALUES 3 SWORD COLUMN_DIR DIRECT /end RECORD_LAYOUT
/begin RECORD_LAYOUT KlAxU8SstxU8WU16 NO_AXIS_PTS_X 1 UBYTE AXIS_PTS_X 2 UBYTE INDEX_INCR DIRECT FNC_VALUES 3 UWORD COLUMN_DIR DIRECT /end RECORD_LAYOUT
/begin RECORD_LAYOUT KwbWU16 FNC_VALUES 1 UWORD COLUMN_DIR DIRECT /end RECORD_LAYOUT
/begin RECORD_LAYOUT KwbWU8 FNC_VALUES 1 UBYTE COLUMN_DIR DIRECT /end RECORD_LAYOUT
/begin RECORD_LAYOUT KwWU16 FNC_VALUES 1 UWORD COLUMN_DIR DIRECT /end RECORD_LAYOUT
/begin RECORD_LAYOUT KwWU8 FNC_VALUES 1 UBYTE COLUMN_DIR DIRECT /end RECORD_LAYOUT
/begin RECORD_LAYOUT Kw_Ws16 FNC_VALUES 1 SWORD COLUMN_DIR DIRECT /end RECORD_LAYOUT
/begin RECORD_LAYOUT Kw_Ws32 FNC_VALUES 1 SLONG COLUMN_DIR DIRECT /end RECORD_LAYOUT
/begin RECORD_LAYOUT Kw_Wu16 FNC_VALUES 1 UWORD COLUMN_DIR DIRECT /end RECORD_LAYOUT
/begin RECORD_LAYOUT Kw_Wu8 FNC_VALUES 1 UBYTE COLUMN_DIR DIRECT /end RECORD_LAYOUT
/begin RECORD_LAYOUT Map_Xs16Ys16Ws16 NO_AXIS_PTS_X 1 SWORD NO_AXIS_PTS_Y 2 SWORD AXIS_PTS_X 3 SWORD INDEX_INCR DIRECT AXIS_PTS_Y 4 SWORD INDEX_INCR DIRECT FNC_VALUES 5 SWORD COLUMN_DIR DIRECT /end RECORD_LAYOUT
/begin RECORD_LAYOUT Val_Ws16 FNC_VALUES 1 SWORD COLUMN_DIR DIRECT /end RECORD_LAYOUT
/begin RECORD_LAYOUT Val_Ws32 FNC_VALUES 1 SLONG COLUMN_DIR DIRECT /end RECORD_LAYOUT
/begin RECORD_LAYOUT Val_Ws8 FNC_VALUES 1 SBYTE COLUMN_DIR DIRECT /end RECORD_LAYOUT
/begin RECORD_LAYOUT Val_Wu16 FNC_VALUES 1 UWORD COLUMN_DIR DIRECT /end RECORD_LAYOUT
/begin RECORD_LAYOUT Val_Wu32 FNC_VALUES 1 ULONG COLUMN_DIR DIRECT /end RECORD_LAYOUT
/begin RECORD_LAYOUT Val_Wu8 FNC_VALUES 1 UBYTE COLUMN_DIR DIRECT /end RECORD_LAYOUT
/end MODULE
/end PROJECT
