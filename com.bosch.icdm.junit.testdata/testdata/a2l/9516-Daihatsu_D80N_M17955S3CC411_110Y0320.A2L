ASAP2_VERSION 1 4
/begin PROJECT M17955S3CC411_110Y0320 "M17955S3CC411_110Y0320"
/begin HEADER "" VERSION "M17955S3CC411_110Y0320" PROJECT_NO M17955S3CC411_110Y0320 /end HEADER
/begin MODULE DIM ""
/begin MOD_COMMON "" BYTE_ORDER MSB_LAST ALIGNMENT_BYTE 1 ALIGNMENT_WORD 2 ALIGNMENT_LONG 4 ALIGNMENT_FLOAT32_IEEE 4 /end MOD_COMMON
/begin CHARACTERISTIC ANZTILRA "" VALUE 0x800478E6 KwWU16 65535.00 dez 0.00 65535.00 FORMAT "%8.2" /end CHARACTERISTIC
/begin CHARACTERISTIC BattU_uDfl_C "" VALUE 0x800495C2 KwWS16 30000.00 Volt_Batt 0.00 30000.00 FORMAT "%8.2" /end CHARACTERISTIC
/begin CHARACTERISTIC BattU_uNrm_C "" VALUE 0x800495C4 KwWS16 30000.00 Volt_Batt 0.00 30000.00 FORMAT "%8.2" /end CHARACTERISTIC
/begin CHARACTERISTIC CNFMDVER "" VALUE 0x800490CE KwWU8 255.0 dez 0.00 255.0 FORMAT "%5.1" /end CHARACTERISTIC
/begin CHARACTERISTIC CREDSTU "" VALUE 0x80048E02 KwWU8 255.0 dez 0.00 255.0 FORMAT "%5.1" /end CHARACTERISTIC
/begin CHARACTERISTIC CWBR "" VALUE 0x80047D78 KwWU8 255.0 dez 0.00 255.0 FORMAT "%5.1" /end CHARACTERISTIC
/begin CHARACTERISTIC CWIR "" VALUE 0x80047D79 KwWU8 255.0 dez 0.00 255.0 FORMAT "%5.1" /end CHARACTERISTIC
/begin CHARACTERISTIC CWLLDEUS "" VALUE 0x800475DE KwWU8 255.0 dez 0.00 255.0 FORMAT "%5.1" /end CHARACTERISTIC
/begin CHARACTERISTIC CWLLRRM "" VALUE 0x800475DF KwWU8 255.0 dez 0.00 255.0 FORMAT "%5.1" /end CHARACTERISTIC
/begin CHARACTERISTIC CWLR "" VALUE 0x80047A10 KwWU8 255.0 dez 0.00 255.0 FORMAT "%5.1" /end CHARACTERISTIC
/begin CHARACTERISTIC CWLRAEB "" VALUE 0x800478E8 KwWU8 255.0 dez 0.00 255.0 FORMAT "%5.1" /end CHARACTERISTIC
/begin CHARACTERISTIC CWLRAEBORA "" VALUE 0x800478E9 KwWU8 255.0 dez 0.00 255.0 FORMAT "%5.1" /end CHARACTERISTIC
/begin CHARACTERISTIC CWLREB "" VALUE 0x800479B4 KwWU8 255.0 dez 0.00 255.0 FORMAT "%5.1" /end CHARACTERISTIC
/begin CHARACTERISTIC CWLREBMD "" VALUE 0x800479B5 KwWU8 255.0 dez 0.00 255.0 FORMAT "%5.1" /end CHARACTERISTIC
/begin CHARACTERISTIC CWLWSDWK "" VALUE 0x80048BDC KwWU8 255.0 dez 0.00 255.0 FORMAT "%5.1" /end CHARACTERISTIC
/begin CHARACTERISTIC CWMBAS "" VALUE 0x80047D7A KwWU8 255.0 OneToOne 0.00 255.0 FORMAT "%5.1" /end CHARACTERISTIC
/begin CHARACTERISTIC CWMDARE "" VALUE 0x80047B08 KwWU8 255.0 dez 0.00 255.0 FORMAT "%5.1" /end CHARACTERISTIC
/begin CHARACTERISTIC CWMDVERAD "" VALUE 0x80048E8E KwWU8 255.0 dez 0.00 255.0 FORMAT "%5.1" /end CHARACTERISTIC
/begin CHARACTERISTIC CWORAP "" VALUE 0x8004797A KwWU8 255.0 dez 0.00 255.0 FORMAT "%5.1" /end CHARACTERISTIC
/begin CHARACTERISTIC CWRKANMOT "" VALUE 0x8004797B KwWU8 255.0 dez 0.00 255.0 FORMAT "%5.1" /end CHARACTERISTIC
/begin CHARACTERISTIC CWTUMKO "" VALUE 0x80048EB8 KwWU8 255.0 dez 0.00 255.0 FORMAT "%5.1" /end CHARACTERISTIC
/begin CHARACTERISTIC DDMRKH "" VALUE 0x80048BD8 KwWU16 99.99847 rel_uw_b100 0.00 99.99847 FORMAT "%8.5" /end CHARACTERISTIC
/begin CHARACTERISTIC DDMVADEP "" VALUE 0x80048E90 KwWS16 99.99695 rel_sw_b100 0.00 99.99695 FORMAT "%8.5" /end CHARACTERISTIC
/begin CHARACTERISTIC DDWPEDMDK "" VALUE 0x800490D0 KwWU16 50.00000 rel_uw_b100 0.00 50.00000 FORMAT "%8.5" /end CHARACTERISTIC
/begin CHARACTERISTIC DETANN "" CURVE 0x80047D7C KlAxU8SstxU8WU16 127.9980 rel_uw_b127p5 0.00 127.9980 FORMAT "%8.4"
 /begin AXIS_DESCR STD_AXIS nmot nmot_ub_q40 10 0.00 10200. FORMAT "%5.0" DEPOSIT ABSOLUTE /end AXIS_DESCR
/end CHARACTERISTIC
/begin CHARACTERISTIC DETANNMA "" CURVE 0x80047D9C KlAxU8SstxU8WU16 127.9980 rel_uw_b127p5 0.00 127.9980 FORMAT "%8.4"
 /begin AXIS_DESCR STD_AXIS nmot nmot_ub_q40 10 0.00 10200. FORMAT "%5.0" DEPOSIT ABSOLUTE /end AXIS_DESCR
/end CHARACTERISTIC
/begin CHARACTERISTIC DETAPN "" CURVE 0x80047DBC KlAxU8SstxU8WU16 127.9980 rel_uw_b127p5 0.00 127.9980 FORMAT "%8.4"
 /begin AXIS_DESCR STD_AXIS nmot nmot_ub_q40 10 0.00 10200. FORMAT "%5.0" DEPOSIT ABSOLUTE /end AXIS_DESCR
/end CHARACTERISTIC
/begin CHARACTERISTIC DFAOWK "" VALUE 0x80048BDD KwWU8 0.9961 fak_ub_b1 0.00 0.9961 /end CHARACTERISTIC
/begin CHARACTERISTIC DFAUWKN "" CURVE 0x80048BDE GklWU8 0.9961 fak_ub_b1 0.00 0.9961
 /begin AXIS_DESCR COM_AXIS nmot nmot_ub_q40 6 0.00 10200. FORMAT "%5.0" AXIS_PTS_REF SNM06MFUB /end AXIS_DESCR
/end CHARACTERISTIC
/begin CHARACTERISTIC DFAWKN "" CURVE 0x80048BE4 GklWU8 0.9961 fak_ub_b1 0.00 0.9961
 /begin AXIS_DESCR COM_AXIS nmot nmot_ub_q40 6 0.00 10200. FORMAT "%5.0" AXIS_PTS_REF SNM06MFUB /end AXIS_DESCR
/end CHARACTERISTIC
/begin CHARACTERISTIC DFRFFRM "" VALUE 0x80047A12 KwWU16 1.999969 fak_uw_b2 0.00 1.999969 FORMAT "%8.6" /end CHARACTERISTIC
/begin CHARACTERISTIC DFRSPS "" VALUE 0x80047A14 KwWS16 0.9999695 fak_sw_b1 0.00 0.9999695 FORMAT "%9.7" /end CHARACTERISTIC
/begin CHARACTERISTIC DLIMXDNS "" CURVE 0x800475E0 GklWU8 24.90 rel_ub_b24p9 0.00 24.90 FORMAT "%5.2"
 /begin AXIS_DESCR COM_AXIS dns nmotd_sb_q10 6 -1280. 1270. FORMAT "%5.0" AXIS_PTS_REF SNZ06LLSB /end AXIS_DESCR
/end CHARACTERISTIC
/begin CHARACTERISTIC DMADFK "" VALUE 0x80048E92 KwWU16 25.00000 rel_sw_b100 0.00 25.00000 FORMAT "%8.5" /end CHARACTERISTIC
/begin CHARACTERISTIC DMADFS "" VALUE 0x80048E94 KwWU16 25.00000 rel_sw_b100 0.00 25.00000 FORMAT "%8.5" /end CHARACTERISTIC
/begin CHARACTERISTIC DMADKO "" VALUE 0x80048E96 KwWU16 25.00000 rel_sw_b100 0.00 25.00000 FORMAT "%8.5" /end CHARACTERISTIC
/begin CHARACTERISTIC DMADLL "" VALUE 0x80048E98 KwWU16 25.00000 rel_sw_b100 0.00 25.00000 FORMAT "%8.5" /end CHARACTERISTIC
/begin CHARACTERISTIC DMADMNFK "" VALUE 0x80048E9A KwWS16 25.00000 rel_sw_b100 -25.00000 0.00 FORMAT "%8.5" /end CHARACTERISTIC
/begin CHARACTERISTIC DMADMNFS "" VALUE 0x80048E9C KwWS16 25.00000 rel_sw_b100 -25.00000 0.00 FORMAT "%8.5" /end CHARACTERISTIC
/begin CHARACTERISTIC DMADMNKO "" VALUE 0x80048E9E KwWS16 25.00000 rel_sw_b100 -25.00000 0.00 FORMAT "%8.5" /end CHARACTERISTIC
/begin CHARACTERISTIC DMADMNLL "" VALUE 0x80048EA0 KwWS16 25.00000 rel_sw_b100 -25.00000 0.00 FORMAT "%8.5" /end CHARACTERISTIC
/begin CHARACTERISTIC DMADMXFK "" VALUE 0x80048EA2 KwWU16 25.00000 rel_sw_b100 0.00 25.00000 FORMAT "%8.5" /end CHARACTERISTIC
/begin CHARACTERISTIC DMADMXFS "" VALUE 0x80048EA4 KwWU16 25.00000 rel_sw_b100 0.00 25.00000 FORMAT "%8.5" /end CHARACTERISTIC
/begin CHARACTERISTIC DMADMXKO "" VALUE 0x80048EA6 KwWU16 25.00000 rel_sw_b100 0.00 25.00000 FORMAT "%8.5" /end CHARACTERISTIC
/begin CHARACTERISTIC DMADMXLL "" VALUE 0x80048EA8 KwWU16 25.00000 rel_sw_b100 0.00 25.00000 FORMAT "%8.5" /end CHARACTERISTIC
/begin CHARACTERISTIC DMARMXKL "" CURVE 0x80047B09 KlAxU8SstxU8WU8 99.61 rel_ub_b100 0.00 99.61 FORMAT "%5.2"
 /begin AXIS_DESCR STD_AXIS tmot temp_ub_q0p75_o48 6 -48.00 143.3 FORMAT "%5.1" DEPOSIT ABSOLUTE /end AXIS_DESCR
/end CHARACTERISTIC
/begin CHARACTERISTIC DMDFAO "" VALUE 0x80048BEA KwWU8 0.9961 fak_ub_b1 0.00 0.9961 /end CHARACTERISTIC
/begin CHARACTERISTIC DMDFAWE "" VALUE 0x80048BEB KwWU8 0.9961 fak_ub_b1 0.00 0.9961 /end CHARACTERISTIC
/begin CHARACTERISTIC DMDKOE "" CURVE 0x80048EB9 KlAxU8SstxU8WU8 50.00 rel_ub_b50 0.00 50.00 FORMAT "%5.2"
 /begin AXIS_DESCR STD_AXIS pach p_q156p86 6 0.00 39999. FORMAT "%5.0" DEPOSIT ABSOLUTE /end AXIS_DESCR
/end CHARACTERISTIC
/begin CHARACTERISTIC DMDLOAD1 "" VALUE 0x80048EC6 KwWU8 50.00 rel_ub_b50 0.00 50.00 FORMAT "%5.2" /end CHARACTERISTIC
/begin CHARACTERISTIC DMDLOAD3 "" VALUE 0x80048EC7 KwWU8 50.00 rel_ub_b50 0.00 50.00 FORMAT "%5.2" /end CHARACTERISTIC
/begin CHARACTERISTIC DMDWANK "" VALUE 0x800490D2 KwWS16 199.9969 rel_sw_b100 -100.0000 99.99695 FORMAT "%8.4" /end CHARACTERISTIC
/begin CHARACTERISTIC DMIZWMN "" VALUE 0x80048E04 KwWU16 99.99847 rel_uw_b100 0.00 99.99847 FORMAT "%8.5" /end CHARACTERISTIC
/begin CHARACTERISTIC DMLLNGEZ "" MAP 0x800475E6 KfAxU8AyU8SstxS16SstyU8WS16 199.9841 rel_q0p00305 -99.99360 99.99055 FORMAT "%8.5"
 /begin AXIS_DESCR STD_AXIS ngasf_w nmotg_sw_q0p39 6 -12800.16 12799.77 FORMAT "%8.2" DEPOSIT ABSOLUTE /end AXIS_DESCR
 /begin AXIS_DESCR STD_AXIS etazws rel_ub_b127p5 4 0.00 127.5 FORMAT "%5.1" DEPOSIT ABSOLUTE /end AXIS_DESCR
/end CHARACTERISTIC
/begin CHARACTERISTIC DMLLNGEZV "" MAP 0x80047628 KfAxU8AyU8SstxS16SstyU8WS16 199.9841 rel_q0p00305 -99.99360 99.99055 FORMAT "%8.5"
 /begin AXIS_DESCR STD_AXIS ngasf_w nmotg_sw_q0p39 6 -12800.16 12799.77 FORMAT "%8.2" DEPOSIT ABSOLUTE /end AXIS_DESCR
 /begin AXIS_DESCR STD_AXIS etazws rel_ub_b127p5 4 0.00 127.5 FORMAT "%5.1" DEPOSIT ABSOLUTE /end AXIS_DESCR
/end CHARACTERISTIC
/begin CHARACTERISTIC DMLLRLMNF "" VALUE 0x8004766A KwWS8 50.00 rel_q0p39 -50.00 0.00 FORMAT "%5.2" /end CHARACTERISTIC
/begin CHARACTERISTIC DMLLRLMNKH "" CURVE 0x8004766B GklWS8 50.00 rel_q0p39 -50.00 0.00 FORMAT "%5.2"
 /begin AXIS_DESCR COM_AXIS nmot_w nmot_uw_q0p25 6 0.00 16383.75 FORMAT "%8.2" AXIS_PTS_REF SNM06LLUW /end AXIS_DESCR
/end CHARACTERISTIC
/begin CHARACTERISTIC DMLLRLMNN "" CURVE 0x80047671 GklWS8 50.00 rel_q0p39 -50.00 0.00 FORMAT "%5.2"
 /begin AXIS_DESCR COM_AXIS nmot_w nmot_uw_q0p25 6 0.00 16383.75 FORMAT "%8.2" AXIS_PTS_REF SNM06LLUW /end AXIS_DESCR
/end CHARACTERISTIC
/begin CHARACTERISTIC DMLLRLMNST "" CURVE 0x80047677 GklWS8 50.00 rel_q0p39 -50.00 0.00 FORMAT "%5.2"
 /begin AXIS_DESCR COM_AXIS nmot_w nmot_uw_q0p25 6 0.00 16383.75 FORMAT "%8.2" AXIS_PTS_REF SNM06LLUW /end AXIS_DESCR
/end CHARACTERISTIC
/begin CHARACTERISTIC DMLLRLMXF "" VALUE 0x8004767D KwWU8 99.61 rel_ub_b99p6 0.00 99.61 FORMAT "%5.2" /end CHARACTERISTIC
/begin CHARACTERISTIC DMLLRLMXN "" CURVE 0x8004767E GklWU8 99.61 rel_ub_b99p6 0.00 99.61 FORMAT "%5.2"
 /begin AXIS_DESCR COM_AXIS nmot_w nmot_uw_q0p25 6 0.00 16383.75 FORMAT "%8.2" AXIS_PTS_REF SNM06LLUW /end AXIS_DESCR
/end CHARACTERISTIC
/begin CHARACTERISTIC DMLLRMNKH "" CURVE 0x80047684 GklWS8 50.00 rel_q0p39 -50.00 0.00 FORMAT "%5.2"
 /begin AXIS_DESCR COM_AXIS nmot_w nmot_uw_q0p25 6 0.00 16383.75 FORMAT "%8.2" AXIS_PTS_REF SNM06LLUW /end AXIS_DESCR
/end CHARACTERISTIC
/begin CHARACTERISTIC DMLLRMNLS "" CURVE 0x8004768A GklWS8 50.00 rel_sb_q0p39 -50.00 0.00 FORMAT "%5.2"
 /begin AXIS_DESCR COM_AXIS nmot_w nmot_uw_q0p25 6 0.00 16383.75 FORMAT "%8.2" AXIS_PTS_REF SNM06LLUW /end AXIS_DESCR
/end CHARACTERISTIC
/begin CHARACTERISTIC DMLLRMNN "" CURVE 0x80047690 GklWS8 50.00 rel_q0p39 -50.00 0.00 FORMAT "%5.2"
 /begin AXIS_DESCR COM_AXIS nmot_w nmot_uw_q0p25 6 0.00 16383.75 FORMAT "%8.2" AXIS_PTS_REF SNM06LLUW /end AXIS_DESCR
/end CHARACTERISTIC
/begin CHARACTERISTIC DMLLRMNNK "" CURVE 0x80047696 GklWS8 50.00 rel_q0p39 -50.00 0.00 FORMAT "%5.2"
 /begin AXIS_DESCR COM_AXIS nmot_w nmot_uw_q0p25 6 0.00 16383.75 FORMAT "%8.2" AXIS_PTS_REF SNM06LLUW /end AXIS_DESCR
/end CHARACTERISTIC
/begin CHARACTERISTIC DMLLRMNST "" CURVE 0x8004769C GklWS8 50.00 rel_q0p39 -50.00 0.00 FORMAT "%5.2"
 /begin AXIS_DESCR COM_AXIS nmot_w nmot_uw_q0p25 6 0.00 16383.75 FORMAT "%8.2" AXIS_PTS_REF SNM06LLUW /end AXIS_DESCR
/end CHARACTERISTIC
/begin CHARACTERISTIC DMLLRMXN "" CURVE 0x800476A2 GklWU8 99.61 rel_ub_b99p6 0.00 99.61 FORMAT "%5.2"
 /begin AXIS_DESCR COM_AXIS nmot_w nmot_uw_q0p25 6 0.00 16383.75 FORMAT "%8.2" AXIS_PTS_REF SNM06LLUW /end AXIS_DESCR
/end CHARACTERISTIC
/begin CHARACTERISTIC DMLLRMXNK "" CURVE 0x800476A8 GklWU8 99.61 rel_ub_b99p6 0.00 99.61 FORMAT "%5.2"
 /begin AXIS_DESCR COM_AXIS nmot_w nmot_uw_q0p25 6 0.00 16383.75 FORMAT "%8.2" AXIS_PTS_REF SNM06LLUW /end AXIS_DESCR
/end CHARACTERISTIC
/begin CHARACTERISTIC DMLWSDU "" VALUE 0x80048BEC KwWS16 199.9969 rel_sw_b100 -100.0000 99.99695 FORMAT "%8.4" /end CHARACTERISTIC
/begin CHARACTERISTIC DMLWWKMK "" CURVE 0x80048BEE KlAxU8SstxS16WS16 199.9969 rel_sw_b100 -100.0000 99.99695 FORMAT "%8.4"
 /begin AXIS_DESCR STD_AXIS mdk_w rel_sw_b100 6 -100.0000 99.99695 FORMAT "%8.4" DEPOSIT ABSOLUTE /end AXIS_DESCR
/end CHARACTERISTIC
/begin CHARACTERISTIC DMMDSTN "" VALUE 0x80048E5C KwWU16 99.99847 rel_uw_b100 0.00 99.99847 FORMAT "%8.5" /end CHARACTERISTIC
/begin CHARACTERISTIC DMRSA "" VALUE 0x80048E38 KwWU16 99.99847 rel_uw_b100 0.00 99.99847 FORMAT "%8.5" /end CHARACTERISTIC
/begin CHARACTERISTIC DMSABDYN "" VALUE 0x80047A16 KwWU16 6553.500 m_uw_b6553p5 0.00 6553.500 FORMAT "%8.3" /end CHARACTERISTIC
/begin CHARACTERISTIC DMVERLMN "" VALUE 0x800490D4 KwWU16 99.99847 rel_uw_b100 0.00 99.99847 FORMAT "%8.5" /end CHARACTERISTIC
/begin CHARACTERISTIC DNLLRESWUS "" VALUE 0x800476AE KwWS16 16383.75 nmot_sw_q0p25 -8192.000 8191.750 FORMAT "%8.3" /end CHARACTERISTIC
/begin CHARACTERISTIC DNLLRIST "" VALUE 0x800476B0 KwWS8 2550. nmotd_sb_q10 -1280. 1270. FORMAT "%5.0" /end CHARACTERISTIC
/begin CHARACTERISTIC DNLLSTS "" VALUE 0x800476B1 KwWS8 1020. nmot_q4 -512.0 508.0 FORMAT "%5.1" /end CHARACTERISTIC
/begin CHARACTERISTIC DNMNI "" VALUE 0x800476B2 KwWS16 16383.75 nmotd_sw_q0p25 -8192.000 8191.750 FORMAT "%8.3" /end CHARACTERISTIC
/begin CHARACTERISTIC DUBDMM "" CURVE 0x80048EC8 KlAxU8SstxU8WU8 50.00 rel_ub_b50 0.00 50.00 FORMAT "%5.2"
 /begin AXIS_DESCR STD_AXIS dubfilm spg_q0p1 6 0.00 25.50 FORMAT "%5.2" DEPOSIT ABSOLUTE /end AXIS_DESCR
/end CHARACTERISTIC
/begin CHARACTERISTIC DVNG "" CURVE 0x800476B4 GklWU8 0.1245 rel_qn0p000488 -0.1245 0.00 FORMAT "%6.4"
 /begin AXIS_DESCR COM_AXIS ngfil nmotg_sb_q100 6 -12800. 12700. FORMAT "%5.0" AXIS_PTS_REF SNG06LLSB /end AXIS_DESCR
/end CHARACTERISTIC
/begin CHARACTERISTIC DVNGKH "" CURVE 0x800476BA GklWU8 0.1245 rel_qn0p000488 -0.1245 0.00 FORMAT "%6.4"
 /begin AXIS_DESCR COM_AXIS ngfil nmotg_sb_q100 6 -12800. 12700. FORMAT "%5.0" AXIS_PTS_REF SNG06LLSB /end AXIS_DESCR
/end CHARACTERISTIC
/begin CHARACTERISTIC DVNGV "" CURVE 0x800476C0 GklWU8 0.1245 rel_qn0p000488 -0.1245 0.00 FORMAT "%6.4"
 /begin AXIS_DESCR COM_AXIS ngfil nmotg_sb_q100 6 -12800. 12700. FORMAT "%5.0" AXIS_PTS_REF SNG06LLSB /end AXIS_DESCR
/end CHARACTERISTIC
/begin CHARACTERISTIC DWDKTPS "" VALUE 0x80047DDC KwWS16 1599.976 relDK_q0p02441 -800.0000 799.9756 FORMAT "%8.4" /end CHARACTERISTIC
/begin CHARACTERISTIC DWPEDDP "" VALUE 0x800476C6 KwWU16 100.0000 relPED_uw_b100 0.00 100.0000 FORMAT "%8.4" /end CHARACTERISTIC
/begin CHARACTERISTIC DWPEDMDK "" VALUE 0x800490D6 KwWS16 99.99847 rel_sw_b50 -50.00000 49.99847 FORMAT "%8.5" /end CHARACTERISTIC
/begin CHARACTERISTIC DZWOLA "" CURVE 0x80047DDE KlAxU8SstxU8WS8 191.3 zw_sb_q0p75 -96.00 95.25 FORMAT "%5.2"
 /begin AXIS_DESCR STD_AXIS lambas fak_q0p0078 10 0.00 1.992 FORMAT "%5.3" DEPOSIT ABSOLUTE /end AXIS_DESCR
/end CHARACTERISTIC
/begin CHARACTERISTIC DZWOM "" CURVE 0x80047DF4 KlAxU8SstxU8WS8 191.3 zw_sb_q0p75 -96.00 95.25 FORMAT "%5.2"
 /begin AXIS_DESCR STD_AXIS tmot temp_ub_q0p75_o48 5 -48.00 143.3 FORMAT "%5.1" DEPOSIT ABSOLUTE /end AXIS_DESCR
/end CHARACTERISTIC
/begin CHARACTERISTIC EnvP_pDfl_C "" VALUE 0x800495C6 KwWS16 3500.000 Pres_hPa 0.00 3500.000 FORMAT "%8.3" /end CHARACTERISTIC
/begin CHARACTERISTIC EnvT_tDfl_C "" VALUE 0x800495C8 KwWS16 250.0000 Temp_Cels -50.04000 199.9600 FORMAT "%8.4" /end CHARACTERISTIC
/begin CHARACTERISTIC ETALAM "" CURVE 0x80047E00 KlAxU8SstxU8WU8 127.5 rel_ub_b127p5 0.00 127.5 FORMAT "%5.1"
 /begin AXIS_DESCR STD_AXIS lambas fak_q0p0078 10 0.00 1.992 FORMAT "%5.3" DEPOSIT ABSOLUTE /end AXIS_DESCR
/end CHARACTERISTIC
/begin CHARACTERISTIC FDDN "" CURVE 0x800476C8 GklWU8 0.9961 fak_ub_b1 0.00 0.9961
 /begin AXIS_DESCR COM_AXIS dns nmotd_sb_q10 6 -1280. 1270. FORMAT "%5.0" AXIS_PTS_REF SNS06LLSB /end AXIS_DESCR
/end CHARACTERISTIC
/begin CHARACTERISTIC FDNIKOR "" VALUE 0x800476CE KwWU8 1.992188 fak_ub_b2 0.00 1.992188 FORMAT "%8.6" /end CHARACTERISTIC
/begin CHARACTERISTIC FFRAKFV "" VALUE 0x8004797C KwWU16 31.87500 fak_ub_b32 0.00 31.87500 FORMAT "%8.5" /end CHARACTERISTIC
/begin CHARACTERISTIC FFRITMS "" CURVE 0x80047A18 KlAxU8SstxU8WU8 0.9961 fak_ub_b1 0.00 0.9961
 /begin AXIS_DESCR STD_AXIS tmst temp_ub_q0p75_o48 4 -48.00 143.3 FORMAT "%5.1" DEPOSIT ABSOLUTE /end AXIS_DESCR
/end CHARACTERISTIC
/begin CHARACTERISTIC FHORESW "" VALUE 0x800476CF KwWU8 3.984 fak_ub_b4 0.00 3.984 FORMAT "%5.3" /end CHARACTERISTIC
/begin CHARACTERISTIC FKTLL "" VALUE 0x800476D0 KwWU8 0.9961 fak_ub_b1 0.00 0.9961 /end CHARACTERISTIC
/begin CHARACTERISTIC FKTLNL "" VALUE 0x800476D1 KwWU8 0.9961 fak_ub_b1 0.00 0.9961 /end CHARACTERISTIC
/begin CHARACTERISTIC FKTZLL "" VALUE 0x800476D2 KwWU8 0.9961 fak_ub_b1 0.00 0.9961 /end CHARACTERISTIC
/begin CHARACTERISTIC FKTZNL "" VALUE 0x800476D3 KwWU8 0.9961 fak_ub_b1 0.00 0.9961 /end CHARACTERISTIC
/begin CHARACTERISTIC FLRM "" CURVE 0x80047A21 KlAxU8SstxU8WU8 3.984 fak_ub_b4 0.00 3.984 FORMAT "%5.3"
 /begin AXIS_DESCR STD_AXIS tmot temp_ub_q0p75_o48 5 -48.00 143.3 FORMAT "%5.1" DEPOSIT ABSOLUTE /end AXIS_DESCR
/end CHARACTERISTIC
/begin CHARACTERISTIC FMIVL "" VALUE 0x80048D64 KwWU8 1.992188 fak_ub_b2 0.00 1.992188 FORMAT "%8.6" /end CHARACTERISTIC
/begin CHARACTERISTIC FNSTABNV "" CURVE 0x80048DDC KlAxU8SstxU16WU16 7.999878 fak_uw_b8 0.00 7.999878 FORMAT "%8.6"
 /begin AXIS_DESCR STD_AXIS nver_w fak_uw_b8 6 0.00 7.999878 FORMAT "%8.6" DEPOSIT ABSOLUTE /end AXIS_DESCR
/end CHARACTERISTIC
/begin CHARACTERISTIC FORAKFV "" VALUE 0x8004797E KwWU8 31.88 fak_ub_b32 0.00 31.88 FORMAT "%5.2" /end CHARACTERISTIC
/begin CHARACTERISTIC FRAK "" VALUE 0x80047980 KwWU16 4.999924 q7p63Em5_DIV_s 0.00 4.999924 FORMAT "%8.6" /end CHARACTERISTIC
/begin CHARACTERISTIC FRAMN "" VALUE 0x80047982 KwWU16 1.999969 fak_uw_b2 0.00 1.999969 FORMAT "%8.6" /end CHARACTERISTIC
/begin CHARACTERISTIC FRAMX "" VALUE 0x80047984 KwWU16 1.999969 fak_uw_b2 0.00 1.999969 FORMAT "%8.6" /end CHARACTERISTIC
/begin CHARACTERISTIC FRIPTES "" VALUE 0x80047A2C KwWU8 3.984 fak_ub_b4 0.00 3.984 FORMAT "%5.3" /end CHARACTERISTIC
/begin CHARACTERISTIC FRLKEVT "" CURVE 0x80048D66 KlAxU8SstxU8WU16 1.999969 fak_uw_b2 0.00 1.999969 FORMAT "%8.6"
 /begin AXIS_DESCR STD_AXIS evtmod temp_ub_q0p75_o48 6 -48.00 143.3 FORMAT "%5.1" DEPOSIT ABSOLUTE /end AXIS_DESCR
/end CHARACTERISTIC
/begin CHARACTERISTIC FRMAX "" VALUE 0x80047A2E KwWU16 1.999969 fak_uw_b2 0.00 1.999969 FORMAT "%8.6" /end CHARACTERISTIC
/begin CHARACTERISTIC FRMIN "" VALUE 0x80047A30 KwWU16 1.999969 fak_uw_b2 0.00 1.999969 FORMAT "%8.6" /end CHARACTERISTIC
/begin CHARACTERISTIC FTSPERN "" VALUE 0x80047A32 KwWU8 1.992188 fak_ub_b2 0.00 1.992188 FORMAT "%8.6" /end CHARACTERISTIC
/begin CHARACTERISTIC FTVMAX "" VALUE 0x80047A34 KwWU16 15.99976 fak_uw_b16 0.00 15.99976 FORMAT "%8.5" /end CHARACTERISTIC
/begin CHARACTERISTIC FVLRAS "" VALUE 0x80047986 KwWU16 1.999969 fak_uw_b2 0.00 1.999969 FORMAT "%8.6" /end CHARACTERISTIC
/begin CHARACTERISTIC GFDMARMXKF "" MAP 0x80047B16 KfAxU8AyU8SstxU8SstyU8WU8 1.000000 fak_ub_b2 0.00 1.000000 FORMAT "%8.6"
 /begin AXIS_DESCR STD_AXIS rl rel_ub_q0p75 6 0.00 191.3 FORMAT "%5.1" DEPOSIT ABSOLUTE /end AXIS_DESCR
 /begin AXIS_DESCR STD_AXIS nmot nmot_ub_q40 6 0.00 10200. FORMAT "%5.0" DEPOSIT ABSOLUTE /end AXIS_DESCR
/end CHARACTERISTIC
/begin CHARACTERISTIC GVDNSKL "" CURVE 0x80047B48 KlAxU8SstxS8WU8 1.000 fak_q0p0078 0.00 1.000 FORMAT "%5.3"
 /begin AXIS_DESCR STD_AXIS dns nmotd_sb_q10 4 -1280. 1270. FORMAT "%5.0" DEPOSIT ABSOLUTE /end AXIS_DESCR
/end CHARACTERISTIC
/begin CHARACTERISTIC GVMTKL "" CURVE 0x80047B52 KlAxU8SstxU8WU8 1.992 fak_q0p0078 0.00 1.992 FORMAT "%5.3"
 /begin AXIS_DESCR STD_AXIS tmot temp_ub_q0p75_o48 6 -48.00 143.3 FORMAT "%5.1" DEPOSIT ABSOLUTE /end AXIS_DESCR
/end CHARACTERISTIC
/begin CHARACTERISTIC GVVFZGKL "" CURVE 0x80047B60 KlAxU8SstxU16WU8 1.000 fak_q0p0078 0.00 1.000 FORMAT "%5.3"
 /begin AXIS_DESCR STD_AXIS vfzg_w vfzg_uw_b512 3 0.00 511.9922 FORMAT "%8.4" DEPOSIT ABSOLUTE /end AXIS_DESCR
/end CHARACTERISTIC
/begin CHARACTERISTIC IMLEVABS "" VALUE 0x800479B6 KwWU16 4660.267 m_uw_b4660 0.00 4660.267 FORMAT "%8.3" /end CHARACTERISTIC
/begin CHARACTERISTIC IMLRAAEIN "" VALUE 0x800478EA KwWU16 116.5067 m_q1p7778Em3_kg 0.00 116.5067 FORMAT "%8.4" /end CHARACTERISTIC
/begin CHARACTERISTIC IMLSALR "" VALUE 0x800479B8 KwWU8 18.13 m_uw_b4660 0.00 18.13 FORMAT "%5.2" /end CHARACTERISTIC
/begin CHARACTERISTIC IMTEFVDFRM "" VALUE 0x80047988 KwWU8 11.32 m_ub_q0p0444 0.00 11.32 FORMAT "%5.2" /end CHARACTERISTIC
/begin CHARACTERISTIC INITFRA "" VALUE 0x8004798A KwWU16 1.999969 fak_uw_b2 0.00 1.999969 FORMAT "%8.6" /end CHARACTERISTIC
/begin CHARACTERISTIC INITORA "" VALUE 0x8004798C KwWS16 3071.953 rel_sw_b1536 -1536.000 1535.953 FORMAT "%8.3" /end CHARACTERISTIC
/begin CHARACTERISTIC IVDNDTEH "" CURVE 0x800476D4 GklWU8 0.6076 rel_q0p002383 0.00 0.6076
 /begin AXIS_DESCR COM_AXIS dn_w nmot_sw_q0p25 10 -8192.000 8191.750 FORMAT "%8.3" AXIS_PTS_REF SDN10LLSW /end AXIS_DESCR
/end CHARACTERISTIC
/begin CHARACTERISTIC IVDNHOM "" CURVE 0x800476DE GklWU8 0.6076 rel_q0p002383 0.00 0.6076
 /begin AXIS_DESCR COM_AXIS dn_w nmot_sw_q0p25 10 -8192.000 8191.750 FORMAT "%8.3" AXIS_PTS_REF SDN10LLSW /end AXIS_DESCR
/end CHARACTERISTIC
/begin CHARACTERISTIC IVDNHOMKH "" CURVE 0x800476E8 GklWU8 0.6076 rel_q0p002383 0.00 0.6076
 /begin AXIS_DESCR COM_AXIS dn_w nmot_sw_q0p25 10 -8192.000 8191.750 FORMAT "%8.3" AXIS_PTS_REF SDN10LLSW /end AXIS_DESCR
/end CHARACTERISTIC
/begin CHARACTERISTIC IVDNHOMV "" CURVE 0x800476F2 GklWU8 0.6076 rel_q0p002383 0.00 0.6076
 /begin AXIS_DESCR COM_AXIS dn_w nmot_sw_q0p25 10 -8192.000 8191.750 FORMAT "%8.3" AXIS_PTS_REF SDN10LLSW /end AXIS_DESCR
/end CHARACTERISTIC
/begin CHARACTERISTIC JMOTOR "" VALUE 0x80048E6C KwUw 0.9999847 fak_q1p5258Em5_kgmmdivNm 0.00 0.9999847 FORMAT "%9.7" /end CHARACTERISTIC
/begin CHARACTERISTIC KFDLAQHOM "" MAP 0x80047A36 GkfWS8 0.06226 fak_sb_b0p03125 -0.03125 0.03101 FORMAT "%7.5"
 /begin AXIS_DESCR COM_AXIS nmot nmot_ub_q40 7 0.00 10200. FORMAT "%5.0" AXIS_PTS_REF SNM07LRUB /end AXIS_DESCR
 /begin AXIS_DESCR COM_AXIS rlsrl rel_ub_q0p75 6 0.00 191.3 FORMAT "%5.1" AXIS_PTS_REF SRL06LRUB /end AXIS_DESCR
/end CHARACTERISTIC
/begin CHARACTERISTIC KFDMDFA "" MAP 0x80048C08 GkfWU8 0.9961 fak_ub_b1 0.00 0.9961
 /begin AXIS_DESCR COM_AXIS xgang dez 6 0.00 255.0 FORMAT "%5.1" AXIS_PTS_REF SGA06MFUB /end AXIS_DESCR
 /begin AXIS_DESCR COM_AXIS nmot nmot_ub_q40 6 0.00 10200. FORMAT "%5.0" AXIS_PTS_REF SNM06MFUB /end AXIS_DESCR
/end CHARACTERISTIC
/begin CHARACTERISTIC KFDMDFAS "" MAP 0x80048C2C GkfWU8 0.9961 fak_ub_b1 0.00 0.9961
 /begin AXIS_DESCR COM_AXIS xgang dez 6 0.00 255.0 FORMAT "%5.1" AXIS_PTS_REF SGA06MFUB /end AXIS_DESCR
 /begin AXIS_DESCR COM_AXIS nmot nmot_ub_q40 6 0.00 10200. FORMAT "%5.0" AXIS_PTS_REF SNM06MFUB /end AXIS_DESCR
/end CHARACTERISTIC
/begin CHARACTERISTIC KFDMDFAU "" MAP 0x80048C50 GkfWU8 0.9961 fak_ub_b1 0.00 0.9961
 /begin AXIS_DESCR COM_AXIS xgang dez 6 0.00 255.0 FORMAT "%5.1" AXIS_PTS_REF SGA06MFUB /end AXIS_DESCR
 /begin AXIS_DESCR COM_AXIS nmot nmot_ub_q40 6 0.00 10200. FORMAT "%5.0" AXIS_PTS_REF SNM06MFUB /end AXIS_DESCR
/end CHARACTERISTIC
/begin CHARACTERISTIC KFDMDKOE "" MAP 0x80048ED5 GkfWU8 50.00 rel_ub_b50 0.00 50.00 FORMAT "%5.2"
 /begin AXIS_DESCR COM_AXIS nmot nmot_ub_q40 6 0.00 10200. FORMAT "%5.0" AXIS_PTS_REF SNM06KOUB /end AXIS_DESCR
 /begin AXIS_DESCR COM_AXIS tatuko temp_ub_q0p75_o48 6 -48.00 143.3 FORMAT "%5.1" AXIS_PTS_REF STA06LLUB /end AXIS_DESCR
/end CHARACTERISTIC
/begin CHARACTERISTIC KFDMDKOEFS "" MAP 0x80048EF9 KfAxU8AyU8SstxU8SstyU8WU8 50.00 rel_ub_b50 0.00 50.00 FORMAT "%5.2"
 /begin AXIS_DESCR STD_AXIS pach p_q156p86 6 0.00 39999. FORMAT "%5.0" DEPOSIT ABSOLUTE /end AXIS_DESCR
 /begin AXIS_DESCR STD_AXIS tmot temp_ub_q0p75_o48 6 -48.00 143.3 FORMAT "%5.1" DEPOSIT ABSOLUTE /end AXIS_DESCR
/end CHARACTERISTIC
/begin CHARACTERISTIC KFDMDNSM "" MAP 0x800490D8 KfAxU8AyU8SstxU8SstyU8WU8 99.61 rel_ub_b99p6 0.00 99.61 FORMAT "%5.2"
 /begin AXIS_DESCR STD_AXIS tmot temp_ub_q0p75_o48 8 -48.00 143.3 FORMAT "%5.1" DEPOSIT ABSOLUTE /end AXIS_DESCR
 /begin AXIS_DESCR STD_AXIS nstat nmot_ub_q10 2 0.00 2550. FORMAT "%5.0" DEPOSIT ABSOLUTE /end AXIS_DESCR
/end CHARACTERISTIC
/begin CHARACTERISTIC KFETAZW "" MAP 0x80047E15 KfAxU8AyU8SstxU8SstyU8WU8 127.5 rel_ub_b127p5 0.00 127.5 FORMAT "%5.1"
 /begin AXIS_DESCR STD_AXIS rl rel_ub_q0p75 16 0.00 191.3 FORMAT "%5.1" DEPOSIT ABSOLUTE /end AXIS_DESCR
 /begin AXIS_DESCR STD_AXIS nmot nmot_ub_q40 16 0.00 10200. FORMAT "%5.0" DEPOSIT ABSOLUTE /end AXIS_DESCR
/end CHARACTERISTIC
/begin CHARACTERISTIC KFETAZWN "" MAP 0x80047F37 KfAxU8AyU8SstxU8SstyU8WU8 127.5 rel_ub_b127p5 0.00 127.5 FORMAT "%5.1"
 /begin AXIS_DESCR STD_AXIS rl rel_ub_q0p75 16 0.00 191.3 FORMAT "%5.1" DEPOSIT ABSOLUTE /end AXIS_DESCR
 /begin AXIS_DESCR STD_AXIS nmot nmot_ub_q40 16 0.00 10200. FORMAT "%5.0" DEPOSIT ABSOLUTE /end AXIS_DESCR
/end CHARACTERISTIC
/begin CHARACTERISTIC KFETAZWNDO "" MAP 0x80048059 KfAxU8AyU8SstxU8SstyU8WU8 127.5 rel_ub_b127p5 0.00 127.5 FORMAT "%5.1"
 /begin AXIS_DESCR STD_AXIS rl rel_ub_q0p75 16 0.00 191.3 FORMAT "%5.1" DEPOSIT ABSOLUTE /end AXIS_DESCR
 /begin AXIS_DESCR STD_AXIS nmot nmot_ub_q40 16 0.00 10200. FORMAT "%5.0" DEPOSIT ABSOLUTE /end AXIS_DESCR
/end CHARACTERISTIC
/begin CHARACTERISTIC KFETAZWNLS "" MAP 0x8004817B KfAxU8AyU8SstxU8SstyU8WU8 127.5 rel_ub_b127p5 0.00 127.5 FORMAT "%5.1"
 /begin AXIS_DESCR STD_AXIS rl rel_ub_q0p75 16 0.00 191.3 FORMAT "%5.1" DEPOSIT ABSOLUTE /end AXIS_DESCR
 /begin AXIS_DESCR STD_AXIS nmot nmot_ub_q40 16 0.00 10200. FORMAT "%5.0" DEPOSIT ABSOLUTE /end AXIS_DESCR
/end CHARACTERISTIC
/begin CHARACTERISTIC KFETAZWNMA "" MAP 0x8004829D KfAxU8AyU8SstxU8SstyU8WU8 127.5 rel_ub_b127p5 0.00 127.5 FORMAT "%5.1"
 /begin AXIS_DESCR STD_AXIS rl rel_ub_q0p75 16 0.00 191.3 FORMAT "%5.1" DEPOSIT ABSOLUTE /end AXIS_DESCR
 /begin AXIS_DESCR STD_AXIS nmot nmot_ub_q40 16 0.00 10200. FORMAT "%5.0" DEPOSIT ABSOLUTE /end AXIS_DESCR
/end CHARACTERISTIC
/begin CHARACTERISTIC KFETAZWNTA "" MAP 0x800483BF KfAxU8AyU8SstxU8SstyU8WU8 127.5 rel_ub_b127p5 0.00 127.5 FORMAT "%5.1"
 /begin AXIS_DESCR STD_AXIS rl rel_ub_q0p75 16 0.00 191.3 FORMAT "%5.1" DEPOSIT ABSOLUTE /end AXIS_DESCR
 /begin AXIS_DESCR STD_AXIS nmot nmot_ub_q40 16 0.00 10200. FORMAT "%5.0" DEPOSIT ABSOLUTE /end AXIS_DESCR
/end CHARACTERISTIC
/begin CHARACTERISTIC KFLIVNGAS "" MAP 0x800476FC KfAxU8AyU8SstxS16SstyS16WS16 19.99969 fak_sw_b10 -10.00000 9.999695 FORMAT "%8.5"
 /begin AXIS_DESCR STD_AXIS ngasf_w nmotg_sw_q0p39 6 -12800.16 12799.77 FORMAT "%8.2" DEPOSIT ABSOLUTE /end AXIS_DESCR
 /begin AXIS_DESCR STD_AXIS ndifstat nmot_q10 3 -1280.000 1270.000 FORMAT "%8.3" DEPOSIT ABSOLUTE /end AXIS_DESCR
/end CHARACTERISTIC
/begin CHARACTERISTIC KFMDKO "" MAP 0x80048F2B GkfWU8 50.00 rel_ub_b50 0.00 50.00 FORMAT "%5.2"
 /begin AXIS_DESCR COM_AXIS nmot nmot_ub_q40 6 0.00 10200. FORMAT "%5.0" AXIS_PTS_REF SNM06KOUB /end AXIS_DESCR
 /begin AXIS_DESCR COM_AXIS tatuko temp_ub_q0p75_o48 6 -48.00 143.3 FORMAT "%5.1" AXIS_PTS_REF STA06LLUB /end AXIS_DESCR
/end CHARACTERISTIC
/begin CHARACTERISTIC KFMDKOFST "" MAP 0x80048F50 KfAxU8AyU8SstxU8SstyU16WU8 50.00 rel_ub_b50 0.00 50.00 FORMAT "%5.2"
 /begin AXIS_DESCR STD_AXIS nmot nmot_ub_q40 6 0.00 10200. FORMAT "%5.0" DEPOSIT ABSOLUTE /end AXIS_DESCR
 /begin AXIS_DESCR STD_AXIS pach_w p_sw_q0p9155 6 0.00 60000.92 FORMAT "%8.2" DEPOSIT ABSOLUTE /end AXIS_DESCR
/end CHARACTERISTIC
/begin CHARACTERISTIC KFMDKOPA "" MAP 0x80048F88 KfAxU8AyU8SstxU8SstyU16WU8 50.00 rel_ub_b50 0.00 50.00 FORMAT "%5.2"
 /begin AXIS_DESCR STD_AXIS nmot nmot_ub_q40 6 0.00 10200. FORMAT "%5.0" DEPOSIT ABSOLUTE /end AXIS_DESCR
 /begin AXIS_DESCR STD_AXIS pach_w p_sw_q0p9155 6 0.00 60000.92 FORMAT "%8.2" DEPOSIT ABSOLUTE /end AXIS_DESCR
/end CHARACTERISTIC
/begin CHARACTERISTIC KFMDS "" MAP 0x800490F4 GkfWU16 99.99847 rel_uw_b100 0.00 99.99847 FORMAT "%8.5"
 /begin AXIS_DESCR COM_AXIS nmot_w nmot_uw_q0p25 16 0.00 16383.75 FORMAT "%8.2" AXIS_PTS_REF SNM16OPUW /end AXIS_DESCR
 /begin AXIS_DESCR COM_AXIS dpusms p_uw_q0p039 11 0.00 2559.961 FORMAT "%8.3" AXIS_PTS_REF SPU11OPUW /end AXIS_DESCR
/end CHARACTERISTIC
/begin CHARACTERISTIC KFMDSNW "" MAP 0x80049254 GkfWU16 99.99847 rel_uw_b100 0.00 99.99847 FORMAT "%8.5"
 /begin AXIS_DESCR COM_AXIS nmot_w nmot_uw_q0p25 16 0.00 16383.75 FORMAT "%8.2" AXIS_PTS_REF SNM16OPUW /end AXIS_DESCR
 /begin AXIS_DESCR COM_AXIS rl_w rel_q0p0234 11 0.00 1535.977 FORMAT "%8.3" AXIS_PTS_REF SRL11OPUW /end AXIS_DESCR
/end CHARACTERISTIC
/begin CHARACTERISTIC KFMDSZAS "" MAP 0x800493B4 GkfWU16 99.99847 rel_uw_b100 0.00 99.99847 FORMAT "%8.5"
 /begin AXIS_DESCR COM_AXIS nmot_w nmot_uw_q0p25 16 0.00 16383.75 FORMAT "%8.2" AXIS_PTS_REF SNM16OPUW /end AXIS_DESCR
 /begin AXIS_DESCR COM_AXIS rl_w rel_q0p0234 11 0.00 1535.977 FORMAT "%8.3" AXIS_PTS_REF SRL11OPUW /end AXIS_DESCR
/end CHARACTERISTIC
/begin CHARACTERISTIC KFMIOP "" MAP 0x800484E2 KfAxU8AyU8SstxU16SstyU16WU16 99.99847 rel_uw_b100 0.00 99.99847 FORMAT "%8.5"
 /begin AXIS_DESCR STD_AXIS nmot_w nmot_uw_q0p25 16 0.00 16383.75 FORMAT "%8.2" DEPOSIT ABSOLUTE /end AXIS_DESCR
 /begin AXIS_DESCR STD_AXIS rl_w rel_uw_q0p0234 11 0.00 1535.977 FORMAT "%8.3" DEPOSIT ABSOLUTE /end AXIS_DESCR
/end CHARACTERISTIC
/begin CHARACTERISTIC KFMIRL "" MAP 0x80048982 KfAxU8AyU8SstxU16SstyU16WU16 1535.977 rel_uw_q0p0234 0.00 1535.977 FORMAT "%8.3"
 /begin AXIS_DESCR STD_AXIS nmot_w nmot_uw_q0p25 16 0.00 16383.75 FORMAT "%8.2" DEPOSIT ABSOLUTE /end AXIS_DESCR
 /begin AXIS_DESCR STD_AXIS dmisopl1_w rel_uw_b100 12 0.00 99.99847 FORMAT "%8.5" DEPOSIT ABSOLUTE /end AXIS_DESCR
/end CHARACTERISTIC
/begin CHARACTERISTIC KFMPED "" MAP 0x80048B3E KfAxU8AyU8SstxU8SstyU8WU8 99.61 rel_ub_b99p6 0.00 99.61 FORMAT "%5.2"
 /begin AXIS_DESCR STD_AXIS wdkba relDK_ub_b100 16 0.00 100.0 FORMAT "%5.1" DEPOSIT ABSOLUTE /end AXIS_DESCR
 /begin AXIS_DESCR STD_AXIS nmot nmot_ub_q40 8 0.00 10200. FORMAT "%5.0" DEPOSIT ABSOLUTE /end AXIS_DESCR
/end CHARACTERISTIC
/begin CHARACTERISTIC KFRI "" MAP 0x80047A60 GkfWU8 77.82 fak_ub_b77p81 0.00 77.82 FORMAT "%5.2"
 /begin AXIS_DESCR COM_AXIS nmot nmot_ub_q40 7 0.00 10200. FORMAT "%5.0" AXIS_PTS_REF SNM07LRUB /end AXIS_DESCR
 /begin AXIS_DESCR COM_AXIS rlsrl rel_ub_q0p75 6 0.00 191.3 FORMAT "%5.1" AXIS_PTS_REF SRL06LRUB /end AXIS_DESCR
/end CHARACTERISTIC
/begin CHARACTERISTIC KFRP "" MAP 0x80047A8A GkfWU8 12.45 fak_ub_b12p45 0.00 12.45 FORMAT "%5.2"
 /begin AXIS_DESCR COM_AXIS nmot nmot_ub_q40 7 0.00 10200. FORMAT "%5.0" AXIS_PTS_REF SNM07LRUB /end AXIS_DESCR
 /begin AXIS_DESCR COM_AXIS rlsrl rel_ub_q0p75 6 0.00 191.3 FORMAT "%5.1" AXIS_PTS_REF SRL06LRUB /end AXIS_DESCR
/end CHARACTERISTIC
/begin CHARACTERISTIC KFTFRC "" MAP 0x80047AB4 GkfWU8 5.100 t_q0p02 0.00 5.100 FORMAT "%5.3"
 /begin AXIS_DESCR COM_AXIS nmot nmot_ub_q40 7 0.00 10200. FORMAT "%5.0" AXIS_PTS_REF SNM07LRUB /end AXIS_DESCR
 /begin AXIS_DESCR COM_AXIS rlsrl rel_ub_q0p75 6 0.00 191.3 FORMAT "%5.1" AXIS_PTS_REF SRL06LRUB /end AXIS_DESCR
/end CHARACTERISTIC
/begin CHARACTERISTIC KFZKMDKOFS "" MAP 0x80048FC0 KfAxU8AyU8SstxU8SstyU16WU16 1310.6999997 zk20msxs_uw_b1310 0.020000305180 1310.7200000 FORMAT "%12.7"
 /begin AXIS_DESCR STD_AXIS tmot temp_ub_q0p75_o48 6 -48.00 143.3 FORMAT "%5.1" DEPOSIT ABSOLUTE /end AXIS_DESCR
 /begin AXIS_DESCR STD_AXIS pach_w p_sw_q0p9155 6 0.00 60000.92 FORMAT "%8.2" DEPOSIT ABSOLUTE /end AXIS_DESCR
/end CHARACTERISTIC
/begin CHARACTERISTIC KFZMDFA "" MAP 0x80048C74 GkfWU8 2.54000 zk10msxs_ub_b2p55 0.0100000 2.55000 FORMAT "%7.5"
 /begin AXIS_DESCR COM_AXIS xgang dez 6 0.00 255.0 FORMAT "%5.1" AXIS_PTS_REF SGA06MFUB /end AXIS_DESCR
 /begin AXIS_DESCR COM_AXIS nmot nmot_ub_q40 6 0.00 10200. FORMAT "%5.0" AXIS_PTS_REF SNM06MFUB /end AXIS_DESCR
/end CHARACTERISTIC
/begin CHARACTERISTIC KFZMDFAS "" MAP 0x80048C98 GkfWU8 2.54000 zk10msxs_ub_b2p55 0.0100000 2.55000 FORMAT "%7.5"
 /begin AXIS_DESCR COM_AXIS xgang dez 6 0.00 255.0 FORMAT "%5.1" AXIS_PTS_REF SGA06MFUB /end AXIS_DESCR
 /begin AXIS_DESCR COM_AXIS nmot nmot_ub_q40 6 0.00 10200. FORMAT "%5.0" AXIS_PTS_REF SNM06MFUB /end AXIS_DESCR
/end CHARACTERISTIC
/begin CHARACTERISTIC KFZMDFAU "" MAP 0x80048CBC GkfWU8 2.54000 zk10msxs_ub_b2p55 0.0100000 2.55000 FORMAT "%7.5"
 /begin AXIS_DESCR COM_AXIS xgang dez 6 0.00 255.0 FORMAT "%5.1" AXIS_PTS_REF SGA06MFUB /end AXIS_DESCR
 /begin AXIS_DESCR COM_AXIS nmot nmot_ub_q40 6 0.00 10200. FORMAT "%5.0" AXIS_PTS_REF SNM06MFUB /end AXIS_DESCR
/end CHARACTERISTIC
/begin CHARACTERISTIC KFZMDNSM "" MAP 0x80049514 KfAxU8AyU8SstxU8SstyU8WU8 12.7498 zk50msxs_ub_b12p8 0.0501961 12.8000 FORMAT "%7.4"
 /begin AXIS_DESCR STD_AXIS tmot temp_ub_q0p75_o48 8 -48.00 143.3 FORMAT "%5.1" DEPOSIT ABSOLUTE /end AXIS_DESCR
 /begin AXIS_DESCR STD_AXIS nstat nmot_ub_q10 2 0.00 2550. FORMAT "%5.0" DEPOSIT ABSOLUTE /end AXIS_DESCR
/end CHARACTERISTIC
/begin CHARACTERISTIC KFZWOP "" MAP 0x8004867C GkfWS8 191.3 zw_sb_q0p75 -96.00 95.25 FORMAT "%5.2"
 /begin AXIS_DESCR COM_AXIS nmot_w nmot_uw_q0p25 16 0.00 16383.75 FORMAT "%8.2" AXIS_PTS_REF SNM16OPUW /end AXIS_DESCR
 /begin AXIS_DESCR COM_AXIS rl_w rel_q0p0234 11 0.00 1535.977 FORMAT "%8.3" AXIS_PTS_REF SRL11OPUW /end AXIS_DESCR
/end CHARACTERISTIC
/begin CHARACTERISTIC KFZWOP2 "" MAP 0x8004872C GkfWS8 191.3 zw_sb_q0p75 -96.00 95.25 FORMAT "%5.2"
 /begin AXIS_DESCR COM_AXIS nmot_w nmot_uw_q0p25 16 0.00 16383.75 FORMAT "%8.2" AXIS_PTS_REF SNM16OPUW /end AXIS_DESCR
 /begin AXIS_DESCR COM_AXIS rl_w rel_q0p0234 11 0.00 1535.977 FORMAT "%8.3" AXIS_PTS_REF SRL11OPUW /end AXIS_DESCR
/end CHARACTERISTIC
/begin CHARACTERISTIC KFZWOPL "" MAP 0x800487DC GkfWS8 191.3 zw_sb_q0p75 -96.00 95.25 FORMAT "%5.2"
 /begin AXIS_DESCR COM_AXIS nmot_w nmot_uw_q0p25 16 0.00 16383.75 FORMAT "%8.2" AXIS_PTS_REF SNM16OPUW /end AXIS_DESCR
 /begin AXIS_DESCR COM_AXIS rl_w rel_q0p0234 11 0.00 1535.977 FORMAT "%8.3" AXIS_PTS_REF SRL11OPUW /end AXIS_DESCR
/end CHARACTERISTIC
/begin CHARACTERISTIC KFZWOPL2 "" MAP 0x8004888C GkfWS8 191.3 zw_sb_q0p75 -96.00 95.25 FORMAT "%5.2"
 /begin AXIS_DESCR COM_AXIS nmot_w nmot_uw_q0p25 16 0.00 16383.75 FORMAT "%8.2" AXIS_PTS_REF SNM16OPUW /end AXIS_DESCR
 /begin AXIS_DESCR COM_AXIS rl_w rel_q0p0234 11 0.00 1535.977 FORMAT "%8.3" AXIS_PTS_REF SRL11OPUW /end AXIS_DESCR
/end CHARACTERISTIC
/begin CHARACTERISTIC KITHRESG "" VALUE 0x80047736 KwWS8 2550. nmotd_sb_q10 -1280. 1270. FORMAT "%5.0" /end CHARACTERISTIC
/begin CHARACTERISTIC KLDMDLOAD2 "" CURVE 0x8004901C KlAxU8SstxU8WU8 50.00 rel_ub_b50 0.00 50.00 FORMAT "%5.2"
 /begin AXIS_DESCR STD_AXIS tmot temp_ub_q0p75_o48 8 -48.00 143.3 FORMAT "%5.1" DEPOSIT ABSOLUTE /end AXIS_DESCR
/end CHARACTERISTIC
/begin CHARACTERISTIC KLDMDRKO "" CURVE 0x8004902D KlAxU8SstxU8WU8 99.61 rel_ub_b99p6 0.00 99.61 FORMAT "%5.2"
 /begin AXIS_DESCR STD_AXIS pach p_q156p86 6 0.00 39999. FORMAT "%5.0" DEPOSIT ABSOLUTE /end AXIS_DESCR
/end CHARACTERISTIC
/begin CHARACTERISTIC KLDMLWSDO "" CURVE 0x80048CE0 KlAxU8SstxS16WS16 199.9969 rel_sw_b100 -100.0000 99.99695 FORMAT "%8.4"
 /begin AXIS_DESCR STD_AXIS mdk_w rel_sw_b100 6 -100.0000 99.99695 FORMAT "%8.4" DEPOSIT ABSOLUTE /end AXIS_DESCR
/end CHARACTERISTIC
/begin CHARACTERISTIC KLDNLLDEUS "" CURVE 0x80047737 KlAxU8SstxS8WS8 25500. nmotg_sb_q100 -12800. 12700. FORMAT "%5.0"
 /begin AXIS_DESCR STD_AXIS dns nmotd_sb_q10 6 -1280. 1270. FORMAT "%5.0" DEPOSIT ABSOLUTE /end AXIS_DESCR
/end CHARACTERISTIC
/begin CHARACTERISTIC KLETAEDK "" CURVE 0x8004893C KlAxU8SstxU16WU8 127.5 rel_ub_b127p5 0.00 127.5 FORMAT "%5.1"
 /begin AXIS_DESCR STD_AXIS tmot temp_ub_q0p75_o48 16 -48.00000 143.2500 FORMAT "%8.4" DEPOSIT ABSOLUTE /end AXIS_DESCR
/end CHARACTERISTIC
/begin CHARACTERISTIC KLFDALL "" CURVE 0x80047744 KlAxU8SstxS16WU16 0.9960938 fak_ub_b1 0.00 0.9960938 FORMAT "%9.7"
 /begin AXIS_DESCR STD_AXIS dn_w nmot_sw_q0p25 10 -8192.000 8191.750 FORMAT "%8.3" DEPOSIT ABSOLUTE /end AXIS_DESCR
/end CHARACTERISTIC
/begin CHARACTERISTIC KLFDANL "" CURVE 0x8004776E KlAxU8SstxS16WU16 0.9960938 fak_ub_b1 0.00 0.9960938 FORMAT "%9.7"
 /begin AXIS_DESCR STD_AXIS dn_w nmot_sw_q0p25 10 -8192.000 8191.750 FORMAT "%8.3" DEPOSIT ABSOLUTE /end AXIS_DESCR
/end CHARACTERISTIC
/begin CHARACTERISTIC KLFKTIT "" CURVE 0x80047798 GklWU8 1.992188 fak_ub_b2 0.00 1.992188 FORMAT "%8.6"
 /begin AXIS_DESCR COM_AXIS tmot temp_ub_q0p75_o48 6 -48.00 143.3 FORMAT "%5.1" AXIS_PTS_REF STM06LLUB /end AXIS_DESCR
/end CHARACTERISTIC
/begin CHARACTERISTIC KLFKTLT "" CURVE 0x8004779E GklWU8 1.992188 fak_ub_b2 0.00 1.992188 FORMAT "%8.6"
 /begin AXIS_DESCR COM_AXIS tmot temp_ub_q0p75_o48 6 -48.00 143.3 FORMAT "%5.1" AXIS_PTS_REF STM06LLUB /end AXIS_DESCR
/end CHARACTERISTIC
/begin CHARACTERISTIC KLFKTZT "" CURVE 0x800477A4 GklWU8 1.992188 fak_ub_b2 0.00 1.992188 FORMAT "%8.6"
 /begin AXIS_DESCR COM_AXIS tmot temp_ub_q0p75_o48 6 -48.00 143.3 FORMAT "%5.1" AXIS_PTS_REF STM06LLUB /end AXIS_DESCR
/end CHARACTERISTIC
/begin CHARACTERISTIC KLFLRTV "" CURVE 0x80047ADE KlAxU8SstxU16WU16 16.00000 fak_ub_b16 0.00 16.00000 FORMAT "%8.5"
 /begin AXIS_DESCR STD_AXIS ftv_w fak_uw_b16 3 0.00 15.99976 FORMAT "%8.5" DEPOSIT ABSOLUTE /end AXIS_DESCR
/end CHARACTERISTIC
/begin CHARACTERISTIC KLFRAMILH "" CURVE 0x800478EC KlAxU8SstxU8WU16 99.99847 rel_uw_b100 0.00 99.99847 FORMAT "%8.5"
 /begin AXIS_DESCR STD_AXIS nmot nmot_ub_q40 4 0.00 10200. FORMAT "%5.0" DEPOSIT ABSOLUTE /end AXIS_DESCR
/end CHARACTERISTIC
/begin CHARACTERISTIC KLFRAMILL "" CURVE 0x800478FA KlAxU8SstxU8WU16 99.99847 rel_uw_b100 0.00 99.99847 FORMAT "%8.5"
 /begin AXIS_DESCR STD_AXIS nmot nmot_ub_q40 4 0.00 10200. FORMAT "%5.0" DEPOSIT ABSOLUTE /end AXIS_DESCR
/end CHARACTERISTIC
/begin CHARACTERISTIC KLFRKANMOT "" CURVE 0x8004798E KlAxU8SstxU8WU16 1.999969 fak_uw_b2 0.00 1.999969 FORMAT "%8.6"
 /begin AXIS_DESCR STD_AXIS nmot nmot_ub_q40 8 0.00 10200. FORMAT "%5.0" DEPOSIT ABSOLUTE /end AXIS_DESCR
/end CHARACTERISTIC
/begin CHARACTERISTIC KLKOFFTUM "" CURVE 0x8004903A KlAxU8SstxU8WU16 13107.00 t200msxs_uw_q0p2 0.00 13107.00 FORMAT "%8.2"
 /begin AXIS_DESCR STD_AXIS tum temp_ub_q0p75_o48 6 -48.00 143.3 FORMAT "%5.1" DEPOSIT ABSOLUTE /end AXIS_DESCR
/end CHARACTERISTIC
/begin CHARACTERISTIC KLLIMNV "" CURVE 0x800477AA KlAxU8SstxU16WU8 24.90 rel_ub_bn24p9 -24.90 0.00 FORMAT "%5.2"
 /begin AXIS_DESCR STD_AXIS nmot_w nmot_uw_q0p25 6 0.00 16383.75 FORMAT "%8.2" DEPOSIT ABSOLUTE /end AXIS_DESCR
/end CHARACTERISTIC
/begin CHARACTERISTIC KLMDACMX "" CURVE 0x8004904E KlAxU8SstxU8WU8 25.50 md_ub_q0p1 0.00 25.50 FORMAT "%5.2"
 /begin AXIS_DESCR STD_AXIS pach p_q156p86 6 0.00 39999. FORMAT "%5.0" DEPOSIT ABSOLUTE /end AXIS_DESCR
/end CHARACTERISTIC
/begin CHARACTERISTIC KLMDLFPW "" CURVE 0x8004905B KlAxU8SstxU8WU8 99.61 rel_ub_b100 0.00 99.61 FORMAT "%5.2"
 /begin AXIS_DESCR STD_AXIS tvlues1 rel_ub_b99p6 6 0.00 99.61 FORMAT "%5.2" DEPOSIT ABSOLUTE /end AXIS_DESCR
/end CHARACTERISTIC
/begin CHARACTERISTIC KLMDLOAD2 "" CURVE 0x80049068 KlAxU8SstxU8WU8 50.00 rel_ub_b50 0.00 50.00 FORMAT "%5.2"
 /begin AXIS_DESCR STD_AXIS tmot temp_ub_q0p75_o48 8 -48.00 143.3 FORMAT "%5.1" DEPOSIT ABSOLUTE /end AXIS_DESCR
/end CHARACTERISTIC
/begin CHARACTERISTIC KLMDNSL "" CURVE 0x80049079 KlAxU8SstxU8WU8 1.992188 fak_ub_b2 0.00 1.992188 FORMAT "%8.6"
 /begin AXIS_DESCR STD_AXIS nmot nmot_ub_q40 4 0.00 10200. FORMAT "%5.0" DEPOSIT ABSOLUTE /end AXIS_DESCR
/end CHARACTERISTIC
/begin CHARACTERISTIC KLMDPSL "" CURVE 0x80049082 KlAxU8SstxU8WU8 100.0 fak_ub_b100 0.00 100.0 FORMAT "%5.1"
 /begin AXIS_DESCR STD_AXIS psl p_q500 6 0.00 127500. FORMAT "%5.0" DEPOSIT ABSOLUTE /end AXIS_DESCR
/end CHARACTERISTIC
/begin CHARACTERISTIC KLMKLWSD "" CURVE 0x80048CFA GklWU16 199.9969 rel_sw_b100 0.00 199.9969 FORMAT "%8.4"
 /begin AXIS_DESCR COM_AXIS nmot nmot_ub_q40 6 0.00 10200. FORMAT "%5.0" AXIS_PTS_REF SNM06MFUB /end AXIS_DESCR
/end CHARACTERISTIC
/begin CHARACTERISTIC KLORAMILH "" CURVE 0x80047908 KlAxU8SstxU8WU16 99.99847 rel_uw_b100 0.00 99.99847 FORMAT "%8.5"
 /begin AXIS_DESCR STD_AXIS nmot nmot_ub_q40 4 0.00 10200. FORMAT "%5.0" DEPOSIT ABSOLUTE /end AXIS_DESCR
/end CHARACTERISTIC
/begin CHARACTERISTIC KLORAMILHF "" CURVE 0x80047916 KlAxU8SstxU8WU16 99.99847 rel_uw_b100 0.00 99.99847 FORMAT "%8.5"
 /begin AXIS_DESCR STD_AXIS nmot nmot_ub_q40 4 0.00 10200. FORMAT "%5.0" DEPOSIT ABSOLUTE /end AXIS_DESCR
/end CHARACTERISTIC
/begin CHARACTERISTIC KLORAMILL "" CURVE 0x80047924 KlAxU8SstxU8WU16 99.99847 rel_uw_b100 0.00 99.99847 FORMAT "%8.5"
 /begin AXIS_DESCR STD_AXIS nmot nmot_ub_q40 4 0.00 10200. FORMAT "%5.0" DEPOSIT ABSOLUTE /end AXIS_DESCR
/end CHARACTERISTIC
/begin CHARACTERISTIC KLPSDO "" CURVE 0x8004896E KlAxU8SstxU8WU8 2550. p_ub_q10 0.00 2550. FORMAT "%5.0"
 /begin AXIS_DESCR STD_AXIS nmot nmot_ub_q40 6 0.00 10200. FORMAT "%5.0" DEPOSIT ABSOLUTE /end AXIS_DESCR
/end CHARACTERISTIC
/begin CHARACTERISTIC KLREDNMX "" CURVE 0x80048E06 FklWU8 255.0 dez 0.00 255.0 FORMAT "%5.1"
 /begin AXIS_DESCR FIX_AXIS gangi dez 8 0.00 7.000 FORMAT "%5.3" FIX_AXIS_PAR 0 0 8 /end AXIS_DESCR
/end CHARACTERISTIC
/begin CHARACTERISTIC KLRLVMX "" CURVE 0x80048D7A KlAxU8SstxU16WU16 1535.977 rel_uw_q0p0234 0.00 1535.977 FORMAT "%8.3"
 /begin AXIS_DESCR STD_AXIS nmot_w nmot_uw_q0p25 11 0.00 16383.75 FORMAT "%8.2" DEPOSIT ABSOLUTE /end AXIS_DESCR
/end CHARACTERISTIC
/begin CHARACTERISTIC KLRLVSMX "" CURVE 0x80048DA8 KlAxU8SstxU16WU16 1535.977 rel_uw_q0p0234 0.00 1535.977 FORMAT "%8.3"
 /begin AXIS_DESCR STD_AXIS nmot_w nmot_uw_q0p25 11 0.00 16383.75 FORMAT "%8.2" DEPOSIT ABSOLUTE /end AXIS_DESCR
/end CHARACTERISTIC
/begin CHARACTERISTIC KLTDMFBSA "" CURVE 0x80048E3A FklWU16 655.34999985 zk10msxs_uw_b655 0.010000152590 655.36000000 FORMAT "%12.8"
 /begin AXIS_DESCR FIX_AXIS gangi dez 8 0.00 7.000 FORMAT "%5.3" FIX_AXIS_PAR 0 0 8 /end AXIS_DESCR
/end CHARACTERISTIC
/begin CHARACTERISTIC KLTDMFBWE "" CURVE 0x80048E4A FklWU16 655.34999985 zk10msxs_uw_b655 0.010000152590 655.36000000 FORMAT "%12.8"
 /begin AXIS_DESCR FIX_AXIS gangi dez 8 0.00 7.000 FORMAT "%5.3" FIX_AXIS_PAR 0 0 8 /end AXIS_DESCR
/end CHARACTERISTIC
/begin CHARACTERISTIC KLTONLRALA "" CURVE 0x80047932 KlAxU8SstxU16WU16 13107.00 t_q0p2 0.00 13107.00 FORMAT "%8.2"
 /begin AXIS_DESCR STD_AXIS lamtme_w t_q0p2 3 0.00 13107.00 FORMAT "%8.2" DEPOSIT ABSOLUTE /end AXIS_DESCR
/end CHARACTERISTIC
/begin CHARACTERISTIC KLTURAA "" CURVE 0x80047940 KlAxU8SstxU8WU8 191.3 temp_ub_q0p75_o48 -48.00 143.3 FORMAT "%5.1"
 /begin AXIS_DESCR STD_AXIS tumg temp_ub_q0p75_o48 4 -48.00 143.3 FORMAT "%5.1" DEPOSIT ABSOLUTE /end AXIS_DESCR
/end CHARACTERISTIC
/begin CHARACTERISTIC KLZNFILT "" CURVE 0x80048E6E KlAUbSstSwWUw 655.34999985 zk10msxs_uw_b655 0.010000152590 655.36000000 FORMAT "%12.8"
 /begin AXIS_DESCR STD_AXIS ngas_w nmotg_sw_q0p39 7 -12800.16 12799.77 FORMAT "%8.2" DEPOSIT ABSOLUTE /end AXIS_DESCR
/end CHARACTERISTIC
/begin CHARACTERISTIC KWTFRAMX "" VALUE 0x8004795C KwWU16 13107.00 t_q0p2 0.00 13107.00 FORMAT "%8.2" /end CHARACTERISTIC
/begin CHARACTERISTIC KWTORAMX "" VALUE 0x8004795E KwWU16 13107.00 t_q0p2 0.00 13107.00 FORMAT "%8.2" /end CHARACTERISTIC
/begin CHARACTERISTIC KWTPFRAMX "" VALUE 0x80047960 KwWU16 13107.00 t_q0p2 0.00 13107.00 FORMAT "%8.2" /end CHARACTERISTIC
/begin CHARACTERISTIC KWTPORAMX "" VALUE 0x80047962 KwWU16 13107.00 t_q0p2 0.00 13107.00 FORMAT "%8.2" /end CHARACTERISTIC
/begin CHARACTERISTIC LAMGAFVMN "" VALUE 0x8004794A KwWU16 15.99976 fak_uw_b16 0.00 15.99976 FORMAT "%8.5" /end CHARACTERISTIC
/begin CHARACTERISTIC LAMGAMN "" VALUE 0x8004794C KwWU16 15.99976 fak_uw_b16 0.00 15.99976 FORMAT "%8.5" /end CHARACTERISTIC
/begin CHARACTERISTIC LAMGAMX "" VALUE 0x8004794E KwWU16 15.99976 fak_uw_b16 0.00 15.99976 FORMAT "%8.5" /end CHARACTERISTIC
/begin CHARACTERISTIC LIMN "" VALUE 0x800477BE KwWU8 24.90 rel_ub_bn24p9 -24.90 0.00 FORMAT "%5.2" /end CHARACTERISTIC
/begin CHARACTERISTIC LIMNDLLR "" VALUE 0x800477BF KwWU8 24.90 rel_ub_bn24p9 -24.90 0.00 FORMAT "%5.2" /end CHARACTERISTIC
/begin CHARACTERISTIC LIMNDTES "" VALUE 0x800477C0 KwWU8 24.90 rel_ub_bn24p9 -24.90 0.00 FORMAT "%5.2" /end CHARACTERISTIC
/begin CHARACTERISTIC LIMXDNS "" CURVE 0x800477C1 GklWU8 24.90 rel_ub_b24p9 0.00 24.90 FORMAT "%5.2"
 /begin AXIS_DESCR COM_AXIS dns nmotd_sb_q10 6 -1280. 1270. FORMAT "%5.0" AXIS_PTS_REF SNZ06LLSB /end AXIS_DESCR
/end CHARACTERISTIC
/begin CHARACTERISTIC LIMXVDNS "" CURVE 0x800477C7 GklWU8 24.90 rel_ub_b24p9 0.00 24.90 FORMAT "%5.2"
 /begin AXIS_DESCR COM_AXIS dns nmotd_sb_q10 6 -1280. 1270. FORMAT "%5.0" AXIS_PTS_REF SNZ06LLSB /end AXIS_DESCR
/end CHARACTERISTIC
/begin CHARACTERISTIC LISTM "" CURVE 0x800477CD GklWU8 24.90 rel_ub_b24p9 0.00 24.90 FORMAT "%5.2"
 /begin AXIS_DESCR COM_AXIS tmot temp_ub_q0p75_o48 6 -48.00 143.3 FORMAT "%5.1" AXIS_PTS_REF STM06LLUB /end AXIS_DESCR
/end CHARACTERISTIC
/begin CHARACTERISTIC LIVFZDEUS "" VALUE 0x800477D3 KwWU8 318.8 vfzg_ub_q1p25 0.00 318.8 FORMAT "%5.1" /end CHARACTERISTIC
/begin CHARACTERISTIC LLRICNF "" VALUE 0x800477D4 KwWU8 255.0 dez 0.00 255.0 FORMAT "%5.1" /end CHARACTERISTIC
/begin CHARACTERISTIC LRDYNLL "" VALUE 0x80047AEC KwWU16 7.999878 fak_uw_b8 0.00 7.999878 FORMAT "%8.6" /end CHARACTERISTIC
/begin CHARACTERISTIC LRLASOMN "" VALUE 0x800479BA KwWU16 15.99976 fak_uw_b16 0.00 15.99976 FORMAT "%8.5" /end CHARACTERISTIC
/begin CHARACTERISTIC LRLASOMX "" VALUE 0x800479BC KwWU16 15.99976 fak_uw_b16 0.00 15.99976 FORMAT "%8.5" /end CHARACTERISTIC
/begin CHARACTERISTIC MDHYEZ "" VALUE 0x80048E0E KwWU8 99.61 rel_ub_b99p6 0.00 99.61 FORMAT "%5.2" /end CHARACTERISTIC
/begin CHARACTERISTIC MDLF1 "" VALUE 0x8004908F KwWU8 50.00 rel_ub_b50 0.00 50.00 FORMAT "%5.2" /end CHARACTERISTIC
/begin CHARACTERISTIC MDLF2 "" VALUE 0x80049090 KwWU8 50.00 rel_ub_b50 0.00 50.00 FORMAT "%5.2" /end CHARACTERISTIC
/begin CHARACTERISTIC MDLFE1 "" VALUE 0x80049091 KwWU8 50.00 rel_ub_b50 0.00 50.00 FORMAT "%5.2" /end CHARACTERISTIC
/begin CHARACTERISTIC MDLFE2 "" VALUE 0x80049092 KwWU8 50.00 rel_ub_b50 0.00 50.00 FORMAT "%5.2" /end CHARACTERISTIC
/begin CHARACTERISTIC MDLFPWMMN "" VALUE 0x80049093 KwWU8 99.61 rel_ub_b100 0.00 99.61 FORMAT "%5.2" /end CHARACTERISTIC
/begin CHARACTERISTIC MDLOAD1 "" VALUE 0x80049094 KwWU8 99.61 rel_ub_b100 0.00 99.61 FORMAT "%5.2" /end CHARACTERISTIC
/begin CHARACTERISTIC MDLOAD3 "" VALUE 0x80049095 KwWU8 99.61 rel_ub_b100 0.00 99.61 FORMAT "%5.2" /end CHARACTERISTIC
/begin CHARACTERISTIC MDSH "" CURVE 0x80049530 KlAxU8SstxU16WS16 100.1957 rel_q0p1957 -50.09785 50.09785 FORMAT "%8.5"
 /begin AXIS_DESCR STD_AXIS fho fak_ub_b4 6 0.00 3.984375 FORMAT "%8.6" DEPOSIT ABSOLUTE /end AXIS_DESCR
/end CHARACTERISTIC
/begin CHARACTERISTIC MDSM "" CURVE 0x8004954A GklWU16 99.99847 rel_uw_b100 0.00 99.99847 FORMAT "%8.5"
 /begin AXIS_DESCR COM_AXIS tmot temp_ub_q0p75_o48 10 -48.00 143.3 FORMAT "%5.1" AXIS_PTS_REF STM10_UB /end AXIS_DESCR
/end CHARACTERISTIC
/begin CHARACTERISTIC MDSMNW "" CURVE 0x8004955E GklWU16 99.99847 rel_uw_b100 0.00 99.99847 FORMAT "%8.5"
 /begin AXIS_DESCR COM_AXIS tmot temp_ub_q0p75_o48 10 -48.00 143.3 FORMAT "%5.1" AXIS_PTS_REF STM10_UB /end AXIS_DESCR
/end CHARACTERISTIC
/begin CHARACTERISTIC MDSMZAS "" CURVE 0x80049572 GklWU16 99.99847 rel_uw_b100 0.00 99.99847 FORMAT "%8.5"
 /begin AXIS_DESCR COM_AXIS tmot temp_ub_q0p75_o48 10 -48.00 143.3 FORMAT "%5.1" AXIS_PTS_REF STM10_UB /end AXIS_DESCR
/end CHARACTERISTIC
/begin CHARACTERISTIC MDVGLW "" CURVE 0x80049586 KlAxU8SstxU8WU16 99.99847 rel_uw_b100 0.00 99.99847 FORMAT "%8.5"
 /begin AXIS_DESCR STD_AXIS tmot temp_ub_q0p75_o48 6 -48.00 143.3 FORMAT "%5.1" DEPOSIT ABSOLUTE /end AXIS_DESCR
/end CHARACTERISTIC
/begin CHARACTERISTIC MDWANK "" VALUE 0x8004959A KwWS16 199.9969 rel_sw_b100 -100.0000 99.99695 FORMAT "%8.4" /end CHARACTERISTIC
/begin CHARACTERISTIC MKLWON "" CURVE 0x80048D06 GklWS16 199.9969 rel_sw_b100 -100.0000 99.99695 FORMAT "%8.4"
 /begin AXIS_DESCR COM_AXIS nmot nmot_ub_q40 6 0.00 10200. FORMAT "%5.0" AXIS_PTS_REF SNM06MFUB /end AXIS_DESCR
/end CHARACTERISTIC
/begin CHARACTERISTIC MKLWOWKN "" CURVE 0x80048D12 GklWS16 199.9969 rel_sw_b100 -100.0000 99.99695 FORMAT "%8.4"
 /begin AXIS_DESCR COM_AXIS nmot nmot_ub_q40 6 0.00 10200. FORMAT "%5.0" AXIS_PTS_REF SNM06MFUB /end AXIS_DESCR
/end CHARACTERISTIC
/begin CHARACTERISTIC MKLWSAN "" CURVE 0x80048D1E GklWS16 199.9969 rel_sw_b100 -100.0000 99.99695 FORMAT "%8.4"
 /begin AXIS_DESCR COM_AXIS nmot nmot_ub_q40 6 0.00 10200. FORMAT "%5.0" AXIS_PTS_REF SNM06MFUB /end AXIS_DESCR
/end CHARACTERISTIC
/begin CHARACTERISTIC MKLWSDWK "" VALUE 0x80048D2A KwWS16 199.9969 rel_sw_b100 -100.0000 99.99695 FORMAT "%8.4" /end CHARACTERISTIC
/begin CHARACTERISTIC MKLWUN "" CURVE 0x80048D2C GklWS16 199.9969 rel_sw_b100 -100.0000 99.99695 FORMAT "%8.4"
 /begin AXIS_DESCR COM_AXIS nmot nmot_ub_q40 6 0.00 10200. FORMAT "%5.0" AXIS_PTS_REF SNM06MFUB /end AXIS_DESCR
/end CHARACTERISTIC
/begin CHARACTERISTIC MKLWUWKN "" CURVE 0x80048D38 GklWS16 199.9969 rel_sw_b100 -100.0000 99.99695 FORMAT "%8.4"
 /begin AXIS_DESCR COM_AXIS nmot nmot_ub_q40 6 0.00 10200. FORMAT "%5.0" AXIS_PTS_REF SNM06MFUB /end AXIS_DESCR
/end CHARACTERISTIC
/begin CHARACTERISTIC N0 "" VALUE 0x800479A8 KwWU8 10200. nmot_ub_q40 0.00 10200. FORMAT "%5.0" /end CHARACTERISTIC
/begin CHARACTERISTIC NARMNKL "" CURVE 0x80047B6C GklWU8 6480. nmot_ub_q40 520.0 7000. FORMAT "%5.0"
 /begin AXIS_DESCR COM_AXIS uevges_w fak_q0p02 8 0.00 1310.700 FORMAT "%8.3" AXIS_PTS_REF STUEVGES /end AXIS_DESCR
/end CHARACTERISTIC
/begin CHARACTERISTIC NARMNLLKL "" CURVE 0x80047B74 GklWU8 6480. nmot_ub_q40 520.0 7000. FORMAT "%5.0"
 /begin AXIS_DESCR COM_AXIS uevges_w fak_q0p02 8 0.00 1310.700 FORMAT "%8.3" AXIS_PTS_REF STUEVGES /end AXIS_DESCR
/end CHARACTERISTIC
/begin CHARACTERISTIC NARMXKL "" CURVE 0x80047B7C GklWU8 6480. nmot_ub_q40 520.0 7000. FORMAT "%5.0"
 /begin AXIS_DESCR COM_AXIS uevges_w fak_q0p02 8 0.00 1310.700 FORMAT "%8.3" AXIS_PTS_REF STUEVGES /end AXIS_DESCR
/end CHARACTERISTIC
/begin CHARACTERISTIC NARMXLLKL "" CURVE 0x80047B84 GklWU8 6480. nmot_ub_q40 520.0 7000. FORMAT "%5.0"
 /begin AXIS_DESCR COM_AXIS uevges_w fak_q0p02 8 0.00 1310.700 FORMAT "%8.3" AXIS_PTS_REF STUEVGES /end AXIS_DESCR
/end CHARACTERISTIC
/begin CHARACTERISTIC NASNOT "" VALUE 0x80048BDA KwWU8 10200. nmot_ub_q40 0.00 10200. FORMAT "%5.0" /end CHARACTERISTIC
/begin CHARACTERISTIC NASNOTFS "" VALUE 0x80048BDB KwWU8 10200. nmot_ub_q40 0.00 10200. FORMAT "%5.0" /end CHARACTERISTIC
/begin CHARACTERISTIC NGFILMN "" VALUE 0x80047B8C KwWS16 25599.94 nmotg_sw_q0p39 -12800.16 12799.77 FORMAT "%8.2" /end CHARACTERISTIC
/begin CHARACTERISTIC NGFILMX "" VALUE 0x80047B8E KwWS16 25599.94 nmotg_sw_q0p39 -12800.16 12799.77 FORMAT "%8.2" /end CHARACTERISTIC
/begin CHARACTERISTIC NGFSAWE "" VALUE 0x80048E5A KwWS16 25599.94 nmotg_sw_q0p39 -12800.16 12799.77 FORMAT "%8.2" /end CHARACTERISTIC
/begin CHARACTERISTIC NGIR "" VALUE 0x8004897C KwWS16 25599.94 nmotg_sw_q0p39 -12800.16 12799.77 FORMAT "%8.2" /end CHARACTERISTIC
/begin CHARACTERISTIC NIMDSTN "" VALUE 0x80048E5E KwWU16 16383.75 nmot_uw_q0p25 0.00 16383.75 FORMAT "%8.2" /end CHARACTERISTIC
/begin CHARACTERISTIC NLLRRI "" VALUE 0x800477D6 KwWU16 16383.75 nmot_uw_q0p25 0.00 16383.75 FORMAT "%8.2" /end CHARACTERISTIC
/begin CHARACTERISTIC NMAXSAWE "" VALUE 0x80048E0F KwWU8 10200. nmot_ub_q40 0.00 10200. FORMAT "%5.0" /end CHARACTERISTIC
/begin CHARACTERISTIC NOLRA "" VALUE 0x80047950 KwWU8 255.0 dez 0.00 255.0 FORMAT "%5.1" /end CHARACTERISTIC
/begin CHARACTERISTIC NRKAB "" VALUE 0x800479A9 KwWU8 10200. nmot_ub_q40 0.00 10200. FORMAT "%5.0" /end CHARACTERISTIC
/begin CHARACTERISTIC ORAK "" VALUE 0x800479AA KwWU16 3839.941 q0p0586_pc_DIV_s 0.00 3839.941 FORMAT "%8.3" /end CHARACTERISTIC
/begin CHARACTERISTIC ORAMN "" VALUE 0x800479AC KwWS16 3071.953 rel_sw_b1536 -1536.000 1535.953 FORMAT "%8.3" /end CHARACTERISTIC
/begin CHARACTERISTIC ORAMX "" VALUE 0x800479AE KwWS16 3071.953 rel_sw_b1536 -1536.000 1535.953 FORMAT "%8.3" /end CHARACTERISTIC
/begin CHARACTERISTIC ORASPV "" VALUE 0x80047952 KwWU16 511.9922 vfzg_uw_b512 0.00 511.9922 FORMAT "%8.4" /end CHARACTERISTIC
/begin CHARACTERISTIC PHUFRAHP "" VALUE 0x80047964 KwWU8 255.0 dez 0.00 255.0 FORMAT "%5.1" /end CHARACTERISTIC
/begin CHARACTERISTIC PHUFRALP "" VALUE 0x80047965 KwWU8 255.0 dez 0.00 255.0 FORMAT "%5.1" /end CHARACTERISTIC
/begin CHARACTERISTIC PHUFRAMP "" VALUE 0x80047966 KwWU8 255.0 dez 0.00 255.0 FORMAT "%5.1" /end CHARACTERISTIC
/begin CHARACTERISTIC PHUORAHP "" VALUE 0x80047967 KwWU8 255.0 dez 0.00 255.0 FORMAT "%5.1" /end CHARACTERISTIC
/begin CHARACTERISTIC PHUORALP "" VALUE 0x80047968 KwWU8 255.0 dez 0.00 255.0 FORMAT "%5.1" /end CHARACTERISTIC
/begin CHARACTERISTIC PHUORAMP "" VALUE 0x80047969 KwWU8 255.0 dez 0.00 255.0 FORMAT "%5.1" /end CHARACTERISTIC
/begin CHARACTERISTIC PVDNHOM "" CURVE 0x800477D8 GklWU8 0.3891 fak_q0p00153 0.00 0.3891
 /begin AXIS_DESCR COM_AXIS dnpzw_w nmot_sw_q0p25 10 -8192.000 8191.750 FORMAT "%8.3" AXIS_PTS_REF SDNM10LLSW /end AXIS_DESCR
/end CHARACTERISTIC
/begin CHARACTERISTIC PVDNHOMV "" CURVE 0x800477E2 GklWU8 0.3891 fak_q0p00153 0.00 0.3891
 /begin AXIS_DESCR COM_AXIS dnpzw_w nmot_sw_q0p25 10 -8192.000 8191.750 FORMAT "%8.3" AXIS_PTS_REF SDNM10LLSW /end AXIS_DESCR
/end CHARACTERISTIC
/begin CHARACTERISTIC PVDNKFKH "" MAP 0x800477EC KfAxU8AyU8SstxS8SstyU8WU8 0.3891 fak_q0p00153 0.00 0.3891
 /begin AXIS_DESCR STD_AXIS dnpzwloc nmot_sb_q10 6 -1280. 1270. FORMAT "%5.0" DEPOSIT ABSOLUTE /end AXIS_DESCR
 /begin AXIS_DESCR STD_AXIS nmotll nmot_ub_q10 4 0.00 2550. FORMAT "%5.0" DEPOSIT ABSOLUTE /end AXIS_DESCR
/end CHARACTERISTIC
/begin CHARACTERISTIC PVDNSTW "" CURVE 0x80047810 GklWU8 0.3891 fak_q0p00153 0.00 0.3891
 /begin AXIS_DESCR COM_AXIS dnpzw_w nmot_sw_q0p25 10 -8192.000 8191.750 FORMAT "%8.3" AXIS_PTS_REF SDNM10LLSW /end AXIS_DESCR
/end CHARACTERISTIC
/begin CHARACTERISTIC PVLDNEZ "" MAP 0x8004781A GkfWU8 0.3891 fak_q0p00153 0.00 0.3891
 /begin AXIS_DESCR COM_AXIS dn_w nmot_sw_q0p25 10 -8192.000 8191.750 FORMAT "%8.3" AXIS_PTS_REF SDN10LLSW /end AXIS_DESCR
 /begin AXIS_DESCR COM_AXIS etazws rel_ub_b127p5 4 0.00 127.5 FORMAT "%5.1" AXIS_PTS_REF SEZ04LLUB /end AXIS_DESCR
/end CHARACTERISTIC
/begin CHARACTERISTIC PVLDNEZKH "" MAP 0x80047842 GkfWU8 0.3891 fak_q0p00153 0.00 0.3891
 /begin AXIS_DESCR COM_AXIS dn_w nmot_sw_q0p25 10 -8192.000 8191.750 FORMAT "%8.3" AXIS_PTS_REF SDN10LLSW /end AXIS_DESCR
 /begin AXIS_DESCR COM_AXIS etazws rel_ub_b127p5 4 0.00 127.5 FORMAT "%5.1" AXIS_PTS_REF SEZ04LLUB /end AXIS_DESCR
/end CHARACTERISTIC
/begin CHARACTERISTIC PVLDNEZV "" MAP 0x8004786A GkfWU8 0.3891 fak_q0p00153 0.00 0.3891
 /begin AXIS_DESCR COM_AXIS dn_w nmot_sw_q0p25 10 -8192.000 8191.750 FORMAT "%8.3" AXIS_PTS_REF SDN10LLSW /end AXIS_DESCR
 /begin AXIS_DESCR COM_AXIS etazws rel_ub_b127p5 4 0.00 127.5 FORMAT "%5.1" AXIS_PTS_REF SEZ04LLUB /end AXIS_DESCR
/end CHARACTERISTIC
/begin CHARACTERISTIC REDHYOC "" VALUE 0x80048E10 KwWS8 3.984 fak_sb_b2 -2.000 1.984 FORMAT "%5.3" /end CHARACTERISTIC
/begin CHARACTERISTIC REDHYOCS "" VALUE 0x80048E11 KwWS8 3.984 fak_sb_b2 -2.000 1.984 FORMAT "%5.3" /end CHARACTERISTIC
/begin CHARACTERISTIC REDHYUC "" VALUE 0x80048E12 KwWS8 3.984 fak_sb_b2 -2.000 1.984 FORMAT "%5.3" /end CHARACTERISTIC
/begin CHARACTERISTIC REDHYUCS "" VALUE 0x80048E13 KwWS8 3.984 fak_sb_b2 -2.000 1.984 FORMAT "%5.3" /end CHARACTERISTIC
/begin CHARACTERISTIC REDMXSA "" VALUE 0x80048E14 KwWU8 255.0 dez 0.00 255.0 FORMAT "%5.1" /end CHARACTERISTIC
/begin CHARACTERISTIC REDZEM "" CURVE 0x80048E16 KlAxU8SstxU16WU8 255.0 dez 0.00 255.0 FORMAT "%5.1"
 /begin AXIS_DESCR STD_AXIS tmot temp_ub_q0p75_o48 5 -48.00000 143.2500 FORMAT "%8.4" DEPOSIT ABSOLUTE /end AXIS_DESCR
/end CHARACTERISTIC
/begin CHARACTERISTIC REDZEMNL "" CURVE 0x80048E28 KlAxU8SstxU8WU8 255.0 dez 0.00 255.0 FORMAT "%5.1"
 /begin AXIS_DESCR STD_AXIS tmot temp_ub_q0p75_o48 5 -48.00 143.3 FORMAT "%5.1" DEPOSIT ABSOLUTE /end AXIS_DESCR
/end CHARACTERISTIC
/begin CHARACTERISTIC RLABW "" VALUE 0x80048EAA KwWU16 1535.977 rel_uw_q0p0234 0.00 1535.977 FORMAT "%8.3" /end CHARACTERISTIC
/begin CHARACTERISTIC RLLRUN "" CURVE 0x800479BE KlAxU8SstxU8WU8 191.3 rel_ub_q0p75 0.00 191.3 FORMAT "%5.1"
 /begin AXIS_DESCR STD_AXIS nmot nmot_ub_q40 8 0.00 10200. FORMAT "%5.0" DEPOSIT ABSOLUTE /end AXIS_DESCR
/end CHARACTERISTIC
/begin CHARACTERISTIC RLRVAO "" VALUE 0x800479CF KwWU8 191.3 rel_ub_q0p75 0.00 191.3 FORMAT "%5.1" /end CHARACTERISTIC
/begin CHARACTERISTIC RTELRMX "" VALUE 0x80047AEE KwWU16 0.9999847 fak_uw_b1 0.00 0.9999847 FORMAT "%9.7" /end CHARACTERISTIC
/begin CHARACTERISTIC SARDYNDPKF "" MAP 0x80047B90 GkfWS16 99.99695 rel_sw_b100 0.00 99.99695 FORMAT "%8.5"
 /begin AXIS_DESCR COM_AXIS uevges_w fak_q0p02 8 0.00 1310.700 FORMAT "%8.3" AXIS_PTS_REF STUEVGES /end AXIS_DESCR
 /begin AXIS_DESCR COM_AXIS stmkfanb_w rel_sw_b100 8 -100.0000 99.99695 FORMAT "%8.4" AXIS_PTS_REF STMKFANB /end AXIS_DESCR
/end CHARACTERISTIC
/begin CHARACTERISTIC SARDYNKF "" MAP 0x80047C10 GkfWS16 99.99695 rel_sw_b100 0.00 99.99695 FORMAT "%8.5"
 /begin AXIS_DESCR COM_AXIS uevges_w fak_q0p02 8 0.00 1310.700 FORMAT "%8.3" AXIS_PTS_REF STUEVGES /end AXIS_DESCR
 /begin AXIS_DESCR COM_AXIS stmkfanb_w rel_sw_b100 8 -100.0000 99.99695 FORMAT "%8.4" AXIS_PTS_REF STMKFANB /end AXIS_DESCR
/end CHARACTERISTIC
/begin CHARACTERISTIC SARSTATKF "" MAP 0x80047C90 GkfWS16 99.99695 rel_sw_b100 0.00 99.99695 FORMAT "%8.5"
 /begin AXIS_DESCR COM_AXIS uevges_w fak_q0p02 8 0.00 1310.700 FORMAT "%8.3" AXIS_PTS_REF STUEVGES /end AXIS_DESCR
 /begin AXIS_DESCR COM_AXIS stmkfanb_w rel_sw_b100 8 -100.0000 99.99695 FORMAT "%8.4" AXIS_PTS_REF STMKFANB /end AXIS_DESCR
/end CHARACTERISTIC
/begin AXIS_PTS SDN10LLSW "" 0x80047892 dn_w SstAU8SstS16 16383.75 nmot_sw_q0p25 10 -8192.000 8191.750 FORMAT "%8.3" DEPOSIT ABSOLUTE /end AXIS_PTS
/begin AXIS_PTS SDNM10LLSW "" 0x800478A8 dnpzw_w SstAU8SstS16 16383.75 nmot_sw_q0p25 10 -8192.000 8191.750 FORMAT "%8.3" DEPOSIT ABSOLUTE /end AXIS_PTS
/begin AXIS_PTS SEZ04LLUB "" 0x800478BE etazws SstAU8SstU8 127.5 rel_ub_b127p5 4 0.00 127.5 FORMAT "%5.1" DEPOSIT ABSOLUTE /end AXIS_PTS
/begin AXIS_PTS SGA06MFUB "" 0x80048D44 xgang SstAU8SstU8 255.0 dez 6 0.00 255.0 FORMAT "%5.1" DEPOSIT ABSOLUTE /end AXIS_PTS
/begin AXIS_PTS SNG06LLSB "" 0x80049E99 ngfil SstAU8SstS8 25500. nmotg_sb_q100 6 -12800. 12700. FORMAT "%5.0" DEPOSIT ABSOLUTE /end AXIS_PTS
/begin AXIS_PTS SNM06KOUB "" 0x80049096 nmot SstAU8SstU8 10200. nmot_ub_q40 6 0.00 10200. FORMAT "%5.0" DEPOSIT ABSOLUTE /end AXIS_PTS
/begin AXIS_PTS SNM06LLUW "" 0x80049EA6 nmot_w SstAUwSstUw 16383.75 nmot_uw_q0p25 6 0.00 16383.75 FORMAT "%8.2" DEPOSIT ABSOLUTE /end AXIS_PTS
/begin AXIS_PTS SNM06MFUB "" 0x80048D4B nmot SstAU8SstU8 10200. nmot_ub_q40 6 0.00 10200. FORMAT "%5.0" DEPOSIT ABSOLUTE /end AXIS_PTS
/begin AXIS_PTS SNM07LRUB "" 0x80047AF0 nmot SstAU8SstU8 10200. nmot_ub_q40 7 0.00 10200. FORMAT "%5.0" DEPOSIT ABSOLUTE /end AXIS_PTS
/begin AXIS_PTS SNM16OPUW "" 0x80049EC6 nmot_w SstAU8SstU16 16383.75 nmot_uw_q0p25 16 0.00 16383.75 FORMAT "%8.2" DEPOSIT ABSOLUTE /end AXIS_PTS
/begin AXIS_PTS SNS06LLSB "" 0x80047446 dns SstAU8SstS8 2550. nmotd_sb_q10 6 -1280. 1270. FORMAT "%5.0" DEPOSIT ABSOLUTE /end AXIS_PTS
/begin AXIS_PTS SNZ06LLSB "" 0x800478C3 dns SstAU8SstS8 2550. nmotd_sb_q10 6 -1280. 1270. FORMAT "%5.0" DEPOSIT ABSOLUTE /end AXIS_PTS
/begin AXIS_PTS SPU11OPUW "" 0x8004959C dpusms SstAU8SstU16 2559.961 p_uw_q0p039 11 0.00 2559.961 FORMAT "%8.3" DEPOSIT ABSOLUTE /end AXIS_PTS
/begin CHARACTERISTIC SRKTEVS "" VALUE 0x800478CA KwWU16 1310.680 t20msxs_uw_b1310 0.02000000 1310.700 FORMAT "%8.3" /end CHARACTERISTIC
/begin AXIS_PTS SRL06LRUB "" 0x80047AF8 rlsrl SstAU8SstU8 191.3 rel_ub_q0p75 6 0.00 191.3 FORMAT "%5.1" DEPOSIT ABSOLUTE /end AXIS_PTS
/begin AXIS_PTS SRL11OPUW "" 0x80049F24 rl_w SstAU8SstU16 1535.977 rel_q0p0234 11 0.00 1535.977 FORMAT "%8.3" DEPOSIT ABSOLUTE /end AXIS_PTS
/begin AXIS_PTS STA06LLUB "" 0x8004909D tatuko SstAU8SstU8 191.3 temp_ub_q0p75_o48 6 -48.00 143.3 FORMAT "%5.1" DEPOSIT ABSOLUTE /end AXIS_PTS
/begin AXIS_PTS STM06LLUB "" 0x80049F89 tmot SstAU8SstU8 191.3 temp_ub_q0p75_o48 6 -48.00 143.3 FORMAT "%5.1" DEPOSIT ABSOLUTE /end AXIS_PTS
/begin AXIS_PTS STM08LEUB "" 0x800479D0 tmot SstAU8SstU8 191.3 temp_ub_q0p75_o48 8 -48.00 143.3 FORMAT "%5.1" DEPOSIT ABSOLUTE /end AXIS_PTS
/begin AXIS_PTS STM10_UB "" 0x800495B4 tmot SstAU8SstU8 191.3 temp_ub_q0p75_o48 10 -48.00 143.3 FORMAT "%5.1" DEPOSIT ABSOLUTE /end AXIS_PTS
/begin AXIS_PTS STMKFANB "" 0x80047D10 stmkfanb_w SstAU8SstS16 199.9969 rel_sw_b100 8 -100.0000 99.99695 FORMAT "%8.4" DEPOSIT ABSOLUTE /end AXIS_PTS
/begin AXIS_PTS STMS06LLUB "" 0x80049FBB tmst SstAUbSstUb 191.3 temp_ub_q0p75_o48 6 -48.00 143.3 FORMAT "%5.1" DEPOSIT ABSOLUTE /end AXIS_PTS
/begin AXIS_PTS STNMOT "" 0x80047D22 stnmott SstAU8SstU8 10200. nmot_ub_q40 4 0.00 10200. FORMAT "%5.0" DEPOSIT ABSOLUTE /end AXIS_PTS
/begin AXIS_PTS STUEVGES "" 0x80047D28 uevges_w SstAU8SstU16 1310.700 fak_q0p02 8 0.00 1310.700 FORMAT "%8.3" DEPOSIT ABSOLUTE /end AXIS_PTS
/begin CHARACTERISTIC TABSTAC "" CURVE 0x800490A4 KlAxU8SstxU8WU8 255.0 t1sxs_uw_q1 0.00 255.0 FORMAT "%5.1"
 /begin AXIS_DESCR STD_AXIS tmst temp_ub_q0p75_o48 6 -48.00 143.3 FORMAT "%5.1" DEPOSIT ABSOLUTE /end AXIS_DESCR
/end CHARACTERISTIC
/begin CHARACTERISTIC TARA "" VALUE 0x80047954 KwWU8 191.3 temp_ub_q0p75_o48 -48.00 143.3 FORMAT "%5.1" /end CHARACTERISTIC
/begin CHARACTERISTIC TARNSKL "" CURVE 0x80047D3A GklWU8 0.4801 t_q2p0345Em3 0.03866 0.5188
 /begin AXIS_DESCR COM_AXIS uevges_w fak_q0p02 8 0.00 1310.700 FORMAT "%8.3" AXIS_PTS_REF STUEVGES /end AXIS_DESCR
/end CHARACTERISTIC
/begin CHARACTERISTIC TARNSOT "" VALUE 0x80047D42 KwWU8 0.4801 t_q2p0345Em3 0.03866 0.5188 /end CHARACTERISTIC
/begin CHARACTERISTIC TASHS "" VALUE 0x800479D9 KwWU8 191.3 temp_ub_q0p75_o48 -48.00 143.3 FORMAT "%5.1" /end CHARACTERISTIC
/begin CHARACTERISTIC TDAIR "" VALUE 0x8004897E KwWU16 655.3500 t10msxs_uw_b655p35 0.00 655.3500 FORMAT "%8.4" /end CHARACTERISTIC
/begin CHARACTERISTIC TDMFBSA "" VALUE 0x80048DD6 KwWU16 655.34999985 zk10msxs_uw_b655 0.010000152590 655.36000000 FORMAT "%12.8" /end CHARACTERISTIC
/begin CHARACTERISTIC TDMFBWE "" VALUE 0x80048DD8 KwWU16 655.34999985 zk10msxs_uw_b655 0.010000152590 655.36000000 FORMAT "%12.8" /end CHARACTERISTIC
/begin CHARACTERISTIC TDMFBWEN "" VALUE 0x80048DDA KwWU16 655.34999985 zk10msxs_uw_b655 0.010000152590 655.36000000 FORMAT "%12.8" /end CHARACTERISTIC
/begin CHARACTERISTIC TDMKOW "" VALUE 0x800490B1 KwWU8 5.100 t20msxs_ub_b5p1 0.00 5.100 FORMAT "%5.3" /end CHARACTERISTIC
/begin CHARACTERISTIC TDMRESLLUS "" VALUE 0x800478CC KwWU8 5.100 t20msxs_ub_b5p1 0.00 5.100 FORMAT "%5.3" /end CHARACTERISTIC
/begin CHARACTERISTIC TFRAFV "" VALUE 0x8004796A KwWU16 13107.00 t_q0p2 0.00 13107.00 FORMAT "%8.2" /end CHARACTERISTIC
/begin CHARACTERISTIC TFRAINI "" VALUE 0x8004796C KwWU16 13107.00 t_q0p2 0.00 13107.00 FORMAT "%8.2" /end CHARACTERISTIC
/begin CHARACTERISTIC TFRAPH "" VALUE 0x8004796E KwWU16 13107.00 t_q0p2 0.00 13107.00 FORMAT "%8.2" /end CHARACTERISTIC
/begin CHARACTERISTIC TFRASTABZ "" VALUE 0x80047970 KwWU16 13107.00 t_q0p2 0.00 13107.00 FORMAT "%8.2" /end CHARACTERISTIC
/begin CHARACTERISTIC TKIHKMDRED "" VALUE 0x80048E34 KwWU16 1535.977 temp_q0p0234_o273 -273.1500 1262.827 FORMAT "%8.3" /end CHARACTERISTIC
/begin CHARACTERISTIC TLRBAMW "" CURVE 0x800479DA GklWU16 1310.700 t_q0p02 0.00 1310.700 FORMAT "%8.3"
 /begin AXIS_DESCR COM_AXIS tmot temp_ub_q0p75_o48 8 -48.00 143.3 FORMAT "%5.1" AXIS_PTS_REF STM08LEUB /end AXIS_DESCR
/end CHARACTERISTIC
/begin CHARACTERISTIC TLRHS "" VALUE 0x800479EA KwWU16 6553.500 t_q0p1 0.00 6553.500 FORMAT "%8.3" /end CHARACTERISTIC
/begin CHARACTERISTIC TLRPROT "" VALUE 0x800479EC KwWU8 5.100 t_q0p02 0.00 5.100 FORMAT "%5.3" /end CHARACTERISTIC
/begin CHARACTERISTIC TLRTMS "" CURVE 0x800479EE KlAxU8SstxU8WU16 6553.500 t_q0p1 0.00 6553.500 FORMAT "%8.3"
 /begin AXIS_DESCR STD_AXIS tmst temp_ub_q0p75_o48 5 -48.00 143.3 FORMAT "%5.1" DEPOSIT ABSOLUTE /end AXIS_DESCR
/end CHARACTERISTIC
/begin CHARACTERISTIC TLRVAMW "" CURVE 0x800479FE GklWU16 1310.700 t_q0p02 0.00 1310.700 FORMAT "%8.3"
 /begin AXIS_DESCR COM_AXIS tmot temp_ub_q0p75_o48 8 -48.00 143.3 FORMAT "%5.1" AXIS_PTS_REF STM08LEUB /end AXIS_DESCR
/end CHARACTERISTIC
/begin CHARACTERISTIC TMAR "" VALUE 0x80047D43 KwWU8 191.3 temp_ub_q0p75_o48 -48.00 143.3 FORMAT "%5.1" /end CHARACTERISTIC
/begin CHARACTERISTIC TMAXSAWE "" VALUE 0x80048E36 KwWU8 25.50 t100msxs_ub_b25p5 0.00 25.50 FORMAT "%5.2" /end CHARACTERISTIC
/begin CHARACTERISTIC TMDBUBOM "" VALUE 0x800490B2 KwWU8 191.3 temp_ub_q0p75_o48 -48.00 143.3 FORMAT "%5.1" /end CHARACTERISTIC
/begin CHARACTERISTIC TMDBUBUM "" VALUE 0x800490B3 KwWU8 191.3 temp_ub_q0p75_o48 -48.00 143.3 FORMAT "%5.1" /end CHARACTERISTIC
/begin CHARACTERISTIC TMDMAD "" VALUE 0x80048EAC KwWU8 191.3 temp_ub_q0p75_o48 -48.00 143.3 FORMAT "%5.1" /end CHARACTERISTIC
/begin CHARACTERISTIC TMFVDFRM "" VALUE 0x800479B0 KwWU8 191.3 temp_ub_q0p75_o48 -48.00 143.3 FORMAT "%5.1" /end CHARACTERISTIC
/begin CHARACTERISTIC TMLWSD "" VALUE 0x80048D52 KwWU8 191.3 temp_ub_q0p75_o48 -48.00 143.3 FORMAT "%5.1" /end CHARACTERISTIC
/begin CHARACTERISTIC TMRAA "" VALUE 0x80047955 KwWU8 191.3 temp_ub_q0p75_o48 -48.00 143.3 FORMAT "%5.1" /end CHARACTERISTIC
/begin CHARACTERISTIC TMSHS "" VALUE 0x80047A0E KwWU8 191.3 temp_ub_q0p75_o48 -48.00 143.3 FORMAT "%5.1" /end CHARACTERISTIC
/begin CHARACTERISTIC TNSDM "" VALUE 0x800478CE KwWU16 655.3500 t10msxs_uw_b655p35 0.00 655.3500 FORMAT "%8.4" /end CHARACTERISTIC
/begin CHARACTERISTIC TORAFV "" VALUE 0x80047972 KwWU16 13107.00 t_q0p2 0.00 13107.00 FORMAT "%8.2" /end CHARACTERISTIC
/begin CHARACTERISTIC TORAINI "" VALUE 0x80047974 KwWU16 13107.00 t_q0p2 0.00 13107.00 FORMAT "%8.2" /end CHARACTERISTIC
/begin CHARACTERISTIC TORAPH "" VALUE 0x80047976 KwWU16 13107.00 t_q0p2 0.00 13107.00 FORMAT "%8.2" /end CHARACTERISTIC
/begin CHARACTERISTIC TORASTA "" VALUE 0x80047978 KwWU16 13107.00 t_q0p2 0.00 13107.00 FORMAT "%8.2" /end CHARACTERISTIC
/begin CHARACTERISTIC TRAU "" VALUE 0x80047A0F KwWU8 25.50 t_q0p1 0.00 25.50 FORMAT "%5.2" /end CHARACTERISTIC
/begin CHARACTERISTIC TTPDFRM "" VALUE 0x800479B2 KwWU16 13106.999997 zk200msxs_uw_b13107 0.20000305180 13107.200000 FORMAT "%12.6" /end CHARACTERISTIC
/begin CHARACTERISTIC TVADFR "" VALUE 0x80048EAD KwWU8 51.00 t200msxs_ub_b51 0.00 51.00 FORMAT "%5.2" /end CHARACTERISTIC
/begin CHARACTERISTIC TVARDYN "" VALUE 0x80047D44 KwWU8 2.540 t_q0p01 0.01000 2.550 FORMAT "%5.3" /end CHARACTERISTIC
/begin CHARACTERISTIC TVARSA "" VALUE 0x80047D45 KwWU8 2.550 t_q0p01 0.00 2.550 FORMAT "%5.3" /end CHARACTERISTIC
/begin CHARACTERISTIC TVARSDYN "" VALUE 0x80047D46 KwWU8 2.540 t_q0p01 0.01000 2.550 FORMAT "%5.3" /end CHARACTERISTIC
/begin CHARACTERISTIC TVARSTAT "" VALUE 0x80047D47 KwWU8 2.540 t_q0p01 0.01000 2.550 FORMAT "%5.3" /end CHARACTERISTIC
/begin CHARACTERISTIC TVDUB "" VALUE 0x800490B4 KwWU8 5.100 t20msxs_ub_b5p1 0.00 5.100 FORMAT "%5.3" /end CHARACTERISTIC
/begin CHARACTERISTIC TVDUBMD "" VALUE 0x800490B6 KwWU16 1310.700 t20msxs_uw_b1310 0.00 1310.700 FORMAT "%8.3" /end CHARACTERISTIC
/begin CHARACTERISTIC TVDUBSTM "" VALUE 0x800490B8 KwWU16 1310.700 t20msxs_uw_b1310 0.00 1310.700 FORMAT "%8.3" /end CHARACTERISTIC
/begin CHARACTERISTIC TVGRMRUS "" VALUE 0x800478D0 KwWU8 5.100 t20msxs_ub_b5p1 0.00 5.100 FORMAT "%5.3" /end CHARACTERISTIC
/begin CHARACTERISTIC TVKINGAS "" VALUE 0x800478D1 KwWU8 5.100 t20msxs_ub_b5p1 0.00 5.100 FORMAT "%5.3" /end CHARACTERISTIC
/begin CHARACTERISTIC TVLISTU "" VALUE 0x800478D2 KwWU8 5.100 t20msxs_ub_b5p1 0.00 5.100 FORMAT "%5.3" /end CHARACTERISTIC
/begin CHARACTERISTIC TVLLRPST "" VALUE 0x800478D3 KwWU8 51.00 t200msxs_ub_b51 0.00 51.00 FORMAT "%5.2" /end CHARACTERISTIC
/begin CHARACTERISTIC TVLLRST "" VALUE 0x800478D4 KwWU8 5.100 t20msxs_ub_b5p1 0.00 5.100 FORMAT "%5.3" /end CHARACTERISTIC
/begin CHARACTERISTIC TVLRA "" VALUE 0x80047956 KwWU8 51.00 t_q0p2 0.00 51.00 FORMAT "%5.2" /end CHARACTERISTIC
/begin CHARACTERISTIC TVLRDYN "" VALUE 0x80047AFF KwWU8 2.550 t_q0p01 0.00 2.550 FORMAT "%5.3" /end CHARACTERISTIC
/begin CHARACTERISTIC TVLWSDSA "" VALUE 0x80048D53 KwWU8 25.50 t100msxs_ub_b25p5 0.00 25.50 FORMAT "%5.2" /end CHARACTERISTIC
/begin CHARACTERISTIC TVMDCVTK "" VALUE 0x800495BF KwWU8 5.100 t20msxs_ub_b5p1 0.00 5.100 FORMAT "%5.3" /end CHARACTERISTIC
/begin CHARACTERISTIC TVMDTRAEGM "" VALUE 0x80048E8C KwUb 2.550 t_q0p01 0.00 2.550 FORMAT "%5.3" /end CHARACTERISTIC
/begin CHARACTERISTIC TVNLGA "" VALUE 0x80047957 KwWU8 51.00 t_q0p2 0.00 51.00 FORMAT "%5.2" /end CHARACTERISTIC
/begin CHARACTERISTIC TVPKH "" VALUE 0x800478D6 KwWU16 13107.00 t200msxs_uw_q0p2 0.00 13107.00 FORMAT "%8.2" /end CHARACTERISTIC
/begin CHARACTERISTIC TVRESLLUS "" VALUE 0x800478D8 KwWU16 1310.700 t20msxs_uw_q0p02 0.00 1310.700 FORMAT "%8.3" /end CHARACTERISTIC
/begin CHARACTERISTIC TVSPMN "" VALUE 0x800478DA KwWU8 5.100 t20msxs_ub_b5p1 0.00 5.100 FORMAT "%5.3" /end CHARACTERISTIC
/begin CHARACTERISTIC TVUBLRA "" VALUE 0x80047958 KwWU8 51.00 t_q0p2 0.00 51.00 FORMAT "%5.2" /end CHARACTERISTIC
/begin CHARACTERISTIC TVUBLRAFRA "" VALUE 0x80047959 KwWU8 51.00 t_q0p2 0.00 51.00 FORMAT "%5.2" /end CHARACTERISTIC
/begin CHARACTERISTIC TVUBLRAORA "" VALUE 0x8004795A KwWU8 51.00 t_q0p2 0.00 51.00 FORMAT "%5.2" /end CHARACTERISTIC
/begin CHARACTERISTIC TWDMAD "" VALUE 0x80048EAE KwWU8 51.00 t200msxs_ub_b51 0.00 51.00 FORMAT "%5.2" /end CHARACTERISTIC
/begin CHARACTERISTIC USR "" VALUE 0x80047B00 KwWU8 1.330 spg_ub_q0p0052_o0p2 -0.2000 1.130 FORMAT "%5.3" /end CHARACTERISTIC
/begin CHARACTERISTIC USRW "" VALUE 0x80047B02 KwWU16 319.9951 spg_uw_q0p00488_o1 -1.000000 318.9951 FORMAT "%8.4" /end CHARACTERISTIC
/begin CHARACTERISTIC VARAO "" VALUE 0x80047D48 KwWU16 511.9922 vfzg_uw_b512 0.00 511.9922 FORMAT "%8.4" /end CHARACTERISTIC
/begin CHARACTERISTIC VARAU "" VALUE 0x80047D4A KwWU16 511.9922 vfzg_uw_b512 0.00 511.9922 FORMAT "%8.4" /end CHARACTERISTIC
/begin CHARACTERISTIC VARDYNKF "" MAP 0x80047D4C GkfWU8 0.7782 q0p00305_pc_DIV_rpm 0.00 0.7782
 /begin AXIS_DESCR COM_AXIS uevges_w fak_q0p02 8 0.00 1310.700 FORMAT "%8.3" AXIS_PTS_REF STUEVGES /end AXIS_DESCR
 /begin AXIS_DESCR COM_AXIS stnmott nmot_ub_q40 4 0.00 10200. FORMAT "%5.0" AXIS_PTS_REF STNMOT /end AXIS_DESCR
/end CHARACTERISTIC
/begin CHARACTERISTIC VARDYNOT "" VALUE 0x80047D6C KwWU8 1.556 q0p0061_pc_DIV_rpm 0.00 1.556 FORMAT "%5.3" /end CHARACTERISTIC
/begin CHARACTERISTIC VARMDKRMP "" VALUE 0x80047D6E KwWU16 0.07629395 fak_uw_b1 0.00 0.07629395 FORMAT "%10.8" /end CHARACTERISTIC
/begin CHARACTERISTIC VARSTATKL "" CURVE 0x80047D70 GklWU8 0.7782 q0p00305_pc_DIV_rpm 0.00 0.7782
 /begin AXIS_DESCR COM_AXIS uevges_w fak_q0p02 8 0.00 1310.700 FORMAT "%8.3" AXIS_PTS_REF STUEVGES /end AXIS_DESCR
/end CHARACTERISTIC
/begin CHARACTERISTIC VFZGDO "" VALUE 0x80048980 KwWU8 318.8 vfzg_ub_q1p25 0.00 318.8 FORMAT "%5.1" /end CHARACTERISTIC
/begin CHARACTERISTIC VFZGDU "" VALUE 0x80048981 KwWU8 318.8 vfzg_ub_q1p25 0.00 318.8 FORMAT "%5.1" /end CHARACTERISTIC
/begin CHARACTERISTIC VLWSD "" VALUE 0x80048D54 KwWU8 318.8 vfzg_ub_q1p25 0.00 318.8 FORMAT "%5.1" /end CHARACTERISTIC
/begin CHARACTERISTIC WDKBALI "" VALUE 0x800478DC KwWU16 200.0000 relDK_q0p02441 0.00 200.0000 FORMAT "%8.4" /end CHARACTERISTIC
/begin CHARACTERISTIC ZDFR "" VALUE 0x80047B04 KwWU16 0.9999847 fak_uw_b1 0.00 0.9999847 FORMAT "%9.7" /end CHARACTERISTIC
/begin CHARACTERISTIC ZFAOWK "" VALUE 0x80048D55 KwWU8 2.54000 zk10msxs_ub_b2p55 0.0100000 2.55000 FORMAT "%7.5" /end CHARACTERISTIC
/begin CHARACTERISTIC ZFAUWKN "" CURVE 0x80048D56 GklWU8 2.54000 zk10msxs_ub_b2p55 0.0100000 2.55000 FORMAT "%7.5"
 /begin AXIS_DESCR COM_AXIS nmot nmot_ub_q40 6 0.00 10200. FORMAT "%5.0" AXIS_PTS_REF SNM06MFUB /end AXIS_DESCR
/end CHARACTERISTIC
/begin CHARACTERISTIC ZFAWKN "" CURVE 0x80048D5C GklWU8 2.54000 zk10msxs_ub_b2p55 0.0100000 2.55000 FORMAT "%7.5"
 /begin AXIS_DESCR COM_AXIS nmot nmot_ub_q40 6 0.00 10200. FORMAT "%5.0" AXIS_PTS_REF SNM06MFUB /end AXIS_DESCR
/end CHARACTERISTIC
/begin CHARACTERISTIC ZFLLRPL "" VALUE 0x800478DE KwWU16 1310.6999997 zk20msxs_uw_b1310p72 0.020000305180 1310.7200000 FORMAT "%12.7" /end CHARACTERISTIC
/begin CHARACTERISTIC ZFMDVERL "" VALUE 0x800495C0 KwWU8 2.53000 zk20msxs_ub_b5p1 0.0200000 2.55000 FORMAT "%7.5" /end CHARACTERISTIC
/begin CHARACTERISTIC ZKDDMM "" VALUE 0x800490BA KwWU16 1310.6999997 zk20msxs_uw_b1310 0.020000305180 1310.7200000 FORMAT "%12.7" /end CHARACTERISTIC
/begin CHARACTERISTIC ZKDMADFK "" VALUE 0x80048EB0 KwWU16 870.61333333 zk200msxs_uw_b13107 3.2000000000 873.81333333 FORMAT "%12.8" /end CHARACTERISTIC
/begin CHARACTERISTIC ZKDMADFS "" VALUE 0x80048EB2 KwWU16 870.61333333 zk200msxs_uw_b13107 3.2000000000 873.81333333 FORMAT "%12.8" /end CHARACTERISTIC
/begin CHARACTERISTIC ZKDMADKO "" VALUE 0x80048EB4 KwWU16 870.61333333 zk200msxs_uw_b13107 3.2000000000 873.81333333 FORMAT "%12.8" /end CHARACTERISTIC
/begin CHARACTERISTIC ZKDMADLL "" VALUE 0x80048EB6 KwWU16 870.61333333 zk200msxs_uw_b13107 3.2000000000 873.81333333 FORMAT "%12.8" /end CHARACTERISTIC
/begin CHARACTERISTIC ZKDUBFILM "" VALUE 0x800490BC KwWU16 1310.6999997 zk20msxs_uw_b1310 0.020000305180 1310.7200000 FORMAT "%12.7" /end CHARACTERISTIC
/begin CHARACTERISTIC ZKDUBMD "" VALUE 0x800490BE KwWU8 5.08000 zk20msxs_ub_b5p1 0.0200000 5.10000 FORMAT "%7.5" /end CHARACTERISTIC
/begin CHARACTERISTIC ZKLLRD "" VALUE 0x800478E0 KwWU16 1310.6999997 zk20msxs_uw_b1310p72 0.020000305180 1310.7200000 FORMAT "%12.7" /end CHARACTERISTIC
/begin CHARACTERISTIC ZKLMDSTN "" CURVE 0x80048E60 GklWU16 655.34999985 zk10msxs_uw_b655p36 0.010000152590 655.36000000 FORMAT "%12.8"
 /begin AXIS_DESCR COM_AXIS tmst temp_ub_q0p75_o48 6 -48.00 143.3 FORMAT "%5.1" AXIS_PTS_REF STMS06LLUB /end AXIS_DESCR
/end CHARACTERISTIC
/begin CHARACTERISTIC ZKMDKO "" VALUE 0x800490C0 KwWU16 1310.6999997 zk20msxs_uw_b1310 0.020000305180 1310.7200000 FORMAT "%12.7" /end CHARACTERISTIC
/begin CHARACTERISTIC ZKMDLF "" VALUE 0x800490C2 KwWU16 1310.6999997 zk20msxs_uw_b1310 0.020000305180 1310.7200000 FORMAT "%12.7" /end CHARACTERISTIC
/begin CHARACTERISTIC ZKMDLFPW "" VALUE 0x800490C4 KwWU16 1310.6999997 zk20msxs_uw_b1310 0.020000305180 1310.7200000 FORMAT "%12.7" /end CHARACTERISTIC
/begin CHARACTERISTIC ZKMDLOAD1 "" VALUE 0x800490C6 KwWU16 1310.6999997 zk20msxs_uw_b1310 0.020000305180 1310.7200000 FORMAT "%12.7" /end CHARACTERISTIC
/begin CHARACTERISTIC ZKMDLOAD2 "" VALUE 0x800490C8 KwWU16 1310.6999997 zk20msxs_uw_b1310 0.020000305180 1310.7200000 FORMAT "%12.7" /end CHARACTERISTIC
/begin CHARACTERISTIC ZKMDLOAD3 "" VALUE 0x800490CA KwWU16 1310.6999997 zk20msxs_uw_b1310 0.020000305180 1310.7200000 FORMAT "%12.7" /end CHARACTERISTIC
/begin CHARACTERISTIC ZLIBG "" VALUE 0x800478E2 KwWU16 1310.6999997 zk20msxs_uw_b1310p72 0.020000305180 1310.7200000 FORMAT "%12.7" /end CHARACTERISTIC
/begin CHARACTERISTIC ZLRFRI "" VALUE 0x80047B06 KwWU16 6553.4999985 zk100msxs_uw_b6553p6 0.10000152590 6553.6000000 FORMAT "%12.7" /end CHARACTERISTIC
/begin CHARACTERISTIC ZMDFAO "" VALUE 0x80048D62 KwWU8 2.54000 zk10msxs_ub_b2p55 0.0100000 2.55000 FORMAT "%7.5" /end CHARACTERISTIC
/begin CHARACTERISTIC ZMDFAWE "" VALUE 0x80048D63 KwWU8 2.54000 zk10msxs_ub_b2p55 0.0100000 2.55000 FORMAT "%7.5" /end CHARACTERISTIC
/begin CHARACTERISTIC ZMDRKO "" VALUE 0x800490CC KwWU16 1310.6999997 zk20msxs_uw_b1310 0.020000305180 1310.7200000 FORMAT "%12.7" /end CHARACTERISTIC
/begin CHARACTERISTIC ZNFNGLL "" VALUE 0x800478E4 KwWU16 1310.6999997 zk20msxs_uw_b1310p72 0.020000305180 1310.7200000 FORMAT "%12.7" /end CHARACTERISTIC
/begin CHARACTERISTIC ZNSM "" CURVE 0x80048DF6 GklWU8 5.08000 zk20msxs_ub_b5p1 0.0200000 5.10000 FORMAT "%7.5"
 /begin AXIS_DESCR COM_AXIS tmot temp_ub_q0p75_o48 6 -48.00 143.3 FORMAT "%5.1" AXIS_PTS_REF STM06LLUB /end AXIS_DESCR
/end CHARACTERISTIC
/begin CHARACTERISTIC ZNSMTCU "" CURVE 0x80048DFC GklWU8 5.08000 zk20msxs_ub_b5p1 0.0200000 5.10000 FORMAT "%7.5"
 /begin AXIS_DESCR COM_AXIS tmot temp_ub_q0p75_o48 6 -48.00 143.3 FORMAT "%5.1" AXIS_PTS_REF STM06LLUB /end AXIS_DESCR
/end CHARACTERISTIC
/begin MEASUREMENT AirSys_rChCyl "" SWORD rel_q0p02344 1 100 0.00 767.9766 FORMAT "%8.4" ECU_ADDRESS 0xD0003456 /end MEASUREMENT
/begin MEASUREMENT AirSys_rChCylLRes "" UBYTE rel_q0p75 1 100 0.00 191.3 FORMAT "%5.1" ECU_ADDRESS 0xD0003C03 /end MEASUREMENT
/begin MEASUREMENT AirSys_rChrgCyl "" SWORD rel_q0p02344 1 100 0.00 767.9766 FORMAT "%8.4" ECU_ADDRESS 0xD0003458 /end MEASUREMENT
/begin MEASUREMENT AirSys_rMsCyl "" UBYTE rel_ub_b99p6 1 100 0.00 99.61 FORMAT "%5.2" ECU_ADDRESS 0xD0003C04 /end MEASUREMENT
/begin MEASUREMENT BasSvr_bActrTstReq "" UBYTE B_TRUE 1 100 0.00 1.00000000000 BIT_MASK 0x2 FORMAT "%13.11" ECU_ADDRESS 0xD0000061 /end MEASUREMENT
/begin MEASUREMENT BasSvr_bFuncTstReq "" UBYTE B_TRUE 1 100 0.00 1.00000000000 BIT_MASK 0x2 FORMAT "%13.11" ECU_ADDRESS 0xD0000059 /end MEASUREMENT
/begin MEASUREMENT BattU_facCor "" SWORD Fact 1 100 -4.000000 3.999878 FORMAT "%8.6" ECU_ADDRESS 0xD000346E /end MEASUREMENT
/begin MEASUREMENT BattU_u "" SWORD Volt_Batt 1 100 0.00 30000.00 FORMAT "%8.2" ECU_ADDRESS 0xD0003470 /end MEASUREMENT
/begin MEASUREMENT BattU_uRaw "" SWORD Volt 1 100 0.00 3300.000 FORMAT "%8.3" ECU_ADDRESS 0xD0003472 /end MEASUREMENT
/begin MEASUREMENT BattU_uSens "" SWORD Volt_Batt 1 100 0.00 30000.00 FORMAT "%8.2" ECU_ADDRESS 0xD0003474 /end MEASUREMENT
/begin MEASUREMENT B_acfston "" UBYTE B_TRUE 1 100 0.00 1.00000000000 BIT_MASK 0x8 FORMAT "%13.11" ECU_ADDRESS 0xD0000064 /end MEASUREMENT
/begin MEASUREMENT B_adwfk "" UBYTE B_TRUE 1 100 0.00 1.00000000000 BIT_MASK 0x40 FORMAT "%13.11" ECU_ADDRESS 0xD0000046 /end MEASUREMENT
/begin MEASUREMENT B_adwfs "" UBYTE B_TRUE 1 100 0.00 1.00000000000 BIT_MASK 0x20 FORMAT "%13.11" ECU_ADDRESS 0xD0000046 /end MEASUREMENT
/begin MEASUREMENT B_adwko "" UBYTE B_TRUE 1 100 0.00 1.00000000000 BIT_MASK 0x10 FORMAT "%13.11" ECU_ADDRESS 0xD0000046 /end MEASUREMENT
/begin MEASUREMENT B_ar "" UBYTE B_TRUE 1 100 0.00 1.00000000000 BIT_MASK 0x20 FORMAT "%13.11" ECU_ADDRESS 0xD000007B /end MEASUREMENT
/begin MEASUREMENT B_arfgsa "" UBYTE B_TRUE 1 100 0.00 1.00000000000 BIT_MASK 0x1 FORMAT "%13.11" ECU_ADDRESS 0xD0000DD3 /end MEASUREMENT
/begin MEASUREMENT B_avfra "" UBYTE B_TRUE 1 100 0.00 1.00000000000 BIT_MASK 0x1 FORMAT "%13.11" ECU_ADDRESS 0xD000008E /end MEASUREMENT
/begin MEASUREMENT B_avora "" UBYTE B_TRUE 1 100 0.00 1.00000000000 BIT_MASK 0x10 FORMAT "%13.11" ECU_ADDRESS 0xD0000057 /end MEASUREMENT
/begin MEASUREMENT B_bag_TOFV.outbit "" UBYTE B_TRUE 1 100 0.00 1.00000000000 BIT_MASK 0x1 FORMAT "%13.11" ECU_ADDRESS 0xD00015B0 /end MEASUREMENT
/begin MEASUREMENT B_bag_TOFV.time "" UWORD t_q0p02 1 100 0.00 1310.700 FORMAT "%8.3" ECU_ADDRESS 0xD00015B2 /end MEASUREMENT
/begin MEASUREMENT B_balra "" UBYTE B_TRUE 1 100 0.00 1.00000000000 BIT_MASK 0x4 FORMAT "%13.11" ECU_ADDRESS 0xD000008C /end MEASUREMENT
/begin MEASUREMENT B_calcmn "" UBYTE B_TRUE 1 100 0.00 1.00000000000 BIT_MASK 0x4 FORMAT "%13.11" ECU_ADDRESS 0xD0000DD3 /end MEASUREMENT
/begin MEASUREMENT B_dmverlin "" UBYTE B_TRUE 1 100 0.00 1.00000000000 BIT_MASK 0x4 FORMAT "%13.11" ECU_ADDRESS 0xD0000046 /end MEASUREMENT
/begin MEASUREMENT B_dowhill "" UBYTE B_TRUE 1 100 0.00 1.00000000000 BIT_MASK 0x1 FORMAT "%13.11" ECU_ADDRESS 0xD000007A /end MEASUREMENT
/begin MEASUREMENT B_ellstmp "" UBYTE B_TRUE 1 100 0.00 1.00000000000 BIT_MASK 0x4 FORMAT "%13.11" ECU_ADDRESS 0xD0000042 /end MEASUREMENT
/begin MEASUREMENT B_enmdsawe "" UBYTE B_TRUE 1 100 0.00 1.00000000000 BIT_MASK 0x10 FORMAT "%13.11" ECU_ADDRESS 0xD0000093 /end MEASUREMENT
/begin MEASUREMENT B_eobdlr "" UBYTE B_TRUE 1 100 0.00 1.00000000000 BIT_MASK 0x20 FORMAT "%13.11" ECU_ADDRESS 0xD000005F /end MEASUREMENT
/begin MEASUREMENT B_etagst "" UBYTE B_TRUE 1 100 0.00 1.00000000000 BIT_MASK 0x40 FORMAT "%13.11" ECU_ADDRESS 0xD0000082 /end MEASUREMENT
/begin MEASUREMENT B_fil "" UBYTE B_TRUE 1 100 0.00 1.00000000000 BIT_MASK 0x10 FORMAT "%13.11" ECU_ADDRESS 0xD0000090 /end MEASUREMENT
/begin MEASUREMENT B_frab "" UBYTE B_TRUE 1 100 0.00 1.00000000000 BIT_MASK 0x2 FORMAT "%13.11" ECU_ADDRESS 0xD0000043 /end MEASUREMENT
/begin MEASUREMENT B_frfvlra_FF.status "" UBYTE B_TRUE 1 100 0.00 1.00000000000 BIT_MASK 0x1 FORMAT "%13.11" ECU_ADDRESS 0xD0001560 /end MEASUREMENT
/begin MEASUREMENT B_frini "" UBYTE B_TRUE 1 100 0.00 1.00000000000 BIT_MASK 0x8 FORMAT "%13.11" ECU_ADDRESS 0xD000009E /end MEASUREMENT
/begin MEASUREMENT B_frmax "" UBYTE B_TRUE 1 100 0.00 1.00000000000 BIT_MASK 0x20 FORMAT "%13.11" ECU_ADDRESS 0xD0000097 /end MEASUREMENT
/begin MEASUREMENT B_frmin "" UBYTE B_TRUE 1 100 0.00 1.00000000000 BIT_MASK 0x1 FORMAT "%13.11" ECU_ADDRESS 0xD0000077 /end MEASUREMENT
/begin MEASUREMENT B_frsp "" UBYTE B_TRUE 1 100 0.00 1.00000000000 BIT_MASK 0x80 FORMAT "%13.11" ECU_ADDRESS 0xD000006F /end MEASUREMENT
/begin MEASUREMENT B_frspini "" UBYTE B_TRUE 1 100 0.00 1.00000000000 BIT_MASK 0x10 FORMAT "%13.11" ECU_ADDRESS 0xD0000042 /end MEASUREMENT
/begin MEASUREMENT B_fvlra "" UBYTE B_TRUE 1 100 0.00 1.00000000000 BIT_MASK 0x8 FORMAT "%13.11" ECU_ADDRESS 0xD000006C /end MEASUREMENT
/begin MEASUREMENT B_iflsd "" UBYTE B_TRUE 1 100 0.00 1.00000000000 BIT_MASK 0x20 FORMAT "%13.11" ECU_ADDRESS 0xD0000044 /end MEASUREMENT
/begin MEASUREMENT B_int "" UBYTE B_TRUE 1 100 0.00 1.00000000000 BIT_MASK 0x20 FORMAT "%13.11" ECU_ADDRESS 0xD0000042 /end MEASUREMENT
/begin MEASUREMENT B_iredk "" UBYTE B_TRUE 1 100 0.00 1.00000000000 BIT_MASK 0x40 FORMAT "%13.11" ECU_ADDRESS 0xD0000099 /end MEASUREMENT
/begin MEASUREMENT B_kofflong "" UBYTE B_TRUE 1 100 0.00 1.00000000000 BIT_MASK 0x2 FORMAT "%13.11" ECU_ADDRESS 0xD0000047 /end MEASUREMENT
/begin MEASUREMENT B_lldeus "" UBYTE B_TRUE 1 100 0.00 1.00000000000 BIT_MASK 0x20 FORMAT "%13.11" ECU_ADDRESS 0xD0000083 /end MEASUREMENT
/begin MEASUREMENT B_lldub "" UBYTE B_TRUE 1 100 0.00 1.00000000000 BIT_MASK 0x1 FORMAT "%13.11" ECU_ADDRESS 0xD0000E52 /end MEASUREMENT
/begin MEASUREMENT B_llrilimn "" UBYTE B_TRUE 1 100 0.00 1.00000000000 BIT_MASK 0x1 FORMAT "%13.11" ECU_ADDRESS 0xD0000DC2 /end MEASUREMENT
/begin MEASUREMENT B_llrpkh "" UBYTE B_TRUE 1 100 0.00 1.00000000000 BIT_MASK 0x2 FORMAT "%13.11" ECU_ADDRESS 0xD0000DBF /end MEASUREMENT
/begin MEASUREMENT B_llrpst "" UBYTE B_TRUE 1 100 0.00 1.00000000000 BIT_MASK 0x2 FORMAT "%13.11" ECU_ADDRESS 0xD0000DC2 /end MEASUREMENT
/begin MEASUREMENT B_llrst "" UBYTE B_TRUE 1 100 0.00 1.00000000000 BIT_MASK 0x4 FORMAT "%13.11" ECU_ADDRESS 0xD0000DC2 /end MEASUREMENT
/begin MEASUREMENT B_lr "" UBYTE B_TRUE 1 100 0.00 1.00000000000 BIT_MASK 0x4 FORMAT "%13.11" ECU_ADDRESS 0xD0000063 /end MEASUREMENT
/begin MEASUREMENT B_lrab "" UBYTE B_TRUE 1 100 0.00 1.00000000000 BIT_MASK 0x2 FORMAT "%13.11" ECU_ADDRESS 0xD0000075 /end MEASUREMENT
/begin MEASUREMENT B_lrafra "" UBYTE B_TRUE 1 100 0.00 1.00000000000 BIT_MASK 0x20 FORMAT "%13.11" ECU_ADDRESS 0xD000009B /end MEASUREMENT
/begin MEASUREMENT B_lraora "" UBYTE B_TRUE 1 100 0.00 1.00000000000 BIT_MASK 0x40 FORMAT "%13.11" ECU_ADDRESS 0xD000008D /end MEASUREMENT
/begin MEASUREMENT B_lrare "" UBYTE B_TRUE 1 100 0.00 1.00000000000 BIT_MASK 0x40 FORMAT "%13.11" ECU_ADDRESS 0xD0000098 /end MEASUREMENT
/begin MEASUREMENT B_lrareb "" UBYTE B_TRUE 1 100 0.00 1.00000000000 BIT_MASK 0x40 FORMAT "%13.11" ECU_ADDRESS 0xD0000075 /end MEASUREMENT
/begin MEASUREMENT B_lrdyntv "" UBYTE B_TRUE 1 100 0.00 1.00000000000 BIT_MASK 0x1 FORMAT "%13.11" ECU_ADDRESS 0xD0000043 /end MEASUREMENT
/begin MEASUREMENT B_lrfsbs "" UBYTE B_TRUE 1 100 0.00 1.00000000000 BIT_MASK 0x20 FORMAT "%13.11" ECU_ADDRESS 0xD0000067 /end MEASUREMENT
/begin MEASUREMENT B_lrhmb "" UBYTE B_TRUE 1 100 0.00 1.00000000000 BIT_MASK 0x40 FORMAT "%13.11" ECU_ADDRESS 0xD0000043 /end MEASUREMENT
/begin MEASUREMENT B_lrmsbs "" UBYTE B_TRUE 1 100 0.00 1.00000000000 BIT_MASK 0x4 FORMAT "%13.11" ECU_ADDRESS 0xD000009E /end MEASUREMENT
/begin MEASUREMENT B_lrmstr "" UBYTE B_TRUE 1 100 0.00 1.00000000000 BIT_MASK 0x80 FORMAT "%13.11" ECU_ADDRESS 0xD0000043 /end MEASUREMENT
/begin MEASUREMENT B_lrnbsnc "" UBYTE B_TRUE 1 100 0.00 1.00000000000 BIT_MASK 0x20 FORMAT "%13.11" ECU_ADDRESS 0xD0000043 /end MEASUREMENT
/begin MEASUREMENT B_lrnd "" UBYTE B_TRUE 1 100 0.00 1.00000000000 BIT_MASK 0x4 FORMAT "%13.11" ECU_ADDRESS 0xD0000087 /end MEASUREMENT
/begin MEASUREMENT B_lrnda "" UBYTE B_TRUE 1 100 0.00 1.00000000000 BIT_MASK 0x2 FORMAT "%13.11" ECU_ADDRESS 0xD000007C /end MEASUREMENT
/begin MEASUREMENT B_lrrl "" UBYTE B_TRUE 1 100 0.00 1.00000000000 BIT_MASK 0x8 FORMAT "%13.11" ECU_ADDRESS 0xD0000043 /end MEASUREMENT
/begin MEASUREMENT B_lrseta "" UBYTE B_TRUE 1 100 0.00 1.00000000000 BIT_MASK 0x2 FORMAT "%13.11" ECU_ADDRESS 0xD0000091 /end MEASUREMENT
/begin MEASUREMENT B_lrsetp "" UBYTE B_TRUE 1 100 0.00 1.00000000000 BIT_MASK 0x40 FORMAT "%13.11" ECU_ADDRESS 0xD000005F /end MEASUREMENT
/begin MEASUREMENT B_lrsp "" UBYTE B_TRUE 1 100 0.00 1.00000000000 BIT_MASK 0x4 FORMAT "%13.11" ECU_ADDRESS 0xD000008A /end MEASUREMENT
/begin MEASUREMENT B_lrssp "" UBYTE B_TRUE 1 100 0.00 1.00000000000 BIT_MASK 0x4 FORMAT "%13.11" ECU_ADDRESS 0xD0000075 /end MEASUREMENT
/begin MEASUREMENT B_lrstat "" UBYTE B_TRUE 1 100 0.00 1.00000000000 BIT_MASK 0x10 FORMAT "%13.11" ECU_ADDRESS 0xD000006B /end MEASUREMENT
/begin MEASUREMENT B_lrstatn "" UBYTE B_TRUE 1 100 0.00 1.00000000000 BIT_MASK 0x80 FORMAT "%13.11" ECU_ADDRESS 0xD0000042 /end MEASUREMENT
/begin MEASUREMENT B_lrtpp "" UBYTE B_TRUE 1 100 0.00 1.00000000000 BIT_MASK 0x40 FORMAT "%13.11" ECU_ADDRESS 0xD000008C /end MEASUREMENT
/begin MEASUREMENT B_lwsd "" UBYTE B_TRUE 1 100 0.00 1.00000000000 BIT_MASK 0x1 FORMAT "%13.11" ECU_ADDRESS 0xD000008F /end MEASUREMENT
/begin MEASUREMENT B_lwsdsa "" UBYTE B_TRUE 1 100 0.00 1.00000000000 BIT_MASK 0x1 FORMAT "%13.11" ECU_ADDRESS 0xD0000E47 /end MEASUREMENT
/begin MEASUREMENT B_lwsfao "" UBYTE B_TRUE 1 100 0.00 1.00000000000 BIT_MASK 0x2 FORMAT "%13.11" ECU_ADDRESS 0xD0000E47 /end MEASUREMENT
/begin MEASUREMENT B_lwsuk "" UBYTE B_TRUE 1 100 0.00 1.00000000000 BIT_MASK 0x4 FORMAT "%13.11" ECU_ADDRESS 0xD0000E47 /end MEASUREMENT
/begin MEASUREMENT B_madfk "" UBYTE B_TRUE 1 100 0.00 1.00000000000 BIT_MASK 0x1 FORMAT "%13.11" ECU_ADDRESS 0xD0000047 /end MEASUREMENT
/begin MEASUREMENT B_madfs "" UBYTE B_TRUE 1 100 0.00 1.00000000000 BIT_MASK 0x80 FORMAT "%13.11" ECU_ADDRESS 0xD0000046 /end MEASUREMENT
/begin MEASUREMENT B_madko "" UBYTE B_TRUE 1 100 0.00 1.00000000000 BIT_MASK 0x2 FORMAT "%13.11" ECU_ADDRESS 0xD0000071 /end MEASUREMENT
/begin MEASUREMENT B_madll "" UBYTE B_TRUE 1 100 0.00 1.00000000000 BIT_MASK 0x1 FORMAT "%13.11" ECU_ADDRESS 0xD000007B /end MEASUREMENT
/begin MEASUREMENT B_mdcvtk "" UBYTE B_TRUE 1 100 0.00 1.00000000000 BIT_MASK 0x2 FORMAT "%13.11" ECU_ADDRESS 0xD0000046 /end MEASUREMENT
/begin MEASUREMENT B_mdee "" UBYTE B_TRUE 1 100 0.00 1.00000000000 BIT_MASK 0x2 FORMAT "%13.11" ECU_ADDRESS 0xD000007B /end MEASUREMENT
/begin MEASUREMENT B_mdeemx "" UBYTE B_TRUE 1 100 0.00 1.00000000000 BIT_MASK 0x40 FORMAT "%13.11" ECU_ADDRESS 0xD0000045 /end MEASUREMENT
/begin MEASUREMENT B_mdeenf "" UBYTE B_TRUE 1 100 0.00 1.00000000000 BIT_MASK 0x80 FORMAT "%13.11" ECU_ADDRESS 0xD0000045 /end MEASUREMENT
/begin MEASUREMENT B_mdeenl "" UBYTE B_TRUE 1 100 0.00 1.00000000000 BIT_MASK 0x1 FORMAT "%13.11" ECU_ADDRESS 0xD0000046 /end MEASUREMENT
/begin MEASUREMENT B_mdeetk "" UBYTE B_TRUE 1 100 0.00 1.00000000000 BIT_MASK 0x40 FORMAT "%13.11" ECU_ADDRESS 0xD0000044 /end MEASUREMENT
/begin MEASUREMENT B_mdeevb "" UBYTE B_TRUE 1 100 0.00 1.00000000000 BIT_MASK 0x40 FORMAT "%13.11" ECU_ADDRESS 0xD0000067 /end MEASUREMENT
/begin MEASUREMENT B_mdein "" UBYTE B_TRUE 1 100 0.00 1.00000000000 BIT_MASK 0x4 FORMAT "%13.11" ECU_ADDRESS 0xD000006E /end MEASUREMENT
/begin MEASUREMENT B_mdsawe "" UBYTE B_TRUE 1 100 0.00 1.00000000000 BIT_MASK 0x4 FORMAT "%13.11" ECU_ADDRESS 0xD0000045 /end MEASUREMENT
/begin MEASUREMENT B_mlevab "" UBYTE B_TRUE 1 100 0.00 1.00000000000 BIT_MASK 0x2 FORMAT "%13.11" ECU_ADDRESS 0xD0000090 /end MEASUREMENT
/begin MEASUREMENT B_mlrsa "" UBYTE B_TRUE 1 100 0.00 1.00000000000 BIT_MASK 0x80 FORMAT "%13.11" ECU_ADDRESS 0xD0000060 /end MEASUREMENT
/begin MEASUREMENT B_nofra "" UBYTE B_TRUE 1 100 0.00 1.00000000000 BIT_MASK 0x80 FORMAT "%13.11" ECU_ADDRESS 0xD000008D /end MEASUREMENT
/begin MEASUREMENT B_noora "" UBYTE B_TRUE 1 100 0.00 1.00000000000 BIT_MASK 0x20 FORMAT "%13.11" ECU_ADDRESS 0xD0000093 /end MEASUREMENT
/begin MEASUREMENT B_nozwe "" UBYTE B_TRUE 1 100 0.00 1.00000000000 BIT_MASK 0x40 FORMAT "%13.11" ECU_ADDRESS 0xD0000056 /end MEASUREMENT
/begin MEASUREMENT B_nozwvs "" UBYTE B_TRUE 1 100 0.00 1.00000000000 BIT_MASK 0x10 FORMAT "%13.11" ECU_ADDRESS 0xD0000044 /end MEASUREMENT
/begin MEASUREMENT B_nphyora "" UBYTE B_TRUE 1 100 0.00 1.00000000000 BIT_MASK 0x1 FORMAT "%13.11" ECU_ADDRESS 0xAFE801A6 /end MEASUREMENT
/begin MEASUREMENT B_ot "" UBYTE B_TRUE 1 100 0.00 1.00000000000 BIT_MASK 0x10 FORMAT "%13.11" ECU_ADDRESS 0xD0000DD3 /end MEASUREMENT
/begin MEASUREMENT B_petafil "" UBYTE B_TRUE 1 100 0.00 1.00000000000 BIT_MASK 0x4 FORMAT "%13.11" ECU_ADDRESS 0xD000008E /end MEASUREMENT
/begin MEASUREMENT B_pspaus "" UBYTE B_TRUE 1 100 0.00 1.00000000000 BIT_MASK 0x10 FORMAT "%13.11" ECU_ADDRESS 0xD0000043 /end MEASUREMENT
/begin MEASUREMENT B_pspwl "" UBYTE B_TRUE 1 100 0.00 1.00000000000 BIT_MASK 0x20 FORMAT "%13.11" ECU_ADDRESS 0xD000009A /end MEASUREMENT
/begin MEASUREMENT B_redsch "" UBYTE B_TRUE 1 100 0.00 1.00000000000 BIT_MASK 0x20 FORMAT "%13.11" ECU_ADDRESS 0xD0000045 /end MEASUREMENT
/begin MEASUREMENT B_refrast "" UBYTE B_TRUE 1 100 0.00 1.00000000000 BIT_MASK 0x20 FORMAT "%13.11" ECU_ADDRESS 0xD0000058 /end MEASUREMENT
/begin MEASUREMENT B_reorast "" UBYTE B_TRUE 1 100 0.00 1.00000000000 BIT_MASK 0x20 FORMAT "%13.11" ECU_ADDRESS 0xD0000087 /end MEASUREMENT
/begin MEASUREMENT B_reqlra "" UBYTE B_TRUE 1 100 0.00 1.00000000000 BIT_MASK 0x2 FORMAT "%13.11" ECU_ADDRESS 0xAFE801A5 /end MEASUREMENT
/begin MEASUREMENT B_sa "" UBYTE B_TRUE 1 100 0.00 1.00000000000 BIT_MASK 0x4 FORMAT "%13.11" ECU_ADDRESS 0xD0000086 /end MEASUREMENT
/begin MEASUREMENT B_sabmee "" UBYTE B_TRUE 1 100 0.00 1.00000000000 BIT_MASK 0x1 FORMAT "%13.11" ECU_ADDRESS 0xD0000045 /end MEASUREMENT
/begin MEASUREMENT B_sgnlr "" UBYTE B_TRUE 1 100 0.00 1.00000000000 BIT_MASK 0x10 FORMAT "%13.11" ECU_ADDRESS 0xD000009E /end MEASUREMENT
/begin MEASUREMENT B_sgnlrd "" UBYTE B_TRUE 1 100 0.00 1.00000000000 BIT_MASK 0x8 FORMAT "%13.11" ECU_ADDRESS 0xD0000042 /end MEASUREMENT
/begin MEASUREMENT B_spvkea "" UBYTE B_TRUE 1 100 0.00 1.00000000000 BIT_MASK 0x40 FORMAT "%13.11" ECU_ADDRESS 0xD000007A /end MEASUREMENT
/begin MEASUREMENT B_tdmkow "" UBYTE B_TRUE 1 100 0.00 1.00000000000 BIT_MASK 0x8 FORMAT "%13.11" ECU_ADDRESS 0xD0000074 /end MEASUREMENT
/begin MEASUREMENT B_tspon "" UBYTE B_TRUE 1 100 0.00 1.00000000000 BIT_MASK 0x40 FORMAT "%13.11" ECU_ADDRESS 0xD0000042 /end MEASUREMENT
/begin MEASUREMENT B_tvarsa "" UBYTE B_TRUE 1 100 0.00 1.00000000000 BIT_MASK 0x40 FORMAT "%13.11" ECU_ADDRESS 0xD0000DD3 /end MEASUREMENT
/begin MEASUREMENT B_ubfra "" UBYTE B_TRUE 1 100 0.00 1.00000000000 BIT_MASK 0x80 FORMAT "%13.11" ECU_ADDRESS 0xD0000084 /end MEASUREMENT
/begin MEASUREMENT B_ubora "" UBYTE B_TRUE 1 100 0.00 1.00000000000 BIT_MASK 0x20 FORMAT "%13.11" ECU_ADDRESS 0xD0000099 /end MEASUREMENT
/begin MEASUREMENT B_ubphyfra "" UBYTE B_TRUE 1 100 0.00 1.00000000000 BIT_MASK 0x1 FORMAT "%13.11" ECU_ADDRESS 0xD000007C /end MEASUREMENT
/begin MEASUREMENT B_ubphyora "" UBYTE B_TRUE 1 100 0.00 1.00000000000 BIT_MASK 0x1 FORMAT "%13.11" ECU_ADDRESS 0xD0000057 /end MEASUREMENT
/begin MEASUREMENT B_umetazw "" UBYTE B_TRUE 1 100 0.00 1.00000000000 BIT_MASK 0x8 FORMAT "%13.11" ECU_ADDRESS 0xD0000044 /end MEASUREMENT
/begin MEASUREMENT B_vag_TOFV.outbit "" UBYTE B_TRUE 1 100 0.00 1.00000000000 BIT_MASK 0x1 FORMAT "%13.11" ECU_ADDRESS 0xD00015B4 /end MEASUREMENT
/begin MEASUREMENT B_vag_TOFV.time "" UWORD t_q0p02 1 100 0.00 1310.700 FORMAT "%8.3" ECU_ADDRESS 0xD00015B6 /end MEASUREMENT
/begin MEASUREMENT B_vormdred "" UBYTE B_TRUE 1 100 0.00 1.00000000000 BIT_MASK 0x2 FORMAT "%13.11" ECU_ADDRESS 0xD0000045 /end MEASUREMENT
/begin MEASUREMENT B_vzw "" UBYTE B_TRUE 1 100 0.00 1.00000000000 BIT_MASK 0x8 FORMAT "%13.11" ECU_ADDRESS 0xD000006D /end MEASUREMENT
/begin MEASUREMENT B_wkaufa "" UBYTE B_TRUE 1 100 0.00 1.00000000000 BIT_MASK 0x8 FORMAT "%13.11" ECU_ADDRESS 0xD0000E47 /end MEASUREMENT
/begin MEASUREMENT B_wrendad "" UBYTE B_TRUE 1 100 0.00 1.00000000000 BIT_MASK 0x8 FORMAT "%13.11" ECU_ADDRESS 0xD0000046 /end MEASUREMENT
/begin MEASUREMENT B_za "" UBYTE B_TRUE 1 100 0.00 1.00000000000 BIT_MASK 0x4 FORMAT "%13.11" ECU_ADDRESS 0xD000006C /end MEASUREMENT
/begin MEASUREMENT CoEng_bEngReStrt "" UBYTE B_TRUE 1 100 0.00 1.00000000000 BIT_MASK 0x1 FORMAT "%13.11" ECU_ADDRESS 0xD0000074 /end MEASUREMENT
/begin MEASUREMENT CoEng_bFrstStrtEnd "" UBYTE B_TRUE 1 100 0.00 1.00000000000 BIT_MASK 0x20 FORMAT "%13.11" ECU_ADDRESS 0xD000005B /end MEASUREMENT
/begin MEASUREMENT CoEng_bStrtEndIA "" UBYTE B_TRUE 1 100 0.00 1.00000000000 BIT_MASK 0x10 FORMAT "%13.11" ECU_ADDRESS 0xD0000085 /end MEASUREMENT
/begin MEASUREMENT CoEng_bStrtEndSpdGov "" UBYTE B_TRUE 1 100 0.00 1.00000000000 BIT_MASK 0x10 FORMAT "%13.11" ECU_ADDRESS 0xD0000095 /end MEASUREMENT
/begin MEASUREMENT CoEng_bStrtEndTrqStruct "" UBYTE B_TRUE 1 100 0.00 1.00000000000 BIT_MASK 0x2 FORMAT "%13.11" ECU_ADDRESS 0xD0000095 /end MEASUREMENT
/begin MEASUREMENT CoEng_tiStrtDly "" SWORD Time_ms 1 100 -327680.0 327670.0 FORMAT "%8.1" ECU_ADDRESS 0xD000349C /end MEASUREMENT
/begin MEASUREMENT CoPOM_mAirMassIntegFrstStrt "" UWORD m_uw_b23p3 1 100 0.00 23.30133 FORMAT "%8.5" ECU_ADDRESS 0xD00035D2 /end MEASUREMENT
/begin MEASUREMENT ctr_ac_on "" UBYTE dez 1 100 0.00 255.0 FORMAT "%5.1" ECU_ADDRESS 0xAFE801A7 /end MEASUREMENT
/begin MEASUREMENT dfrmk_w "" SWORD fak_sw_b1 1 100 -1.000000 0.9999695 FORMAT "%8.6" ECU_ADDRESS 0xD00008EA /end MEASUREMENT
/begin MEASUREMENT dfrmtp_w "" UWORD fak_uw_b2 1 100 0.00 1.999969 FORMAT "%8.6" ECU_ADDRESS 0xD00008EC /end MEASUREMENT
/begin MEASUREMENT dfrm_w "" SWORD fak_sw_b1 1 100 -1.000000 0.9999695 FORMAT "%8.6" ECU_ADDRESS 0xD00008EE /end MEASUREMENT
/begin MEASUREMENT dfrsp_w "" SWORD fak_sw_b1 1 100 -1.000000 0.9999695 FORMAT "%8.6" ECU_ADDRESS 0xD00008CE /end MEASUREMENT
/begin MEASUREMENT dfrstga_w "" SWORD fak_sw_b1 1 100 0.00 0.9999695 FORMAT "%9.7" ECU_ADDRESS 0xAFE8012A /end MEASUREMENT
/begin MEASUREMENT dfrstte_w "" SWORD fak_sw_b1 1 100 0.00 0.9999695 FORMAT "%9.7" ECU_ADDRESS 0xAFE8012C /end MEASUREMENT
/begin MEASUREMENT dfrst_w "" SWORD fak_sw_b1 1 100 0.00 0.9999695 FORMAT "%9.7" ECU_ADDRESS 0xD00008D0 /end MEASUREMENT
/begin MEASUREMENT dfrzaff_w "" SWORD fak_sw_b1 1 100 -1.000000 0.9999695 FORMAT "%8.6" ECU_ADDRESS 0xD00008B4 /end MEASUREMENT
/begin MEASUREMENT dfrzaf_w "" SWORD fak_sw_b1 1 100 -1.000000 0.9999695 FORMAT "%8.6" ECU_ADDRESS 0xD00008D2 /end MEASUREMENT
/begin MEASUREMENT dfrza_w "" SWORD fak_sw_b1 1 100 -1.000000 0.9999695 FORMAT "%8.6" ECU_ADDRESS 0xD00008B6 /end MEASUREMENT
/begin MEASUREMENT dlaqhom "" SBYTE fak_sb_b0p03125 1 100 -0.03125 0.03101 FORMAT "%7.5" ECU_ADDRESS 0xD0000DC3 /end MEASUREMENT
/begin MEASUREMENT dlatvlr_w "" SWORD fak_sw_b8 1 100 -8.000000 7.999756 FORMAT "%8.6" ECU_ADDRESS 0xD00008B8 /end MEASUREMENT
/begin MEASUREMENT dmarmx_w "" SWORD rel_sw_b100 1 100 0.00 99.99695 FORMAT "%8.5" ECU_ADDRESS 0xD0000910 /end MEASUREMENT
/begin MEASUREMENT dmar_w "" SWORD rel_sw_b100 1 100 -100.0000 99.99695 FORMAT "%8.4" ECU_ADDRESS 0xD000091C /end MEASUREMENT
/begin MEASUREMENT dmdfa "" UBYTE fak_ub_b1 1 100 0.00 0.9961 ECU_ADDRESS 0xD0000E46 /end MEASUREMENT
/begin MEASUREMENT dmdubm "" UBYTE rel_ub_b50 1 100 0.00 50.00 FORMAT "%5.2" ECU_ADDRESS 0xD0000E4F /end MEASUREMENT
/begin MEASUREMENT dmilora_w "" UWORD rel_uw_b100 1 100 0.00 99.99847 FORMAT "%8.5" ECU_ADDRESS 0xAFE80134 /end MEASUREMENT
/begin MEASUREMENT dmilsol_w "" UWORD rel_uw_b100 1 100 0.00 99.99847 FORMAT "%8.5" ECU_ADDRESS 0xD000095A /end MEASUREMENT
/begin MEASUREMENT dmisopl1_w "" UWORD rel_uw_b100 1 100 0.00 99.99847 FORMAT "%8.5" ECU_ADDRESS 0xD000093A /end MEASUREMENT
/begin MEASUREMENT dmllr1_w "" SWORD rel_sw_b100 1 100 -100.0000 99.99695 FORMAT "%8.4" ECU_ADDRESS 0xD000088A /end MEASUREMENT
/begin MEASUREMENT dmllrdl_w "" SWORD rel_sw_b100 1 100 -100.0000 99.99695 FORMAT "%8.4" ECU_ADDRESS 0xD00008A0 /end MEASUREMENT
/begin MEASUREMENT dmllrd_w "" SWORD rel_sw_b100 1 100 -100.0000 99.99695 FORMAT "%8.4" ECU_ADDRESS 0xD00008A2 /end MEASUREMENT
/begin MEASUREMENT dmllrib_w "" SWORD rel_sw_b100 1 100 -100.0000 99.99695 FORMAT "%8.4" ECU_ADDRESS 0xD000088C /end MEASUREMENT
/begin MEASUREMENT dmllriio_w "" SWORD rel_sw_b100 1 100 -100.0000 99.99695 FORMAT "%8.4" ECU_ADDRESS 0xD000088E /end MEASUREMENT
/begin MEASUREMENT dmllrii_w "" SWORD rel_sw_b100 1 100 -100.0000 99.99695 FORMAT "%8.4" ECU_ADDRESS 0xD0000890 /end MEASUREMENT
/begin MEASUREMENT dmllriz_w "" SWORD rel_sw_b100 1 100 -100.0000 99.99695 FORMAT "%8.4" ECU_ADDRESS 0xD0000892 /end MEASUREMENT
/begin MEASUREMENT dmllri_w "" SWORD rel_sw_b100 1 100 -100.0000 99.99695 FORMAT "%8.4" ECU_ADDRESS 0xD00008A4 /end MEASUREMENT
/begin MEASUREMENT dmllrl_w "" SWORD rel_sw_b100 1 100 -100.0000 99.99695 FORMAT "%8.4" ECU_ADDRESS 0xD00008A6 /end MEASUREMENT
/begin MEASUREMENT dmllrpl_w "" SWORD rel_sw_b100 1 100 -100.0000 99.99695 FORMAT "%8.4" ECU_ADDRESS 0xD00008A8 /end MEASUREMENT
/begin MEASUREMENT dmllrp_w "" SWORD rel_sw_b100 1 100 -100.0000 99.99695 FORMAT "%8.4" ECU_ADDRESS 0xD00008AA /end MEASUREMENT
/begin MEASUREMENT dmllr_w "" SWORD rel_sw_b100 1 100 -100.0000 99.99695 FORMAT "%8.4" ECU_ADDRESS 0xD00008AC /end MEASUREMENT
/begin MEASUREMENT dmload2 "" UBYTE rel_ub_b50 1 100 0.00 50.00 FORMAT "%5.2" ECU_ADDRESS 0xD0000E50 /end MEASUREMENT
/begin MEASUREMENT dmrac "" UBYTE rel_ub_b99p6 1 100 0.00 99.61 FORMAT "%5.2" ECU_ADDRESS 0xD0000E5D /end MEASUREMENT
/begin MEASUREMENT dmristtmp_w "" UWORD rel_uw_b100 1 100 0.00 99.99847 FORMAT "%8.5" ECU_ADDRESS 0xD0000946 /end MEASUREMENT
/begin MEASUREMENT dmvadfk_w "" SWORD rel_sw_b100 1 100 -100.0000 99.99695 FORMAT "%8.4" ECU_ADDRESS 0xAFE8013E /end MEASUREMENT
/begin MEASUREMENT dmvadfs_w "" SWORD rel_sw_b100 1 100 -100.0000 99.99695 FORMAT "%8.4" ECU_ADDRESS 0xAFE80140 /end MEASUREMENT
/begin MEASUREMENT dmvadko_w "" SWORD rel_sw_b100 1 100 -100.0000 99.99695 FORMAT "%8.4" ECU_ADDRESS 0xAFE80142 /end MEASUREMENT
/begin MEASUREMENT dmvadll_w "" SWORD rel_sw_b100 1 100 -100.0000 99.99695 FORMAT "%8.4" ECU_ADDRESS 0xAFE80144 /end MEASUREMENT
/begin MEASUREMENT dmvad_w "" SWORD rel_sw_b100 1 100 -100.0000 99.99695 FORMAT "%8.4" ECU_ADDRESS 0xD00009BC /end MEASUREMENT
/begin MEASUREMENT dmvamnfk_w "" SWORD rel_sw_b100 1 100 -100.0000 99.99695 FORMAT "%8.4" ECU_ADDRESS 0xD00009AA /end MEASUREMENT
/begin MEASUREMENT dmvamnfs_w "" SWORD rel_sw_b100 1 100 -100.0000 99.99695 FORMAT "%8.4" ECU_ADDRESS 0xD00009AC /end MEASUREMENT
/begin MEASUREMENT dmvamnko_w "" SWORD rel_sw_b100 1 100 -100.0000 99.99695 FORMAT "%8.4" ECU_ADDRESS 0xD00009AE /end MEASUREMENT
/begin MEASUREMENT dmvamnll_w "" SWORD rel_sw_b100 1 100 -100.0000 99.99695 FORMAT "%8.4" ECU_ADDRESS 0xD00009B0 /end MEASUREMENT
/begin MEASUREMENT dmvamxfk_w "" SWORD rel_sw_b100 1 100 -100.0000 99.99695 FORMAT "%8.4" ECU_ADDRESS 0xD00009B2 /end MEASUREMENT
/begin MEASUREMENT dmvamxfs_w "" SWORD rel_sw_b100 1 100 -100.0000 99.99695 FORMAT "%8.4" ECU_ADDRESS 0xD00009B4 /end MEASUREMENT
/begin MEASUREMENT dmvamxko_w "" SWORD rel_sw_b100 1 100 -100.0000 99.99695 FORMAT "%8.4" ECU_ADDRESS 0xD00009B6 /end MEASUREMENT
/begin MEASUREMENT dmvamxll_w "" SWORD rel_sw_b100 1 100 -100.0000 99.99695 FORMAT "%8.4" ECU_ADDRESS 0xD00009B8 /end MEASUREMENT
/begin MEASUREMENT dmverl_w "" SWORD rel_sw_b100 1 100 -100.0000 99.99695 FORMAT "%8.4" ECU_ADDRESS 0xD000099C /end MEASUREMENT
/begin MEASUREMENT dnikorr_w "" UWORD nmot_uw_q0p25 1 100 0.00 16383.75 FORMAT "%8.2" ECU_ADDRESS 0xD0000894 /end MEASUREMENT
/begin MEASUREMENT dnpzwloc "" SBYTE nmot_sb_q10 1 100 -1280. 1270. FORMAT "%5.0" ECU_ADDRESS 0xD0000DBC /end MEASUREMENT
/begin MEASUREMENT dnpzw_w "" SWORD nmot_sw_q0p25 1 100 -8192.000 8191.750 FORMAT "%8.3" ECU_ADDRESS 0xD0000896 /end MEASUREMENT
/begin MEASUREMENT dn_w "" SWORD nmot_sw_q0p25 1 100 -8192.000 8191.750 FORMAT "%8.3" ECU_ADDRESS 0xD00008AE /end MEASUREMENT
/begin MEASUREMENT dpusms "" UWORD p_uw_q0p039 1 100 0.00 2559.961 FORMAT "%8.3" ECU_ADDRESS 0xD000098A /end MEASUREMENT
/begin MEASUREMENT drlllss_w "" UWORD rel_uw_q0p0234 1 100 0.00 1535.977 FORMAT "%8.3" ECU_ADDRESS 0xD000093C /end MEASUREMENT
/begin MEASUREMENT dubfilm "" UBYTE spg_q0p1 1 100 0.00 25.50 FORMAT "%5.2" ECU_ADDRESS 0xD0000E51 /end MEASUREMENT
/begin MEASUREMENT dzwb "" SBYTE zw_sb_q0p75 1 100 -96.00 95.25 FORMAT "%5.2" ECU_ADDRESS 0xD0000DE2 /end MEASUREMENT
/begin MEASUREMENT dzweta_in "" UBYTE rel_ub_b127p5 1 100 0.00 127.5 FORMAT "%5.1" ECU_ADDRESS 0xD0000E62 /end MEASUREMENT
/begin MEASUREMENT dzwgru "" SBYTE zw_sb_q0p75 1 100 -96.00 95.25 FORMAT "%5.2" ECU_ADDRESS 0xD0000DE3 /end MEASUREMENT
/begin MEASUREMENT dzwi "" SBYTE zw_sb_q0p75 1 100 0.00 95.25 FORMAT "%5.2" ECU_ADDRESS 0xD0000E43 /end MEASUREMENT
/begin MEASUREMENT dzwoag "" SBYTE zw_sb_q0p75 1 100 -96.00 95.25 FORMAT "%5.2" ECU_ADDRESS 0xD0000E37 /end MEASUREMENT
/begin MEASUREMENT dzwol "" SBYTE zw_sb_q0p75 1 100 -96.00 95.25 FORMAT "%5.2" ECU_ADDRESS 0xD0000E38 /end MEASUREMENT
/begin MEASUREMENT dzwotm "" SBYTE zw_sb_q0p75 1 100 -96.00 95.25 FORMAT "%5.2" ECU_ADDRESS 0xD0000DE4 /end MEASUREMENT
/begin MEASUREMENT dzws "" SBYTE zw_sb_q0p75 1 100 -96.00 95.25 FORMAT "%5.2" ECU_ADDRESS 0xD0000E63 /end MEASUREMENT
/begin MEASUREMENT dzwtm "" SBYTE zw_sb_q0p75 1 100 -96.00 95.25 FORMAT "%5.2" ECU_ADDRESS 0xD0000DE5 /end MEASUREMENT
/begin MEASUREMENT dzwvgd "" SBYTE zw_sb_q0p75 1 100 -96.00 95.25 FORMAT "%5.2" ECU_ADDRESS 0xD0000E39 /end MEASUREMENT
/begin MEASUREMENT dzwvgdm "" SBYTE zw_sb_q0p75 1 100 -96.00 95.25 FORMAT "%5.2" ECU_ADDRESS 0xD0000E3A /end MEASUREMENT
/begin MEASUREMENT dzwvgdtab "" SBYTE zw_sb_q0p75 1 100 -96.00 95.25 FORMAT "%5.2" ARRAY_SIZE 10 ECU_ADDRESS 0xD0000DE6 /end MEASUREMENT
/begin MEASUREMENT dzwvgdtp "" SWORD zw_sb_q0p75 1 100 -24576.00 24575.25 FORMAT "%8.2" ECU_ADDRESS 0xD0000922 /end MEASUREMENT
/begin MEASUREMENT dzwvgd_summe "" SWORD zw_sb_q0p75 1 100 -24576.00 24575.25 FORMAT "%8.2" ECU_ADDRESS 0xD0000924 /end MEASUREMENT
/begin MEASUREMENT EGSys_bCH "" UBYTE B_TRUE 1 100 0.00 1.00000000000 BIT_MASK 0x1 FORMAT "%13.11" ECU_ADDRESS 0xD0000090 /end MEASUREMENT
/begin MEASUREMENT EGSys_bFCORdnCoPr "" UBYTE B_TRUE 1 100 0.00 1.00000000000 BIT_MASK 0x40 FORMAT "%13.11" ECU_ADDRESS 0xD0000092 /end MEASUREMENT
/begin MEASUREMENT EGSys_etaCH "" UWORD fak_uw_b2 1 100 0.00 1.999969 FORMAT "%8.6" ECU_ADDRESS 0xD00035DC /end MEASUREMENT
/begin MEASUREMENT EGSys_tLSXDstrMnCat "" SWORD temp_q0p1_o273 1 100 -3549.940 3003.560 FORMAT "%8.3" ECU_ADDRESS 0xD00034C4 /end MEASUREMENT
/begin MEASUREMENT EGSys_tManifMod "" SWORD temp_q0p1_o273 1 100 -3549.940 3003.560 FORMAT "%8.3" ECU_ADDRESS 0xD00034C6 /end MEASUREMENT
/begin MEASUREMENT EGSys_tMnCatMod "" SWORD temp_q0p1_o273 1 100 -3549.940 3003.560 FORMAT "%8.3" ECU_ADDRESS 0xD00034C8 /end MEASUREMENT
/begin MEASUREMENT EGSys_tPreCatMod "" SWORD temp_q0p1_o273 1 100 -3549.940 3003.560 FORMAT "%8.3" ECU_ADDRESS 0xD00034CA /end MEASUREMENT
/begin MEASUREMENT EGSys_trqResvCH "" SWORD md_q0p1 1 100 -3276.800 3276.700 FORMAT "%8.3" ECU_ADDRESS 0xD00034CC /end MEASUREMENT
/begin MEASUREMENT EnvP_p "" SWORD Pres_hPa 1 100 0.00 3500.000 FORMAT "%8.3" ECU_ADDRESS 0xD00034E8 /end MEASUREMENT
/begin MEASUREMENT EnvT_t "" SWORD Temp_Cels 1 100 -50.04000 199.9600 FORMAT "%8.4" ECU_ADDRESS 0xD00034EA /end MEASUREMENT
/begin MEASUREMENT EnvT_tMod "" UWORD Temp_Cels 1 100 -273.1400 6280.360 FORMAT "%8.3" ECU_ADDRESS 0xD00035E0 /end MEASUREMENT
/begin MEASUREMENT etalab "" UBYTE rel_ub_b127p5 1 100 0.00 127.5 FORMAT "%5.1" ECU_ADDRESS 0xD0000E3B /end MEASUREMENT
/begin MEASUREMENT etatemp "" UBYTE rel_ub_b127p5 1 100 0.00 127.5 FORMAT "%5.1" ECU_ADDRESS 0xD0000E64 /end MEASUREMENT
/begin MEASUREMENT etatmp "" UBYTE fak_ub_b1 1 100 0.00 0.9961 ECU_ADDRESS 0xD0000DF0 /end MEASUREMENT
/begin MEASUREMENT etazaist "" UBYTE rel_ub_b127p5 1 100 0.00 127.5 FORMAT "%5.1" ECU_ADDRESS 0xD0000E44 /end MEASUREMENT
/begin MEASUREMENT etazas_w "" UWORD rel_uw_b200 1 100 0.00 199.9969 FORMAT "%8.4" ECU_ADDRESS 0xD000097A /end MEASUREMENT
/begin MEASUREMENT etazwb "" UBYTE rel_ub_b127p5 1 100 0.00 127.5 FORMAT "%5.1" ECU_ADDRESS 0xD0000E3C /end MEASUREMENT
/begin MEASUREMENT etazwbm "" UBYTE rel_ub_b127p5 1 100 0.00 127.5 FORMAT "%5.1" ECU_ADDRESS 0xD0000E3D /end MEASUREMENT
/begin MEASUREMENT etazwb_w "" UWORD fak_uw_b2 1 100 0.00 1.999969 FORMAT "%8.6" ECU_ADDRESS 0xD000092C /end MEASUREMENT
/begin MEASUREMENT etazwist "" UBYTE rel_ub_b127p5 1 100 0.00 127.5 FORMAT "%5.1" ECU_ADDRESS 0xD0000E45 /end MEASUREMENT
/begin MEASUREMENT etazwist_w "" UWORD fak_uw_b2 1 100 0.00 1.999969 FORMAT "%8.6" ECU_ADDRESS 0xD0000942 /end MEASUREMENT
/begin MEASUREMENT etazws "" UBYTE rel_ub_b127p5 1 100 0.00 127.5 FORMAT "%5.1" ECU_ADDRESS 0xD0000E66 /end MEASUREMENT
/begin MEASUREMENT etazwsol "" UBYTE fak_ub_b1 1 100 0.00 0.9961 ECU_ADDRESS 0xD0000E67 /end MEASUREMENT
/begin MEASUREMENT etazwtp "" UWORD rel_ub_b127p5 1 100 0.00 32767.50 FORMAT "%8.2" ECU_ADDRESS 0xD0000926 /end MEASUREMENT
/begin MEASUREMENT etazwvg "" UBYTE rel_ub_b127p5 1 100 0.00 127.5 FORMAT "%5.1" ECU_ADDRESS 0xD0000E3E /end MEASUREMENT
/begin MEASUREMENT etazwvgd "" UBYTE rel_ub_b127p5 1 100 0.00 127.5 FORMAT "%5.1" ECU_ADDRESS 0xD0000DF1 /end MEASUREMENT
/begin MEASUREMENT etazwvgold "" UBYTE rel_ub_b127p5 1 100 0.00 127.5 FORMAT "%5.1" ECU_ADDRESS 0xD0000DF2 /end MEASUREMENT
/begin MEASUREMENT etazwvst "" UBYTE rel_ub_b127p5 1 100 0.00 127.5 FORMAT "%5.1" ECU_ADDRESS 0xD0000E3F /end MEASUREMENT
/begin MEASUREMENT eta_summe "" UWORD rel_ub_b127p5 1 100 0.00 32767.50 FORMAT "%8.2" ECU_ADDRESS 0xD0000928 /end MEASUREMENT
/begin MEASUREMENT Exh_tTrbnUs "" SWORD temp_q0p1_o273 1 100 -3549.940 3003.560 FORMAT "%8.3" ECU_ADDRESS 0xD0003528 /end MEASUREMENT
/begin MEASUREMENT fetatemp "" UBYTE fak_ub_b2 1 100 0.00 1.992188 FORMAT "%8.6" ECU_ADDRESS 0xD0000E65 /end MEASUREMENT
/begin MEASUREMENT ffri "" UBYTE fak_ub_b4 1 100 0.00 3.984 FORMAT "%5.3" ECU_ADDRESS 0xD0000DC4 /end MEASUREMENT
/begin MEASUREMENT ffripbs_w "" UWORD fak_uw_b8 1 100 0.00 7.999878 FORMAT "%8.6" ECU_ADDRESS 0xD00008BA /end MEASUREMENT
/begin MEASUREMENT ffrip_w "" UWORD fak_uw_b8 1 100 0.00 7.999878 FORMAT "%8.6" ECU_ADDRESS 0xD00008BC /end MEASUREMENT
/begin MEASUREMENT fnstab_w "" UWORD fak_uw_b8 1 100 0.00 7.999878 FORMAT "%8.6" ECU_ADDRESS 0xD0000978 /end MEASUREMENT
/begin MEASUREMENT frai_w "" UWORD fak_uw_b2 1 100 0.00 1.999969 FORMAT "%8.6" ECU_ADDRESS 0xAFE8012E /end MEASUREMENT
/begin MEASUREMENT framn_w "" UWORD fak_uw_b2 1 100 0.00 1.999969 FORMAT "%8.6" ECU_ADDRESS 0xD00008E2 /end MEASUREMENT
/begin MEASUREMENT framx_w "" UWORD fak_uw_b2 1 100 0.00 1.999969 FORMAT "%8.6" ECU_ADDRESS 0xD00008E4 /end MEASUREMENT
/begin MEASUREMENT fra_w "" UWORD fak_uw_b2 1 100 0.00 1.999969 FORMAT "%8.6" ECU_ADDRESS 0xD00008F0 /end MEASUREMENT
/begin MEASUREMENT fri "" UBYTE fak_ub_b77p81 1 100 0.00 77.82 FORMAT "%5.2" ECU_ADDRESS 0xD0000DC5 /end MEASUREMENT
/begin MEASUREMENT friint "" UBYTE fak_ub_b77p81 1 100 0.00 77.82 FORMAT "%5.2" ECU_ADDRESS 0xD0000DC6 /end MEASUREMENT
/begin MEASUREMENT frini_w "" UWORD fak_uw_b2 1 100 0.00 1.999969 FORMAT "%8.6" ECU_ADDRESS 0xD00008BE /end MEASUREMENT
/begin MEASUREMENT frmcnto_w "" UWORD dez 1 100 0.00 65535.00 FORMAT "%8.2" ECU_ADDRESS 0xD00008C0 /end MEASUREMENT
/begin MEASUREMENT frmcnt_w "" UWORD dez 1 100 0.00 65535.00 FORMAT "%8.2" ECU_ADDRESS 0xD00008C2 /end MEASUREMENT
/begin MEASUREMENT frmh_l "" ULONG fak_q3p0518Em5 1 100 0.00 131071.999969 FORMAT "%13.6" ECU_ADDRESS 0xD00022D4 /end MEASUREMENT
/begin MEASUREMENT frmn_w "" UWORD fak_uw_b2 1 100 0.00 1.999969 FORMAT "%8.6" ECU_ADDRESS 0xD00008D4 /end MEASUREMENT
/begin MEASUREMENT frmo_l "" ULONG fak_q3p0518Em5 1 100 0.00 131071.999969 FORMAT "%13.6" ECU_ADDRESS 0xD00022D8 /end MEASUREMENT
/begin MEASUREMENT frmx_w "" UWORD fak_uw_b2 1 100 0.00 1.999969 FORMAT "%8.6" ECU_ADDRESS 0xD00008D6 /end MEASUREMENT
/begin MEASUREMENT frm_w "" UWORD fak_uw_b2 1 100 0.00 1.999969 FORMAT "%8.6" ECU_ADDRESS 0xD00008D8 /end MEASUREMENT
/begin MEASUREMENT frp "" UBYTE rel_ub_b99p6 1 100 0.00 99.61 FORMAT "%5.2" ECU_ADDRESS 0xD0000DC7 /end MEASUREMENT
/begin MEASUREMENT frpint "" UBYTE fak_ub_b12p45 1 100 0.00 12.45 FORMAT "%5.2" ECU_ADDRESS 0xD0000DC8 /end MEASUREMENT
/begin MEASUREMENT frsp_w "" UWORD fak_uw_b2 1 100 0.00 1.999969 FORMAT "%8.6" ECU_ADDRESS 0xD00008C4 /end MEASUREMENT
/begin MEASUREMENT fr_w "" UWORD fak_uw_b2 1 100 0.00 1.999969 FORMAT "%8.6" ECU_ADDRESS 0xD00008DA /end MEASUREMENT
/begin MEASUREMENT ftv_w "" UWORD fak_uw_b16 1 100 0.00 15.99976 FORMAT "%8.5" ECU_ADDRESS 0xD00008C6 /end MEASUREMENT
/begin MEASUREMENT imlraa_w "" UWORD m_q1p7778Em3_kg 1 100 0.00 116.5067 FORMAT "%8.4" ECU_ADDRESS 0xD00008FA /end MEASUREMENT
/begin MEASUREMENT iver "" UBYTE rel_q0p002383 1 100 0.00 0.6076 ECU_ADDRESS 0xD0000DBD /end MEASUREMENT
/begin MEASUREMENT kfmdsnw_w "" UWORD rel_uw_b100 1 100 0.00 99.99847 FORMAT "%8.5" ECU_ADDRESS 0xD000098C /end MEASUREMENT
/begin MEASUREMENT LAMSONS_SW.timeCounter "" UWORD t_q0p2 1 100 0.00 13107.00 FORMAT "%8.2" ECU_ADDRESS 0xD0001574 /end MEASUREMENT
/begin MEASUREMENT LAMSONS_TONV.outbit "" UBYTE B_TRUE 1 100 0.00 1.00000000000 BIT_MASK 0x1 FORMAT "%13.11" ECU_ADDRESS 0xD0001576 /end MEASUREMENT
/begin MEASUREMENT LAMSONS_TONV.time "" UWORD t_q0p2 1 100 0.00 13107.00 FORMAT "%8.2" ECU_ADDRESS 0xD0001578 /end MEASUREMENT
/begin MEASUREMENT lamtme_w "" UWORD t_q0p2 1 100 0.00 13107.00 FORMAT "%8.2" ECU_ADDRESS 0xD00008FC /end MEASUREMENT
/begin MEASUREMENT limax_w "" SWORD rel_sw_b100 1 100 -100.0000 99.99695 FORMAT "%8.4" ECU_ADDRESS 0xD00008B0 /end MEASUREMENT
/begin MEASUREMENT limin_w "" SWORD rel_sw_b100 1 100 -100.0000 99.99695 FORMAT "%8.4" ECU_ADDRESS 0xD00008B2 /end MEASUREMENT
/begin MEASUREMENT limnst "" UBYTE rel_ub_b24p9 1 100 0.00 24.90 FORMAT "%5.2" ECU_ADDRESS 0xD0000DBE /end MEASUREMENT
/begin MEASUREMENT longft1_w "" UWORD fak_uw_b2 1 100 0.00 1.999969 FORMAT "%8.6" ECU_ADDRESS 0xD00008F8 /end MEASUREMENT
/begin MEASUREMENT lrdtwl_w "" UWORD t_q0p1 1 100 0.00 6553.500 FORMAT "%8.3" ECU_ADDRESS 0xD000090E /end MEASUREMENT
/begin MEASUREMENT l_fact_w "" UWORD fak_uw_b2 1 100 0.00 1.999969 FORMAT "%8.6" ECU_ADDRESS 0xD0000898 /end MEASUREMENT
/begin MEASUREMENT mdacmx "" UBYTE md_ub_q0p1 1 100 0.00 25.50 FORMAT "%5.2" ECU_ADDRESS 0xD0000E5E /end MEASUREMENT
/begin MEASUREMENT mdko "" UBYTE rel_ub_b100 1 100 0.00 99.61 FORMAT "%5.2" ECU_ADDRESS 0xD0000E5F /end MEASUREMENT
/begin MEASUREMENT mdkov "" UBYTE rel_ub_b100 1 100 0.00 99.61 FORMAT "%5.2" ECU_ADDRESS 0xD0000E53 /end MEASUREMENT
/begin MEASUREMENT mdk_w "" SWORD rel_sw_b100 1 100 -100.0000 99.99695 FORMAT "%8.4" ECU_ADDRESS 0xD000095C /end MEASUREMENT
/begin MEASUREMENT mdload "" UBYTE rel_ub_b100 1 100 0.00 99.61 FORMAT "%5.2" ECU_ADDRESS 0xD0000E54 /end MEASUREMENT
/begin MEASUREMENT mdns_w "" UWORD rel_uw_b100 1 100 0.00 99.99847 FORMAT "%8.5" ECU_ADDRESS 0xD000099E /end MEASUREMENT
/begin MEASUREMENT mdsh_w "" SWORD rel_sw_b50 1 100 -50.00000 49.99847 FORMAT "%8.5" ECU_ADDRESS 0xD00009A0 /end MEASUREMENT
/begin MEASUREMENT mdsmnw_w "" UWORD rel_uw_b100 1 100 0.00 99.99847 FORMAT "%8.5" ECU_ADDRESS 0xD000098E /end MEASUREMENT
/begin MEASUREMENT mdsmzas_w "" UWORD rel_uw_b100 1 100 0.00 99.99847 FORMAT "%8.5" ECU_ADDRESS 0xD0000990 /end MEASUREMENT
/begin MEASUREMENT mdsm_w "" UWORD rel_uw_b100 1 100 0.00 99.99847 FORMAT "%8.5" ECU_ADDRESS 0xD0000992 /end MEASUREMENT
/begin MEASUREMENT mdsnw_w "" UWORD rel_uw_b100 1 100 0.00 99.99847 FORMAT "%8.5" ECU_ADDRESS 0xD0000994 /end MEASUREMENT
/begin MEASUREMENT mdssta_w "" UWORD rel_uw_b100 1 100 0.00 99.99847 FORMAT "%8.5" ECU_ADDRESS 0xD00009A2 /end MEASUREMENT
/begin MEASUREMENT mdswl "" UBYTE rel_ub_b100 1 100 0.00 99.61 FORMAT "%5.2" ECU_ADDRESS 0xD0000E60 /end MEASUREMENT
/begin MEASUREMENT mds_w "" UWORD rel_uw_b100 1 100 0.00 99.99847 FORMAT "%8.5" ECU_ADDRESS 0xD0000996 /end MEASUREMENT
/begin MEASUREMENT mdverb "" UBYTE rel_ub_b100 1 100 0.00 99.61 FORMAT "%5.2" ECU_ADDRESS 0xD0000E61 /end MEASUREMENT
/begin MEASUREMENT mdverb_w "" UWORD rel_uw_b100 1 100 0.00 99.99847 FORMAT "%8.5" ECU_ADDRESS 0xD00009C2 /end MEASUREMENT
/begin MEASUREMENT mdverf_in "" UWORD zk20msxs_uw_b655 1 100 0.020000305180 1310.7200000 FORMAT "%12.7" ECU_ADDRESS 0xD0000998 /end MEASUREMENT
/begin MEASUREMENT mdverf_w "" UWORD rel_uw_b100 1 100 0.00 99.99847 FORMAT "%8.5" ECU_ADDRESS 0xD00009A4 /end MEASUREMENT
/begin MEASUREMENT mdverl_w "" UWORD rel_uw_b100 1 100 0.00 99.99847 FORMAT "%8.5" ECU_ADDRESS 0xD00009A6 /end MEASUREMENT
/begin MEASUREMENT mdvervf_w "" SWORD rel_sw_b100 1 100 -100.0000 99.99695 FORMAT "%8.4" ECU_ADDRESS 0xD000099A /end MEASUREMENT
/begin MEASUREMENT mdvglw_w "" UWORD rel_uw_b100 1 100 0.00 99.99847 FORMAT "%8.5" ECU_ADDRESS 0xD00009A8 /end MEASUREMENT
/begin MEASUREMENT mdytragm_w "" SWORD rel_sw_b100 1 100 -100.0000 99.99695 FORMAT "%8.4" ECU_ADDRESS 0xD0000988 /end MEASUREMENT
/begin MEASUREMENT mdzw_t1 "" UWORD rel_uw_b100 1 100 0.00 99.99847 FORMAT "%8.5" ECU_ADDRESS 0xD00009C4 /end MEASUREMENT
/begin MEASUREMENT md_lf "" UBYTE rel_ub_b100 1 100 0.00 99.61 FORMAT "%5.2" ECU_ADDRESS 0xD0000E5B /end MEASUREMENT
/begin MEASUREMENT mibas_w "" UWORD rel_uw_b100 1 100 0.00 99.99847 FORMAT "%8.5" ECU_ADDRESS 0xD000092E /end MEASUREMENT
/begin MEASUREMENT mibeg_w "" UWORD rel_uw_b100 1 100 0.00 99.99847 FORMAT "%8.5" ECU_ADDRESS 0xD0000948 /end MEASUREMENT
/begin MEASUREMENT mibgrex_w "" UWORD rel_uw_b100 1 100 0.00 99.99847 FORMAT "%8.5" ECU_ADDRESS 0xD000094A /end MEASUREMENT
/begin MEASUREMENT midstn_w "" UWORD rel_uw_b100 1 100 0.00 99.99847 FORMAT "%8.5" ECU_ADDRESS 0xD0000984 /end MEASUREMENT
/begin MEASUREMENT miextv_w "" UWORD rel_uw_b100 1 100 0.00 99.99847 FORMAT "%8.5" ECU_ADDRESS 0xD000094C /end MEASUREMENT
/begin MEASUREMENT miext_w "" UWORD rel_uw_b100 1 100 0.00 99.99847 FORMAT "%8.5" ECU_ADDRESS 0xD000094E /end MEASUREMENT
/begin MEASUREMENT mifa "" UBYTE rel_ub_b100 1 100 0.00 99.61 FORMAT "%5.2" ECU_ADDRESS 0xD0000E40 /end MEASUREMENT
/begin MEASUREMENT mifalws_w "" UWORD rel_uw_b100 1 100 0.00 99.99847 FORMAT "%8.5" ECU_ADDRESS 0xD0000962 /end MEASUREMENT
/begin MEASUREMENT mifal_w "" UWORD rel_uw_b100 1 100 0.00 99.99847 FORMAT "%8.5" ECU_ADDRESS 0xD0000930 /end MEASUREMENT
/begin MEASUREMENT mifa_w "" UWORD rel_uw_b100 1 100 0.00 99.99847 FORMAT "%8.5" ECU_ADDRESS 0xD0000932 /end MEASUREMENT
/begin MEASUREMENT mifil_w "" UWORD rel_uw_b100 1 100 0.00 99.99847 FORMAT "%8.5" ECU_ADDRESS 0xD0000936 /end MEASUREMENT
/begin MEASUREMENT miini_w "" UWORD rel_uw_b100 1 100 0.00 99.99847 FORMAT "%8.5" ECU_ADDRESS 0xD000095E /end MEASUREMENT
/begin MEASUREMENT miist_w "" UWORD rel_uw_b100 1 100 0.00 99.99847 FORMAT "%8.5" ECU_ADDRESS 0xD0000944 /end MEASUREMENT
/begin MEASUREMENT mill_w "" UWORD rel_uw_b100 1 100 0.00 99.99847 FORMAT "%8.5" ECU_ADDRESS 0xD000096E /end MEASUREMENT
/begin MEASUREMENT milshfra_w "" UWORD rel_uw_b100 1 100 0.00 99.99847 FORMAT "%8.5" ECU_ADDRESS 0xD00008FE /end MEASUREMENT
/begin MEASUREMENT milshora_w "" UWORD rel_uw_b100 1 100 0.00 99.99847 FORMAT "%8.5" ECU_ADDRESS 0xD0000900 /end MEASUREMENT
/begin MEASUREMENT milslfra_w "" UWORD rel_uw_b100 1 100 0.00 99.99847 FORMAT "%8.5" ECU_ADDRESS 0xD0000902 /end MEASUREMENT
/begin MEASUREMENT milslora_w "" UWORD rel_uw_b100 1 100 0.00 99.99847 FORMAT "%8.5" ECU_ADDRESS 0xD0000904 /end MEASUREMENT
/begin MEASUREMENT milsol_w "" UWORD rel_uw_b100 1 100 0.00 99.99847 FORMAT "%8.5" ECU_ADDRESS 0xD0000950 /end MEASUREMENT
/begin MEASUREMENT mimax_w "" UWORD rel_uw_b100 1 100 0.00 99.99847 FORMAT "%8.5" ECU_ADDRESS 0xD000096A /end MEASUREMENT
/begin MEASUREMENT miminf_w "" UWORD rel_uw_b100 1 100 0.00 99.99847 FORMAT "%8.5" ECU_ADDRESS 0xD0000970 /end MEASUREMENT
/begin MEASUREMENT miminu_w "" UWORD rel_uw_b100 1 100 0.00 99.99847 FORMAT "%8.5" ECU_ADDRESS 0xD0000972 /end MEASUREMENT
/begin MEASUREMENT mimin_w "" UWORD rel_uw_b100 1 100 0.00 99.99847 FORMAT "%8.5" ECU_ADDRESS 0xD0000974 /end MEASUREMENT
/begin MEASUREMENT mimxl1_w "" UWORD rel_uw_b100 1 100 0.00 99.99847 FORMAT "%8.5" ECU_ADDRESS 0xD0000964 /end MEASUREMENT
/begin MEASUREMENT mioes_w "" UWORD rel_uw_b100 1 100 0.00 99.99847 FORMAT "%8.5" ECU_ADDRESS 0xD0000952 /end MEASUREMENT
/begin MEASUREMENT mioptl1_w "" UWORD rel_uw_b100 1 100 0.00 99.99847 FORMAT "%8.5" ECU_ADDRESS 0xD000092A /end MEASUREMENT
/begin MEASUREMENT miopt_w "" UWORD rel_uw_b100 1 100 0.00 99.99847 FORMAT "%8.5" ECU_ADDRESS 0xD0000934 /end MEASUREMENT
/begin MEASUREMENT miped "" UBYTE rel_ub_b99p6 1 100 0.00 99.61 FORMAT "%5.2" ECU_ADDRESS 0xD0000E42 /end MEASUREMENT
/begin MEASUREMENT miped_w "" UWORD rel_uw_b100 1 100 0.00 99.99847 FORMAT "%8.5" ECU_ADDRESS 0xD000093E /end MEASUREMENT
/begin MEASUREMENT miptzwei_w "" UWORD rel_uw_b100 1 100 0.00 99.99847 FORMAT "%8.5" ECU_ADDRESS 0xD0000960 /end MEASUREMENT
/begin MEASUREMENT misawe_w "" UWORD rel_uw_b100 1 100 0.00 99.99847 FORMAT "%8.5" ECU_ADDRESS 0xD0000982 /end MEASUREMENT
/begin MEASUREMENT misolv_w "" UWORD rel_uw_b100 1 100 0.00 99.99847 FORMAT "%8.5" ECU_ADDRESS 0xD0000954 /end MEASUREMENT
/begin MEASUREMENT misol_w "" UWORD rel_uw_b100 1 100 0.00 99.99847 FORMAT "%8.5" ECU_ADDRESS 0xD0000956 /end MEASUREMENT
/begin MEASUREMENT mizsol_w "" UWORD rel_uw_b100 1 100 0.00 99.99847 FORMAT "%8.5" ECU_ADDRESS 0xD0000958 /end MEASUREMENT
/begin MEASUREMENT mizwmn_w "" UWORD rel_uw_b100 1 100 0.00 99.99847 FORMAT "%8.5" ECU_ADDRESS 0xD000097E /end MEASUREMENT
/begin MEASUREMENT mkfanb_w "" SWORD rel_sw_b100 1 100 -100.0000 99.99695 FORMAT "%8.4" ECU_ADDRESS 0xD0000938 /end MEASUREMENT
/begin MEASUREMENT MLEVABLR.imlevab_l "" ULONG m_q2p777Em4_g 1 100 0.00 1193046.47083 FORMAT "%13.5" ECU_ADDRESS 0xD00015C4 /end MEASUREMENT
/begin MEASUREMENT mrfa_w "" UWORD rel_uw_b200 1 100 0.00 199.9969 FORMAT "%8.4" ECU_ADDRESS 0xD0000940 /end MEASUREMENT
/begin MEASUREMENT msabsp_w "" UWORD m_uw_b6553p5 1 100 0.00 6553.500 FORMAT "%8.3" ECU_ADDRESS 0xD00008C8 /end MEASUREMENT
/begin MEASUREMENT ndifstat "" SBYTE nmot_q10 1 100 -1280. 1270. FORMAT "%5.0" ECU_ADDRESS 0xD0000DC0 /end MEASUREMENT
/begin MEASUREMENT ngasf_w "" SWORD nmotg_sw_q0p39 1 100 -12800.16 12799.77 FORMAT "%8.2" ECU_ADDRESS 0xD000089A /end MEASUREMENT
/begin MEASUREMENT ngfilmn_w "" SWORD nmotg_sw_q0p39 1 100 -12800.16 12799.77 FORMAT "%8.2" ECU_ADDRESS 0xD0000912 /end MEASUREMENT
/begin MEASUREMENT ngfilt_w "" SWORD nmotg_sw_q0p39 1 100 -12800.16 12799.77 FORMAT "%8.2" ECU_ADDRESS 0xD0000986 /end MEASUREMENT
/begin MEASUREMENT nsar_w "" SWORD nmot_q7p8125Em3 1 100 -256.0000 255.9922 FORMAT "%8.4" ECU_ADDRESS 0xD0000920 /end MEASUREMENT
/begin MEASUREMENT nstatf "" UBYTE nmot_ub_q10 1 100 0.00 2550. FORMAT "%5.0" ECU_ADDRESS 0xD0000E4A /end MEASUREMENT
/begin MEASUREMENT nver_w "" UWORD fak_uw_b8 1 100 0.00 7.999878 FORMAT "%8.6" ECU_ADDRESS 0xD0000976 /end MEASUREMENT
/begin MEASUREMENT orah_w "" SWORD rel_sw_b1536 1 100 -1536.000 1535.953 FORMAT "%8.3" ECU_ADDRESS 0xAFE80130 /end MEASUREMENT
/begin MEASUREMENT orai_w "" SWORD rel_sw_b1536 1 100 -1536.000 1535.953 FORMAT "%8.3" ECU_ADDRESS 0xD00008F2 /end MEASUREMENT
/begin MEASUREMENT oramn_w "" SWORD rel_sw_b1536 1 100 -1536.000 1535.953 FORMAT "%8.3" ECU_ADDRESS 0xD00008E6 /end MEASUREMENT
/begin MEASUREMENT oramx_w "" SWORD rel_sw_b1536 1 100 -1536.000 1535.953 FORMAT "%8.3" ECU_ADDRESS 0xD00008E8 /end MEASUREMENT
/begin MEASUREMENT orap_w "" SWORD rel_sw_b1536 1 100 -1536.000 1535.953 FORMAT "%8.3" ECU_ADDRESS 0xAFE80132 /end MEASUREMENT
/begin MEASUREMENT ora_w "" SWORD rel_sw_b1536 1 100 -1536.000 1535.953 FORMAT "%8.3" ECU_ADDRESS 0xD00008F4 /end MEASUREMENT
/begin MEASUREMENT phufraloc "" UBYTE dez 1 100 0.00 255.0 FORMAT "%5.1" ECU_ADDRESS 0xD0000DD1 /end MEASUREMENT
/begin MEASUREMENT phuoraloc "" UBYTE dez 1 100 0.00 255.0 FORMAT "%5.1" ECU_ADDRESS 0xD0000DD2 /end MEASUREMENT
/begin MEASUREMENT pvdnkhl "" UBYTE fak_q0p00153 1 100 0.00 0.3891 ECU_ADDRESS 0xD0000DC1 /end MEASUREMENT
/begin MEASUREMENT redeta_w "" SLONG rel_sw_b32 1 100 -32.0000000000 31.9990234375 FORMAT "%13.10" ECU_ADDRESS 0xD0002378 /end MEASUREMENT
/begin MEASUREMENT redhyst "" SBYTE fak_sb_b2 1 100 -2.000 1.984 FORMAT "%5.3" ECU_ADDRESS 0xD0000E4B /end MEASUREMENT
/begin MEASUREMENT redneu "" UBYTE dez 1 100 0.00 255.0 FORMAT "%5.1" ECU_ADDRESS 0xD0000E4C /end MEASUREMENT
/begin MEASUREMENT redsol "" UBYTE dez 1 100 0.00 255.0 FORMAT "%5.1" ECU_ADDRESS 0xD0000E4E /end MEASUREMENT
/begin MEASUREMENT redze "" UBYTE dez 1 100 0.00 255.0 FORMAT "%5.1" ECU_ADDRESS 0xD0000E4D /end MEASUREMENT
/begin MEASUREMENT redzenl "" UWORD dez 1 100 0.00 255.0000 FORMAT "%8.4" ECU_ADDRESS 0xD000097C /end MEASUREMENT
/begin MEASUREMENT rka_w "" SWORD rel_sw_b1536 1 100 -1536.000 1535.953 FORMAT "%8.3" ECU_ADDRESS 0xD00008F6 /end MEASUREMENT
/begin MEASUREMENT rldif_w "" SWORD rel_sw_q0p0234 1 100 -768.0000 767.9766 FORMAT "%8.4" ECU_ADDRESS 0xD00009BA /end MEASUREMENT
/begin MEASUREMENT rlmax "" UWORD rel_uw_q0p0234 1 100 0.00 1535.977 FORMAT "%8.3" ECU_ADDRESS 0xD0000966 /end MEASUREMENT
/begin MEASUREMENT rlsrl "" UBYTE rel_ub_q0p75 1 100 0.00 191.3 FORMAT "%5.1" ECU_ADDRESS 0xD0000DC9 /end MEASUREMENT
/begin MEASUREMENT rlugd_w "" UWORD rel_uw_q0p0234 1 100 0.00 1535.977 FORMAT "%8.3" ECU_ADDRESS 0xD000096C /end MEASUREMENT
/begin MEASUREMENT rlvugd_w "" UWORD rel_uw_q0p0234 1 100 0.00 1535.977 FORMAT "%8.3" ECU_ADDRESS 0xD0000968 /end MEASUREMENT
/begin MEASUREMENT sardyn_w "" SWORD rel_sw_b100 1 100 -100.0000 99.99695 FORMAT "%8.4" ECU_ADDRESS 0xD0000914 /end MEASUREMENT
/begin MEASUREMENT sarstat_w "" SWORD rel_sw_b100 1 100 -100.0000 99.99695 FORMAT "%8.4" ECU_ADDRESS 0xD0000916 /end MEASUREMENT
/begin MEASUREMENT stmkfanb_w "" SWORD rel_sw_b100 1 100 -100.0000 99.99695 FORMAT "%8.4" ECU_ADDRESS 0xD0000918 /end MEASUREMENT
/begin MEASUREMENT stnmott "" UBYTE nmot_ub_q40 1 100 0.00 10200. FORMAT "%5.0" ECU_ADDRESS 0xD0000DDE /end MEASUREMENT
/begin MEASUREMENT tarns "" UBYTE t_q2p0345Em3 1 100 0.03866 0.5188 ECU_ADDRESS 0xD0000DE1 /end MEASUREMENT
/begin MEASUREMENT tatuko "" UBYTE temp_ub_q0p75_o48 1 100 -48.00 143.3 FORMAT "%5.1" ECU_ADDRESS 0xD0000E5C /end MEASUREMENT
/begin MEASUREMENT tfraffv_w "" UWORD t_q0p2 1 100 0.00 13107.00 FORMAT "%8.2" ECU_ADDRESS 0xD0000906 /end MEASUREMENT
/begin MEASUREMENT tfraf_w "" UWORD t_q0p2 1 100 0.00 13107.00 FORMAT "%8.2" ECU_ADDRESS 0xD0000908 /end MEASUREMENT
/begin MEASUREMENT tfrc_w "" UWORD t_q0p01 1 100 0.00 655.3500 FORMAT "%8.4" ECU_ADDRESS 0xD00008DC /end MEASUREMENT
/begin MEASUREMENT tfrn_w "" UWORD t_q0p01 1 100 0.00 655.3500 FORMAT "%8.4" ECU_ADDRESS 0xD00008DE /end MEASUREMENT
/begin MEASUREMENT tfrp_w "" UWORD t_q0p01 1 100 0.00 655.3500 FORMAT "%8.4" ECU_ADDRESS 0xD00008E0 /end MEASUREMENT
/begin MEASUREMENT tfr_w "" UWORD t_q0p01 1 100 0.00 655.3500 FORMAT "%8.4" ECU_ADDRESS 0xD00008CA /end MEASUREMENT
/begin MEASUREMENT tlrint_w "" UWORD t_q0p01 1 100 0.00 655.3500 FORMAT "%8.4" ECU_ADDRESS 0xD00008CC /end MEASUREMENT
/begin MEASUREMENT tmraaein "" UBYTE temp_ub_q0p75_o48 1 100 -48.00 143.3 FORMAT "%5.1" ECU_ADDRESS 0xD0000DD0 /end MEASUREMENT
/begin MEASUREMENT tnacoff_w "" UWORD t200msxs_uw_q0p2 1 100 0.00 13107.00 FORMAT "%8.2" ECU_ADDRESS 0xD00009BE /end MEASUREMENT
/begin MEASUREMENT toraffv_w "" UWORD t_q0p2 1 100 0.00 13107.00 FORMAT "%8.2" ECU_ADDRESS 0xD000090A /end MEASUREMENT
/begin MEASUREMENT toraf_w "" UWORD t_q0p2 1 100 0.00 13107.00 FORMAT "%8.2" ECU_ADDRESS 0xD000090C /end MEASUREMENT
/begin MEASUREMENT tsperr "" UBYTE t_q0p01 1 100 0.00 2.550 FORMAT "%5.3" ECU_ADDRESS 0xD0000DCA /end MEASUREMENT
/begin MEASUREMENT tvlr "" UBYTE t_q0p01 1 100 0.00 2.550 FORMAT "%5.3" ECU_ADDRESS 0xD0000DCB /end MEASUREMENT
/begin MEASUREMENT tvlrdis "" UBYTE t_q0p01 1 100 0.00 2.550 FORMAT "%5.3" ECU_ADDRESS 0xD0000DCC /end MEASUREMENT
/begin MEASUREMENT tvlrtime "" SBYTE t_q0p01 1 100 -1.280 1.270 FORMAT "%5.3" ECU_ADDRESS 0xD0000DCD /end MEASUREMENT
/begin MEASUREMENT tvomdkat "" UBYTE t_q0p01 1 100 0.00 2.550 FORMAT "%5.3" ECU_ADDRESS 0xD0000DCE /end MEASUREMENT
/begin MEASUREMENT tvtime "" SBYTE t_q0p01 1 100 -1.280 1.270 FORMAT "%5.3" ECU_ADDRESS 0xD0000DCF /end MEASUREMENT
/begin MEASUREMENT vardyn "" UBYTE q0p0061_pc_DIV_rpm 1 100 0.00 1.556 FORMAT "%5.3" ECU_ADDRESS 0xD0000DDF /end MEASUREMENT
/begin MEASUREMENT varmdk_w "" UWORD fak_uw_b1 1 100 0.00 0.9999847 FORMAT "%9.7" ECU_ADDRESS 0xD000091A /end MEASUREMENT
/begin MEASUREMENT varstat "" UBYTE q0p0061_pc_DIV_rpm 1 100 0.00 1.556 FORMAT "%5.3" ECU_ADDRESS 0xD0000DE0 /end MEASUREMENT
/begin MEASUREMENT xgang "" UBYTE dez 1 100 0.00 255.0 FORMAT "%5.1" ECU_ADDRESS 0xD0000E48 /end MEASUREMENT
/begin MEASUREMENT zfllrpl_tmp "" SWORD rel_sw_b100 1 100 -100.0000 99.99695 FORMAT "%8.4" ECU_ADDRESS 0xD000089C /end MEASUREMENT
/begin MEASUREMENT zkmdo "" UWORD zk20msxs_uw_b1310 1 100 0.020000305180 1310.7200000 FORMAT "%12.7" ECU_ADDRESS 0xD00009C0 /end MEASUREMENT
/begin MEASUREMENT zmdfa "" UBYTE zk10msxs_ub_b2p55 1 100 0.0100000 2.55000 FORMAT "%7.5" ECU_ADDRESS 0xD0000E49 /end MEASUREMENT
/begin MEASUREMENT zmisawe "" UWORD zk10msxs_uw_b655 1 100 0.010000152590 655.36000000 FORMAT "%12.8" ECU_ADDRESS 0xD0000980 /end MEASUREMENT
/begin MEASUREMENT zwopt "" SBYTE zw_sb_q0p75 1 100 -96.00 95.25 FORMAT "%5.2" ECU_ADDRESS 0xD0000E41 /end MEASUREMENT
/begin MEASUREMENT zwoptl1 "" SBYTE zw_sb_q0p75 1 100 -96.00 95.25 FORMAT "%5.2" ECU_ADDRESS 0xD0000DF3 /end MEASUREMENT
/begin MEASUREMENT zwsol "" SBYTE zw_sb_q0p75 1 100 -96.00 95.25 FORMAT "%5.2" ECU_ADDRESS 0xD0000E68 /end MEASUREMENT
/begin MEASUREMENT zwtp1 "" SBYTE zw_sb_q0p75 1 100 -96.00 95.25 FORMAT "%5.2" ECU_ADDRESS 0xD0000DF4 /end MEASUREMENT
/begin MEASUREMENT zw_local "" SBYTE zw_sb_q0p75 1 100 -96.00 95.25 FORMAT "%5.2" ECU_ADDRESS 0xD0000DF5 /end MEASUREMENT
/begin MEASUREMENT Zyl_block "" UBYTE rel_ub_b127p5 1 100 0.00 127.5 FORMAT "%5.1" ARRAY_SIZE 65 ECU_ADDRESS 0xD0000DF6 /end MEASUREMENT
/begin MEASUREMENT z_fact_w "" UWORD fak_uw_b2 1 100 0.00 1.999969 FORMAT "%8.6" ECU_ADDRESS 0xD000089E /end MEASUREMENT
/begin FUNCTION LLRRM "4.0.1"
 /begin DEF_CHARACTERISTIC CWLLDEUS CWLLRRM DLIMXDNS DMLLNGEZ DMLLNGEZV DMLLRLMNF DMLLRLMNKH DMLLRLMNN DMLLRLMNST DMLLRLMXF DMLLRLMXN DMLLRMNKH DMLLRMNLS DMLLRMNN DMLLRMNNK DMLLRMNST DMLLRMXN DMLLRMXNK DNLLRESWUS DNLLRIST DNLLSTS DNMNI DVNG DVNGKH DVNGV DWPEDDP FDDN FDNIKOR FHORESW FKTLL FKTLNL FKTZLL FKTZNL IVDNDTEH IVDNHOM IVDNHOMKH IVDNHOMV KFLIVNGAS KITHRESG KLDNLLDEUS KLFDALL KLFDANL KLFKTIT KLFKTLT KLFKTZT KLLIMNV LIMN LIMNDLLR LIMNDTES LIMXDNS LIMXVDNS LISTM LIVFZDEUS LLRICNF NLLRRI PVDNHOM PVDNHOMV PVDNKFKH PVDNSTW PVLDNEZ PVLDNEZKH PVLDNEZV SDN10LLSW SDNM10LLSW SEZ04LLUB SNZ06LLSB SRKTEVS TDMRESLLUS TNSDM TVGRMRUS TVKINGAS TVLISTU TVLLRPST TVLLRST TVPKH TVRESLLUS TVSPMN WDKBALI ZFLLRPL ZKLLRD ZLIBG ZNFNGLL /end DEF_CHARACTERISTIC
 /begin REF_CHARACTERISTIC SNG06LLSB SNM06LLUW SNS06LLSB STM06LLUB /end REF_CHARACTERISTIC
 /begin IN_MEASUREMENT B_dllr B_dteaam B_dtes B_dtest B_faan B_kh B_kha B_khn B_koe B_kuppl B_ll B_llde B_llr B_llrein B_llri B_llrpd B_mdmin B_nsolst B_nswo1 B_st B_stend B_temin B_trkh B_vllr dns esst_snm06lluw etazws fho gangi ngas_w ngfil nmotll nmot_w nsol nsol_w nstat tmot tnst_w vfzg wdkba_w wped_w /end IN_MEASUREMENT
 /begin OUT_MEASUREMENT B_lldeus B_llrilimn B_llrpst B_llrst dmllrdl_w dmllrd_w dmllri_w dmllrl_w dmllrpl_w dmllrp_w dmllr_w dn_w limax_w limin_w /end OUT_MEASUREMENT
 /begin LOC_MEASUREMENT B_ellstmp B_llrpkh dmllr1_w dmllrib_w dmllriio_w dmllrii_w dmllriz_w dnikorr_w dnpzwloc dnpzw_w iver limnst l_fact_w ndifstat ngasf_w pvdnkhl zfllrpl_tmp z_fact_w /end LOC_MEASUREMENT
 FUNCTION_VERSION "4.0.1" /end FUNCTION
/begin FUNCTION LR "1.21.0"
 /begin DEF_CHARACTERISTIC CWLR DFRFFRM DFRSPS DMSABDYN FFRITMS FLRM FRIPTES FRMAX FRMIN FTSPERN FTVMAX KFDLAQHOM KFRI KFRP KFTFRC KLFLRTV LRDYNLL RTELRMX SNM07LRUB SRL06LRUB TVLRDYN USR USRW ZDFR ZLRFRI /end DEF_CHARACTERISTIC
 /begin IN_MEASUREMENT ESC_tiSampling B_dktlp B_lasostc B_llri B_lr B_lrfsbs B_lrmsbs B_lrnd B_pwf B_sbbvk B_te B_temin dlaskat_w dlatrmc_w falrdkt lamsbg_w lamsons_w msabvhk_w nmot osctvdkt_w rkg_w rkte_w rl tlrs_w tmot tmst TWCC_rLamCtlTrimB1 usvk_w zlrs_w /end IN_MEASUREMENT
 /begin OUT_MEASUREMENT B_frini B_frmax B_frmin B_frsp B_lrseta B_lrsp B_lrssp B_lrstat B_lrtpp B_sgnlr B_spvkea B_za dfrsp_w dfrst_w dfrzaf_w frmn_w frmx_w frm_w fr_w tfrc_w tfrn_w tfrp_w /end OUT_MEASUREMENT
 /begin LOC_MEASUREMENT B_frab B_frspini B_int B_lrdyntv B_lrstatn B_sgnlrd B_tspon dfrstga_w dfrstte_w dfrzaff_w dfrza_w dlaqhom dlatvlr_w ffri ffripbs_w ffrip_w fri friint frini_w frmcnto_w frmcnt_w frmh_l frmo_l frp frpint frsp_w ftv_w msabsp_w rlsrl tfr_w tlrint_w tsperr tvlr tvlrdis tvlrtime tvomdkat tvtime /end LOC_MEASUREMENT
 FUNCTION_VERSION "1.21.0" /end FUNCTION
/begin FUNCTION LRA "1.21.0"
 /begin DEF_CHARACTERISTIC CWORAP CWRKANMOT FFRAKFV FORAKFV FRAK FRAMN FRAMX FVLRAS IMTEFVDFRM INITFRA INITORA KLFRKANMOT N0 NRKAB ORAK ORAMN ORAMX TMFVDFRM TTPDFRM /end DEF_CHARACTERISTIC
 /begin REF_CHARACTERISTIC ANZTILRA /end REF_CHARACTERISTIC
 /begin IN_MEASUREMENT anztib_w B_falra B_fedkapb B_fedssb B_fvgte B_lr B_lrafra B_lraora B_lrareb B_nofra B_noora B_pwf B_te B_zora dlahp_w frm_w imsteini nmot tmot /end IN_MEASUREMENT
 /begin OUT_MEASUREMENT B_fvlra B_lrare B_reqlra dfrmk_w dfrmtp_w dfrm_w frai_w fra_w orah_w orai_w orap_w ora_w rka_w /end OUT_MEASUREMENT
 /begin LOC_MEASUREMENT B_frfvlra_FF.status framn_w framx_w oramn_w oramx_w /end LOC_MEASUREMENT
 FUNCTION_VERSION "1.21.0" /end FUNCTION
/begin FUNCTION LRA2SV "1.2.0" /begin IN_MEASUREMENT anztib_w frai_w fra_w rka_w rllaso_w rlp_w /end IN_MEASUREMENT /begin OUT_MEASUREMENT longft1_w /end OUT_MEASUREMENT FUNCTION_VERSION "1.2.0" /end FUNCTION
/begin FUNCTION LRAEB "1.24.0"
 /begin DEF_CHARACTERISTIC ANZTILRA CWLRAEB CWLRAEBORA IMLRAAEIN KLFRAMILH KLFRAMILL KLORAMILH KLORAMILHF KLORAMILL KLTONLRALA KLTURAA LAMGAFVMN LAMGAMN LAMGAMX NOLRA ORASPV TARA TMRAA TVLRA TVNLGA TVUBLRA TVUBLRAFRA TVUBLRAORA /end DEF_CHARACTERISTIC
 /begin IN_MEASUREMENT anztib_w B_fa B_falra B_fedssb B_feete B_frastab B_lamkh B_lr B_nmot B_orastab B_reqlra B_ukg B_vl lamsons_w milsol_w ml_w nmot tans tmot tumg vfzg_w /end IN_MEASUREMENT
 /begin OUT_MEASUREMENT B_avfra B_avora B_balra B_lrab B_lrafra B_lraora B_lrareb B_nofra B_noora B_nphyora B_ubfra B_ubora B_ubphyfra B_ubphyora milshfra_w milshora_w milslfra_w milslora_w tmraaein /end OUT_MEASUREMENT
 /begin LOC_MEASUREMENT dmilora_w imlraa_w LAMSONS_SW.timeCounter LAMSONS_TONV.outbit LAMSONS_TONV.time lamtme_w /end LOC_MEASUREMENT
 FUNCTION_VERSION "1.24.0" /end FUNCTION
/begin FUNCTION LRAPHU "1.8.1"
 /begin DEF_CHARACTERISTIC KWTFRAMX KWTORAMX KWTPFRAMX KWTPORAMX PHUFRAHP PHUFRALP PHUFRAMP PHUORAHP PHUORALP PHUORAMP TFRAFV TFRAINI TFRAPH TFRASTABZ TORAFV TORAINI TORAPH TORASTA /end DEF_CHARACTERISTIC
 /begin IN_MEASUREMENT B_avfra B_avora B_edkvs B_fdgser B_frastab B_fvlra B_nphyora B_odgser B_orastab B_stendz /end IN_MEASUREMENT
 /begin OUT_MEASUREMENT B_refrast B_reorast phufraloc phuoraloc /end OUT_MEASUREMENT
 /begin LOC_MEASUREMENT tfraffv_w tfraf_w toraffv_w toraf_w /end LOC_MEASUREMENT
 FUNCTION_VERSION "1.8.1" /end FUNCTION
/begin FUNCTION LREB "1.9.0"
 /begin DEF_CHARACTERISTIC CWLREB CWLREBMD IMLEVABS IMLSALR LRLASOMN LRLASOMX RLLRUN RLRVAO STM08LEUB TASHS TLRBAMW TLRHS TLRPROT TLRTMS TLRVAMW TMSHS TRAU /end DEF_CHARACTERISTIC
 /begin IN_MEASUREMENT B_bag B_bevab B_eev B_falr B_frini B_lamdiag B_mdarv B_mdkat B_sa B_sbbvk B_stend B_temin B_vag lamsbrs_w lamsons_w ml_w nmot rl tansst tmot tmst /end IN_MEASUREMENT
 /begin OUT_MEASUREMENT B_eobdlr B_lr B_lrfsbs B_lrmsbs B_lrnd B_lrnda B_lrsetp B_mlevab B_mlrsa B_pspwl /end OUT_MEASUREMENT
 /begin LOC_MEASUREMENT B_bag_TOFV.outbit B_bag_TOFV.time B_lrhmb B_lrmstr B_lrnbsnc B_lrrl B_pspaus B_vag_TOFV.outbit B_vag_TOFV.time lrdtwl_w MLEVABLR.imlevab_l /end LOC_MEASUREMENT
 FUNCTION_VERSION "1.9.0" /end FUNCTION
/begin FUNCTION MDARE "1.0.0"
 /begin DEF_CHARACTERISTIC CWMDARE DMARMXKL GFDMARMXKF GVDNSKL GVMTKL GVVFZGKL NARMNKL NARMNLLKL NARMXKL NARMXLLKL NGFILMN NGFILMX SARDYNDPKF SARDYNKF SARSTATKF STMKFANB STNMOT STUEVGES TARNSKL TARNSOT TMAR TVARDYN TVARSA TVARSDYN TVARSTAT VARAO VARAU VARDYNKF VARDYNOT VARMDKRMP VARSTATKL /end DEF_CHARACTERISTIC
 /begin IN_MEASUREMENT B_autget B_dash B_enmdsawe B_evakt B_fgr B_kraftsch B_ll B_lwsd B_mdein B_stend B_vzw dns mkfanb_w ngfil_w nmot nsar_w rl tmot uevges_w vfzg_w /end IN_MEASUREMENT
 /begin OUT_MEASUREMENT B_ar dmar_w tarns /end OUT_MEASUREMENT
 /begin LOC_MEASUREMENT B_arfgsa B_calcmn B_ot B_tvarsa dmarmx_w ngfilmn_w sardyn_w sarstat_w stmkfanb_w stnmott vardyn varmdk_w varstat /end LOC_MEASUREMENT
 FUNCTION_VERSION "1.0.0" /end FUNCTION
/begin FUNCTION MDARNS "1.0.0" /begin IN_MEASUREMENT B_ar nmot_w tarns /end IN_MEASUREMENT /begin OUT_MEASUREMENT B_vzw nsar_w /end OUT_MEASUREMENT FUNCTION_VERSION "1.0.0" /end FUNCTION
/begin FUNCTION MDBAS "2.2.0"
 /begin DEF_CHARACTERISTIC CWBR CWIR CWMBAS DETANN DETANNMA DETAPN DWDKTPS DZWOLA DZWOM ETALAM KFETAZW KFETAZWN KFETAZWNDO KFETAZWNLS KFETAZWNMA KFETAZWNTA KFMIOP KFZWOP KFZWOP2 KFZWOPL KFZWOPL2 KLETAEDK KLPSDO NGIR TDAIR VFZGDO VFZGDU /end DEF_CHARACTERISTIC
 /begin REF_CHARACTERISTIC DZWETA ETADZW SNM16OPUW SRL11OPUW /end REF_CHARACTERISTIC
 /begin IN_MEASUREMENT B_brems B_edks B_koe B_ll B_llrein B_stend B_tansh dwdkba_w dwkr dzwks dzwwl esst_srl11opuw etakh fho fwnwe lambas ngas_w ngfil_w nmot nmot_w ps_w rl rl_w tmot vfzg vfzg_w wkrdyv zwbas zzyl /end IN_MEASUREMENT
 /begin OUT_MEASUREMENT B_dowhill B_etagst B_iredk B_petafil dzwoag dzwol dzwvgd dzwvgdm etalab etazwb etazwbm etazwb_w etazwvg etazwvst mibas_w mifa mifal_w mifa_w miopt_w zwopt /end OUT_MEASUREMENT
 /begin LOC_MEASUREMENT B_umetazw dzwb dzwgru dzwotm dzwtm dzwvgdtab dzwvgdtp dzwvgd_summe etatmp etazwtp etazwvgd etazwvgold eta_summe mioptl1_w zwoptl1 zwtp1 zw_local Zyl_block /end LOC_MEASUREMENT
 FUNCTION_VERSION "2.2.0" /end FUNCTION
/begin FUNCTION MDFIL "1.0.0" /begin IN_MEASUREMENT B_fil B_lwsd mdverl_w mifalws_w mifa_w misawe_w /end IN_MEASUREMENT /begin OUT_MEASUREMENT mifil_w mkfanb_w /end OUT_MEASUREMENT FUNCTION_VERSION "1.0.0" /end FUNCTION
/begin FUNCTION MDFUE "3.0.0" /begin DEF_CHARACTERISTIC KFMIRL /end DEF_CHARACTERISTIC /begin IN_MEASUREMENT dmilsol_w dmrkh_w etalab etazwvst nmot_w rlmin_w /end IN_MEASUREMENT /begin OUT_MEASUREMENT drlllss_w /end OUT_MEASUREMENT /begin LOC_MEASUREMENT dmisopl1_w /end LOC_MEASUREMENT FUNCTION_VERSION "3.0.0" /end FUNCTION
/begin FUNCTION MDFW "1.0.0" /begin DEF_CHARACTERISTIC KFMPED /end DEF_CHARACTERISTIC /begin IN_MEASUREMENT dmllri_w mimax_w mimin_w nmot wdkba /end IN_MEASUREMENT /begin OUT_MEASUREMENT miped miped_w mrfa_w /end OUT_MEASUREMENT FUNCTION_VERSION "1.0.0" /end FUNCTION
/begin FUNCTION MDIST "3.0.0" /begin REF_CHARACTERISTIC ETADZW /end REF_CHARACTERISTIC /begin IN_MEASUREMENT miopt_w redist zwist zwopt /end IN_MEASUREMENT /begin OUT_MEASUREMENT dzwi etazaist etazwist etazwist_w miist_w /end OUT_MEASUREMENT FUNCTION_VERSION "3.0.0" /end FUNCTION
/begin FUNCTION MDKOG "4.0.0" /begin DEF_CHARACTERISTIC DDMRKH NASNOT NASNOTFS /end DEF_CHARACTERISTIC /begin REF_CHARACTERISTIC MDIMX /end REF_CHARACTERISTIC
 /begin IN_MEASUREMENT B_asr B_autget B_ll B_llrein dmar_w dmllr_w dmrkhmn_w miasrs_w mibas_w midstn_w mifil_w migs_w mimsr_w minmx_w miopt_w mivmx_w mizwmn_w nmot /end IN_MEASUREMENT
 /begin OUT_MEASUREMENT B_mdein B_nozwe milsol_w mioes_w misolv_w misol_w mizsol_w /end OUT_MEASUREMENT
 /begin LOC_MEASUREMENT B_nozwvs dmristtmp_w mibeg_w mibgrex_w miextv_w miext_w /end LOC_MEASUREMENT
 FUNCTION_VERSION "4.0.0" /end FUNCTION
/begin FUNCTION MDKOL "2.0.0"
 /begin IN_MEASUREMENT B_llri B_llrpd dmllrdl_w dmllri_w dmllr_w mibas_w midash_w mimin_w mimsr_w mizwmn_w /end IN_MEASUREMENT
 /begin OUT_MEASUREMENT dmilsol_w /end OUT_MEASUREMENT
 FUNCTION_VERSION "2.0.0" /end FUNCTION
/begin FUNCTION MDLWSD "1.0.0"
 /begin DEF_CHARACTERISTIC CWLWSDWK DFAOWK DFAUWKN DFAWKN DMDFAO DMDFAWE DMLWSDU DMLWWKMK KFDMDFA KFDMDFAS KFDMDFAU KFZMDFA KFZMDFAS KFZMDFAU KLDMLWSDO KLMKLWSD MKLWON MKLWOWKN MKLWSAN MKLWSDWK MKLWUN MKLWUWKN SGA06MFUB SNM06MFUB TMLWSD TVLWSDSA VLWSD ZFAOWK ZFAUWKN ZFAWKN ZMDFAO ZMDFAWE /end DEF_CHARACTERISTIC
 /begin IN_MEASUREMENT B_ll B_petafil B_sa B_sab B_st B_wkauf gangi mdverl_w mifa_w mifil_w nmot tmot vfzg /end IN_MEASUREMENT
 /begin OUT_MEASUREMENT B_lwsd mifalws_w /end OUT_MEASUREMENT
 /begin LOC_MEASUREMENT B_iflsd B_lwsdsa B_lwsfao B_lwsuk B_wkaufa dmdfa mdk_w miini_w miptzwei_w xgang zmdfa /end LOC_MEASUREMENT
 FUNCTION_VERSION "1.0.0" /end FUNCTION
/begin FUNCTION MDMAX "3.0.0" /begin DEF_CHARACTERISTIC FMIVL FRLKEVT KLRLVMX KLRLVSMX /end DEF_CHARACTERISTIC /begin REF_CHARACTERISTIC KFMIOP /end REF_CHARACTERISTIC /begin IN_MEASUREMENT evtmod fho_w nmot_w /end IN_MEASUREMENT /begin OUT_MEASUREMENT mimax_w rlugd_w /end OUT_MEASUREMENT /begin LOC_MEASUREMENT mimxl1_w rlmax rlvugd_w /end LOC_MEASUREMENT FUNCTION_VERSION "3.0.0" /end FUNCTION
/begin FUNCTION MDMIN "3.1.0" /begin DEF_CHARACTERISTIC TDMFBSA TDMFBWE TDMFBWEN /end DEF_CHARACTERISTIC /begin IN_MEASUREMENT B_autget B_fil B_fs B_sa B_sab fnstab_w mdverf_w mistt /end IN_MEASUREMENT /begin OUT_MEASUREMENT mill_w miminf_w miminu_w mimin_w /end OUT_MEASUREMENT FUNCTION_VERSION "3.1.0" /end FUNCTION
/begin FUNCTION MDNSTAB "3.0.0" /begin DEF_CHARACTERISTIC FNSTABNV ZNSM ZNSMTCU /end DEF_CHARACTERISTIC /begin REF_CHARACTERISTIC STM06LLUB /end REF_CHARACTERISTIC /begin IN_MEASUREMENT B_llrein B_nsoltcu nmot_w nstat tmot /end IN_MEASUREMENT /begin OUT_MEASUREMENT fnstab_w nstatf /end OUT_MEASUREMENT /begin LOC_MEASUREMENT nver_w /end LOC_MEASUREMENT FUNCTION_VERSION "3.0.0" /end FUNCTION
/begin FUNCTION MDRED "8.0.0"
 /begin DEF_CHARACTERISTIC CREDSTU DMIZWMN KLREDNMX MDHYEZ NMAXSAWE REDHYOC REDHYOCS REDHYUC REDHYUCS REDMXSA REDZEM REDZEMNL TKIHKMDRED TMAXSAWE /end DEF_CHARACTERISTIC
 /begin IN_MEASUREMENT B_asr B_dknolu B_dkpu B_evakt B_fil B_mdeeub B_msr B_nmax B_sab B_sgs B_sgsred B_stend B_vnull dn_w etazwmn gangi mibas_w miopt_w misol_w nmot redist tkihkm_w tmot /end IN_MEASUREMENT
 /begin OUT_MEASUREMENT B_enmdsawe B_mdee B_mdeevb B_sa mizwmn_w redsol /end OUT_MEASUREMENT
 /begin LOC_MEASUREMENT B_mdeemx B_mdeenf B_mdeenl B_mdeetk B_mdsawe B_redsch B_sabmee B_vormdred etazas_w redeta_w redhyst redneu redze redzenl /end LOC_MEASUREMENT
 FUNCTION_VERSION "8.0.0" /end FUNCTION
/begin FUNCTION MDSAWE "1.0.0" /begin DEF_CHARACTERISTIC DMRSA KLTDMFBSA KLTDMFBWE NGFSAWE /end DEF_CHARACTERISTIC
 /begin IN_MEASUREMENT B_ll B_ngsawe B_petafil B_sa B_sab B_vnull gangi mifa_w miist_w ngfil_w /end IN_MEASUREMENT
 /begin OUT_MEASUREMENT B_fil misawe_w /end OUT_MEASUREMENT
 /begin LOC_MEASUREMENT zmisawe /end LOC_MEASUREMENT
 FUNCTION_VERSION "1.0.0" /end FUNCTION
/begin FUNCTION MDSTN "2.0.0" /begin DEF_CHARACTERISTIC DMMDSTN NIMDSTN ZKLMDSTN /end DEF_CHARACTERISTIC /begin REF_CHARACTERISTIC STMS06LLUB /end REF_CHARACTERISTIC /begin IN_MEASUREMENT B_nmot esst_stms06llub mibas_w mimin_w nmot_w tmst /end IN_MEASUREMENT /begin OUT_MEASUREMENT midstn_w /end OUT_MEASUREMENT FUNCTION_VERSION "2.0.0" /end FUNCTION
/begin FUNCTION MDTRAEGM "1.1.1" /begin DEF_CHARACTERISTIC JMOTOR KLZNFILT TVMDTRAEGM /end DEF_CHARACTERISTIC /begin IN_MEASUREMENT ngas_w tnst_w /end IN_MEASUREMENT /begin OUT_MEASUREMENT mdytragm_w /end OUT_MEASUREMENT /begin LOC_MEASUREMENT ngfilt_w /end LOC_MEASUREMENT FUNCTION_VERSION "1.1.1" /end FUNCTION
/begin FUNCTION MDVER "3.1.0"
 /begin DEF_CHARACTERISTIC CNFMDVER DDWPEDMDK DMDWANK DMVERLMN DWPEDMDK KFDMDNSM KFMDS KFMDSNW KFMDSZAS KFZMDNSM MDSH MDSM MDSMNW MDSMZAS MDVGLW MDWANK SPU11OPUW STM10_UB TVMDCVTK ZFMDVERL /end DEF_CHARACTERISTIC
 /begin REF_CHARACTERISTIC SNM16OPUW SRL11OPUW /end REF_CHARACTERISTIC
 /begin IN_MEASUREMENT B_cvt B_kuppl B_llrein B_sa dmvad_w dwped_w esst_srl11opuw fho fnstab_w fnwue mdverb_w nmotll nmot_w nsol nstat ps_w pu_w rl_w tmot /end IN_MEASUREMENT
 /begin OUT_MEASUREMENT dmverl_w mdns_w mdsh_w mdssta_w mdverf_w mdverl_w mdvglw_w /end OUT_MEASUREMENT
 /begin LOC_MEASUREMENT B_dmverlin B_mdcvtk dpusms kfmdsnw_w mdsmnw_w mdsmzas_w mdsm_w mdsnw_w mds_w mdverf_in mdvervf_w /end LOC_MEASUREMENT
 FUNCTION_VERSION "3.1.0" /end FUNCTION
/begin FUNCTION MDVERAD "3.0.0"
 /begin DEF_CHARACTERISTIC CWMDVERAD DDMVADEP DMADFK DMADFS DMADKO DMADLL DMADMNFK DMADMNFS DMADMNKO DMADMNLL DMADMXFK DMADMXFS DMADMXKO DMADMXLL RLABW TMDMAD TVADFR TWDMAD ZKDMADFK ZKDMADFS ZKDMADKO ZKDMADLL /end DEF_CHARACTERISTIC
 /begin IN_MEASUREMENT B_clreepr B_dtes B_fs B_koe B_llr B_llrein B_nmot B_pwf B_vllr dmllri_w drlllss_w rl_w tmot /end IN_MEASUREMENT
 /begin OUT_MEASUREMENT B_madko B_madll dmvadfk_w dmvadfs_w dmvadko_w dmvadll_w dmvad_w /end OUT_MEASUREMENT
 /begin LOC_MEASUREMENT B_adwfk B_adwfs B_adwko B_madfk B_madfs B_wrendad dmvamnfk_w dmvamnfs_w dmvamnko_w dmvamnll_w dmvamxfk_w dmvamxfs_w dmvamxko_w dmvamxll_w rldif_w /end LOC_MEASUREMENT
 FUNCTION_VERSION "3.0.0" /end FUNCTION
/begin FUNCTION MDVERB "3.0.0"
 /begin DEF_CHARACTERISTIC CWTUMKO DMDKOE DMDLOAD1 DMDLOAD3 DUBDMM KFDMDKOE KFDMDKOEFS KFMDKO KFMDKOFST KFMDKOPA KFZKMDKOFS KLDMDLOAD2 KLDMDRKO KLKOFFTUM KLMDACMX KLMDLFPW KLMDLOAD2 KLMDNSL KLMDPSL MDLF1 MDLF2 MDLFE1 MDLFE2 MDLFPWMMN MDLOAD1 MDLOAD3 SNM06KOUB STA06LLUB TABSTAC TDMKOW TMDBUBOM TMDBUBUM TVDUB TVDUBMD TVDUBSTM ZKDDMM ZKDUBFILM ZKDUBMD ZKMDKO ZKMDLF ZKMDLFPW ZKMDLOAD1 ZKMDLOAD2 ZKMDLOAD3 ZMDRKO /end DEF_CHARACTERISTIC
 /begin IN_MEASUREMENT B_acres B_fs B_koe B_komd B_lf1 B_lf1res B_lf2 B_lf2res B_ll B_load1 B_load2 B_load3 B_stend mdgen_w mdkocan nmot pach pach_w psl tabst_w tans tmot tmst tum tvlues1 ubsq /end IN_MEASUREMENT
 /begin OUT_MEASUREMENT B_acfston B_tdmkow dmrac mdacmx mdko mdswl mdverb mdverb_w /end OUT_MEASUREMENT
 /begin LOC_MEASUREMENT B_kofflong B_lldub ctr_ac_on dmdubm dmload2 dubfilm mdkov mdload md_lf tatuko tnacoff_w zkmdo /end LOC_MEASUREMENT
 FUNCTION_VERSION "3.0.0" /end FUNCTION
/begin FUNCTION MDZW "3.2.0" /begin REF_CHARACTERISTIC DZWETA /end REF_CHARACTERISTIC
 /begin IN_MEASUREMENT B_nozwe etazaist etazwvst mifa_w miopt_w mizsol_w zwbas zwopt /end IN_MEASUREMENT
 /begin OUT_MEASUREMENT etazws etazwsol zwsol /end OUT_MEASUREMENT
 /begin LOC_MEASUREMENT dzweta_in dzws etatemp fetatemp mdzw_t1 /end LOC_MEASUREMENT
 FUNCTION_VERSION "3.2.0" /end FUNCTION
/begin FUNCTION MED2ADC "2.1.0" /begin IN_MEASUREMENT rl rl_w rml /end IN_MEASUREMENT
 /begin OUT_MEASUREMENT AirSys_rChCyl AirSys_rChCylLRes AirSys_rChrgCyl AirSys_rMsCyl /end OUT_MEASUREMENT
 FUNCTION_VERSION "2.1.0" /end FUNCTION
/begin FUNCTION MED2BasSvr "2.0.0" /begin IN_MEASUREMENT B_fa B_sttakt /end IN_MEASUREMENT /begin OUT_MEASUREMENT BasSvr_bActrTstReq BasSvr_bFuncTstReq /end OUT_MEASUREMENT FUNCTION_VERSION "2.0.0" /end FUNCTION
/begin FUNCTION MED2BattU "3.8.0" /begin DEF_CHARACTERISTIC BattU_uDfl_C BattU_uNrm_C /end DEF_CHARACTERISTIC /begin IN_MEASUREMENT B_ubpvg ubsq_w /end IN_MEASUREMENT /begin OUT_MEASUREMENT BattU_facCor BattU_u BattU_uRaw BattU_uSens /end OUT_MEASUREMENT FUNCTION_VERSION "3.8.0" /end FUNCTION
/begin FUNCTION MED2CES "1.3.0" /begin IN_MEASUREMENT B_engrest B_stendll B_stendmd B_stendz B_stendzw tistrtdly /end IN_MEASUREMENT
 /begin OUT_MEASUREMENT CoEng_bEngReStrt CoEng_bFrstStrtEnd CoEng_bStrtEndIA CoEng_bStrtEndSpdGov CoEng_bStrtEndTrqStruct CoEng_tiStrtDly /end OUT_MEASUREMENT
 FUNCTION_VERSION "1.3.0" /end FUNCTION
/begin FUNCTION MED2ECT "2.1.0" /begin REF_CHARACTERISTIC MDNORM /end REF_CHARACTERISTIC /begin IN_MEASUREMENT B_kh B_sabbts etakh_w /end IN_MEASUREMENT /begin OUT_MEASUREMENT EGSys_bCH EGSys_bFCORdnCoPr EGSys_etaCH EGSys_trqResvCH /end OUT_MEASUREMENT FUNCTION_VERSION "2.1.0" /end FUNCTION
/begin FUNCTION MED2EDM "1.4.0" /begin IN_MEASUREMENT imlatmz_w tahso_w taikr_w tkihkm_w tkivkm_w /end IN_MEASUREMENT
 /begin OUT_MEASUREMENT CoPOM_mAirMassIntegFrstStrt EGSys_tLSXDstrMnCat EGSys_tManifMod EGSys_tMnCatMod EGSys_tPreCatMod Exh_tTrbnUs /end OUT_MEASUREMENT
 FUNCTION_VERSION "1.4.0" /end FUNCTION
/begin FUNCTION MED2EnvP "1.2.0" /begin DEF_CHARACTERISTIC EnvP_pDfl_C /end DEF_CHARACTERISTIC /begin IN_MEASUREMENT pu_w /end IN_MEASUREMENT /begin OUT_MEASUREMENT EnvP_p /end OUT_MEASUREMENT FUNCTION_VERSION "1.2.0" /end FUNCTION
/begin FUNCTION MED2EnvT "3.1.0" /begin DEF_CHARACTERISTIC EnvT_tDfl_C /end DEF_CHARACTERISTIC /begin IN_MEASUREMENT tumg /end IN_MEASUREMENT /begin OUT_MEASUREMENT EnvT_t EnvT_tMod /end OUT_MEASUREMENT FUNCTION_VERSION "3.1.0" /end FUNCTION
/begin COMPU_METHOD B_TRUE "" TAB_VERB "%6.3" "" COMPU_TAB_REF B_TRUE /end COMPU_METHOD
/begin COMPU_VTAB B_TRUE "" TAB_VERB 2 0 "----" 1 "TRUE" /end COMPU_VTAB
/begin COMPU_METHOD dez "" RAT_FUNC "%6.2" "" COEFFS 0 1 0 0 0 1 /end COMPU_METHOD
/begin COMPU_METHOD Fact "" RAT_FUNC "%6.5" "-" COEFFS 0 8192 0 0 0 1 /end COMPU_METHOD
/begin COMPU_METHOD fak_q0p00153 "" RAT_FUNC "%6.4" "-" COEFFS 0 256 0 0 0 0.390625 /end COMPU_METHOD
/begin COMPU_METHOD fak_q0p0078 "" RAT_FUNC "%6.4" "-" COEFFS 0 128 0 0 0 1 /end COMPU_METHOD
/begin COMPU_METHOD fak_q0p02 "" RAT_FUNC "%6.4" "" COEFFS 0 50 0 0 0 1 /end COMPU_METHOD
/begin COMPU_METHOD fak_q1p5258Em5_kgmmdivNm "" RAT_FUNC "%7.6" "kgm^2/Nm" COEFFS 0 65536 0 0 0 1 /end COMPU_METHOD
/begin COMPU_METHOD fak_q3p0518Em5 "" RAT_FUNC "%7.6" "" COEFFS 0 32768 0 0 0 1 /end COMPU_METHOD
/begin COMPU_METHOD fak_sb_b0p03125 "" RAT_FUNC "%6.5" "-" COEFFS 0 256 0 0 0 0.0625 /end COMPU_METHOD
/begin COMPU_METHOD fak_sb_b2 "" RAT_FUNC "%6.4" "-" COEFFS 0 256 0 0 0 4 /end COMPU_METHOD
/begin COMPU_METHOD fak_sw_b1 "" RAT_FUNC "%7.6" "-" COEFFS 0 65536 0 0 0 2 /end COMPU_METHOD
/begin COMPU_METHOD fak_sw_b10 "" RAT_FUNC "%6.5" "-" COEFFS 0 65536 0 0 0 20 /end COMPU_METHOD
/begin COMPU_METHOD fak_sw_b8 "" RAT_FUNC "%6.5" "-" COEFFS 0 65536 0 0 0 16 /end COMPU_METHOD
/begin COMPU_METHOD fak_ub_b1 "" RAT_FUNC "%6.4" "-" COEFFS 0 256 0 0 0 1 /end COMPU_METHOD
/begin COMPU_METHOD fak_ub_b100 "" RAT_FUNC "%6.3" "" COEFFS 0 255 0 0 0 100 /end COMPU_METHOD
/begin COMPU_METHOD fak_ub_b12p45 "" RAT_FUNC "%6.4" "%" COEFFS 0 2048 0 0 0 100 /end COMPU_METHOD
/begin COMPU_METHOD fak_ub_b16 "" RAT_FUNC "%6.4" "-" COEFFS 0 256 0 0 0 16 /end COMPU_METHOD
/begin COMPU_METHOD fak_ub_b2 "" RAT_FUNC "%8.5" "-" COEFFS 0 256 0 0 0 2 /end COMPU_METHOD
/begin COMPU_METHOD fak_ub_b32 "" RAT_FUNC "%6.3" "-" COEFFS 0 256 0 0 0 32 /end COMPU_METHOD
/begin COMPU_METHOD fak_ub_b4 "" RAT_FUNC "%6.4" "-" COEFFS 0 256 0 0 0 4 /end COMPU_METHOD
/begin COMPU_METHOD fak_ub_b77p81 "" RAT_FUNC "%6.3" "%/s" COEFFS 0 327.68 0 0 0 100 /end COMPU_METHOD
/begin COMPU_METHOD fak_uw_b1 "" RAT_FUNC "%7.6" "-" COEFFS 0 65536 0 0 0 1 /end COMPU_METHOD
/begin COMPU_METHOD fak_uw_b16 "" RAT_FUNC "%6.5" "-" COEFFS 0 65536 0 0 0 16 /end COMPU_METHOD
/begin COMPU_METHOD fak_uw_b2 "" RAT_FUNC "%7.6" "-" COEFFS 0 65536 0 0 0 2 /end COMPU_METHOD
/begin COMPU_METHOD fak_uw_b8 "" RAT_FUNC "%6.5" "-" COEFFS 0 65536 0 0 0 8 /end COMPU_METHOD
/begin COMPU_METHOD md_q0p1 "" RAT_FUNC "%6.3" "Nm" COEFFS 0 10 0 0 0 1 /end COMPU_METHOD
/begin COMPU_METHOD md_ub_q0p1 "" RAT_FUNC "%6.3" "Nm" COEFFS 0 10 0 0 0 1 /end COMPU_METHOD
/begin COMPU_METHOD m_q1p7778Em3_kg "" RAT_FUNC "%6.4" "kg" COEFFS 0 36000 0 0 0 64 /end COMPU_METHOD
/begin COMPU_METHOD m_q2p777Em4_g "" RAT_FUNC "%6.5" "g" COEFFS 0 3600 0 0 0 1 /end COMPU_METHOD
/begin COMPU_METHOD m_ub_q0p0444 "" RAT_FUNC "%6.4" "g" COEFFS 0 1 0 0 0 0.0444 /end COMPU_METHOD
/begin COMPU_METHOD m_uw_b23p3 "" RAT_FUNC "%6.5" "kg" COEFFS 0 2812.5 0 0 0 1 /end COMPU_METHOD
/begin COMPU_METHOD m_uw_b4660 "" RAT_FUNC "%6.4" "g" COEFFS 0 3600 0 0 0 256 /end COMPU_METHOD
/begin COMPU_METHOD m_uw_b6553p5 "" RAT_FUNC "%6.3" "kg/h" COEFFS 0 1 0 0 0 0.1 /end COMPU_METHOD
/begin COMPU_METHOD nmotd_sb_q10 "" RAT_FUNC "%6.1" "1/min" COEFFS 0 1 0 0 0 10 /end COMPU_METHOD
/begin COMPU_METHOD nmotd_sw_q0p25 "" RAT_FUNC "%6.3" "1/min" COEFFS 0 1 0 0 0 0.25 /end COMPU_METHOD
/begin COMPU_METHOD nmotg_sb_q100 "" RAT_FUNC "%6.0" "1/(min*s)" COEFFS 0 1 0 0 0 100 /end COMPU_METHOD
/begin COMPU_METHOD nmotg_sw_q0p39 "" RAT_FUNC "%6.3" "1/(min*s)" COEFFS 0 1 0 0 0 0.39063 /end COMPU_METHOD
/begin COMPU_METHOD nmot_q10 "" RAT_FUNC "%6.1" "1/min" COEFFS 0 1 0 0 0 10 /end COMPU_METHOD
/begin COMPU_METHOD nmot_q4 "" RAT_FUNC "%6.2" "U/min" COEFFS 0 1 0 0 0 4 /end COMPU_METHOD
/begin COMPU_METHOD nmot_q7p8125Em3 "" RAT_FUNC "%6.4" "rpm" COEFFS 0 128 0 0 0 1 /end COMPU_METHOD
/begin COMPU_METHOD nmot_sb_q10 "" RAT_FUNC "%6.1" "1/min" COEFFS 0 1 0 0 0 10 /end COMPU_METHOD
/begin COMPU_METHOD nmot_sw_q0p25 "" RAT_FUNC "%6.3" "1/min" COEFFS 0 1 0 0 0 0.25 /end COMPU_METHOD
/begin COMPU_METHOD nmot_ub_q10 "" RAT_FUNC "%6.1" "1/min" COEFFS 0 1 0 0 0 10 /end COMPU_METHOD
/begin COMPU_METHOD nmot_ub_q40 "" RAT_FUNC "%6.1" "1/min" COEFFS 0 1 0 0 0 40 /end COMPU_METHOD
/begin COMPU_METHOD nmot_uw_q0p25 "" RAT_FUNC "%6.3" "1/min" COEFFS 0 1 0 0 0 0.25 /end COMPU_METHOD
/begin COMPU_METHOD OneToOne "" RAT_FUNC "%6.2" "-" COEFFS 0 1 0 0 0 1 /end COMPU_METHOD
/begin COMPU_METHOD Pres_hPa "" RAT_FUNC "%6.2" "hPa" COEFFS 0 1 0 0 0 1 /end COMPU_METHOD
/begin COMPU_METHOD p_q156p86 "" RAT_FUNC "%6.0" "hPa" COEFFS 0 1 0 0 0 156.86 /end COMPU_METHOD
/begin COMPU_METHOD p_q500 "" RAT_FUNC "%6.0" "hPa" COEFFS 0 1 0 0 0 500 /end COMPU_METHOD
/begin COMPU_METHOD p_sw_q0p9155 "" RAT_FUNC "%6.2" "hPa" COEFFS 0 32767 0 0 0 30000 /end COMPU_METHOD
/begin COMPU_METHOD p_ub_q10 "" RAT_FUNC "%6.1" "hPa" COEFFS 0 1 0 0 0 10 /end COMPU_METHOD
/begin COMPU_METHOD p_uw_q0p039 "" RAT_FUNC "%6.4" "hPa" COEFFS 0 256 0 0 0 10 /end COMPU_METHOD
/begin COMPU_METHOD q0p00305_pc_DIV_rpm "" RAT_FUNC "%6.4" "%/rpm" COEFFS 0 8192 0 0 0 25 /end COMPU_METHOD
/begin COMPU_METHOD q0p0061_pc_DIV_rpm "" RAT_FUNC "%6.4" "%/rpm" COEFFS 0 4096 0 0 0 25 /end COMPU_METHOD
/begin COMPU_METHOD q0p0586_pc_DIV_s "" RAT_FUNC "%6.4" "%/s" COEFFS 0 256 0 0 0 15 /end COMPU_METHOD
/begin COMPU_METHOD q7p63Em5_DIV_s "" RAT_FUNC "%7.6" "1/s" COEFFS 0 65536 0 0 0 5 /end COMPU_METHOD
/begin COMPU_METHOD relDK_q0p02441 "" RAT_FUNC "%6.4" "%DK" COEFFS 0 65536 0 0 0 1600 /end COMPU_METHOD
/begin COMPU_METHOD relDK_ub_b100 "" RAT_FUNC "%6.3" "%DK" COEFFS 0 255 0 0 0 100 /end COMPU_METHOD
/begin COMPU_METHOD relPED_uw_b100 "" RAT_FUNC "%6.4" "%PED" COEFFS 0 65535 0 0 0 100 /end COMPU_METHOD
/begin COMPU_METHOD rel_q0p002383 "" RAT_FUNC "%6.4" "%/(s*1/min)" COEFFS 0 256 0 0 0 0.61 /end COMPU_METHOD
/begin COMPU_METHOD rel_q0p00305 "" RAT_FUNC "%6.4" "%/(1/min)" COEFFS 0 256 0 0 0 0.7812 /end COMPU_METHOD
/begin COMPU_METHOD rel_q0p0234 "" RAT_FUNC "%6.4" "%" COEFFS 0 128 0 0 0 3 /end COMPU_METHOD
/begin COMPU_METHOD rel_q0p02344 "" RAT_FUNC "%6.4" "%" COEFFS 0 32 0 0 0 0.75 /end COMPU_METHOD
/begin COMPU_METHOD rel_q0p1957 "" RAT_FUNC "%6.3" "%" COEFFS 0 511 0 0 0 100 /end COMPU_METHOD
/begin COMPU_METHOD rel_q0p39 "" RAT_FUNC "%6.3" "%" COEFFS 0 256 0 0 0 100 /end COMPU_METHOD
/begin COMPU_METHOD rel_q0p75 "" RAT_FUNC "%6.3" "%" COEFFS 0 4 0 0 0 3 /end COMPU_METHOD
/begin COMPU_METHOD rel_qn0p000488 "" RAT_FUNC "%8.7" "(%*s)/(1/min)" COEFFS 0 -256 0 0 0 0.125 /end COMPU_METHOD
/begin COMPU_METHOD rel_sb_q0p39 "" RAT_FUNC "%6.3" "%" COEFFS 0 1 0 0 0 0.3906 /end COMPU_METHOD
/begin COMPU_METHOD rel_sw_b100 "" RAT_FUNC "%6.4" "%" COEFFS 0 32768 0 0 0 100 /end COMPU_METHOD
/begin COMPU_METHOD rel_sw_b1536 "" RAT_FUNC "%6.4" "%" COEFFS 0 65536 0 0 0 3072 /end COMPU_METHOD
/begin COMPU_METHOD rel_sw_b32 "" RAT_FUNC "%6.5" "%" COEFFS 0 65536 0 0 0 64 /end COMPU_METHOD
/begin COMPU_METHOD rel_sw_b50 "" RAT_FUNC "%6.4" "%" COEFFS 0 65536 0 0 0 100 /end COMPU_METHOD
/begin COMPU_METHOD rel_sw_q0p0234 "" RAT_FUNC "%6.4" "%/seg" COEFFS 0 32 0 0 0 0.75 /end COMPU_METHOD
/begin COMPU_METHOD rel_ub_b100 "" RAT_FUNC "%6.3" "%" COEFFS 0 256 0 0 0 100 /end COMPU_METHOD
/begin COMPU_METHOD rel_ub_b127p5 "" RAT_FUNC "%6.3" "%" COEFFS 0 2 0 0 0 1 /end COMPU_METHOD
/begin COMPU_METHOD rel_ub_b24p9 "" RAT_FUNC "%6.3" "%" COEFFS 0 255 0 0 0 24.9 /end COMPU_METHOD
/begin COMPU_METHOD rel_ub_b50 "" RAT_FUNC "%6.3" "%" COEFFS 0 255 0 0 0 50 /end COMPU_METHOD
/begin COMPU_METHOD rel_ub_b99p6 "" RAT_FUNC "%6.3" "%" COEFFS 0 256 0 0 0 100 /end COMPU_METHOD
/begin COMPU_METHOD rel_ub_bn24p9 "" RAT_FUNC "%6.5" "%" COEFFS 0 -255 0 0 0 24.9 /end COMPU_METHOD
/begin COMPU_METHOD rel_ub_q0p75 "" RAT_FUNC "%6.3" "%" COEFFS 0 1 0 0 0 0.75 /end COMPU_METHOD
/begin COMPU_METHOD rel_uw_b100 "" RAT_FUNC "%6.4" "%" COEFFS 0 65536 0 0 0 100 /end COMPU_METHOD
/begin COMPU_METHOD rel_uw_b127p5 "" RAT_FUNC "%6.4" "%" COEFFS 0 512 0 0 0 1 /end COMPU_METHOD
/begin COMPU_METHOD rel_uw_b200 "" RAT_FUNC "%6.4" "%" COEFFS 0 65536 0 0 0 200 /end COMPU_METHOD
/begin COMPU_METHOD rel_uw_q0p0234 "" RAT_FUNC "%6.4" "%" COEFFS 0 32 0 0 0 0.75 /end COMPU_METHOD
/begin COMPU_METHOD spg_q0p1 "" RAT_FUNC "%6.3" "V" COEFFS 0 1 0 0 0 0.1 /end COMPU_METHOD
/begin COMPU_METHOD spg_ub_q0p0052_o0p2 "" RAT_FUNC "%6.3" "V" COEFFS 0 255 51 0 0 1.33 /end COMPU_METHOD
/begin COMPU_METHOD spg_uw_q0p00488_o1 "" RAT_FUNC "%6.3" "V" COEFFS 0 1024 1024 0 0 5 /end COMPU_METHOD
/begin COMPU_METHOD SY_KLDF_Compu "" TAB_VERB "%6.3" "" COMPU_TAB_REF SY_KLDF_Compu /end COMPU_METHOD
/begin COMPU_VTAB SY_KLDF_Compu "" TAB_VERB 7 0 "kein Generator-Lastsignal vorhanden" 1 "Lastsignal über PWM vorhanden" 2 "Lastsignal über CAN" 4 "Lastsignal über Treiber" 8 "Generator benötigt G-Signal" 3 "Lastsignal über CAN und PWM vorhanden" 6 "Lastsignal über CAN und Treiber" /end COMPU_VTAB
/begin COMPU_METHOD SY_KMTR_Compu "" TAB_VERB "%6.3" "" COMPU_TAB_REF SY_KMTR_Compu /end COMPU_METHOD
/begin COMPU_VTAB SY_KMTR_Compu "" TAB_VERB 2 0 "keine Kuehlmitteltemperaturregelung vorhanden" 1 "Kuehlmitteltemperaturregelung vorhanden" /end COMPU_VTAB
/begin COMPU_METHOD SY_KOLBSC_Compu "" RAT_FUNC "%6.2" "" COEFFS 0 1 0 0 0 1 /end COMPU_METHOD
/begin COMPU_METHOD SY_KONWDK_Compu "" TAB_VERB "%6.3" "" COMPU_TAB_REF SY_KONWDK_Compu /end COMPU_METHOD
/begin COMPU_VTAB SY_KONWDK_Compu "" TAB_VERB 2 0 "keine Koordination zwischen DK (FUEDK) und NWS" 1 "Koordination zwischen DK und NWS" /end COMPU_VTAB
/begin COMPU_METHOD SY_KOP_Compu "" TAB_VERB "%6.3" "" COMPU_TAB_REF SY_KOP_Compu /end COMPU_METHOD
/begin COMPU_VTAB SY_KOP_Compu "" TAB_VERB 2 0 "False" 1 "True" /end COMPU_VTAB
/begin COMPU_METHOD SY_KORRZ_Compu "" RAT_FUNC "%6.2" "" COEFFS 0 1 0 0 0 1 /end COMPU_METHOD
/begin COMPU_METHOD SY_KRADPZI_Compu "" TAB_VERB "%6.3" "" COMPU_TAB_REF SY_KRADPZI_Compu /end COMPU_METHOD
/begin COMPU_VTAB SY_KRADPZI_Compu "" TAB_VERB 2 0 "0" 1 "1" /end COMPU_VTAB
/begin COMPU_METHOD SY_KRK_Compu "" TAB_VERB "%6.3" "" COMPU_TAB_REF SY_KRK_Compu /end COMPU_METHOD
/begin COMPU_VTAB SY_KRK_Compu "" TAB_VERB 2 0 "False" 1 "True" /end COMPU_VTAB
/begin COMPU_METHOD SY_KRLZ_Compu "" TAB_VERB "%6.3" "" COMPU_TAB_REF SY_KRLZ_Compu /end COMPU_METHOD
/begin COMPU_VTAB SY_KRLZ_Compu "" TAB_VERB 2 0 "%KRLZ nicht vorhanden" 1 "%KRLZ vorhanden" /end COMPU_VTAB
/begin COMPU_METHOD SY_KRSAINT_Compu "" TAB_VERB "%6.3" "" COMPU_TAB_REF SY_KRSAINT_Compu /end COMPU_METHOD
/begin COMPU_VTAB SY_KRSAINT_Compu "" TAB_VERB 2 0 "SY_KRSAINT" 1 "SY_KRSAINT" /end COMPU_VTAB
/begin COMPU_METHOD SY_KRSASW_Compu "" TAB_VERB "%6.3" "" COMPU_TAB_REF SY_KRSASW_Compu /end COMPU_METHOD
/begin COMPU_VTAB SY_KRSASW_Compu "" TAB_VERB 2 0 "KNOCKCONTROLEXTERNALSIGNALEVALUATION" 1 "KNOCKCONTROLINTERNALSIGNALEVALUATIONMx17" /end COMPU_VTAB
/begin COMPU_METHOD SY_KRZMF_Compu "" TAB_VERB "%6.3" "" COMPU_TAB_REF SY_KRZMF_Compu /end COMPU_METHOD
/begin COMPU_VTAB SY_KRZMF_Compu "" TAB_VERB 2 0 "False" 1 "True" /end COMPU_VTAB
/begin COMPU_METHOD SY_KS1_Compu "" RAT_FUNC "%6.2" "" COEFFS 0 1 0 0 0 1 /end COMPU_METHOD
/begin COMPU_METHOD SY_KS2_Compu "" RAT_FUNC "%6.2" "" COEFFS 0 1 0 0 0 1 /end COMPU_METHOD
/begin COMPU_METHOD SY_KS3_Compu "" RAT_FUNC "%6.2" "" COEFFS 0 1 0 0 0 1 /end COMPU_METHOD
/begin COMPU_METHOD SY_KS4_Compu "" RAT_FUNC "%6.2" "" COEFFS 0 1 0 0 0 1 /end COMPU_METHOD
/begin COMPU_METHOD SY_KSEINTS_Compu "" TAB_VERB "%6.3" "" COMPU_TAB_REF SY_KSEINTS_Compu /end COMPU_METHOD
/begin COMPU_VTAB SY_KSEINTS_Compu "" TAB_VERB 3 0 "NOSTORAGE" 1 "STORAGE_ED_DEV" 2 "STORAGE_ETKT" /end COMPU_VTAB
/begin COMPU_METHOD SY_KSENCHN_Compu "" RAT_FUNC "%6.2" "" COEFFS 0 1 0 0 0 1 /end COMPU_METHOD
/begin COMPU_METHOD SY_KSENFLT_Compu "" RAT_FUNC "%6.2" "" COEFFS 0 1 0 0 0 1 /end COMPU_METHOD
/begin COMPU_METHOD SY_KSE_Compu "" TAB_VERB "%6.3" "" COMPU_TAB_REF SY_KSE_Compu /end COMPU_METHOD
/begin COMPU_VTAB SY_KSE_Compu "" TAB_VERB 2 0 "False" 1 "True" /end COMPU_VTAB
/begin COMPU_METHOD SY_KSZA_Compu "" TAB_VERB "%6.3" "" COMPU_TAB_REF SY_KSZA_Compu /end COMPU_METHOD
/begin COMPU_VTAB SY_KSZA_Compu "" TAB_VERB 5 0 "number of knock sensors is 0" 1 "number of knock sensors is 1" 2 "number of knock sensors is 2" 3 "number of knock sensors is 3" 4 "number of knock sensors is 4" /end COMPU_VTAB
/begin COMPU_METHOD SY_KTIGNBI_Compu "" TAB_VERB "%6.3" "" COMPU_TAB_REF SY_KTIGNBI_Compu /end COMPU_METHOD
/begin COMPU_VTAB SY_KTIGNBI_Compu "" TAB_VERB 2 0 "False" 1 "True" /end COMPU_VTAB
/begin COMPU_METHOD SY_KT_Compu "" RAT_FUNC "%6.2" "" COEFFS 0 1 0 0 0 1 /end COMPU_METHOD
/begin COMPU_METHOD SY_KUPOT_Compu "" TAB_VERB "%6.3" "" COMPU_TAB_REF SY_KUPOT_Compu /end COMPU_METHOD
/begin COMPU_VTAB SY_KUPOT_Compu "" TAB_VERB 2 0 "kein Kupplungspoti verbaut" 1 "Kupplungspoti verbaut" /end COMPU_VTAB
/begin COMPU_METHOD SY_KWFOSC_Compu "" TAB_VERB "%6.3" "" COMPU_TAB_REF SY_KWFOSC_Compu /end COMPU_METHOD
/begin COMPU_VTAB SY_KWFOSC_Compu "" TAB_VERB 2 0 "KWFOSC_NO" 1 "KWFOSC_YES" /end COMPU_VTAB
/begin COMPU_METHOD SY_LAGENDI_Compu "" TAB_VERB "%6.3" "" COMPU_TAB_REF SY_LAGENDI_Compu /end COMPU_METHOD
/begin COMPU_VTAB SY_LAGENDI_Compu "" TAB_VERB 2 0 "False" 1 "True" /end COMPU_VTAB
/begin COMPU_METHOD SY_LALIM_Compu "" TAB_VERB "%6.3" "" COMPU_TAB_REF SY_LALIM_Compu /end COMPU_METHOD
/begin COMPU_VTAB SY_LALIM_Compu "" TAB_VERB 2 0 "False" 1 "True" /end COMPU_VTAB
/begin COMPU_METHOD SY_LAMKAPP_Compu "" TAB_VERB "%6.3" "" COMPU_TAB_REF SY_LAMKAPP_Compu /end COMPU_METHOD
/begin COMPU_VTAB SY_LAMKAPP_Compu "" TAB_VERB 2 0 "SY_LAMKAPP_NO" 1 "SY_LAMKAPP_YES" /end COMPU_VTAB
/begin COMPU_METHOD SY_LAMNSWLP_Compu "" TAB_VERB "%6.3" "" COMPU_TAB_REF SY_LAMNSWLP_Compu /end COMPU_METHOD
/begin COMPU_VTAB SY_LAMNSWLP_Compu "" TAB_VERB 2 0 "False" 1 "True" /end COMPU_VTAB
/begin COMPU_METHOD SY_LAMOBC_Compu "" TAB_VERB "%6.3" "" COMPU_TAB_REF SY_LAMOBC_Compu /end COMPU_METHOD
/begin COMPU_VTAB SY_LAMOBC_Compu "" TAB_VERB 2 0 "False" 1 "True" /end COMPU_VTAB
/begin COMPU_METHOD SY_LBKMD_Compu "" TAB_VERB "%6.3" "" COMPU_TAB_REF SY_LBKMD_Compu /end COMPU_METHOD
/begin COMPU_VTAB SY_LBKMD_Compu "" TAB_VERB 2 0 "einfache Md-Modellierung LBK" 1 "erweiterte Md-Modellierung LBK (ETADZWL)" /end COMPU_VTAB
/begin COMPU_METHOD SY_LBK_Compu "" TAB_VERB "%6.3" "" COMPU_TAB_REF SY_LBK_Compu /end COMPU_METHOD
/begin COMPU_VTAB SY_LBK_Compu "" TAB_VERB 7 0 "keine Ladungsbewegungsklappe vorhanden" 1 "Ladungsbewegungsklappe ohne Lagerückmeldung vorhan" 2 "Ladungsbewegungsklappe mit Lagerückmeldung vorhand" 3 "Ladungsbewegungsklappe kontiniuierlich mit DC Moto" 4 "Ladungsbewegungsklappe kontinuierlich mit Stepper" 5 "kontinuierliche LBK mit Lageregelung vor Ort" 6 "kontinuierliche LBK mit Lageregelung im SG" /end COMPU_VTAB
/begin COMPU_METHOD SY_LCSS_Compu "" TAB_VERB "%6.3" "" COMPU_TAB_REF SY_LCSS_Compu /end COMPU_METHOD
/begin COMPU_VTAB SY_LCSS_Compu "" TAB_VERB 2 0 "false" 1 "true" /end COMPU_VTAB
/begin COMPU_METHOD SY_LEITMOD_Compu "" TAB_VERB "%6.3" "" COMPU_TAB_REF SY_LEITMOD_Compu /end COMPU_METHOD
/begin COMPU_VTAB SY_LEITMOD_Compu "" TAB_VERB 2 0 "Leitungsmodell nicht aktiv" 1 "Leitungsmodell aktiv" /end COMPU_VTAB
/begin COMPU_METHOD SY_LENKH_Compu "" TAB_VERB "%6.3" "" COMPU_TAB_REF SY_LENKH_Compu /end COMPU_METHOD
/begin COMPU_VTAB SY_LENKH_Compu "" TAB_VERB 2 0 "keine Servolenkung vorhanden" 1 "Servolenkung vorhanden" /end COMPU_VTAB
/begin COMPU_METHOD SY_LF2B_Compu "" TAB_VERB "%6.3" "" COMPU_TAB_REF SY_LF2B_Compu /end COMPU_METHOD
/begin COMPU_VTAB SY_LF2B_Compu "" TAB_VERB 6 0 "0" 1 "1" 2 "2" 3 "3" 4 "4" 255 "255" /end COMPU_VTAB
/begin COMPU_METHOD SY_LFSPWM_Compu "" TAB_VERB "%6.3" "" COMPU_TAB_REF SY_LFSPWM_Compu /end COMPU_METHOD
/begin COMPU_VTAB SY_LFSPWM_Compu "" TAB_VERB 2 0 "False" 1 "True" /end COMPU_VTAB
/begin COMPU_METHOD SY_LLKEO_Compu "" TAB_VERB "%6.3" "" COMPU_TAB_REF SY_LLKEO_Compu /end COMPU_METHOD
/begin COMPU_VTAB SY_LLKEO_Compu "" TAB_VERB 3 2 "INTCOOL_DS" 0 "NO_INTCOOL" 1 "INTCOOL_US" /end COMPU_VTAB
/begin COMPU_METHOD SY_LLSGSTA_Compu "" TAB_VERB "%6.3" "" COMPU_TAB_REF SY_LLSGSTA_Compu /end COMPU_METHOD
/begin COMPU_VTAB SY_LLSGSTA_Compu "" TAB_VERB 2 0 "0" 1 "1" /end COMPU_VTAB
/begin COMPU_METHOD SY_LLS_Compu "" TAB_VERB "%6.3" "" COMPU_TAB_REF SY_LLS_Compu /end COMPU_METHOD
/begin COMPU_VTAB SY_LLS_Compu "" TAB_VERB 4 0 "kein_LLS" 1 "EWD" 2 "ZWD" 3 "Denso_LLS" /end COMPU_VTAB
/begin COMPU_METHOD SY_LOWRA_Compu "" TAB_VERB "%6.3" "" COMPU_TAB_REF SY_LOWRA_Compu /end COMPU_METHOD
/begin COMPU_VTAB SY_LOWRA_Compu "" TAB_VERB 2 0 "FALSE" 1 "TRUE" /end COMPU_VTAB
/begin COMPU_METHOD SY_LR2PAR_Compu "" TAB_VERB "%6.3" "" COMPU_TAB_REF SY_LR2PAR_Compu /end COMPU_METHOD
/begin COMPU_VTAB SY_LR2PAR_Compu "" TAB_VERB 2 0 "Gemeinsame Lambdaregelungsparameter Bank 1/ 2" 1 "Separate Lambdaregelungsparameter Bank 1/ 2" /end COMPU_VTAB
/begin COMPU_METHOD SY_LRATKG_Compu "" TAB_VERB "%6.3" "" COMPU_TAB_REF SY_LRATKG_Compu /end COMPU_METHOD
/begin COMPU_VTAB SY_LRATKG_Compu "" TAB_VERB 2 0 "FALSE" 1 "TRUE" /end COMPU_VTAB
/begin COMPU_METHOD SY_LRAT_Compu "" TAB_VERB "%6.3" "" COMPU_TAB_REF SY_LRAT_Compu /end COMPU_METHOD
/begin COMPU_VTAB SY_LRAT_Compu "" TAB_VERB 2 0 "False" 1 "True" /end COMPU_VTAB
/begin COMPU_METHOD SY_LRDPAR_Compu "" TAB_VERB "%6.3" "" COMPU_TAB_REF SY_LRDPAR_Compu /end COMPU_METHOD
/begin COMPU_VTAB SY_LRDPAR_Compu "" TAB_VERB 2 0 "0" 1 "1" /end COMPU_VTAB
/begin COMPU_METHOD SY_LREBMD_Compu "" TAB_VERB "%6.3" "" COMPU_TAB_REF SY_LREBMD_Compu /end COMPU_METHOD
/begin COMPU_VTAB SY_LREBMD_Compu "" TAB_VERB 4 0 "0 LR and LRHK on at B_mdarv" 1 "1 state set by codeword" 2 "2 LR on, LRHK off at B_mdarv" 3 "3 LR off, LRHK off at B_mdarv" /end COMPU_VTAB
/begin COMPU_METHOD SY_LREBPS_Compu "" TAB_VERB "%6.3" "" COMPU_TAB_REF SY_LREBPS_Compu /end COMPU_METHOD
/begin COMPU_VTAB SY_LREBPS_Compu "" TAB_VERB 2 0 "False" 1 "True" /end COMPU_VTAB
/begin COMPU_METHOD SY_LRFK2_Compu "" TAB_VERB "%6.3" "" COMPU_TAB_REF SY_LRFK2_Compu /end COMPU_METHOD
/begin COMPU_VTAB SY_LRFK2_Compu "" TAB_VERB 2 0 "0" 1 "1" /end COMPU_VTAB
/begin COMPU_METHOD SY_LRFKEF_Compu "" TAB_VERB "%6.3" "" COMPU_TAB_REF SY_LRFKEF_Compu /end COMPU_METHOD
/begin COMPU_VTAB SY_LRFKEF_Compu "" TAB_VERB 2 0 "keine Eigenfrequenzregelung hinter Frontkat" 1 "Eigenfrequenzregelung hinter Frontkat" /end COMPU_VTAB
/begin COMPU_METHOD SY_LRFK_Compu "" TAB_VERB "%6.3" "" COMPU_TAB_REF SY_LRFK_Compu /end COMPU_METHOD
/begin COMPU_VTAB SY_LRFK_Compu "" TAB_VERB 2 0 "0" 1 "1" /end COMPU_VTAB
/begin COMPU_METHOD SY_LRHK2_Compu "" TAB_VERB "%6.3" "" COMPU_TAB_REF SY_LRHK2_Compu /end COMPU_METHOD
/begin COMPU_VTAB SY_LRHK2_Compu "" TAB_VERB 2 0 "0" 1 "1" /end COMPU_VTAB
/begin COMPU_METHOD SY_LRHKEF_Compu "" TAB_VERB "%6.3" "" COMPU_TAB_REF SY_LRHKEF_Compu /end COMPU_METHOD
/begin COMPU_VTAB SY_LRHKEF_Compu "" TAB_VERB 2 0 "false" 1 "true" /end COMPU_VTAB
/begin COMPU_METHOD SY_LRHK_Compu "" TAB_VERB "%6.3" "" COMPU_TAB_REF SY_LRHK_Compu /end COMPU_METHOD
/begin COMPU_VTAB SY_LRHK_Compu "" TAB_VERB 2 0 "0" 1 "1" /end COMPU_VTAB
/begin COMPU_METHOD SY_LRLAIF_Compu "" TAB_VERB "%6.3" "" COMPU_TAB_REF SY_LRLAIF_Compu /end COMPU_METHOD
/begin COMPU_VTAB SY_LRLAIF_Compu "" TAB_VERB 2 0 "false" 1 "true" /end COMPU_VTAB
/begin COMPU_METHOD SY_LRNK_Compu "" TAB_VERB "%6.3" "" COMPU_TAB_REF SY_LRNK_Compu /end COMPU_METHOD
/begin COMPU_VTAB SY_LRNK_Compu "" TAB_VERB 2 0 "False" 1 "True" /end COMPU_VTAB
/begin COMPU_METHOD SY_LRSEZ_Compu "" TAB_VERB "%6.3" "" COMPU_TAB_REF SY_LRSEZ_Compu /end COMPU_METHOD
/begin COMPU_VTAB SY_LRSEZ_Compu "" TAB_VERB 2 0 "keine zylinderindividuelle Lambdaregelung" 1 "zylinderindividuelle Lambdaregelung" /end COMPU_VTAB
/begin COMPU_METHOD SY_LSAGETR_Compu "" TAB_VERB "%6.3" "" COMPU_TAB_REF SY_LSAGETR_Compu /end COMPU_METHOD
/begin COMPU_VTAB SY_LSAGETR_Compu "" TAB_VERB 2 0 "False kein Lastschalt Automatikgetriebe eingebaut" 1 "True Lastschalt Automatikgetriebe eingebaut" /end COMPU_VTAB
/begin COMPU_METHOD SY_LSFHV_Compu "" TAB_VERB "%6.3" "" COMPU_TAB_REF SY_LSFHV_Compu /end COMPU_METHOD
/begin COMPU_VTAB SY_LSFHV_Compu "" TAB_VERB 2 0 "keine Diag.vertauschte Sonden hinter F/H-Kat" 1 "Diagn. vertauschte Sonden hinter Front/Hauptkat" /end COMPU_VTAB
/begin COMPU_METHOD SY_LSFIKR2_Compu "" TAB_VERB "%6.3" "" COMPU_TAB_REF SY_LSFIKR2_Compu /end COMPU_METHOD
/begin COMPU_VTAB SY_LSFIKR2_Compu "" TAB_VERB 2 0 "False" 1 "True" /end COMPU_VTAB
/begin COMPU_METHOD SY_LSFIKR_Compu "" TAB_VERB "%6.3" "" COMPU_TAB_REF SY_LSFIKR_Compu /end COMPU_METHOD
/begin COMPU_VTAB SY_LSFIKR_Compu "" TAB_VERB 2 0 "0" 1 "1" /end COMPU_VTAB
/begin COMPU_METHOD SY_LSFNHK2_Compu "" TAB_VERB "%6.3" "" COMPU_TAB_REF SY_LSFNHK2_Compu /end COMPU_METHOD
/begin COMPU_VTAB SY_LSFNHK2_Compu "" TAB_VERB 2 0 "keine LSF nach Hauptkat in Bank2 verbaut" 1 "LSF nach Hauptkat in Bank2 verbaut" /end COMPU_VTAB
/begin COMPU_METHOD SY_LSFNHK_Compu "" TAB_VERB "%6.3" "" COMPU_TAB_REF SY_LSFNHK_Compu /end COMPU_METHOD
/begin COMPU_VTAB SY_LSFNHK_Compu "" TAB_VERB 2 0 "keine LSF nach Hauptkat verbaut" 1 "LSF nach Hauptkat verbaut" /end COMPU_VTAB
/begin COMPU_METHOD SY_LSFNTL2_Compu "" TAB_VERB "%6.3" "" COMPU_TAB_REF SY_LSFNTL2_Compu /end COMPU_METHOD
/begin COMPU_VTAB SY_LSFNTL2_Compu "" TAB_VERB 2 0 "False" 1 "True" /end COMPU_VTAB
/begin COMPU_METHOD SY_LSFNTL_Compu "" TAB_VERB "%6.3" "" COMPU_TAB_REF SY_LSFNTL_Compu /end COMPU_METHOD
/begin COMPU_VTAB SY_LSFNTL_Compu "" TAB_VERB 2 0 "False" 1 "True" /end COMPU_VTAB
/begin COMPU_METHOD SY_LSFNVK2_Compu "" TAB_VERB "%6.3" "" COMPU_TAB_REF SY_LSFNVK2_Compu /end COMPU_METHOD
/begin COMPU_VTAB SY_LSFNVK2_Compu "" TAB_VERB 2 0 "keine Lambdasonde hinter Frontakat Bank 2" 1 "Lambdasonde hinter Frontakat Bank 2" /end COMPU_VTAB
/begin COMPU_METHOD SY_LSFNVK_Compu "" TAB_VERB "%6.3" "" COMPU_TAB_REF SY_LSFNVK_Compu /end COMPU_METHOD
/begin COMPU_VTAB SY_LSFNVK_Compu "" TAB_VERB 2 0 "keine Lambdasonde hinter dem Frontakat vorhanden" 1 "Lambdasonde hinter dem Frontakat vorhanden" /end COMPU_VTAB
/begin COMPU_METHOD SY_LSFVHK2_Compu "" TAB_VERB "%6.3" "" COMPU_TAB_REF SY_LSFVHK2_Compu /end COMPU_METHOD
/begin COMPU_VTAB SY_LSFVHK2_Compu "" TAB_VERB 2 0 "False" 1 "True" /end COMPU_VTAB
/begin COMPU_METHOD SY_LSFVHK_Compu "" TAB_VERB "%6.3" "" COMPU_TAB_REF SY_LSFVHK_Compu /end COMPU_METHOD
/begin COMPU_VTAB SY_LSFVHK_Compu "" TAB_VERB 2 0 "False" 1 "True" /end COMPU_VTAB
/begin COMPU_METHOD SY_LSFVVK2_Compu "" TAB_VERB "%6.3" "" COMPU_TAB_REF SY_LSFVVK2_Compu /end COMPU_METHOD
/begin COMPU_VTAB SY_LSFVVK2_Compu "" TAB_VERB 2 0 "keine LSF vor Vorkatalysator, Bank2 vorhanden" 1 "LSF vor Vorkatalysator, Bank2 vorhanden" /end COMPU_VTAB
/begin COMPU_METHOD SY_LSFVVK_Compu "" TAB_VERB "%6.3" "" COMPU_TAB_REF SY_LSFVVK_Compu /end COMPU_METHOD
/begin COMPU_VTAB SY_LSFVVK_Compu "" TAB_VERB 2 0 "keine LSF vor Vorkatalysator vorhanden" 1 "LSF vor Vorkatalysator vorhanden" /end COMPU_VTAB
/begin COMPU_METHOD SY_LSFV_Compu "" TAB_VERB "%6.3" "" COMPU_TAB_REF SY_LSFV_Compu /end COMPU_METHOD
/begin COMPU_VTAB SY_LSFV_Compu "" TAB_VERB 2 0 "keine Diag.vertauschte Sonden hinter FrontKat" 1 "Diagnose vertauschte Sonden hinter FrontKat" /end COMPU_VTAB
/begin COMPU_METHOD SY_LSHSTA_Compu "" TAB_VERB "%6.3" "" COMPU_TAB_REF SY_LSHSTA_Compu /end COMPU_METHOD
/begin COMPU_VTAB SY_LSHSTA_Compu "" TAB_VERB 2 0 "False" 1 "True" /end COMPU_VTAB
/begin COMPU_METHOD SY_LSHV_Compu "" TAB_VERB "%6.3" "" COMPU_TAB_REF SY_LSHV_Compu /end COMPU_METHOD
/begin COMPU_VTAB SY_LSHV_Compu "" TAB_VERB 2 0 "keine vertauschte Sonde hinter Kat im System" 1 "vertauschte Sonde hinter Kat im System vorhanden" /end COMPU_VTAB
/begin COMPU_METHOD SY_LSUIKR2_Compu "" TAB_VERB "%6.3" "" COMPU_TAB_REF SY_LSUIKR2_Compu /end COMPU_METHOD
/begin COMPU_VTAB SY_LSUIKR2_Compu "" TAB_VERB 2 0 "keine LSU im Abgaskrümmer Bank2 vorhanden" 1 "LSU im Abgaskrümmer Bank2 vorhanden" /end COMPU_VTAB
/begin COMPU_METHOD SY_LSUIKR_Compu "" TAB_VERB "%6.3" "" COMPU_TAB_REF SY_LSUIKR_Compu /end COMPU_METHOD
/begin COMPU_VTAB SY_LSUIKR_Compu "" TAB_VERB 2 0 "keine LSU im Abgaskrümmer vorhanden" 1 "LSU im Abgaskrümmer vorhanden" /end COMPU_VTAB
/begin COMPU_METHOD SY_LSUMRS_Compu "" TAB_VERB "%6.3" "" COMPU_TAB_REF SY_LSUMRS_Compu /end COMPU_METHOD
/begin COMPU_VTAB SY_LSUMRS_Compu "" TAB_VERB 2 0 "keine %LSUMRS vorhanden" 1 "%LSUMRS vorhanden" /end COMPU_VTAB
/begin COMPU_METHOD SY_LSUNHK2_Compu "" TAB_VERB "%6.3" "" COMPU_TAB_REF SY_LSUNHK2_Compu /end COMPU_METHOD
/begin COMPU_VTAB SY_LSUNHK2_Compu "" TAB_VERB 2 0 "LSU nicht nach Hauptkat, Bank2 verbaut" 1 "LSU nach Hauptkat, Bank2 verbaut" /end COMPU_VTAB
/begin COMPU_METHOD SY_LSUNHK_Compu "" TAB_VERB "%6.3" "" COMPU_TAB_REF SY_LSUNHK_Compu /end COMPU_METHOD
/begin COMPU_VTAB SY_LSUNHK_Compu "" TAB_VERB 2 0 "keine LSU nach Hauptkatalysator" 1 "LSU nach Hauptkatalysator" /end COMPU_VTAB
/begin COMPU_METHOD SY_LSUNTL2_Compu "" TAB_VERB "%6.3" "" COMPU_TAB_REF SY_LSUNTL2_Compu /end COMPU_METHOD
/begin COMPU_VTAB SY_LSUNTL2_Compu "" TAB_VERB 2 0 "keine LSU nach Abgasturbolader, Bank2" 1 "LSU nach Abgasturbolader, Bank2" /end COMPU_VTAB
/begin COMPU_METHOD SY_LSUNTL_Compu "" TAB_VERB "%6.3" "" COMPU_TAB_REF SY_LSUNTL_Compu /end COMPU_METHOD
/begin COMPU_VTAB SY_LSUNTL_Compu "" TAB_VERB 2 0 "keine LSU nach Abgasturbolader" 1 "LSU nach Abgasturbolader" /end COMPU_VTAB
/begin COMPU_METHOD SY_LSUNVK2_Compu "" TAB_VERB "%6.3" "" COMPU_TAB_REF SY_LSUNVK2_Compu /end COMPU_METHOD
/begin COMPU_VTAB SY_LSUNVK2_Compu "" TAB_VERB 2 0 "keine LSU nach Vorkat, Bank 2" 1 "LSU nach Vorkatalysator, Bank 2 verbaut" /end COMPU_VTAB
/begin COMPU_METHOD SY_LSUNVK_Compu "" TAB_VERB "%6.3" "" COMPU_TAB_REF SY_LSUNVK_Compu /end COMPU_METHOD
/begin COMPU_VTAB SY_LSUNVK_Compu "" TAB_VERB 2 0 "keine LSU nach Vorkatalysator" 1 "LSU nach Vorkatalysator" /end COMPU_VTAB
/begin COMPU_METHOD SY_LSUVHK2_Compu "" TAB_VERB "%6.3" "" COMPU_TAB_REF SY_LSUVHK2_Compu /end COMPU_METHOD
/begin COMPU_VTAB SY_LSUVHK2_Compu "" TAB_VERB 2 0 "keine LSU vor Hauptkatalysator, Bank 2 verbaut" 1 "LSU vor Hauptkatalysator, Bank 2 verbaut" /end COMPU_VTAB
/begin COMPU_METHOD SY_LSUVHK_Compu "" TAB_VERB "%6.3" "" COMPU_TAB_REF SY_LSUVHK_Compu /end COMPU_METHOD
/begin COMPU_VTAB SY_LSUVHK_Compu "" TAB_VERB 2 0 "keine LSU vor Hauptkatalysator" 1 "LSU vor Hauptkatalysator" /end COMPU_VTAB
/begin COMPU_METHOD SY_LSUVVK2_Compu "" TAB_VERB "%6.3" "" COMPU_TAB_REF SY_LSUVVK2_Compu /end COMPU_METHOD
/begin COMPU_VTAB SY_LSUVVK2_Compu "" TAB_VERB 2 0 "keine LSU vor Vorkatalysator, Bank2" 1 "LSU vor Vorkatalysator, Bank2" /end COMPU_VTAB
/begin COMPU_METHOD SY_LSUVVK_Compu "" TAB_VERB "%6.3" "" COMPU_TAB_REF SY_LSUVVK_Compu /end COMPU_METHOD
/begin COMPU_VTAB SY_LSUVVK_Compu "" TAB_VERB 2 0 "keine LSU vor Vorkatalysator" 1 "LSU vor Vorkatalysator" /end COMPU_VTAB
/begin COMPU_METHOD SY_LSVSTA_Compu "" TAB_VERB "%6.3" "" COMPU_TAB_REF SY_LSVSTA_Compu /end COMPU_METHOD
/begin COMPU_VTAB SY_LSVSTA_Compu "" TAB_VERB 2 0 "False" 1 "True" /end COMPU_VTAB
/begin COMPU_METHOD SY_LSVV_Compu "" TAB_VERB "%6.3" "" COMPU_TAB_REF SY_LSVV_Compu /end COMPU_METHOD
/begin COMPU_VTAB SY_LSVV_Compu "" TAB_VERB 2 0 "keine Diag.vertauschte Sonden vor Vorkat" 1 "Diagnose vertauschte Sonden vor Vorkat vorhanden" /end COMPU_VTAB
/begin COMPU_METHOD SY_LSZYVER_Compu "" TAB_VERB "%6.3" "" COMPU_TAB_REF SY_LSZYVER_Compu /end COMPU_METHOD
/begin COMPU_VTAB SY_LSZYVER_Compu "" TAB_VERB 2 0 "False" 1 "True" /end COMPU_VTAB
/begin COMPU_METHOD SY_LS_Compu "" TAB_VERB "%6.3" "" COMPU_TAB_REF SY_LS_Compu /end COMPU_METHOD
/begin COMPU_VTAB SY_LS_Compu "" TAB_VERB 2 0 "Lambda-Split nicht vorhanden" 1 "Lambda-Split vorhanden" /end COMPU_VTAB
/begin COMPU_METHOD SY_LUARMN_Compu "" TAB_VERB "%6.3" "" COMPU_TAB_REF SY_LUARMN_Compu /end COMPU_METHOD
/begin COMPU_VTAB SY_LUARMN_Compu "" TAB_VERB 2 0 "Min value limitation not available" 1 "Min value limitation available" /end COMPU_VTAB
/begin COMPU_METHOD SY_LUART_Compu "" TAB_VERB "%6.3" "" COMPU_TAB_REF SY_LUART_Compu /end COMPU_METHOD
/begin COMPU_VTAB SY_LUART_Compu "" TAB_VERB 2 0 "Lüfter gesteuert" 1 "Lüfter geschaltet" /end COMPU_VTAB
/begin COMPU_METHOD SY_LUEKONF_Compu "" RAT_FUNC "%6.2" "" COEFFS 0 1 0 0 0 1 /end COMPU_METHOD
/begin COMPU_METHOD SY_LUEX_Compu "" TAB_VERB "%6.3" "" COMPU_TAB_REF SY_LUEX_Compu /end COMPU_METHOD
/begin COMPU_VTAB SY_LUEX_Compu "" TAB_VERB 2 0 "SY_LUEX = 0" 1 "SY_LUEX = 1" /end COMPU_VTAB
/begin COMPU_METHOD SY_LUFAK_Compu "" RAT_FUNC "%6.2" "" COEFFS 0 1 0 0 0 1 /end COMPU_METHOD
/begin COMPU_METHOD SY_LUFIKL_Compu "" TAB_VERB "%6.3" "" COMPU_TAB_REF SY_LUFIKL_Compu /end COMPU_METHOD
/begin COMPU_VTAB SY_LUFIKL_Compu "" TAB_VERB 2 0 "keine Luftfilterklappe vorhanden" 1 "Luftfilterklappe vorhanden" /end COMPU_VTAB
/begin COMPU_METHOD SY_LUSRKR_Compu "" TAB_VERB "%6.3" "" COMPU_TAB_REF SY_LUSRKR_Compu /end COMPU_METHOD
/begin COMPU_VTAB SY_LUSRKR_Compu "" TAB_VERB 3 0 "no Scavenging" 1 "Scavenging with Inlet Cam Phasing" 2 "Scavenging with Inlet and Exhaust Cam Phasing" /end COMPU_VTAB
/begin COMPU_METHOD SY_M8TE_Compu "" TAB_VERB "%6.3" "" COMPU_TAB_REF SY_M8TE_Compu /end COMPU_METHOD
/begin COMPU_VTAB SY_M8TE_Compu "" TAB_VERB 2 0 "False" 1 "True" /end COMPU_VTAB
/begin COMPU_METHOD SY_MAGER_Compu "" TAB_VERB "%6.3" "" COMPU_TAB_REF SY_MAGER_Compu /end COMPU_METHOD
/begin COMPU_VTAB SY_MAGER_Compu "" TAB_VERB 2 0 "kein Magerbetrieb erlaubt" 1 "Magerbetrieb erlaubt" /end COMPU_VTAB
/begin COMPU_METHOD SY_MDBASOG_Compu "" TAB_VERB "%6.3" "" COMPU_TAB_REF SY_MDBASOG_Compu /end COMPU_METHOD
/begin COMPU_VTAB SY_MDBASOG_Compu "" TAB_VERB 2 0 "False" 1 "True" /end COMPU_VTAB
/begin COMPU_METHOD SY_MDBGAGR_Compu "" TAB_VERB "%6.3" "" COMPU_TAB_REF SY_MDBGAGR_Compu /end COMPU_METHOD
/begin COMPU_VTAB SY_MDBGAGR_Compu "" TAB_VERB 2 0 "False" 1 "True" /end COMPU_VTAB
/begin COMPU_METHOD SY_MDBGAT_Compu "" TAB_VERB "%6.3" "" COMPU_TAB_REF SY_MDBGAT_Compu /end COMPU_METHOD
/begin COMPU_VTAB SY_MDBGAT_Compu "" TAB_VERB 2 0 "inaktiv" 1 "aktiv" /end COMPU_VTAB
/begin COMPU_METHOD SY_MDBGHS_Compu "" TAB_VERB "%6.3" "" COMPU_TAB_REF SY_MDBGHS_Compu /end COMPU_METHOD
/begin COMPU_VTAB SY_MDBGHS_Compu "" TAB_VERB 2 0 "False" 1 "True" /end COMPU_VTAB
/begin COMPU_METHOD SY_MDBGTI_Compu "" TAB_VERB "%6.3" "" COMPU_TAB_REF SY_MDBGTI_Compu /end COMPU_METHOD
/begin COMPU_VTAB SY_MDBGTI_Compu "" TAB_VERB 2 0 "0" 1 "1" /end COMPU_VTAB
/begin COMPU_METHOD SY_MDBGTM_Compu "" TAB_VERB "%6.3" "" COMPU_TAB_REF SY_MDBGTM_Compu /end COMPU_METHOD
/begin COMPU_VTAB SY_MDBGTM_Compu "" TAB_VERB 2 0 "False" 1 "True" /end COMPU_VTAB
/begin COMPU_METHOD t100msxs_ub_b25p5 "" RAT_FUNC "%6.3" "s" COEFFS 0 1 0 0 0 0.1 /end COMPU_METHOD
/begin COMPU_METHOD t10msxs_uw_b655p35 "" RAT_FUNC "%6.4" "s" COEFFS 0 1 0 0 0 0.01 /end COMPU_METHOD
/begin COMPU_METHOD t1sxs_uw_q1 "" RAT_FUNC "%6.2" "s" COEFFS 0 1 0 0 0 1 /end COMPU_METHOD
/begin COMPU_METHOD t200msxs_ub_b51 "" RAT_FUNC "%6.3" "s" COEFFS 0 1 0 0 0 0.2 /end COMPU_METHOD
/begin COMPU_METHOD t200msxs_uw_q0p2 "" RAT_FUNC "%6.3" "s" COEFFS 0 1 0 0 0 0.2 /end COMPU_METHOD
/begin COMPU_METHOD t20msxs_ub_b5p1 "" RAT_FUNC "%6.4" "s" COEFFS 0 1 0 0 0 0.02 /end COMPU_METHOD
/begin COMPU_METHOD t20msxs_uw_b1310 "" RAT_FUNC "%6.4" "s" COEFFS 0 1 0 0 0 0.02 /end COMPU_METHOD
/begin COMPU_METHOD t20msxs_uw_q0p02 "" RAT_FUNC "%6.4" "s" COEFFS 0 1 0 0 0 0.02 /end COMPU_METHOD
/begin COMPU_METHOD Temp_Cels "" RAT_FUNC "%6.1" "deg C" COEFFS 0 10 2731.4 0 0 1 /end COMPU_METHOD
/begin COMPU_METHOD temp_q0p0234_o273 "" RAT_FUNC "%6.1" "Grad C" COEFFS 0 1 273.15 0 0 0.0234375 /end COMPU_METHOD
/begin COMPU_METHOD temp_q0p1_o273 "" RAT_FUNC "%6.1" "Grad C" COEFFS 0 10 2731.4 0 0 1 /end COMPU_METHOD
/begin COMPU_METHOD temp_ub_q0p75_o48 "" RAT_FUNC "%6.2" "Grad C" COEFFS 0 1 48 0 0 0.75 /end COMPU_METHOD
/begin COMPU_METHOD Time_ms "" RAT_FUNC "%6.1" "ms" COEFFS 0 0.1 0 0 0 1 /end COMPU_METHOD
/begin COMPU_METHOD t_q0p01 "" RAT_FUNC "%6.4" "" COEFFS 0 100 0 0 0 1 /end COMPU_METHOD
/begin COMPU_METHOD t_q0p02 "" RAT_FUNC "%6.4" "s" COEFFS 0 100 0 0 0 2 /end COMPU_METHOD
/begin COMPU_METHOD t_q0p1 "" RAT_FUNC "%6.3" "s" COEFFS 0 10 0 0 0 1 /end COMPU_METHOD
/begin COMPU_METHOD t_q0p2 "" RAT_FUNC "%6.3" "s" COEFFS 0 10 0 0 0 2 /end COMPU_METHOD
/begin COMPU_METHOD t_q2p0345Em3 "" RAT_FUNC "%6.4" "s" COEFFS 0 12288 0 0 0 25 /end COMPU_METHOD
/begin COMPU_METHOD vfzg_ub_q1p25 "" RAT_FUNC "%6.2" "km/h" COEFFS 0 1 0 0 0 1.25 /end COMPU_METHOD
/begin COMPU_METHOD vfzg_uw_b512 "" RAT_FUNC "%6.4" "km/h" COEFFS 0 65536 0 0 0 512 /end COMPU_METHOD
/begin COMPU_METHOD Volt "" RAT_FUNC "%6.3" "mV" COEFFS 0 5 0 0 0 1 /end COMPU_METHOD
/begin COMPU_METHOD Volt_Batt "" RAT_FUNC "%6.1" "mV" COEFFS 0 0.05 0 0 0 1 /end COMPU_METHOD
/begin COMPU_METHOD zk100msxs_uw_b6553p6 "" RAT_FUNC "%6.1" "s" COEFFS 0 0 65536 0 10 0 /end COMPU_METHOD
/begin COMPU_METHOD zk10msxs_ub_b2p55 "" RAT_FUNC "%6.4" "s" COEFFS 0 0 255 0 100 0 /end COMPU_METHOD
/begin COMPU_METHOD zk10msxs_uw_b655 "" RAT_FUNC "%6.2" "s" COEFFS 0 0 65536 0 100 0 /end COMPU_METHOD
/begin COMPU_METHOD zk10msxs_uw_b655p36 "" RAT_FUNC "%6.2" "s" COEFFS 0 0 65536 0 100 0 /end COMPU_METHOD
/begin COMPU_METHOD zk200msxs_uw_b13107 "" RAT_FUNC "%6.0" "s" COEFFS 0 0 13107.2 0 1 0 /end COMPU_METHOD
/begin COMPU_METHOD zk20msxs_ub_b5p1 "" RAT_FUNC "%6.4" "s" COEFFS 0 0 5.1 0 1 0 /end COMPU_METHOD
/begin COMPU_METHOD zk20msxs_uw_b1310 "" RAT_FUNC "%6.1" "s" COEFFS 0 0 65536 0 50 0 /end COMPU_METHOD
/begin COMPU_METHOD zk20msxs_uw_b1310p72 "" RAT_FUNC "%6.1" "s" COEFFS 0 0 65536 0 50 0 /end COMPU_METHOD
/begin COMPU_METHOD zk20msxs_uw_b655 "" RAT_FUNC "%6.1" "s" COEFFS 0 0 65536 0 50 0 /end COMPU_METHOD
/begin COMPU_METHOD zk50msxs_ub_b12p8 "" RAT_FUNC "%6.3" "s" COEFFS 0 0 256 0 20 0 /end COMPU_METHOD
/begin COMPU_METHOD zw_sb_q0p75 "" RAT_FUNC "%6.3" "Grad KW" COEFFS 0 255 0 0 0 191.25 /end COMPU_METHOD
/begin RECORD_LAYOUT FklWU16 FNC_VALUES 1 UWORD COLUMN_DIR DIRECT /end RECORD_LAYOUT
/begin RECORD_LAYOUT FklWU8 FNC_VALUES 1 UBYTE COLUMN_DIR DIRECT /end RECORD_LAYOUT
/begin RECORD_LAYOUT GkfWS16 FNC_VALUES 1 SWORD COLUMN_DIR DIRECT /end RECORD_LAYOUT
/begin RECORD_LAYOUT GkfWS8 FNC_VALUES 1 SBYTE COLUMN_DIR DIRECT /end RECORD_LAYOUT
/begin RECORD_LAYOUT GkfWU16 FNC_VALUES 1 UWORD COLUMN_DIR DIRECT /end RECORD_LAYOUT
/begin RECORD_LAYOUT GkfWU8 FNC_VALUES 1 UBYTE COLUMN_DIR DIRECT /end RECORD_LAYOUT
/begin RECORD_LAYOUT GklWS16 FNC_VALUES 1 SWORD COLUMN_DIR DIRECT /end RECORD_LAYOUT
/begin RECORD_LAYOUT GklWS8 FNC_VALUES 1 SBYTE COLUMN_DIR DIRECT /end RECORD_LAYOUT
/begin RECORD_LAYOUT GklWU16 FNC_VALUES 1 UWORD COLUMN_DIR DIRECT /end RECORD_LAYOUT
/begin RECORD_LAYOUT GklWU8 FNC_VALUES 1 UBYTE COLUMN_DIR DIRECT /end RECORD_LAYOUT
/begin RECORD_LAYOUT KfAxU8AyU8SstxS16SstyS16WS16 NO_AXIS_PTS_X 1 SWORD NO_AXIS_PTS_Y 2 SWORD AXIS_PTS_X 3 SWORD INDEX_INCR DIRECT AXIS_PTS_Y 4 SWORD INDEX_INCR DIRECT FNC_VALUES 5 SWORD COLUMN_DIR DIRECT /end RECORD_LAYOUT
/begin RECORD_LAYOUT KfAxU8AyU8SstxS16SstyU8WS16 NO_AXIS_PTS_X 1 UBYTE NO_AXIS_PTS_Y 2 UBYTE AXIS_PTS_X 3 SWORD INDEX_INCR DIRECT AXIS_PTS_Y 4 UBYTE INDEX_INCR DIRECT FNC_VALUES 5 SWORD COLUMN_DIR DIRECT /end RECORD_LAYOUT
/begin RECORD_LAYOUT KfAxU8AyU8SstxS8SstyU8WU8 NO_AXIS_PTS_X 1 UBYTE NO_AXIS_PTS_Y 2 UBYTE AXIS_PTS_X 3 SBYTE INDEX_INCR DIRECT AXIS_PTS_Y 4 UBYTE INDEX_INCR DIRECT FNC_VALUES 5 UBYTE COLUMN_DIR DIRECT /end RECORD_LAYOUT
/begin RECORD_LAYOUT KfAxU8AyU8SstxU16SstyU16WU16 NO_AXIS_PTS_X 1 UWORD NO_AXIS_PTS_Y 2 UWORD AXIS_PTS_X 3 UWORD INDEX_INCR DIRECT AXIS_PTS_Y 4 UWORD INDEX_INCR DIRECT FNC_VALUES 5 UWORD COLUMN_DIR DIRECT /end RECORD_LAYOUT
/begin RECORD_LAYOUT KfAxU8AyU8SstxU8SstyU16WU16 NO_AXIS_PTS_X 1 UBYTE NO_AXIS_PTS_Y 2 UBYTE AXIS_PTS_X 3 UBYTE INDEX_INCR DIRECT AXIS_PTS_Y 4 UWORD INDEX_INCR DIRECT FNC_VALUES 5 UWORD COLUMN_DIR DIRECT /end RECORD_LAYOUT
/begin RECORD_LAYOUT KfAxU8AyU8SstxU8SstyU16WU8 NO_AXIS_PTS_X 1 UBYTE NO_AXIS_PTS_Y 2 UBYTE AXIS_PTS_X 3 UBYTE INDEX_INCR DIRECT AXIS_PTS_Y 4 UWORD INDEX_INCR DIRECT FNC_VALUES 5 UBYTE COLUMN_DIR DIRECT /end RECORD_LAYOUT
/begin RECORD_LAYOUT KfAxU8AyU8SstxU8SstyU8WU8 NO_AXIS_PTS_X 1 UBYTE NO_AXIS_PTS_Y 2 UBYTE AXIS_PTS_X 3 UBYTE INDEX_INCR DIRECT AXIS_PTS_Y 4 UBYTE INDEX_INCR DIRECT FNC_VALUES 5 UBYTE COLUMN_DIR DIRECT /end RECORD_LAYOUT
/begin RECORD_LAYOUT KlAUbSstSwWUw NO_AXIS_PTS_X 1 UWORD AXIS_PTS_X 2 SWORD INDEX_INCR DIRECT FNC_VALUES 3 UWORD COLUMN_DIR DIRECT /end RECORD_LAYOUT
/begin RECORD_LAYOUT KlAxU8SstxS16WS16 NO_AXIS_PTS_X 1 SWORD AXIS_PTS_X 2 SWORD INDEX_INCR DIRECT FNC_VALUES 3 SWORD COLUMN_DIR DIRECT /end RECORD_LAYOUT
/begin RECORD_LAYOUT KlAxU8SstxS16WU16 NO_AXIS_PTS_X 1 UWORD AXIS_PTS_X 2 SWORD INDEX_INCR DIRECT FNC_VALUES 3 UWORD COLUMN_DIR DIRECT /end RECORD_LAYOUT
/begin RECORD_LAYOUT KlAxU8SstxS8WS8 NO_AXIS_PTS_X 1 SBYTE AXIS_PTS_X 2 SBYTE INDEX_INCR DIRECT FNC_VALUES 3 SBYTE COLUMN_DIR DIRECT /end RECORD_LAYOUT
/begin RECORD_LAYOUT KlAxU8SstxS8WU8 NO_AXIS_PTS_X 1 UBYTE AXIS_PTS_X 2 SBYTE INDEX_INCR DIRECT FNC_VALUES 3 UBYTE COLUMN_DIR DIRECT /end RECORD_LAYOUT
/begin RECORD_LAYOUT KlAxU8SstxU16WS16 NO_AXIS_PTS_X 1 UWORD AXIS_PTS_X 2 UWORD INDEX_INCR DIRECT FNC_VALUES 3 SWORD COLUMN_DIR DIRECT /end RECORD_LAYOUT
/begin RECORD_LAYOUT KlAxU8SstxU16WU16 NO_AXIS_PTS_X 1 UWORD AXIS_PTS_X 2 UWORD INDEX_INCR DIRECT FNC_VALUES 3 UWORD COLUMN_DIR DIRECT /end RECORD_LAYOUT
/begin RECORD_LAYOUT KlAxU8SstxU16WU8 NO_AXIS_PTS_X 1 UWORD AXIS_PTS_X 2 UWORD INDEX_INCR DIRECT FNC_VALUES 3 UBYTE COLUMN_DIR DIRECT /end RECORD_LAYOUT
/begin RECORD_LAYOUT KlAxU8SstxU8WS8 NO_AXIS_PTS_X 1 UBYTE AXIS_PTS_X 2 UBYTE INDEX_INCR DIRECT FNC_VALUES 3 SBYTE COLUMN_DIR DIRECT /end RECORD_LAYOUT
/begin RECORD_LAYOUT KlAxU8SstxU8WU16 NO_AXIS_PTS_X 1 UBYTE AXIS_PTS_X 2 UBYTE INDEX_INCR DIRECT FNC_VALUES 3 UWORD COLUMN_DIR DIRECT /end RECORD_LAYOUT
/begin RECORD_LAYOUT KlAxU8SstxU8WU8 NO_AXIS_PTS_X 1 UBYTE AXIS_PTS_X 2 UBYTE INDEX_INCR DIRECT FNC_VALUES 3 UBYTE COLUMN_DIR DIRECT /end RECORD_LAYOUT
/begin RECORD_LAYOUT KwUb FNC_VALUES 1 UBYTE COLUMN_DIR DIRECT /end RECORD_LAYOUT
/begin RECORD_LAYOUT KwUw FNC_VALUES 1 UWORD COLUMN_DIR DIRECT /end RECORD_LAYOUT
/begin RECORD_LAYOUT KwWS16 FNC_VALUES 1 SWORD COLUMN_DIR DIRECT /end RECORD_LAYOUT
/begin RECORD_LAYOUT KwWS8 FNC_VALUES 1 SBYTE COLUMN_DIR DIRECT /end RECORD_LAYOUT
/begin RECORD_LAYOUT KwWU16 FNC_VALUES 1 UWORD COLUMN_DIR DIRECT /end RECORD_LAYOUT
/begin RECORD_LAYOUT KwWU8 FNC_VALUES 1 UBYTE COLUMN_DIR DIRECT /end RECORD_LAYOUT
/begin RECORD_LAYOUT SstAU8SstS16 NO_AXIS_PTS_X 1 SWORD AXIS_PTS_X 2 SWORD INDEX_INCR DIRECT /end RECORD_LAYOUT
/begin RECORD_LAYOUT SstAU8SstS8 NO_AXIS_PTS_X 1 SBYTE AXIS_PTS_X 2 SBYTE INDEX_INCR DIRECT /end RECORD_LAYOUT
/begin RECORD_LAYOUT SstAU8SstU16 NO_AXIS_PTS_X 1 UWORD AXIS_PTS_X 2 UWORD INDEX_INCR DIRECT /end RECORD_LAYOUT
/begin RECORD_LAYOUT SstAU8SstU8 NO_AXIS_PTS_X 1 UBYTE AXIS_PTS_X 2 UBYTE INDEX_INCR DIRECT /end RECORD_LAYOUT
/begin RECORD_LAYOUT SstAUbSstUb NO_AXIS_PTS_X 1 UBYTE AXIS_PTS_X 2 UBYTE INDEX_INCR DIRECT /end RECORD_LAYOUT
/begin RECORD_LAYOUT SstAUwSstUw NO_AXIS_PTS_X 1 UWORD AXIS_PTS_X 2 UWORD INDEX_INCR DIRECT /end RECORD_LAYOUT
/end MODULE
/end PROJECT
