ASAP2_VERSION 1 4
/begin PROJECT M17955S3CC411_110Y0320 "M17955S3CC411_110Y0320"
/begin HEADER "" VERSION "M17955S3CC411_110Y0320" PROJECT_NO M17955S3CC411_110Y0320 /end HEADER
/begin MODULE DIM ""
/begin MOD_COMMON "" BYTE_ORDER MSB_LAST ALIGNMENT_BYTE 1 ALIGNMENT_WORD 2 ALIGNMENT_LONG 4 ALIGNMENT_FLOAT32_IEEE 4 /end MOD_COMMON
/begin CHARACTERISTIC Blwr_tiDebHw2Actv_C "" VALUE 0x80041F4C Val_Ws16 655.3500 Time_s -327.6800 327.6700 FORMAT "%8.4" /end CHARACTERISTIC
/begin CHARACTERISTIC Blwr_tiDebHw2Off_C "" VALUE 0x80041F4E Val_Ws16 655.3500 Time_s -327.6800 327.6700 FORMAT "%8.4" /end CHARACTERISTIC
/begin CHARACTERISTIC Brk_MnDeb.tiHiLo_C "" VALUE 0x8004BBF6 Kw_Ws16 655350.0 TimeDeb -327680.0 327670.0 FORMAT "%8.1" /end CHARACTERISTIC
/begin CHARACTERISTIC Brk_MnDeb.tiLoHi_C "" VALUE 0x8004BBF8 Kw_Ws16 655350.0 TimeDeb -327680.0 327670.0 FORMAT "%8.1" /end CHARACTERISTIC
/begin CHARACTERISTIC Brk_RedDeb.tiHiLo_C "" VALUE 0x8004BBFA Kw_Ws16 655350.0 TimeDeb -327680.0 327670.0 FORMAT "%8.1" /end CHARACTERISTIC
/begin CHARACTERISTIC Brk_RedDeb.tiLoHi_C "" VALUE 0x8004BBFC Kw_Ws16 655350.0 TimeDeb -327680.0 327670.0 FORMAT "%8.1" /end CHARACTERISTIC
/begin CHARACTERISTIC Brk_stDflVal_C "" VALUE 0x8004BBFE Val_Wu8 255.0 OneToOne 0.00 255.0 FORMAT "%5.1" /end CHARACTERISTIC
/begin CHARACTERISTIC Brk_swtRedSensPrs_C "" VALUE 0x8004BC00 Val_Wu8 1.000 OneToOne 0.00 1.000 FORMAT "%5.3" /end CHARACTERISTIC
/begin CHARACTERISTIC Brk_swtSig_C "" VALUE 0x8004BBFF Val_Wu8 255.0 OneToOne 0.00 255.0 FORMAT "%5.1" /end CHARACTERISTIC
/begin CHARACTERISTIC Clth_Deb.tiHiLo_C "" VALUE 0x8004BC02 Kw_Ws16 655350.0 TimeDeb -327680.0 327670.0 FORMAT "%8.1" /end CHARACTERISTIC
/begin CHARACTERISTIC Clth_Deb.tiLoHi_C "" VALUE 0x8004BC04 Kw_Ws16 655350.0 TimeDeb -327680.0 327670.0 FORMAT "%8.1" /end CHARACTERISTIC
/begin CHARACTERISTIC Clth_nPlausClsd_C "" VALUE 0x8004BC0C Val_Ws16 6000.000 EngN 0.00 6000.000 FORMAT "%8.3" /end CHARACTERISTIC
/begin CHARACTERISTIC Clth_nPlausOpn_C "" VALUE 0x8004BC0E Val_Ws16 6000.000 EngN 0.00 6000.000 FORMAT "%8.3" /end CHARACTERISTIC
/begin CHARACTERISTIC Clth_rEPBThresClth_C "" VALUE 0x8004BC06 Val_Ws16 799.9878 Prc -400.0000 399.9878 FORMAT "%8.4" /end CHARACTERISTIC
/begin CHARACTERISTIC Clth_rEPBThresNoPrsd_C "" VALUE 0x8004BC22 Val_Ws16 799.9878 Prc -400.0000 399.9878 FORMAT "%8.4" /end CHARACTERISTIC
/begin CHARACTERISTIC Clth_stDflVal_C "" VALUE 0x8004BC10 Val_Wu8 255.0 OneToOne 0.00 255.0 FORMAT "%5.1" /end CHARACTERISTIC
/begin CHARACTERISTIC Clth_stDiag_C "" VALUE 0x8004BC11 Val_Wu8 7.000 OneToOne 0.00 7.000 FORMAT "%5.3" /end CHARACTERISTIC
/begin CHARACTERISTIC Clth_swtDetSlipOpn_C "" VALUE 0x8004BC08 Val_Wu8 1.000 OneToOne 0.00 1.000 FORMAT "%5.3" /end CHARACTERISTIC
/begin CHARACTERISTIC Clth_swtEPBChk_C "" VALUE 0x8004BC09 Val_Wu8 255.0 OneToOne 0.00 255.0 FORMAT "%5.1" /end CHARACTERISTIC
/begin CHARACTERISTIC Clth_swtLiveValInit_C "" VALUE 0x8004BC0A Val_Wu8 1.000 OneToOne 0.00 1.000 FORMAT "%5.3" /end CHARACTERISTIC
/begin CHARACTERISTIC Clth_swtPNEna_C "" VALUE 0x8004BC12 Val_Wu8 1.000 OneToOne 0.00 1.000 FORMAT "%5.3" /end CHARACTERISTIC
/begin CHARACTERISTIC Clth_swtSig_C "" VALUE 0x8004BC0B Val_Wu8 255.0 OneToOne 0.00 255.0 FORMAT "%5.1" /end CHARACTERISTIC
/begin CHARACTERISTIC Clth_tiGearShftClsd_C "" VALUE 0x8004BC14 Val_Ws16 327570.0 Time_ms 0.00 327570.0 FORMAT "%8.1" /end CHARACTERISTIC
/begin CHARACTERISTIC Clth_tiGearShftOpn_C "" VALUE 0x8004BC16 Val_Ws16 327570.0 Time_ms 0.00 327570.0 FORMAT "%8.1" /end CHARACTERISTIC
/begin CHARACTERISTIC Clth_tiPlausEPB_C "" VALUE 0x8004BC18 Val_Wu16 327460.0 Time_ms 0.00 327460.0 FORMAT "%8.1" /end CHARACTERISTIC
/begin CHARACTERISTIC Clth_tiTestSig_C "" VALUE 0x8004BC1A Val_Wu16 327460.0 Time_ms 0.00 327460.0 FORMAT "%8.1" /end CHARACTERISTIC
/begin CHARACTERISTIC Clth_vPlausClsd_C "" VALUE 0x8004BC1C Val_Ws16 300.0000 Vel 0.00 300.0000 FORMAT "%8.4" /end CHARACTERISTIC
/begin CHARACTERISTIC Clth_vPlausOpnMax_C "" VALUE 0x8004BC1E Val_Ws16 300.0000 Vel 0.00 300.0000 FORMAT "%8.4" /end CHARACTERISTIC
/begin CHARACTERISTIC Clth_vPlausOpnMin_C "" VALUE 0x8004BC20 Val_Ws16 300.0000 Vel 0.00 300.0000 FORMAT "%8.4" /end CHARACTERISTIC
/begin CHARACTERISTIC CoEng_nThresCranking_C "" VALUE 0x8004BC3E Val_Ws16 32767.50 EngN -16384.00 16383.50 FORMAT "%8.2" /end CHARACTERISTIC
/begin CHARACTERISTIC CoEng_nThresNrml2Strt_C "" VALUE 0x8004BC40 Val_Ws16 8000.000 EngN 0.00 8000.000 FORMAT "%8.3" /end CHARACTERISTIC
/begin CHARACTERISTIC CoEng_tiNrml2Strt_C "" VALUE 0x8004BC42 Val_Ws16 655350.0 Time_ms -327680.0 327670.0 FORMAT "%8.1" /end CHARACTERISTIC
/begin CHARACTERISTIC CoEng_tiPwrStgDiaRdy_C "" VALUE 0x8004BC44 Val_Ws16 655350.0 Time_ms -327680.0 327670.0 FORMAT "%8.1" /end CHARACTERISTIC
/begin CHARACTERISTIC CoESS_DelEngSetP.tiHiLo_C "" VALUE 0x8004BC24 Kw_Ws16 655350.0 TimeDeb -327680.0 327670.0 FORMAT "%8.1" /end CHARACTERISTIC
/begin CHARACTERISTIC CoESS_DelEngSetP.tiLoHi_C "" VALUE 0x8004BC26 Kw_Ws16 655350.0 TimeDeb -327680.0 327670.0 FORMAT "%8.1" /end CHARACTERISTIC
/begin CHARACTERISTIC CoESS_DelVltgBattRstP.tiHiLo_C "" VALUE 0x8004BC28 Kw_Ws16 655350.0 TimeDeb -327680.0 327670.0 FORMAT "%8.1" /end CHARACTERISTIC
/begin CHARACTERISTIC CoESS_DelVltgBattRstP.tiLoHi_C "" VALUE 0x8004BC2A Kw_Ws16 655350.0 TimeDeb -327680.0 327670.0 FORMAT "%8.1" /end CHARACTERISTIC
/begin CHARACTERISTIC CoESS_DelVltgBattSetP.tiHiLo_C "" VALUE 0x8004BC2C Kw_Ws16 655350.0 TimeDeb -327680.0 327670.0 FORMAT "%8.1" /end CHARACTERISTIC
/begin CHARACTERISTIC CoESS_DelVltgBattSetP.tiLoHi_C "" VALUE 0x8004BC2E Kw_Ws16 655350.0 TimeDeb -327680.0 327670.0 FORMAT "%8.1" /end CHARACTERISTIC
/begin CHARACTERISTIC CoESS_nIdlBattThres_C "" VALUE 0x8004BC30 Val_Ws16 32767.50 EngN -16384.00 16383.50 FORMAT "%8.2" /end CHARACTERISTIC
/begin CHARACTERISTIC CoESS_nMax_C "" VALUE 0x8004BC32 Val_Ws16 32767.50 EngN -16384.00 16383.50 FORMAT "%8.2" /end CHARACTERISTIC
/begin CHARACTERISTIC CoESS_nMinBatt_C "" VALUE 0x8004BC34 Val_Ws16 32767.50 EngN -16384.00 16383.50 FORMAT "%8.2" /end CHARACTERISTIC
/begin CHARACTERISTIC CoESS_nMinThres_C "" VALUE 0x8004BC36 Val_Ws16 32767.50 EngN -16384.00 16383.50 FORMAT "%8.2" /end CHARACTERISTIC
/begin CHARACTERISTIC CoESS_uIdlBattThresRst_C "" VALUE 0x8004BC38 Val_Ws16 1310700. Volt_Batt -655360.0 655340.0 FORMAT "%8.1" /end CHARACTERISTIC
/begin CHARACTERISTIC CoESS_uIdlBattThresSet_C "" VALUE 0x8004BC3A Val_Ws16 1310700. Volt_Batt -655360.0 655340.0 FORMAT "%8.1" /end CHARACTERISTIC
/begin CHARACTERISTIC CoESS_vMinThres_C "" VALUE 0x8004BC3C Val_Ws16 655.3500 Vel -327.6800 327.6700 FORMAT "%8.4" /end CHARACTERISTIC
/begin CHARACTERISTIC Com_stFrmTxEna_C "" VALUE 0x80044220 KwWU32 2147483647.00 OneToOne 0.00 2147483647.00 FORMAT "%13.2" /end CHARACTERISTIC
/begin CHARACTERISTIC CoTS_tClntEngOutDes_C "" VALUE 0x8004BC48 Val_Ws16 6553.500 Temp_Cels -3549.940 3003.560 FORMAT "%8.3" /end CHARACTERISTIC
/begin CHARACTERISTIC CoTS_tiPT1Neg_C "" VALUE 0x8004BC4C Val_Ws32 4294.9672940 TimeDelay_s 0.000002000000001 4294.9672960 FORMAT "%12.7" /end CHARACTERISTIC
/begin CHARACTERISTIC CoTS_tiPT1Pos_C "" VALUE 0x8004BC50 Val_Ws32 4294.9672940 TimeDelay_s 0.000002000000001 4294.9672960 FORMAT "%12.7" /end CHARACTERISTIC
/begin CHARACTERISTIC Cpu_swtClrEnvRAMVals_C "" VALUE 0x8004BC54 Val_Wu8 255.0 OneToOne 0.00 255.0 FORMAT "%5.1" /end CHARACTERISTIC
/begin CHARACTERISTIC CWBGRLP "" VALUE 0x800441FC KwUb 255.0 dez 0.00 255.0 FORMAT "%5.1" /end CHARACTERISTIC
/begin CHARACTERISTIC CWBGWPR "" VALUE 0x800441FD KwUb 255.0 dez 0.00 255.0 FORMAT "%5.1" /end CHARACTERISTIC
/begin CHARACTERISTIC CWDCFFLR "" VALUE 0x80044224 KwWU8 255.0 dez 0.00 255.0 FORMAT "%5.1" /end CHARACTERISTIC
/begin CHARACTERISTIC CWDCTCW "" VALUE 0x80044226 KwWU8 255.0 dez 0.00 255.0 FORMAT "%5.1" /end CHARACTERISTIC
/begin CHARACTERISTIC CWPSEVE "" VALUE 0x8004430C KwWU8 255.0 dez 0.00 255.0 FORMAT "%5.1" /end CHARACTERISTIC
/begin CHARACTERISTIC CWPSKPE "" VALUE 0x8004424A KwWU8 255.0 dez 0.00 255.0 FORMAT "%5.1" /end CHARACTERISTIC
/begin CHARACTERISTIC DDRC_DurDeb.AirC_tiCmprSCBDebOk_C "" VALUE 0x80040116 Val_Wu16 655350.0 DDRCTime_ms 0.00 655350.0 FORMAT "%8.1" /end CHARACTERISTIC
/begin CHARACTERISTIC DDRC_DurDeb.AirC_tiCmprSCBDebDef_C "" VALUE 0x80040118 Val_Wu16 655350.0 DDRCTime_ms 0.00 655350.0 FORMAT "%8.1" /end CHARACTERISTIC
/begin CHARACTERISTIC DDRC_DurDeb.Fan_tiDIOOvrTempDebOk_C "" VALUE 0x8004011A Val_Wu16 655350.0 DDRCTime_ms 0.00 655350.0 FORMAT "%8.1" /end CHARACTERISTIC
/begin CHARACTERISTIC DDRC_DurDeb.Fan_tiDIOOvrTempDebDef_C "" VALUE 0x8004011C Val_Wu16 655350.0 DDRCTime_ms 0.00 655350.0 FORMAT "%8.1" /end CHARACTERISTIC
/begin CHARACTERISTIC DDRC_DurDeb.DevLib_tiBattULoDebOk_C "" VALUE 0x8004011E Val_Wu16 655350.0 DDRCTime_ms 0.00 655350.0 FORMAT "%8.1" /end CHARACTERISTIC
/begin CHARACTERISTIC DDRC_DurDeb.DevLib_tiBattULoDebDef_C "" VALUE 0x80040120 Val_Wu16 655350.0 DDRCTime_ms 0.00 655350.0 FORMAT "%8.1" /end CHARACTERISTIC
/begin CHARACTERISTIC DDRC_DurDeb.Fan_tiDIOOLDebOk_C "" VALUE 0x80040122 Val_Wu16 655350.0 DDRCTime_ms 0.00 655350.0 FORMAT "%8.1" /end CHARACTERISTIC
/begin CHARACTERISTIC DDRC_DurDeb.Fan_tiDIOOLDebDef_C "" VALUE 0x80040124 Val_Wu16 655350.0 DDRCTime_ms 0.00 655350.0 FORMAT "%8.1" /end CHARACTERISTIC
/begin CHARACTERISTIC DDRC_DurDeb.Fan_tiPWMOvrTempDebOk_C "" VALUE 0x80040126 Val_Wu16 655350.0 DDRCTime_ms 0.00 655350.0 FORMAT "%8.1" /end CHARACTERISTIC
/begin CHARACTERISTIC DDRC_DurDeb.Fan_tiPWMOvrTempDebDef_C "" VALUE 0x80040128 Val_Wu16 655350.0 DDRCTime_ms 0.00 655350.0 FORMAT "%8.1" /end CHARACTERISTIC
/begin CHARACTERISTIC DDRC_DurDeb.Fan_tiPWMSCBDebOk_C "" VALUE 0x8004012A Val_Wu16 655350.0 DDRCTime_ms 0.00 655350.0 FORMAT "%8.1" /end CHARACTERISTIC
/begin CHARACTERISTIC DDRC_DurDeb.Fan_tiPWMSCBDebDef_C "" VALUE 0x8004012C Val_Wu16 655350.0 DDRCTime_ms 0.00 655350.0 FORMAT "%8.1" /end CHARACTERISTIC
/begin CHARACTERISTIC DDRC_DurDeb.Fan_tiPWMOLDebOk_C "" VALUE 0x8004012E Val_Wu16 655350.0 DDRCTime_ms 0.00 655350.0 FORMAT "%8.1" /end CHARACTERISTIC
/begin CHARACTERISTIC DDRC_DurDeb.Fan_tiPWMOLDebDef_C "" VALUE 0x80040130 Val_Wu16 655350.0 DDRCTime_ms 0.00 655350.0 FORMAT "%8.1" /end CHARACTERISTIC
/begin CHARACTERISTIC DDRC_DurDeb.AltIO_tiSCBDebOk_C "" VALUE 0x80040132 Val_Wu16 655350.0 DDRCTime_ms 0.00 655350.0 FORMAT "%8.1" /end CHARACTERISTIC
/begin CHARACTERISTIC DDRC_DurDeb.AltIO_tiSCBDebDef_C "" VALUE 0x80040134 Val_Wu16 655350.0 DDRCTime_ms 0.00 655350.0 FORMAT "%8.1" /end CHARACTERISTIC
/begin CHARACTERISTIC DDRC_DurDeb.AltIO_tiOLDebOk_C "" VALUE 0x80040136 Val_Wu16 655350.0 DDRCTime_ms 0.00 655350.0 FORMAT "%8.1" /end CHARACTERISTIC
/begin CHARACTERISTIC DDRC_DurDeb.AltIO_tiOLDebDef_C "" VALUE 0x80040138 Val_Wu16 655350.0 DDRCTime_ms 0.00 655350.0 FORMAT "%8.1" /end CHARACTERISTIC
/begin CHARACTERISTIC DDRC_DurDeb.AltIO_tiOvrTempDebOk_C "" VALUE 0x8004013A Val_Wu16 655350.0 DDRCTime_ms 0.00 655350.0 FORMAT "%8.1" /end CHARACTERISTIC
/begin CHARACTERISTIC DDRC_DurDeb.AltIO_tiOvrTempDebDef_C "" VALUE 0x8004013C Val_Wu16 655350.0 DDRCTime_ms 0.00 655350.0 FORMAT "%8.1" /end CHARACTERISTIC
/begin CHARACTERISTIC DDRC_DurDeb.AirC_tiCmprOvrTempDebOk_C "" VALUE 0x8004013E Val_Wu16 655350.0 DDRCTime_ms 0.00 655350.0 FORMAT "%8.1" /end CHARACTERISTIC
/begin CHARACTERISTIC DDRC_DurDeb.AirC_tiCmprOvrTempDebDef_C "" VALUE 0x80040140 Val_Wu16 655350.0 DDRCTime_ms 0.00 655350.0 FORMAT "%8.1" /end CHARACTERISTIC
/begin CHARACTERISTIC DDRC_DurDeb.Fan_tiDIOSCGDebOk_C "" VALUE 0x80040142 Val_Wu16 655350.0 DDRCTime_ms 0.00 655350.0 FORMAT "%8.1" /end CHARACTERISTIC
/begin CHARACTERISTIC DDRC_DurDeb.Fan_tiDIOSCGDebDef_C "" VALUE 0x80040144 Val_Wu16 655350.0 DDRCTime_ms 0.00 655350.0 FORMAT "%8.1" /end CHARACTERISTIC
/begin CHARACTERISTIC DDRC_DurDeb.Fan_tiDIOSCBDebOk_C "" VALUE 0x80040146 Val_Wu16 655350.0 DDRCTime_ms 0.00 655350.0 FORMAT "%8.1" /end CHARACTERISTIC
/begin CHARACTERISTIC DDRC_DurDeb.Fan_tiDIOSCBDebDef_C "" VALUE 0x80040148 Val_Wu16 655350.0 DDRCTime_ms 0.00 655350.0 FORMAT "%8.1" /end CHARACTERISTIC
/begin CHARACTERISTIC DDRC_DurDeb.AirC_tiCmprOLDebOk_C "" VALUE 0x8004014A Val_Wu16 655350.0 DDRCTime_ms 0.00 655350.0 FORMAT "%8.1" /end CHARACTERISTIC
/begin CHARACTERISTIC DDRC_DurDeb.AirC_tiCmprOLDebDef_C "" VALUE 0x8004014C Val_Wu16 655350.0 DDRCTime_ms 0.00 655350.0 FORMAT "%8.1" /end CHARACTERISTIC
/begin CHARACTERISTIC DDRC_DurDeb.AltIO_tiSRCMinDebOk_C "" VALUE 0x8004014E Val_Wu16 655350.0 DDRCTime_ms 0.00 655350.0 FORMAT "%8.1" /end CHARACTERISTIC
/begin CHARACTERISTIC DDRC_DurDeb.AltIO_tiSRCMinDebDef_C "" VALUE 0x80040150 Val_Wu16 655350.0 DDRCTime_ms 0.00 655350.0 FORMAT "%8.1" /end CHARACTERISTIC
/begin CHARACTERISTIC DDRC_DurDeb.DevLib_tiBattUHiDebOk_C "" VALUE 0x80040152 Val_Wu16 655350.0 DDRCTime_ms 0.00 655350.0 FORMAT "%8.1" /end CHARACTERISTIC
/begin CHARACTERISTIC DDRC_DurDeb.DevLib_tiBattUHiDebDef_C "" VALUE 0x80040154 Val_Wu16 655350.0 DDRCTime_ms 0.00 655350.0 FORMAT "%8.1" /end CHARACTERISTIC
/begin CHARACTERISTIC DDRC_DurDeb.AltIO_tiSCGDebOk_C "" VALUE 0x80040156 Val_Wu16 655350.0 DDRCTime_ms 0.00 655350.0 FORMAT "%8.1" /end CHARACTERISTIC
/begin CHARACTERISTIC DDRC_DurDeb.AltIO_tiSCGDebDef_C "" VALUE 0x80040158 Val_Wu16 655350.0 DDRCTime_ms 0.00 655350.0 FORMAT "%8.1" /end CHARACTERISTIC
/begin CHARACTERISTIC DDRC_DurDeb.Fan_tiPWMSCGDebOk_C "" VALUE 0x8004015A Val_Wu16 655350.0 DDRCTime_ms 0.00 655350.0 FORMAT "%8.1" /end CHARACTERISTIC
/begin CHARACTERISTIC DDRC_DurDeb.Fan_tiPWMSCGDebDef_C "" VALUE 0x8004015C Val_Wu16 655350.0 DDRCTime_ms 0.00 655350.0 FORMAT "%8.1" /end CHARACTERISTIC
/begin CHARACTERISTIC DDRC_DurDeb.AirC_tiCmprSCGDebOk_C "" VALUE 0x8004015E Val_Wu16 655350.0 DDRCTime_ms 0.00 655350.0 FORMAT "%8.1" /end CHARACTERISTIC
/begin CHARACTERISTIC DDRC_DurDeb.AirC_tiCmprSCGDebDef_C "" VALUE 0x80040160 Val_Wu16 655350.0 DDRCTime_ms 0.00 655350.0 FORMAT "%8.1" /end CHARACTERISTIC
/begin CHARACTERISTIC DDRC_DurDeb.AltIO_tiSRCMaxDebOk_C "" VALUE 0x80040162 Val_Wu16 655350.0 DDRCTime_ms 0.00 655350.0 FORMAT "%8.1" /end CHARACTERISTIC
/begin CHARACTERISTIC DDRC_DurDeb.AltIO_tiSRCMaxDebDef_C "" VALUE 0x80040164 Val_Wu16 655350.0 DDRCTime_ms 0.00 655350.0 FORMAT "%8.1" /end CHARACTERISTIC
/begin CHARACTERISTIC DDRC_DurDeb.Clth_tiEPBSensErrDebOk_C "" VALUE 0x80040166 Val_Wu16 655350.0 DDRCTime_ms 0.00 655350.0 FORMAT "%8.1" /end CHARACTERISTIC
/begin CHARACTERISTIC DDRC_DurDeb.Clth_tiEPBSensErrDebDef_C "" VALUE 0x80040168 Val_Wu16 655350.0 DDRCTime_ms 0.00 655350.0 FORMAT "%8.1" /end CHARACTERISTIC
/begin CHARACTERISTIC DDRC_DurDeb.Brk_tiSigDebOk_C "" VALUE 0x8004016A Val_Wu16 655350.0 DDRCTime_ms 0.00 655350.0 FORMAT "%8.1" /end CHARACTERISTIC
/begin CHARACTERISTIC DDRC_DurDeb.Brk_tiSigDebDef_C "" VALUE 0x8004016C Val_Wu16 655350.0 DDRCTime_ms 0.00 655350.0 FORMAT "%8.1" /end CHARACTERISTIC
/begin CHARACTERISTIC DDRC_DurDeb.APP_tiSRCHighDebOk_C "" VALUE 0x8004016E Val_Wu16 655350.0 DDRCTime_ms 0.00 655350.0 FORMAT "%8.1" /end CHARACTERISTIC
/begin CHARACTERISTIC DDRC_DurDeb.APP_tiSRCHighDebDef_C "" VALUE 0x80040170 Val_Wu16 655350.0 DDRCTime_ms 0.00 655350.0 FORMAT "%8.1" /end CHARACTERISTIC
/begin CHARACTERISTIC DDRC_DurDeb.AirC_tiClntSRCMaxDebOk_C "" VALUE 0x80040172 Val_Wu16 655350.0 DDRCTime_ms 0.00 655350.0 FORMAT "%8.1" /end CHARACTERISTIC
/begin CHARACTERISTIC DDRC_DurDeb.AirC_tiClntSRCMaxDebDef_C "" VALUE 0x80040174 Val_Wu16 655350.0 DDRCTime_ms 0.00 655350.0 FORMAT "%8.1" /end CHARACTERISTIC
/begin CHARACTERISTIC DDRC_DurDeb.Clth_tiErrDebOk_C "" VALUE 0x80040176 Val_Wu16 655350.0 DDRCTime_ms 0.00 655350.0 FORMAT "%8.1" /end CHARACTERISTIC
/begin CHARACTERISTIC DDRC_DurDeb.Clth_tiErrDebDef_C "" VALUE 0x80040178 Val_Wu16 655350.0 DDRCTime_ms 0.00 655350.0 FORMAT "%8.1" /end CHARACTERISTIC
/begin CHARACTERISTIC DDRC_DurDeb.VehV_tiPlaDebOk_C "" VALUE 0x8004017A Val_Wu16 655350.0 DDRCTime_ms 0.00 655350.0 FORMAT "%8.1" /end CHARACTERISTIC
/begin CHARACTERISTIC DDRC_DurDeb.VehV_tiPlaDebDef_C "" VALUE 0x8004017C Val_Wu16 655350.0 DDRCTime_ms 0.00 655350.0 FORMAT "%8.1" /end CHARACTERISTIC
/begin CHARACTERISTIC DDRC_DurDeb.VehV_tiSigDebOk_C "" VALUE 0x8004017E Val_Wu16 655350.0 DDRCTime_ms 0.00 655350.0 FORMAT "%8.1" /end CHARACTERISTIC
/begin CHARACTERISTIC DDRC_DurDeb.VehV_tiSigDebDef_C "" VALUE 0x80040180 Val_Wu16 655350.0 DDRCTime_ms 0.00 655350.0 FORMAT "%8.1" /end CHARACTERISTIC
/begin CHARACTERISTIC DDRC_DurDeb.AirC_tiSwtNplDebOk_C "" VALUE 0x80040182 Val_Wu16 655350.0 DDRCTime_ms 0.00 655350.0 FORMAT "%8.1" /end CHARACTERISTIC
/begin CHARACTERISTIC DDRC_DurDeb.AirC_tiSwtNplDebDef_C "" VALUE 0x80040184 Val_Wu16 655350.0 DDRCTime_ms 0.00 655350.0 FORMAT "%8.1" /end CHARACTERISTIC
/begin CHARACTERISTIC DDRC_DurDeb.APP_PlaAPP12DebOk_C "" VALUE 0x80040186 Val_Wu16 655350.0 DDRCTime_ms 0.00 655350.0 FORMAT "%8.1" /end CHARACTERISTIC
/begin CHARACTERISTIC DDRC_DurDeb.APP_PlaAPP12DebDef_C "" VALUE 0x80040188 Val_Wu16 655350.0 DDRCTime_ms 0.00 655350.0 FORMAT "%8.1" /end CHARACTERISTIC
/begin CHARACTERISTIC DDRC_DurDeb.MILLmp_tiSCGDebOk_C "" VALUE 0x8004018A Val_Wu16 655350.0 DDRCTime_ms 0.00 655350.0 FORMAT "%8.1" /end CHARACTERISTIC
/begin CHARACTERISTIC DDRC_DurDeb.MILLmp_tiSCGDebDef_C "" VALUE 0x8004018C Val_Wu16 655350.0 DDRCTime_ms 0.00 655350.0 FORMAT "%8.1" /end CHARACTERISTIC
/begin CHARACTERISTIC DDRC_DurDeb.Clth_tiPlausDebOk_C "" VALUE 0x8004018E Val_Wu16 655350.0 DDRCTime_ms 0.00 655350.0 FORMAT "%8.1" /end CHARACTERISTIC
/begin CHARACTERISTIC DDRC_DurDeb.Clth_tiPlausDebDef_C "" VALUE 0x80040190 Val_Wu16 655350.0 DDRCTime_ms 0.00 655350.0 FORMAT "%8.1" /end CHARACTERISTIC
/begin CHARACTERISTIC DDRC_DurDeb.APP_tiSRCLowDebOk_C "" VALUE 0x80040192 Val_Wu16 655350.0 DDRCTime_ms 0.00 655350.0 FORMAT "%8.1" /end CHARACTERISTIC
/begin CHARACTERISTIC DDRC_DurDeb.APP_tiSRCLowDebDef_C "" VALUE 0x80040194 Val_Wu16 655350.0 DDRCTime_ms 0.00 655350.0 FORMAT "%8.1" /end CHARACTERISTIC
/begin CHARACTERISTIC DDRC_DurDeb.AirC_tiClntSRCMinDebOk_C "" VALUE 0x80040196 Val_Wu16 655350.0 DDRCTime_ms 0.00 655350.0 FORMAT "%8.1" /end CHARACTERISTIC
/begin CHARACTERISTIC DDRC_DurDeb.AirC_tiClntSRCMinDebDef_C "" VALUE 0x80040198 Val_Wu16 655350.0 DDRCTime_ms 0.00 655350.0 FORMAT "%8.1" /end CHARACTERISTIC
/begin CHARACTERISTIC DDRC_DurDeb.MILLmp_tiOLDebOk_C "" VALUE 0x8004019A Val_Wu16 655350.0 DDRCTime_ms 0.00 655350.0 FORMAT "%8.1" /end CHARACTERISTIC
/begin CHARACTERISTIC DDRC_DurDeb.MILLmp_tiOLDebDef_C "" VALUE 0x8004019C Val_Wu16 655350.0 DDRCTime_ms 0.00 655350.0 FORMAT "%8.1" /end CHARACTERISTIC
/begin CHARACTERISTIC DDRC_DurDeb.Clth_tiSigDebOk_C "" VALUE 0x8004019E Val_Wu16 655350.0 DDRCTime_ms 0.00 655350.0 FORMAT "%8.1" /end CHARACTERISTIC
/begin CHARACTERISTIC DDRC_DurDeb.Clth_tiSigDebDef_C "" VALUE 0x800401A0 Val_Wu16 655350.0 DDRCTime_ms 0.00 655350.0 FORMAT "%8.1" /end CHARACTERISTIC
/begin CHARACTERISTIC DDRC_DurDeb.MILLmp_tiSCBDebOk_C "" VALUE 0x800401A2 Val_Wu16 655350.0 DDRCTime_ms 0.00 655350.0 FORMAT "%8.1" /end CHARACTERISTIC
/begin CHARACTERISTIC DDRC_DurDeb.MILLmp_tiSCBDebDef_C "" VALUE 0x800401A4 Val_Wu16 655350.0 DDRCTime_ms 0.00 655350.0 FORMAT "%8.1" /end CHARACTERISTIC
/begin CHARACTERISTIC DDRC_DurDeb.VehV_tiMaxDebOk_C "" VALUE 0x800401A6 Val_Wu16 655350.0 DDRCTime_ms 0.00 655350.0 FORMAT "%8.1" /end CHARACTERISTIC
/begin CHARACTERISTIC DDRC_DurDeb.VehV_tiMaxDebDef_C "" VALUE 0x800401A8 Val_Wu16 655350.0 DDRCTime_ms 0.00 655350.0 FORMAT "%8.1" /end CHARACTERISTIC
/begin CHARACTERISTIC DDRC_DurDeb.AirC_tiSwtSigDebOk_C "" VALUE 0x800401AA Val_Wu16 655350.0 DDRCTime_ms 0.00 655350.0 FORMAT "%8.1" /end CHARACTERISTIC
/begin CHARACTERISTIC DDRC_DurDeb.AirC_tiSwtSigDebDef_C "" VALUE 0x800401AC Val_Wu16 655350.0 DDRCTime_ms 0.00 655350.0 FORMAT "%8.1" /end CHARACTERISTIC
/begin CHARACTERISTIC DDRC_DurDeb.Cj930_tiSSp1MonDebOk_C "" VALUE 0x800401AE Val_Wu16 655350.0 DDRCTime_ms 0.00 655350.0 FORMAT "%8.1" /end CHARACTERISTIC
/begin CHARACTERISTIC DDRC_DurDeb.Cj930_tiSSp1MonDebDef_C "" VALUE 0x800401B0 Val_Wu16 655350.0 DDRCTime_ms 0.00 655350.0 FORMAT "%8.1" /end CHARACTERISTIC
/begin CHARACTERISTIC DDRC_DurDeb.IdleChrgActr_tiStepASigDebOk_C "" VALUE 0x800401B2 Val_Wu16 655350.0 DDRCTime_ms 0.00 655350.0 FORMAT "%8.1" /end CHARACTERISTIC
/begin CHARACTERISTIC DDRC_DurDeb.IdleChrgActr_tiStepASigDebDef_C "" VALUE 0x800401B4 Val_Wu16 655350.0 DDRCTime_ms 0.00 655350.0 FORMAT "%8.1" /end CHARACTERISTIC
/begin CHARACTERISTIC DDRC_DurDeb.IdleChrgActr_tiStepNBMaxDebOk_C "" VALUE 0x800401B6 Val_Wu16 655350.0 DDRCTime_ms 0.00 655350.0 FORMAT "%8.1" /end CHARACTERISTIC
/begin CHARACTERISTIC DDRC_DurDeb.IdleChrgActr_tiStepNBMaxDebDef_C "" VALUE 0x800401B8 Val_Wu16 655350.0 DDRCTime_ms 0.00 655350.0 FORMAT "%8.1" /end CHARACTERISTIC
/begin CHARACTERISTIC DDRC_DurDeb.IdleChrgActr_tiStepNBMinDebOk_C "" VALUE 0x800401BA Val_Wu16 655350.0 DDRCTime_ms 0.00 655350.0 FORMAT "%8.1" /end CHARACTERISTIC
/begin CHARACTERISTIC DDRC_DurDeb.IdleChrgActr_tiStepNBMinDebDef_C "" VALUE 0x800401BC Val_Wu16 655350.0 DDRCTime_ms 0.00 655350.0 FORMAT "%8.1" /end CHARACTERISTIC
/begin CHARACTERISTIC DDRC_DurDeb.IdleChrgActr_tiOverTempDebOk_C "" VALUE 0x800401BE Val_Wu16 655350.0 DDRCTime_ms 0.00 655350.0 FORMAT "%8.1" /end CHARACTERISTIC
/begin CHARACTERISTIC DDRC_DurDeb.IdleChrgActr_tiOverTempDebDef_C "" VALUE 0x800401C0 Val_Wu16 655350.0 DDRCTime_ms 0.00 655350.0 FORMAT "%8.1" /end CHARACTERISTIC
/begin CHARACTERISTIC DDRC_DurDeb.IdleChrgActr_tiGovDeMaxDebOk_C "" VALUE 0x800401C2 Val_Wu16 655350.0 DDRCTime_ms 0.00 655350.0 FORMAT "%8.1" /end CHARACTERISTIC
/begin CHARACTERISTIC DDRC_DurDeb.IdleChrgActr_tiGovDeMaxDebDef_C "" VALUE 0x800401C4 Val_Wu16 655350.0 DDRCTime_ms 0.00 655350.0 FORMAT "%8.1" /end CHARACTERISTIC
/begin CHARACTERISTIC DDRC_DurDeb.IdleChrgActr_tiGovDeColdDebOk_C "" VALUE 0x800401C6 Val_Wu16 655350.0 DDRCTime_ms 0.00 655350.0 FORMAT "%8.1" /end CHARACTERISTIC
/begin CHARACTERISTIC DDRC_DurDeb.IdleChrgActr_tiGovDeColdDebDef_C "" VALUE 0x800401C8 Val_Wu16 655350.0 DDRCTime_ms 0.00 655350.0 FORMAT "%8.1" /end CHARACTERISTIC
/begin CHARACTERISTIC DDRC_DurDeb.Alt_tiAltMaxPwrDebOk_C "" VALUE 0x800401CA Val_Wu16 655350.0 DDRCTime_ms 0.00 655350.0 FORMAT "%8.1" /end CHARACTERISTIC
/begin CHARACTERISTIC DDRC_DurDeb.Alt_tiAltMaxPwrDebDef_C "" VALUE 0x800401CC Val_Wu16 655350.0 DDRCTime_ms 0.00 655350.0 FORMAT "%8.1" /end CHARACTERISTIC
/begin CHARACTERISTIC DDRC_DurDeb.IdleChrgActr_tiStepBMinDebOk_C "" VALUE 0x800401CE Val_Wu16 655350.0 DDRCTime_ms 0.00 655350.0 FORMAT "%8.1" /end CHARACTERISTIC
/begin CHARACTERISTIC DDRC_DurDeb.IdleChrgActr_tiStepBMinDebDef_C "" VALUE 0x800401D0 Val_Wu16 655350.0 DDRCTime_ms 0.00 655350.0 FORMAT "%8.1" /end CHARACTERISTIC
/begin CHARACTERISTIC DDRC_DurDeb.Cj930_tiSSp2MonDebOk_C "" VALUE 0x800401D2 Val_Wu16 655350.0 DDRCTime_ms 0.00 655350.0 FORMAT "%8.1" /end CHARACTERISTIC
/begin CHARACTERISTIC DDRC_DurDeb.Cj930_tiSSp2MonDebDef_C "" VALUE 0x800401D4 Val_Wu16 655350.0 DDRCTime_ms 0.00 655350.0 FORMAT "%8.1" /end CHARACTERISTIC
/begin CHARACTERISTIC DDRC_DurDeb.IdleChrgActr_tiStepAMaxDebOk_C "" VALUE 0x800401D6 Val_Wu16 655350.0 DDRCTime_ms 0.00 655350.0 FORMAT "%8.1" /end CHARACTERISTIC
/begin CHARACTERISTIC DDRC_DurDeb.IdleChrgActr_tiStepAMaxDebDef_C "" VALUE 0x800401D8 Val_Wu16 655350.0 DDRCTime_ms 0.00 655350.0 FORMAT "%8.1" /end CHARACTERISTIC
/begin CHARACTERISTIC DDRC_DurDeb.IdleChrgActr_tiStepNASigDebOk_C "" VALUE 0x800401DA Val_Wu16 655350.0 DDRCTime_ms 0.00 655350.0 FORMAT "%8.1" /end CHARACTERISTIC
/begin CHARACTERISTIC DDRC_DurDeb.IdleChrgActr_tiStepNASigDebDef_C "" VALUE 0x800401DC Val_Wu16 655350.0 DDRCTime_ms 0.00 655350.0 FORMAT "%8.1" /end CHARACTERISTIC
/begin CHARACTERISTIC DDRC_DurDeb.Cj930_tiSSp3MonDebOk_C "" VALUE 0x800401DE Val_Wu16 655350.0 DDRCTime_ms 0.00 655350.0 FORMAT "%8.1" /end CHARACTERISTIC
/begin CHARACTERISTIC DDRC_DurDeb.Cj930_tiSSp3MonDebDef_C "" VALUE 0x800401E0 Val_Wu16 655350.0 DDRCTime_ms 0.00 655350.0 FORMAT "%8.1" /end CHARACTERISTIC
/begin CHARACTERISTIC DDRC_DurDeb.IdleChrgActr_tiStepNAMinDebOk_C "" VALUE 0x800401E2 Val_Wu16 655350.0 DDRCTime_ms 0.00 655350.0 FORMAT "%8.1" /end CHARACTERISTIC
/begin CHARACTERISTIC DDRC_DurDeb.IdleChrgActr_tiStepNAMinDebDef_C "" VALUE 0x800401E4 Val_Wu16 655350.0 DDRCTime_ms 0.00 655350.0 FORMAT "%8.1" /end CHARACTERISTIC
/begin CHARACTERISTIC DDRC_DurDeb.IdleChrgActr_tiStepBSigDebOk_C "" VALUE 0x800401E6 Val_Wu16 655350.0 DDRCTime_ms 0.00 655350.0 FORMAT "%8.1" /end CHARACTERISTIC
/begin CHARACTERISTIC DDRC_DurDeb.IdleChrgActr_tiStepBSigDebDef_C "" VALUE 0x800401E8 Val_Wu16 655350.0 DDRCTime_ms 0.00 655350.0 FORMAT "%8.1" /end CHARACTERISTIC
/begin CHARACTERISTIC DDRC_DurDeb.IdleChrgActr_tiStepBMaxDebOk_C "" VALUE 0x800401EA Val_Wu16 655350.0 DDRCTime_ms 0.00 655350.0 FORMAT "%8.1" /end CHARACTERISTIC
/begin CHARACTERISTIC DDRC_DurDeb.IdleChrgActr_tiStepBMaxDebDef_C "" VALUE 0x800401EC Val_Wu16 655350.0 DDRCTime_ms 0.00 655350.0 FORMAT "%8.1" /end CHARACTERISTIC
/begin CHARACTERISTIC DDRC_DurDeb.IdleChrgActr_tiStepAMinDebOk_C "" VALUE 0x800401EE Val_Wu16 655350.0 DDRCTime_ms 0.00 655350.0 FORMAT "%8.1" /end CHARACTERISTIC
/begin CHARACTERISTIC DDRC_DurDeb.IdleChrgActr_tiStepAMinDebDef_C "" VALUE 0x800401F0 Val_Wu16 655350.0 DDRCTime_ms 0.00 655350.0 FORMAT "%8.1" /end CHARACTERISTIC
/begin CHARACTERISTIC DDRC_DurDeb.MonUMinSupply1DebOk_C "" VALUE 0x800401F2 Val_Wu16 655350.0 DDRCTime_ms 0.00 655350.0 FORMAT "%8.1" /end CHARACTERISTIC
/begin CHARACTERISTIC DDRC_DurDeb.MonUMinSupply1DebDef_C "" VALUE 0x800401F4 Val_Wu16 655350.0 DDRCTime_ms 0.00 655350.0 FORMAT "%8.1" /end CHARACTERISTIC
/begin CHARACTERISTIC DDRC_DurDeb.MonUMaxSupply1DebOk_C "" VALUE 0x800401F6 Val_Wu16 655350.0 DDRCTime_ms 0.00 655350.0 FORMAT "%8.1" /end CHARACTERISTIC
/begin CHARACTERISTIC DDRC_DurDeb.MonUMaxSupply1DebDef_C "" VALUE 0x800401F8 Val_Wu16 655350.0 DDRCTime_ms 0.00 655350.0 FORMAT "%8.1" /end CHARACTERISTIC
/begin CHARACTERISTIC DDRC_DurDeb.IdleChrgActr_tiStepNBSigDebOk_C "" VALUE 0x800401FA Val_Wu16 655350.0 DDRCTime_ms 0.00 655350.0 FORMAT "%8.1" /end CHARACTERISTIC
/begin CHARACTERISTIC DDRC_DurDeb.IdleChrgActr_tiStepNBSigDebDef_C "" VALUE 0x800401FC Val_Wu16 655350.0 DDRCTime_ms 0.00 655350.0 FORMAT "%8.1" /end CHARACTERISTIC
/begin CHARACTERISTIC DDRC_DurDeb.IdleChrgActr_tiStepNAMaxDebOk_C "" VALUE 0x800401FE Val_Wu16 655350.0 DDRCTime_ms 0.00 655350.0 FORMAT "%8.1" /end CHARACTERISTIC
/begin CHARACTERISTIC DDRC_DurDeb.IdleChrgActr_tiStepNAMaxDebDef_C "" VALUE 0x80040200 Val_Wu16 655350.0 DDRCTime_ms 0.00 655350.0 FORMAT "%8.1" /end CHARACTERISTIC
/begin CHARACTERISTIC DDRC_DurDeb.Brk_tiPlaDebOk_C "" VALUE 0x80040202 Val_Wu16 655350.0 DDRCTime_ms 0.00 655350.0 FORMAT "%8.1" /end CHARACTERISTIC
/begin CHARACTERISTIC DDRC_DurDeb.Brk_tiPlaDebDef_C "" VALUE 0x80040204 Val_Wu16 655350.0 DDRCTime_ms 0.00 655350.0 FORMAT "%8.1" /end CHARACTERISTIC
/begin CHARACTERISTIC DDRC_DurDeb.IdleChrgActr_tiGovDeMinDebOk_C "" VALUE 0x80040206 Val_Wu16 655350.0 DDRCTime_ms 0.00 655350.0 FORMAT "%8.1" /end CHARACTERISTIC
/begin CHARACTERISTIC DDRC_DurDeb.IdleChrgActr_tiGovDeMinDebDef_C "" VALUE 0x80040208 Val_Wu16 655350.0 DDRCTime_ms 0.00 655350.0 FORMAT "%8.1" /end CHARACTERISTIC
/begin CHARACTERISTIC DDRC_DurDeb.Clth_numOpnDebOk_C "" VALUE 0x8004020A Val_Wu16 65535.00 OneToOne 0.00 65535.00 FORMAT "%8.2" /end CHARACTERISTIC
/begin CHARACTERISTIC DDRC_DurDeb.Clth_numOpnDebDef_C "" VALUE 0x8004020C Val_Wu16 65535.00 OneToOne 0.00 65535.00 FORMAT "%8.2" /end CHARACTERISTIC
/begin CHARACTERISTIC DDRC_DurDeb.IgnClPs_numDevComErr1DebOk_C "" VALUE 0x8004020E Val_Wu16 65535.00 OneToOne 0.00 65535.00 FORMAT "%8.2" /end CHARACTERISTIC
/begin CHARACTERISTIC DDRC_DurDeb.IgnClPs_numDevComErr1DebDef_C "" VALUE 0x80040210 Val_Wu16 65535.00 OneToOne 0.00 65535.00 FORMAT "%8.2" /end CHARACTERISTIC
/begin CHARACTERISTIC DDRC_DurDeb.IgnClPs_numShCirBatt1DebOk_C "" VALUE 0x80040212 Val_Wu16 65535.00 OneToOne 0.00 65535.00 FORMAT "%8.2" /end CHARACTERISTIC
/begin CHARACTERISTIC DDRC_DurDeb.IgnClPs_numShCirBatt1DebDef_C "" VALUE 0x80040214 Val_Wu16 65535.00 OneToOne 0.00 65535.00 FORMAT "%8.2" /end CHARACTERISTIC
/begin CHARACTERISTIC DDRC_DurDeb.KnDet_numShCirDebOk_C "" VALUE 0x80040216 Val_Wu16 65535.00 OneToOne 0.00 65535.00 FORMAT "%8.2" /end CHARACTERISTIC
/begin CHARACTERISTIC DDRC_DurDeb.KnDet_numShCirDebDef_C "" VALUE 0x80040218 Val_Wu16 65535.00 OneToOne 0.00 65535.00 FORMAT "%8.2" /end CHARACTERISTIC
/begin CHARACTERISTIC DDRC_DurDeb.IgnClPs_numShCirBatt0DebOk_C "" VALUE 0x8004021A Val_Wu16 65535.00 OneToOne 0.00 65535.00 FORMAT "%8.2" /end CHARACTERISTIC
/begin CHARACTERISTIC DDRC_DurDeb.IgnClPs_numShCirBatt0DebDef_C "" VALUE 0x8004021C Val_Wu16 65535.00 OneToOne 0.00 65535.00 FORMAT "%8.2" /end CHARACTERISTIC
/begin CHARACTERISTIC DDRC_DurDeb.IgnClPs_numShCirBatt2DebOk_C "" VALUE 0x8004021E Val_Wu16 65535.00 OneToOne 0.00 65535.00 FORMAT "%8.2" /end CHARACTERISTIC
/begin CHARACTERISTIC DDRC_DurDeb.IgnClPs_numShCirBatt2DebDef_C "" VALUE 0x80040220 Val_Wu16 65535.00 OneToOne 0.00 65535.00 FORMAT "%8.2" /end CHARACTERISTIC
/begin CHARACTERISTIC DDRC_DurDeb.Clth_numClsdDebOk_C "" VALUE 0x80040222 Val_Wu16 65535.00 OneToOne 0.00 65535.00 FORMAT "%8.2" /end CHARACTERISTIC
/begin CHARACTERISTIC DDRC_DurDeb.Clth_numClsdDebDef_C "" VALUE 0x80040224 Val_Wu16 65535.00 OneToOne 0.00 65535.00 FORMAT "%8.2" /end CHARACTERISTIC
/begin CHARACTERISTIC DDRC_DurDeb.VehV_ctWhlErrDebOk_C "" VALUE 0x80040226 Val_Wu16 65535.00 OneToOne 0.00 65535.00 FORMAT "%8.2" /end CHARACTERISTIC
/begin CHARACTERISTIC DDRC_DurDeb.VehV_ctWhlErrDebDef_C "" VALUE 0x80040228 Val_Wu16 65535.00 OneToOne 0.00 65535.00 FORMAT "%8.2" /end CHARACTERISTIC
/begin CHARACTERISTIC DDRC_DurDeb.IgnClPs_numOpenLoad1DebOk_C "" VALUE 0x8004022A Val_Wu16 65535.00 OneToOne 0.00 65535.00 FORMAT "%8.2" /end CHARACTERISTIC
/begin CHARACTERISTIC DDRC_DurDeb.IgnClPs_numOpenLoad1DebDef_C "" VALUE 0x8004022C Val_Wu16 65535.00 OneToOne 0.00 65535.00 FORMAT "%8.2" /end CHARACTERISTIC
/begin CHARACTERISTIC DDRC_DurDeb.IgnClPs_numOpenLoad2DebOk_C "" VALUE 0x8004022E Val_Wu16 65535.00 OneToOne 0.00 65535.00 FORMAT "%8.2" /end CHARACTERISTIC
/begin CHARACTERISTIC DDRC_DurDeb.IgnClPs_numOpenLoad2DebDef_C "" VALUE 0x80040230 Val_Wu16 65535.00 OneToOne 0.00 65535.00 FORMAT "%8.2" /end CHARACTERISTIC
/begin CHARACTERISTIC DDRC_DurDeb.IgnClPs_numShCirGnd0DebOk_C "" VALUE 0x80040232 Val_Wu16 65535.00 OneToOne 0.00 65535.00 FORMAT "%8.2" /end CHARACTERISTIC
/begin CHARACTERISTIC DDRC_DurDeb.IgnClPs_numShCirGnd0DebDef_C "" VALUE 0x80040234 Val_Wu16 65535.00 OneToOne 0.00 65535.00 FORMAT "%8.2" /end CHARACTERISTIC
/begin CHARACTERISTIC DDRC_DurDeb.IgnClPs_numShCirGnd1DebOk_C "" VALUE 0x80040236 Val_Wu16 65535.00 OneToOne 0.00 65535.00 FORMAT "%8.2" /end CHARACTERISTIC
/begin CHARACTERISTIC DDRC_DurDeb.IgnClPs_numShCirGnd1DebDef_C "" VALUE 0x80040238 Val_Wu16 65535.00 OneToOne 0.00 65535.00 FORMAT "%8.2" /end CHARACTERISTIC
/begin CHARACTERISTIC DDRC_DurDeb.IgnClPs_numShCirGnd2DebOk_C "" VALUE 0x8004023A Val_Wu16 65535.00 OneToOne 0.00 65535.00 FORMAT "%8.2" /end CHARACTERISTIC
/begin CHARACTERISTIC DDRC_DurDeb.IgnClPs_numShCirGnd2DebDef_C "" VALUE 0x8004023C Val_Wu16 65535.00 OneToOne 0.00 65535.00 FORMAT "%8.2" /end CHARACTERISTIC
/begin CHARACTERISTIC DDRC_DurDeb.IgnClPs_numOpenLoad0DebOk_C "" VALUE 0x8004023E Val_Wu16 65535.00 OneToOne 0.00 65535.00 FORMAT "%8.2" /end CHARACTERISTIC
/begin CHARACTERISTIC DDRC_DurDeb.IgnClPs_numOpenLoad0DebDef_C "" VALUE 0x80040240 Val_Wu16 65535.00 OneToOne 0.00 65535.00 FORMAT "%8.2" /end CHARACTERISTIC
/begin CHARACTERISTIC DDRC_DurDeb.BusDiag_tiBusOffNodeADebOk_C "" VALUE 0x80040242 Val_Wu16 655350.0 DDRCTime_ms 0.00 655350.0 FORMAT "%8.1" /end CHARACTERISTIC
/begin CHARACTERISTIC DDRC_DurDeb.BusDiag_tiBusOffNodeADebDef_C "" VALUE 0x80040244 Val_Wu16 655350.0 DDRCTime_ms 0.00 655350.0 FORMAT "%8.1" /end CHARACTERISTIC
/begin CHARACTERISTIC DDRC_RatDeb.AirC_tiCmprSCBUDRat_C "" VALUE 0x80040D90 Val_Wu8 3.00000000000 DDRC_Ratio 1.00000000000 4.00000000000 FORMAT "%13.11" /end CHARACTERISTIC
/begin CHARACTERISTIC DDRC_RatDeb.Fan_tiDIOOvrTempUDRat_C "" VALUE 0x80040D91 Val_Wu8 3.00000000000 DDRC_Ratio 1.00000000000 4.00000000000 FORMAT "%13.11" /end CHARACTERISTIC
/begin CHARACTERISTIC DDRC_RatDeb.DevLib_tiBattULoUDRat_C "" VALUE 0x80040D92 Val_Wu8 3.00000000000 DDRC_Ratio 1.00000000000 4.00000000000 FORMAT "%13.11" /end CHARACTERISTIC
/begin CHARACTERISTIC DDRC_RatDeb.Fan_tiDIOOLUDRat_C "" VALUE 0x80040D93 Val_Wu8 3.00000000000 DDRC_Ratio 1.00000000000 4.00000000000 FORMAT "%13.11" /end CHARACTERISTIC
/begin CHARACTERISTIC DDRC_RatDeb.Fan_tiPWMOvrTempUDRat_C "" VALUE 0x80040D94 Val_Wu8 3.00000000000 DDRC_Ratio 1.00000000000 4.00000000000 FORMAT "%13.11" /end CHARACTERISTIC
/begin CHARACTERISTIC DDRC_RatDeb.Fan_tiPWMSCBUDRat_C "" VALUE 0x80040D95 Val_Wu8 3.00000000000 DDRC_Ratio 1.00000000000 4.00000000000 FORMAT "%13.11" /end CHARACTERISTIC
/begin CHARACTERISTIC DDRC_RatDeb.Fan_tiPWMOLUDRat_C "" VALUE 0x80040D96 Val_Wu8 3.00000000000 DDRC_Ratio 1.00000000000 4.00000000000 FORMAT "%13.11" /end CHARACTERISTIC
/begin CHARACTERISTIC DDRC_RatDeb.AltIO_tiSCBUDRat_C "" VALUE 0x80040D97 Val_Wu8 3.00000000000 DDRC_Ratio 1.00000000000 4.00000000000 FORMAT "%13.11" /end CHARACTERISTIC
/begin CHARACTERISTIC DDRC_RatDeb.AltIO_tiOLUDRat_C "" VALUE 0x80040D98 Val_Wu8 3.00000000000 DDRC_Ratio 1.00000000000 4.00000000000 FORMAT "%13.11" /end CHARACTERISTIC
/begin CHARACTERISTIC DDRC_RatDeb.AltIO_tiOvrTempUDRat_C "" VALUE 0x80040D99 Val_Wu8 3.00000000000 DDRC_Ratio 1.00000000000 4.00000000000 FORMAT "%13.11" /end CHARACTERISTIC
/begin CHARACTERISTIC DDRC_RatDeb.AirC_tiCmprOvrTempUDRat_C "" VALUE 0x80040D9A Val_Wu8 3.00000000000 DDRC_Ratio 1.00000000000 4.00000000000 FORMAT "%13.11" /end CHARACTERISTIC
/begin CHARACTERISTIC DDRC_RatDeb.Fan_tiDIOSCGUDRat_C "" VALUE 0x80040D9B Val_Wu8 3.00000000000 DDRC_Ratio 1.00000000000 4.00000000000 FORMAT "%13.11" /end CHARACTERISTIC
/begin CHARACTERISTIC DDRC_RatDeb.Fan_tiDIOSCBUDRat_C "" VALUE 0x80040D9C Val_Wu8 3.00000000000 DDRC_Ratio 1.00000000000 4.00000000000 FORMAT "%13.11" /end CHARACTERISTIC
/begin CHARACTERISTIC DDRC_RatDeb.AirC_tiCmprOLUDRat_C "" VALUE 0x80040D9D Val_Wu8 3.00000000000 DDRC_Ratio 1.00000000000 4.00000000000 FORMAT "%13.11" /end CHARACTERISTIC
/begin CHARACTERISTIC DDRC_RatDeb.AltIO_tiSRCMinUDRat_C "" VALUE 0x80040D9E Val_Wu8 3.00000000000 DDRC_Ratio 1.00000000000 4.00000000000 FORMAT "%13.11" /end CHARACTERISTIC
/begin CHARACTERISTIC DDRC_RatDeb.DevLib_tiBattUHiUDRat_C "" VALUE 0x80040D9F Val_Wu8 3.00000000000 DDRC_Ratio 1.00000000000 4.00000000000 FORMAT "%13.11" /end CHARACTERISTIC
/begin CHARACTERISTIC DDRC_RatDeb.AltIO_tiSCGUDRat_C "" VALUE 0x80040DA0 Val_Wu8 3.00000000000 DDRC_Ratio 1.00000000000 4.00000000000 FORMAT "%13.11" /end CHARACTERISTIC
/begin CHARACTERISTIC DDRC_RatDeb.Fan_tiPWMSCGUDRat_C "" VALUE 0x80040DA1 Val_Wu8 3.00000000000 DDRC_Ratio 1.00000000000 4.00000000000 FORMAT "%13.11" /end CHARACTERISTIC
/begin CHARACTERISTIC DDRC_RatDeb.AirC_tiCmprSCGUDRat_C "" VALUE 0x80040DA2 Val_Wu8 3.00000000000 DDRC_Ratio 1.00000000000 4.00000000000 FORMAT "%13.11" /end CHARACTERISTIC
/begin CHARACTERISTIC DDRC_RatDeb.AltIO_tiSRCMaxUDRat_C "" VALUE 0x80040DA3 Val_Wu8 3.00000000000 DDRC_Ratio 1.00000000000 4.00000000000 FORMAT "%13.11" /end CHARACTERISTIC
/begin CHARACTERISTIC DDRC_RatDeb.Clth_tiEPBSensErrUDRat_C "" VALUE 0x80040DA4 Val_Wu8 3.00000000000 DDRC_Ratio 1.00000000000 4.00000000000 FORMAT "%13.11" /end CHARACTERISTIC
/begin CHARACTERISTIC DDRC_RatDeb.Brk_tiSigUDRat_C "" VALUE 0x80040DA5 Val_Wu8 3.00000000000 DDRC_Ratio 1.00000000000 4.00000000000 FORMAT "%13.11" /end CHARACTERISTIC
/begin CHARACTERISTIC DDRC_RatDeb.APP_tiSRCHighUDRat_C "" VALUE 0x80040DA6 Val_Wu8 3.00000000000 DDRC_Ratio 1.00000000000 4.00000000000 FORMAT "%13.11" /end CHARACTERISTIC
/begin CHARACTERISTIC DDRC_RatDeb.AirC_tiClntSRCMaxUDRat_C "" VALUE 0x80040DA7 Val_Wu8 3.00000000000 DDRC_Ratio 1.00000000000 4.00000000000 FORMAT "%13.11" /end CHARACTERISTIC
/begin CHARACTERISTIC DDRC_RatDeb.Clth_tiErrUDRat_C "" VALUE 0x80040DA8 Val_Wu8 3.00000000000 DDRC_Ratio 1.00000000000 4.00000000000 FORMAT "%13.11" /end CHARACTERISTIC
/begin CHARACTERISTIC DDRC_RatDeb.VehV_tiPlaUDRat_C "" VALUE 0x80040DA9 Val_Wu8 3.00000000000 DDRC_Ratio 1.00000000000 4.00000000000 FORMAT "%13.11" /end CHARACTERISTIC
/begin CHARACTERISTIC DDRC_RatDeb.VehV_tiSigUDRat_C "" VALUE 0x80040DAA Val_Wu8 3.00000000000 DDRC_Ratio 1.00000000000 4.00000000000 FORMAT "%13.11" /end CHARACTERISTIC
/begin CHARACTERISTIC DDRC_RatDeb.AirC_tiSwtNplUDRat_C "" VALUE 0x80040DAB Val_Wu8 3.00000000000 DDRC_Ratio 1.00000000000 4.00000000000 FORMAT "%13.11" /end CHARACTERISTIC
/begin CHARACTERISTIC DDRC_RatDeb.APP_PlaAPP12UDRat_C "" VALUE 0x80040DAC Val_Wu8 3.00000000000 DDRC_Ratio 1.00000000000 4.00000000000 FORMAT "%13.11" /end CHARACTERISTIC
/begin CHARACTERISTIC DDRC_RatDeb.MILLmp_tiSCGUDRat_C "" VALUE 0x80040DAD Val_Wu8 3.00000000000 DDRC_Ratio 1.00000000000 4.00000000000 FORMAT "%13.11" /end CHARACTERISTIC
/begin CHARACTERISTIC DDRC_RatDeb.Clth_tiPlausUDRat_C "" VALUE 0x80040DAE Val_Wu8 3.00000000000 DDRC_Ratio 1.00000000000 4.00000000000 FORMAT "%13.11" /end CHARACTERISTIC
/begin CHARACTERISTIC DDRC_RatDeb.APP_tiSRCLowUDRat_C "" VALUE 0x80040DAF Val_Wu8 3.00000000000 DDRC_Ratio 1.00000000000 4.00000000000 FORMAT "%13.11" /end CHARACTERISTIC
/begin CHARACTERISTIC DDRC_RatDeb.AirC_tiClntSRCMinUDRat_C "" VALUE 0x80040DB0 Val_Wu8 3.00000000000 DDRC_Ratio 1.00000000000 4.00000000000 FORMAT "%13.11" /end CHARACTERISTIC
/begin CHARACTERISTIC DDRC_RatDeb.MILLmp_tiOLUDRat_C "" VALUE 0x80040DB1 Val_Wu8 3.00000000000 DDRC_Ratio 1.00000000000 4.00000000000 FORMAT "%13.11" /end CHARACTERISTIC
/begin CHARACTERISTIC DDRC_RatDeb.Clth_tiSigUDRat_C "" VALUE 0x80040DB2 Val_Wu8 3.00000000000 DDRC_Ratio 1.00000000000 4.00000000000 FORMAT "%13.11" /end CHARACTERISTIC
/begin CHARACTERISTIC DDRC_RatDeb.MILLmp_tiSCBUDRat_C "" VALUE 0x80040DB3 Val_Wu8 3.00000000000 DDRC_Ratio 1.00000000000 4.00000000000 FORMAT "%13.11" /end CHARACTERISTIC
/begin CHARACTERISTIC DDRC_RatDeb.VehV_tiMaxUDRat_C "" VALUE 0x80040DB4 Val_Wu8 3.00000000000 DDRC_Ratio 1.00000000000 4.00000000000 FORMAT "%13.11" /end CHARACTERISTIC
/begin CHARACTERISTIC DDRC_RatDeb.AirC_tiSwtSigUDRat_C "" VALUE 0x80040DB5 Val_Wu8 3.00000000000 DDRC_Ratio 1.00000000000 4.00000000000 FORMAT "%13.11" /end CHARACTERISTIC
/begin CHARACTERISTIC DevLib_DigOutDbgSig_C "" VALUE 0x8004BC56 Val_Wu16 65535.00 OneToOne 0.00 65535.00 FORMAT "%8.2" /end CHARACTERISTIC
/begin CHARACTERISTIC Devlib_PsDisbl.facLowHysLo_C "" VALUE 0x8004BC5A Kw_Ws16 1.000000 Fact 0.00 1.000000 FORMAT "%8.6" /end CHARACTERISTIC
/begin CHARACTERISTIC Devlib_PsDisbl.facLowHysHi_C "" VALUE 0x8004BC5C Kw_Ws16 1.000000 Fact 0.00 1.000000 FORMAT "%8.6" /end CHARACTERISTIC
/begin CHARACTERISTIC Devlib_PsDisbl.facHighHysLo_C "" VALUE 0x8004BC5E Kw_Ws16 2.000000 Fact 1.000000 3.000000 FORMAT "%8.6" /end CHARACTERISTIC
/begin CHARACTERISTIC Devlib_PsDisbl.facHighHysHi_C "" VALUE 0x8004BC60 Kw_Ws16 2.000000 Fact 1.000000 3.000000 FORMAT "%8.6" /end CHARACTERISTIC
/begin CHARACTERISTIC DevLib_PWMOutDbgSig_C "" VALUE 0x8004BC58 Val_Wu16 65535.00 OneToOne 0.00 65535.00 FORMAT "%8.2" /end CHARACTERISTIC
/begin CHARACTERISTIC Devlib_PwrStg.BattLoHysLo_C "" VALUE 0x8004BC62 Kw_Ws16 9000.000 Volt_Batt 3000.000 12000.00 FORMAT "%8.2" /end CHARACTERISTIC
/begin CHARACTERISTIC Devlib_PwrStg.BattLoHysHi_C "" VALUE 0x8004BC64 Kw_Ws16 9000.000 Volt_Batt 3000.000 12000.00 FORMAT "%8.2" /end CHARACTERISTIC
/begin CHARACTERISTIC Devlib_PwrStg.BattHiHysLo_C "" VALUE 0x8004BC66 Kw_Ws16 24000.00 Volt_Batt 12000.00 36000.00 FORMAT "%8.2" /end CHARACTERISTIC
/begin CHARACTERISTIC Devlib_PwrStg.BattHiHysHi_C "" VALUE 0x8004BC68 Kw_Ws16 24000.00 Volt_Batt 12000.00 36000.00 FORMAT "%8.2" /end CHARACTERISTIC
/begin CHARACTERISTIC DRLDYNA "" VALUE 0x800441FE KwSw 767.9766 rel_sw_q0p0234 0.00 767.9766 FORMAT "%8.4" /end CHARACTERISTIC
/begin CHARACTERISTIC DRLDYNE "" VALUE 0x80044200 KwSw 767.9766 rel_sw_q0p0234 0.00 767.9766 FORMAT "%8.4" /end CHARACTERISTIC
/begin CHARACTERISTIC DRLMIN "" VALUE 0x80044202 KwSw 1535.977 rel_sw_q0p0234 -768.0000 767.9766 FORMAT "%8.4" /end CHARACTERISTIC
/begin CHARACTERISTIC DTCWECDTH "" VALUE 0x80044227 KwWU8 25.50 t_q0p1 0.00 25.50 FORMAT "%5.2" /end CHARACTERISTIC
/begin CHARACTERISTIC DTEPRU "" VALUE 0x80044204 KwUw 65.53500 t1p0usxms 0.00 65.53500 FORMAT "%8.5" /end CHARACTERISTIC
/begin CHARACTERISTIC DTHKBTSZA "" VALUE 0x80044210 KwWU16 1535.977 temp_q0p0234 0.00 1535.977 FORMAT "%8.3" /end CHARACTERISTIC
/begin CHARACTERISTIC DTVKBTSZA "" VALUE 0x80044212 KwWU16 1535.977 temp_q0p0234 0.00 1535.977 FORMAT "%8.3" /end CHARACTERISTIC
/begin CHARACTERISTIC DWDKRLP "" VALUE 0x80044206 KwSw 1599.976 relDK_q0p02441 -800.0000 799.9756 FORMAT "%8.4" /end CHARACTERISTIC
/begin CHARACTERISTIC DWPR "" VALUE 0x80044208 KwSb 1530. kw_q6 -768.0 762.0 FORMAT "%5.1" /end CHARACTERISTIC
/begin CHARACTERISTIC DWPRNSP "" VALUE 0x80044209 KwSb 1530. kw_q6 -768.0 762.0 FORMAT "%5.1" /end CHARACTERISTIC
/begin CHARACTERISTIC EKPPA "" VALUE 0x8004424B KwWU8 255.0 dez 0.00 255.0 FORMAT "%5.1" /end CHARACTERISTIC
/begin CHARACTERISTIC IdleChrgActr_deltastep_C "" VALUE 0x80044250 KwWU8 255.0 dez 0.00 255.0 FORMAT "%5.1" /end CHARACTERISTIC
/begin CHARACTERISTIC IdleChrgActr_facSnsrMdl_C "" VALUE 0x80044252 KwWU16 65.53500 fak_q0p001 0.00 65.53500 FORMAT "%8.5" /end CHARACTERISTIC
/begin CHARACTERISTIC IdleChrgActr_facSnsrStep_C "" VALUE 0x80044254 KwWU16 65.53500 fak_q0p001 0.00 65.53500 FORMAT "%8.5" /end CHARACTERISTIC
/begin CHARACTERISTIC IdleChrgActr_frqAdptNearMechLim_C "" VALUE 0x80044256 KwWU8 255.0 dez 0.00 255.0 FORMAT "%5.1" /end CHARACTERISTIC
/begin CHARACTERISTIC IdleChrgActr_frqAdptNrmActvtn_C "" VALUE 0x80044257 KwWU8 255.0 dez 0.00 255.0 FORMAT "%5.1" /end CHARACTERISTIC
/begin CHARACTERISTIC IdleChrgActr_frqMaxActvtn_C "" VALUE 0x80044258 KwWU16 65535.00 dez 0.00 65535.00 FORMAT "%8.2" /end CHARACTERISTIC
/begin CHARACTERISTIC IdleChrgActr_frqNearMechLim_C "" VALUE 0x8004425A KwWU8 255.0 dez 0.00 255.0 FORMAT "%5.1" /end CHARACTERISTIC
/begin CHARACTERISTIC IdleChrgActr_frqStop_C "" VALUE 0x8004425B KwWU8 255.0 dez 0.00 255.0 FORMAT "%5.1" /end CHARACTERISTIC
/begin CHARACTERISTIC IdleChrgActr_frqTestPul_C "" VALUE 0x8004425C KwWU8 255.0 dez 0.00 255.0 FORMAT "%5.1" /end CHARACTERISTIC
/begin CHARACTERISTIC IdleChrgActr_hexStepCodMtrxAcc_CA "" VAL_BLK 0x8004425D KwbWU8 255.0 dez 0.00 255.0 FORMAT "%5.1" NUMBER 4 /end CHARACTERISTIC
/begin CHARACTERISTIC IdleChrgActr_hexStepCodMtrx_CA "" VAL_BLK 0x80044261 KwbWU8 255.0 dez 0.00 255.0 FORMAT "%5.1" NUMBER 4 /end CHARACTERISTIC
/begin CHARACTERISTIC IdleChrgActr_NoMovDelay_C "" VALUE 0x80044266 KwWU16 65.53500 t_q0p001 0.00 65.53500 FORMAT "%8.5" /end CHARACTERISTIC
/begin CHARACTERISTIC IdleChrgActr_numDiagStep_C "" VALUE 0x80044268 KwWU8 255.0 dez 0.00 255.0 FORMAT "%5.1" /end CHARACTERISTIC
/begin CHARACTERISTIC IdleChrgActr_numMechMaxLim_C "" VALUE 0x80044269 KwWU8 255.0 dez 0.00 255.0 FORMAT "%5.1" /end CHARACTERISTIC
/begin CHARACTERISTIC IdleChrgActr_numMechMinLim_C "" VALUE 0x8004426A KwWU8 255.0 dez 0.00 255.0 FORMAT "%5.1" /end CHARACTERISTIC
/begin CHARACTERISTIC IdleChrgActr_numStepNormFrqMaxLim_C "" VALUE 0x8004426B KwWU8 255.0 dez 0.00 255.0 FORMAT "%5.1" /end CHARACTERISTIC
/begin CHARACTERISTIC IdleChrgActr_numStepNormFrqMinLim_C "" VALUE 0x8004426C KwWU8 255.0 dez 0.00 255.0 FORMAT "%5.1" /end CHARACTERISTIC
/begin CHARACTERISTIC IdleChrgActr_PosDrvSetPt_C "" VALUE 0x8004426D KwWU8 255.0 dez 0.00 255.0 FORMAT "%5.1" /end CHARACTERISTIC
/begin CHARACTERISTIC IdleChrgActr_PowCodMtrx_CA "" VAL_BLK 0x8004426E KwbWU8 255.0 dez 0.00 255.0 FORMAT "%5.1" NUMBER 4 /end CHARACTERISTIC
/begin CHARACTERISTIC IdleChrgActr_ratActJamClsd_C "" VALUE 0x80044272 KwWU16 799.9878 Prc 0.00 799.9878 FORMAT "%8.4" /end CHARACTERISTIC
/begin CHARACTERISTIC IdleChrgActr_ratActLow_C "" VALUE 0x80044274 KwWU16 799.9878 Prc 0.00 799.9878 FORMAT "%8.4" /end CHARACTERISTIC
/begin CHARACTERISTIC IdleChrgActr_ratActValTolr_T "" CURVE 0x80044276 KlAxU8SstxU16WU16 799.9878 Prc 0.00 799.9878 FORMAT "%8.4"
 /begin AXIS_DESCR STD_AXIS ratActVal Prc 2 0.00 799.9878 FORMAT "%8.4" DEPOSIT ABSOLUTE /end AXIS_DESCR
/end CHARACTERISTIC
/begin CHARACTERISTIC IdleChrgActr_ratDesActr_T "" CURVE 0x80044280 KlAxU8SstxU16WS16 799.9878 Prc -400.0000 399.9878 FORMAT "%8.4"
 /begin AXIS_DESCR STD_AXIS IdleChrgActr_rat Prc 8 0.00 799.9878 FORMAT "%8.4" DEPOSIT ABSOLUTE /end AXIS_DESCR
/end CHARACTERISTIC
/begin CHARACTERISTIC IdleChrgActr_ratDesValMonMax_C "" VALUE 0x800442A2 KwWU16 799.9878 Prc 0.00 799.9878 FORMAT "%8.4" /end CHARACTERISTIC
/begin CHARACTERISTIC IdleChrgActr_ratDesValMonMin_C "" VALUE 0x800442A4 KwWU16 799.9878 Prc 0.00 799.9878 FORMAT "%8.4" /end CHARACTERISTIC
/begin CHARACTERISTIC IdleChrgActr_ratGovDeMax_C "" VALUE 0x800442A6 KwWS16 799.9878 Prc -400.0000 399.9878 FORMAT "%8.4" /end CHARACTERISTIC
/begin CHARACTERISTIC IdleChrgActr_ratGovDeMin_C "" VALUE 0x800442A8 KwWS16 799.9878 Prc -400.0000 399.9878 FORMAT "%8.4" /end CHARACTERISTIC
/begin CHARACTERISTIC IdleChrgActr_ratSensDef_C "" VALUE 0x800442AA KwWU16 799.9878 Prc 0.00 799.9878 FORMAT "%8.4" /end CHARACTERISTIC
/begin CHARACTERISTIC IdleChrgActr_ratStepShOff_C "" VALUE 0x800442AC KwWU16 799.9878 Prc 0.00 799.9878 FORMAT "%8.4" /end CHARACTERISTIC
/begin CHARACTERISTIC IdleChrgActr_StepFrqDelta_C "" VALUE 0x800442AE KwWU8 255.0 dez 0.00 255.0 FORMAT "%5.1" /end CHARACTERISTIC
/begin CHARACTERISTIC IdleChrgActr_stGovDeMsk_C "" VALUE 0x800442B0 KwWU32 4294967295.00 dez 0.00 4294967295.00 FORMAT "%13.2" /end CHARACTERISTIC
/begin CHARACTERISTIC IdleChrgActr_stMonShOffMask_C "" VALUE 0x800442B4 KwWU32 4294967295.00 dez 0.00 4294967295.00 FORMAT "%13.2" /end CHARACTERISTIC
/begin CHARACTERISTIC IdleChrgActr_swtConf_C "" VALUE 0x800442B8 KwWU32 4294967295.00 dez 0.00 4294967295.00 FORMAT "%13.2" /end CHARACTERISTIC
/begin CHARACTERISTIC IdleChrgActr_swtLrnZrPos_C "" VALUE 0x800442BC KwWU8 255.0 dez 0.00 255.0 FORMAT "%5.1" /end CHARACTERISTIC
/begin CHARACTERISTIC IdleChrgActr_tEngCld_T "" CURVE 0x800442BE KlAxU8SstxS16WS16 6553.500 Temp_Cels -3549.940 3003.560 FORMAT "%8.3"
 /begin AXIS_DESCR STD_AXIS EnvT_t Temp_Cels 6 -3549.940 3003.560 FORMAT "%8.3" DEPOSIT ABSOLUTE /end AXIS_DESCR
/end CHARACTERISTIC
/begin CHARACTERISTIC IdleChrgActr_tExhCld_C "" VALUE 0x800442D8 KwWS16 6553.500 Temp_Cels -3549.940 3003.560 FORMAT "%8.3" /end CHARACTERISTIC
/begin CHARACTERISTIC IdleChrgActr_tiAftStrt_C "" VALUE 0x800442DC KwWU32 42949672950.0 Time_ms 0.00 42949672950.0 FORMAT "%13.1" /end CHARACTERISTIC
/begin CHARACTERISTIC IdleChrgActr_tiDebJamVlv_C "" VALUE 0x800442E0 KwWU16 6553.500 t_q0p1 0.00 6553.500 FORMAT "%8.3" /end CHARACTERISTIC
/begin CHARACTERISTIC IdleChrgActr_tiDesValFild_T "" CURVE 0x800442E2 KlAxU8SstxU16WU16 6553.500 t_q0p1 0.00 6553.500 FORMAT "%8.3"
 /begin AXIS_DESCR STD_AXIS IdleChrgActr_frqAct dez 8 0.00 65535.00 FORMAT "%8.2" DEPOSIT ABSOLUTE /end AXIS_DESCR
/end CHARACTERISTIC
/begin CHARACTERISTIC IdleChrgActr_tiMaxPostDrvDly_C "" VALUE 0x80044304 KwWU16 65.53500 t_q0p001 0.00 65.53500 FORMAT "%8.5" /end CHARACTERISTIC
/begin CHARACTERISTIC IdleChrgActr_uBattChkDelta_C "" VALUE 0x80044306 KwWU8 25.50 spg_q0p1 0.00 25.50 FORMAT "%5.2" /end CHARACTERISTIC
/begin CHARACTERISTIC IdleChrgActr_uBattChkLowThd_C "" VALUE 0x80044307 KwWU8 25.50 spg_q0p1 0.00 25.50 FORMAT "%5.2" /end CHARACTERISTIC
/begin CHARACTERISTIC IdleChrgActr_uBattChkUpThd_C "" VALUE 0x80044308 KwWU8 25.50 spg_q0p1 0.00 25.50 FORMAT "%5.2" /end CHARACTERISTIC
/begin CHARACTERISTIC IdleChrgActr_uStepActvnBattLowThd1_C "" VALUE 0x80044309 KwWU8 25.50 spg_q0p1 0.00 25.50 FORMAT "%5.2" /end CHARACTERISTIC
/begin CHARACTERISTIC IdleChrgActr_uStepActvnBattLowThd2_C "" VALUE 0x8004430A KwWU8 25.50 spg_q0p1 0.00 25.50 FORMAT "%5.2" /end CHARACTERISTIC
/begin CHARACTERISTIC NDDKST "" VALUE 0x80044246 KwWU8 10200. nmot_ub_q40 0.00 10200. FORMAT "%5.0" /end CHARACTERISTIC
/begin CHARACTERISTIC NDECJ "" VALUE 0x80044248 KwWU8 10200. nmot_ub_q40 0.00 10200. FORMAT "%5.0" /end CHARACTERISTIC
/begin CHARACTERISTIC NMOTNSP "" VALUE 0x8004420A KwUw 16383.75 nmot_uw_q0p25 0.00 16383.75 FORMAT "%8.2" /end CHARACTERISTIC
/begin CHARACTERISTIC SF_TA "" VAL_BLK 0x80044238 KwbWU16 86. dfp_verbal 0.00 86. FORMAT "%2.0" READ_ONLY NUMBER 3 /end CHARACTERISTIC
/begin CHARACTERISTIC SF_TASR "" VAL_BLK 0x8004423E KwbWU16 86. dfp_verbal 0.00 86. FORMAT "%2.0" READ_ONLY NUMBER 3 /end CHARACTERISTIC
/begin CHARACTERISTIC SF_TM "" VAL_BLK 0x80044228 KwbWU16 86. dfp_verbal 0.00 86. FORMAT "%2.0" READ_ONLY NUMBER 5 /end CHARACTERISTIC
/begin CHARACTERISTIC TANHKSAO "" VALUE 0x80044214 KwWU16 1535.977 temp_q0p0234_o273 -273.1500 1262.827 FORMAT "%8.3" /end CHARACTERISTIC
/begin CHARACTERISTIC TANSDE "" VALUE 0x80044244 KwWU8 191.3 temp_ub_q0p75_o48 -48.00 143.3 FORMAT "%5.1" /end CHARACTERISTIC
/begin CHARACTERISTIC TAVHKSAO "" VALUE 0x80044216 KwWU16 1535.977 temp_q0p0234_o273 -273.1500 1262.827 FORMAT "%8.3" /end CHARACTERISTIC
/begin CHARACTERISTIC TAVVKSAO "" VALUE 0x80044218 KwWU16 1535.977 temp_q0p0234_o273 -273.1500 1262.827 FORMAT "%8.3" /end CHARACTERISTIC
/begin CHARACTERISTIC TCYCDEKPE "" VALUE 0x8004424C KwWU8 25.50 t_q0p1 0.00 25.50 FORMAT "%5.2" /end CHARACTERISTIC
/begin CHARACTERISTIC TDDKST "" VALUE 0x80044247 KwWU8 25.50 t100msxs_ub_b25p5 0.00 25.50 FORMAT "%5.2" /end CHARACTERISTIC
/begin CHARACTERISTIC TDTM "" VALUE 0x80044232 KwWU8 25.50 t_q0p1 0.00 25.50 FORMAT "%5.2" /end CHARACTERISTIC
/begin CHARACTERISTIC TDTMOTRG "" VALUE 0x80044233 KwWU8 25.50 t_q0p1 0.00 25.50 FORMAT "%5.2" /end CHARACTERISTIC
/begin CHARACTERISTIC TKIHKSAO "" VALUE 0x8004421A KwWU16 1535.977 temp_q0p0234_o273 -273.1500 1262.827 FORMAT "%8.3" /end CHARACTERISTIC
/begin CHARACTERISTIC TKIVKSAO "" VALUE 0x8004421C KwWU16 1535.977 temp_q0p0234_o273 -273.1500 1262.827 FORMAT "%8.3" /end CHARACTERISTIC
/begin CHARACTERISTIC TNSURLP "" VALUE 0x8004420C KwUw 655.3500 t10msxs_uw_b655p35 0.00 655.3500 FORMAT "%8.4" /end CHARACTERISTIC
/begin CHARACTERISTIC TTFANMOT "" VALUE 0x80044245 KwWU8 25.50 t_q0p1 0.00 25.50 FORMAT "%5.2" /end CHARACTERISTIC
/begin CHARACTERISTIC UBCJMN "" VALUE 0x80044249 KwWU8 25.50 spg_q0p1 0.00 25.50 FORMAT "%5.2" /end CHARACTERISTIC
/begin CHARACTERISTIC UBDEKPMN "" VALUE 0x8004424D KwWU8 25.50 spg_q0p1 0.00 25.50 FORMAT "%5.2" /end CHARACTERISTIC
/begin CHARACTERISTIC UTCWMN "" VALUE 0x80044234 KwWU16 4.995117 spg_uw_q0p00488 0.00 4.995117 FORMAT "%8.6" /end CHARACTERISTIC
/begin CHARACTERISTIC UTCWMX "" VALUE 0x80044236 KwWU16 4.995117 spg_uw_q0p00488 0.00 4.995117 FORMAT "%8.6" /end CHARACTERISTIC
/begin CHARACTERISTIC VFZGSA "" VALUE 0x8004421E KwWU16 511.9922 vfzg_uw_b512 0.00 511.9922 FORMAT "%8.4" /end CHARACTERISTIC
/begin CHARACTERISTIC WPRMX "" VALUE 0x8004420E KwUb 1530. kw_q6 0.00 1530. FORMAT "%5.0" /end CHARACTERISTIC
/begin MEASUREMENT Blwr_flgActv "" UBYTE OneToOne 1 100 0.00 1.000 BIT_MASK 0x80 FORMAT "%5.3" ECU_ADDRESS 0xD0000071 /end MEASUREMENT
/begin MEASUREMENT Blwr_flgHwActv "" UBYTE OneToOne 1 100 0.00 1.000 BIT_MASK 0x10 FORMAT "%5.3" ECU_ADDRESS 0xD0000067 /end MEASUREMENT
/begin MEASUREMENT Blwr_flgHwRaw_mp "" UBYTE OneToOne 1 100 0.00 1.000 BIT_MASK 0x1 FORMAT "%5.3" ECU_ADDRESS 0xD00053BD /end MEASUREMENT
/begin MEASUREMENT Brk_pMnCyl "" SWORD Pres_LoRes_COMPU 1 100 -327.6800 327.6700 FORMAT "%8.4" ECU_ADDRESS 0xD0003478 /end MEASUREMENT
/begin MEASUREMENT Brk_st "" UBYTE OneToOne 1 100 0.00 255.0 FORMAT "%5.1" ECU_ADDRESS 0xD0003C17 /end MEASUREMENT
/begin MEASUREMENT Brk_stFreeze_mp "" UBYTE OneToOne 1 100 0.00 255.0 FORMAT "%5.1" ECU_ADDRESS 0xD00053BE /end MEASUREMENT
/begin MEASUREMENT Brk_stMn "" UBYTE OneToOne 1 100 0.00 255.0 FORMAT "%5.1" ECU_ADDRESS 0xD0003C19 /end MEASUREMENT
/begin MEASUREMENT Brk_stMnRaw "" UBYTE OneToOne 1 100 0.00 255.0 FORMAT "%5.1" ECU_ADDRESS 0xD0003C1A /end MEASUREMENT
/begin MEASUREMENT Brk_stRed "" UBYTE OneToOne 1 100 0.00 255.0 FORMAT "%5.1" ECU_ADDRESS 0xD0003C1B /end MEASUREMENT
/begin MEASUREMENT Brk_stRedRaw "" UBYTE OneToOne 1 100 0.00 255.0 FORMAT "%5.1" ECU_ADDRESS 0xD0003C1C /end MEASUREMENT
/begin MEASUREMENT Brk_uPedPosRawZero_mp "" SWORD Volt 1 100 -6553.600 6553.400 FORMAT "%8.3" ECU_ADDRESS 0xD00052C8 /end MEASUREMENT
/begin MEASUREMENT B_br2k "" UBYTE B_TRUE 1 100 0.00 1.00000000000 BIT_MASK 0x40 FORMAT "%13.11" ECU_ADDRESS 0xD0000072 /end MEASUREMENT
/begin MEASUREMENT B_brems "" UBYTE B_TRUE 1 100 0.00 1.00000000000 BIT_MASK 0x80 FORMAT "%13.11" ECU_ADDRESS 0xD0000094 /end MEASUREMENT
/begin MEASUREMENT B_desee "" UBYTE B_TRUE 1 100 0.00 1.00000000000 BIT_MASK 0x1 FORMAT "%13.11" ECU_ADDRESS 0xD000005E /end MEASUREMENT
/begin MEASUREMENT B_deseehr "" UBYTE B_TRUE 1 100 0.00 1.00000000000 BIT_MASK 0x40 FORMAT "%13.11" ECU_ADDRESS 0xD000009B /end MEASUREMENT
/begin MEASUREMENT B_dkpdiaend "" UBYTE B_TRUE 1 100 0.00 1.00000000000 BIT_MASK 0x20 FORMAT "%13.11" ECU_ADDRESS 0xD0000076 /end MEASUREMENT
/begin MEASUREMENT B_eev "" UBYTE B_TRUE 1 100 0.00 1.00000000000 BIT_MASK 0x40 FORMAT "%13.11" ECU_ADDRESS 0xD0000070 /end MEASUREMENT
/begin MEASUREMENT B_emntcwec "" UBYTE B_TRUE 1 100 0.00 1.00000000000 BIT_MASK 0x1 FORMAT "%13.11" ECU_ADDRESS 0xD0000C33 /end MEASUREMENT
/begin MEASUREMENT B_emxtcwec "" UBYTE B_TRUE 1 100 0.00 1.00000000000 BIT_MASK 0x2 FORMAT "%13.11" ECU_ADDRESS 0xD0000C33 /end MEASUREMENT
/begin MEASUREMENT B_enptcwec "" UBYTE B_TRUE 1 100 0.00 1.00000000000 BIT_MASK 0x4 FORMAT "%13.11" ECU_ADDRESS 0xD0000C33 /end MEASUREMENT
/begin MEASUREMENT B_esgtcwec "" UBYTE B_TRUE 1 100 0.00 1.00000000000 BIT_MASK 0x1 FORMAT "%13.11" ECU_ADDRESS 0xD0000C34 /end MEASUREMENT
/begin MEASUREMENT B_etfa1fcl "" UBYTE B_TRUE 1 100 0.00 1.00000000000 BIT_MASK 0x4 FORMAT "%13.11" ECU_ADDRESS 0xD0000C37 /end MEASUREMENT
/begin MEASUREMENT B_htcwec "" UBYTE B_TRUE 1 100 0.00 1.00000000000 BIT_MASK 0x8 FORMAT "%13.11" ECU_ADDRESS 0xD0000C33 /end MEASUREMENT
/begin MEASUREMENT B_kuppl "" UBYTE B_TRUE 1 100 0.00 1.00000000000 BIT_MASK 0x2 FORMAT "%13.11" ECU_ADDRESS 0xD000005D /end MEASUREMENT
/begin MEASUREMENT B_lelsxbb "" UBYTE B_TRUE 1 100 0.00 1.00000000000 BIT_MASK 0x40 FORMAT "%13.11" ECU_ADDRESS 0xD000002D /end MEASUREMENT
/begin MEASUREMENT B_lelsxnb "" UBYTE B_TRUE 1 100 0.00 1.00000000000 BIT_MASK 0x20 FORMAT "%13.11" ECU_ADDRESS 0xD000002D /end MEASUREMENT
/begin MEASUREMENT B_lrebwl "" UBYTE B_TRUE 1 100 0.00 1.00000000000 BIT_MASK 0x80 FORMAT "%13.11" ECU_ADDRESS 0xD000002D /end MEASUREMENT
/begin MEASUREMENT B_mdeebts "" UBYTE B_TRUE 1 100 0.00 1.00000000000 BIT_MASK 0x80 FORMAT "%13.11" ECU_ADDRESS 0xD000006B /end MEASUREMENT
/begin MEASUREMENT B_nsp "" UBYTE B_TRUE 1 100 0.00 1.00000000000 BIT_MASK 0x1 FORMAT "%13.11" ECU_ADDRESS 0xD000006B /end MEASUREMENT
/begin MEASUREMENT B_PmdInit "" UBYTE B_TRUE 1 100 0.00 1.00000000000 BIT_MASK 0x80 FORMAT "%13.11" ECU_ADDRESS 0xD000006E /end MEASUREMENT
/begin MEASUREMENT B_pmntcwec "" UBYTE B_TRUE 1 100 0.00 1.00000000000 BIT_MASK 0x10 FORMAT "%13.11" ECU_ADDRESS 0xD0000C33 /end MEASUREMENT
/begin MEASUREMENT B_pmxtcwec "" UBYTE B_TRUE 1 100 0.00 1.00000000000 BIT_MASK 0x20 FORMAT "%13.11" ECU_ADDRESS 0xD0000C33 /end MEASUREMENT
/begin MEASUREMENT B_pnptcwec "" UBYTE B_TRUE 1 100 0.00 1.00000000000 BIT_MASK 0x40 FORMAT "%13.11" ECU_ADDRESS 0xD0000C33 /end MEASUREMENT
/begin MEASUREMENT B_rlp "" UBYTE B_TRUE 1 100 0.00 1.00000000000 BIT_MASK 0x2 FORMAT "%13.11" ECU_ADDRESS 0xD000005F /end MEASUREMENT
/begin MEASUREMENT B_rlp100ms "" UBYTE B_TRUE 1 100 0.00 1.00000000000 BIT_MASK 0x4 FORMAT "%13.11" ECU_ADDRESS 0xD000002D /end MEASUREMENT
/begin MEASUREMENT B_rlpns "" UBYTE B_TRUE 1 100 0.00 1.00000000000 BIT_MASK 0x1 FORMAT "%13.11" ECU_ADDRESS 0xD000002D /end MEASUREMENT
/begin MEASUREMENT B_sabbts "" UBYTE B_TRUE 1 100 0.00 1.00000000000 BIT_MASK 0x8 FORMAT "%13.11" ECU_ADDRESS 0xD000005F /end MEASUREMENT
/begin MEASUREMENT B_tansgg "" UBYTE B_TRUE 1 100 0.00 1.00000000000 BIT_MASK 0x1 FORMAT "%13.11" ECU_ADDRESS 0xD0000C39 /end MEASUREMENT
/begin MEASUREMENT B_tansnmot "" UBYTE B_TRUE 1 100 0.00 1.00000000000 BIT_MASK 0x1 FORMAT "%13.11" ECU_ADDRESS 0xD0000C36 /end MEASUREMENT
/begin MEASUREMENT B_tasrgg "" UBYTE B_TRUE 1 100 0.00 1.00000000000 BIT_MASK 0x20 FORMAT "%13.11" ECU_ADDRESS 0xD0000C37 /end MEASUREMENT
/begin MEASUREMENT B_tatmsa "" UBYTE B_TRUE 1 100 0.00 1.00000000000 BIT_MASK 0x40 FORMAT "%13.11" ECU_ADDRESS 0xD000007F /end MEASUREMENT
/begin MEASUREMENT B_tcwcsg "" UBYTE B_TRUE 1 100 0.00 1.00000000000 BIT_MASK 0x4 FORMAT "%13.11" ECU_ADDRESS 0xD0000C34 /end MEASUREMENT
/begin MEASUREMENT B_tcwpg "" UBYTE B_TRUE 1 100 0.00 1.00000000000 BIT_MASK 0x2 FORMAT "%13.11" ECU_ADDRESS 0xD0000C34 /end MEASUREMENT
/begin MEASUREMENT B_tfa1gg "" UBYTE B_TRUE 1 100 0.00 1.00000000000 BIT_MASK 0x80 FORMAT "%13.11" ECU_ADDRESS 0xD0000C37 /end MEASUREMENT
/begin MEASUREMENT B_tfa1rg "" UBYTE B_TRUE 1 100 0.00 1.00000000000 BIT_MASK 0x40 FORMAT "%13.11" ECU_ADDRESS 0xD0000C38 /end MEASUREMENT
/begin MEASUREMENT B_tfastz "" UBYTE B_TRUE 1 100 0.00 1.00000000000 BIT_MASK 0x2 FORMAT "%13.11" ECU_ADDRESS 0xD0000C36 /end MEASUREMENT
/begin MEASUREMENT B_tired "" UBYTE B_TRUE 1 100 0.00 1.00000000000 BIT_MASK 0x20 FORMAT "%13.11" ECU_ADDRESS 0xD0000096 /end MEASUREMENT
/begin MEASUREMENT B_tmotgg "" UBYTE B_TRUE 1 100 0.00 1.00000000000 BIT_MASK 0x2 FORMAT "%13.11" ECU_ADDRESS 0xD0000C35 /end MEASUREMENT
/begin MEASUREMENT B_tmotrg "" UBYTE B_TRUE 1 100 0.00 1.00000000000 BIT_MASK 0x1 FORMAT "%13.11" ECU_ADDRESS 0xD0000C35 /end MEASUREMENT
/begin MEASUREMENT B_ugdsp "" UBYTE B_TRUE 1 100 0.00 1.00000000000 BIT_MASK 0x2 FORMAT "%13.11" ECU_ADDRESS 0xD000002D /end MEASUREMENT
/begin MEASUREMENT Clth_bDiaEna "" UBYTE OneToOne 1 100 0.00 1.000 BIT_MASK 0x20 FORMAT "%5.3" ECU_ADDRESS 0xD0000098 /end MEASUREMENT
/begin MEASUREMENT Clth_st "" UBYTE OneToOne 1 100 0.00 255.0 FORMAT "%5.1" ECU_ADDRESS 0xD0003C1D /end MEASUREMENT
/begin MEASUREMENT Clth_stDiag "" UBYTE OneToOne 1 100 0.00 255.0 FORMAT "%5.1" ECU_ADDRESS 0xD0003C1E /end MEASUREMENT
/begin MEASUREMENT Clth_stEPBSigVld "" UBYTE OneToOne 1 100 0.00 1.000 BIT_MASK 0x10 FORMAT "%5.3" ECU_ADDRESS 0xD0000054 /end MEASUREMENT
/begin MEASUREMENT Clth_stIntDebVal "" UBYTE OneToOne 1 100 0.00 255.0 FORMAT "%5.1" ECU_ADDRESS 0xD0003C1F /end MEASUREMENT
/begin MEASUREMENT Clth_stLastGear "" SBYTE OneToOne 1 100 -128.0 127.0 FORMAT "%5.1" ECU_ADDRESS 0xD0003BE4 /end MEASUREMENT
/begin MEASUREMENT Clth_stRaw "" UBYTE OneToOne 1 100 0.00 255.0 FORMAT "%5.1" ECU_ADDRESS 0xD0003C20 /end MEASUREMENT
/begin MEASUREMENT Clth_stTstPrfm "" UBYTE OneToOne 1 100 0.00 255.0 FORMAT "%5.1" ECU_ADDRESS 0xD0003C21 /end MEASUREMENT
/begin MEASUREMENT CoCTM_trqMaxAC "" SWORD Trq 1 100 -3276.800 3276.700 FORMAT "%8.3" ECU_ADDRESS 0xD000348A /end MEASUREMENT
/begin MEASUREMENT CoEng_bStalEng "" UBYTE OneToOne 1 100 0.00 1.000 BIT_MASK 0x1 FORMAT "%5.3" ECU_ADDRESS 0xD0000060 /end MEASUREMENT
/begin MEASUREMENT CoEng_st "" UBYTE OneToOne 1 100 0.00 255.0 FORMAT "%5.1" ECU_ADDRESS 0xD0003C24 /end MEASUREMENT
/begin MEASUREMENT CoEng_stOld "" UBYTE OneToOne 1 100 0.00 255.0 FORMAT "%5.1" ECU_ADDRESS 0xD0003C25 /end MEASUREMENT
/begin MEASUREMENT CoEng_stStalEngReas "" UBYTE OneToOne 1 100 0.00 255.0 FORMAT "%5.1" ECU_ADDRESS 0xD0003C26 /end MEASUREMENT
/begin MEASUREMENT CoEng_stXPostDrv_mp "" UBYTE OneToOne 1 100 0.00 255.0 FORMAT "%5.1" ECU_ADDRESS 0xD00053BF /end MEASUREMENT
/begin MEASUREMENT CoEng_tiAfterrun "" ULONG Time_ms 1 100 0.00 42949672950.0 FORMAT "%13.1" ECU_ADDRESS 0xD0002324 /end MEASUREMENT
/begin MEASUREMENT CoEng_tiAfterrunRed "" SWORD TimeRed 1 100 -5242.880 5242.720 FORMAT "%8.3" ECU_ADDRESS 0xD0003494 /end MEASUREMENT
/begin MEASUREMENT CoEng_tiNormal "" ULONG Time_ms 1 100 0.00 42949672950.0 FORMAT "%13.1" ECU_ADDRESS 0xD0002328 /end MEASUREMENT
/begin MEASUREMENT CoEng_tiNormalOBD "" ULONG Time_sec_q1_COMPU 1 100 0.00 4294967295.00 FORMAT "%13.2" ECU_ADDRESS 0xAFE806F8 /end MEASUREMENT
/begin MEASUREMENT CoEng_tiNormalRed "" SWORD TimeRed 1 100 -5242.880 5242.720 FORMAT "%8.3" ECU_ADDRESS 0xD0003496 /end MEASUREMENT
/begin MEASUREMENT CoEng_tiStandby "" ULONG Time_ms 1 100 0.00 42949672950.0 FORMAT "%13.1" ECU_ADDRESS 0xD000232C /end MEASUREMENT
/begin MEASUREMENT CoEng_tiStandbyRed "" SWORD TimeRed 1 100 -5242.880 5242.720 FORMAT "%8.3" ECU_ADDRESS 0xD0003498 /end MEASUREMENT
/begin MEASUREMENT CoEng_tiStart "" ULONG Time_ms 1 100 0.00 42949672950.0 FORMAT "%13.1" ECU_ADDRESS 0xD0002330 /end MEASUREMENT
/begin MEASUREMENT CoEng_tiStartRed "" SWORD TimeRed 1 100 -5242.880 5242.720 FORMAT "%8.3" ECU_ADDRESS 0xD000349A /end MEASUREMENT
/begin MEASUREMENT CoESS_stAlt "" UBYTE OneToOne 1 100 0.00 255.0 FORMAT "%5.1" ECU_ADDRESS 0xD0003C22 /end MEASUREMENT
/begin MEASUREMENT CoESS_stEngSet_mp "" UBYTE OneToOne 1 100 0.00 255.0 FORMAT "%5.1" ECU_ADDRESS 0xD00053C0 /end MEASUREMENT
/begin MEASUREMENT CoESS_stNBattRst_mp "" UBYTE OneToOne 1 100 0.00 255.0 FORMAT "%5.1" ECU_ADDRESS 0xD00053C1 /end MEASUREMENT
/begin MEASUREMENT CoESS_stNBattSet_mp "" UBYTE OneToOne 1 100 0.00 255.0 FORMAT "%5.1" ECU_ADDRESS 0xD00053C2 /end MEASUREMENT
/begin MEASUREMENT CoESS_stVltgBattRst_mp "" UBYTE OneToOne 1 100 0.00 255.0 FORMAT "%5.1" ECU_ADDRESS 0xD00053C3 /end MEASUREMENT
/begin MEASUREMENT CoESS_stVltgBattSet_mp "" UBYTE OneToOne 1 100 0.00 255.0 FORMAT "%5.1" ECU_ADDRESS 0xD00053C4 /end MEASUREMENT
/begin MEASUREMENT Com_stFrmTxEna "" ULONG OneToOne 1 100 0.00 2147483647.00 FORMAT "%13.2" ECU_ADDRESS 0xD0002C2C /end MEASUREMENT
/begin MEASUREMENT CoTS_rClgDem "" SWORD Prc 1 100 -400.0000 399.9878 FORMAT "%8.4" ECU_ADDRESS 0xD00034A4 /end MEASUREMENT
/begin MEASUREMENT CoTS_tClntEngOutDes "" SWORD Temp_Cels 1 100 -3549.940 3003.560 FORMAT "%8.3" ECU_ADDRESS 0xD00034A6 /end MEASUREMENT
/begin MEASUREMENT CoTS_trqMaxAC "" SWORD Trq 1 100 -3276.800 3276.700 FORMAT "%8.3" ECU_ADDRESS 0xD00034A8 /end MEASUREMENT
/begin MEASUREMENT Cpu_rCurCSACons_mp "" UWORD Ratio_045_COMPU 1 100 0.00 99.99847 FORMAT "%8.5" ECU_ADDRESS 0xD00052CA /end MEASUREMENT
/begin MEASUREMENT Cpu_rCurSysStackCons_mp "" UWORD Ratio_045_COMPU 1 100 0.00 99.99847 FORMAT "%8.5" ECU_ADDRESS 0xD00052CC /end MEASUREMENT
/begin MEASUREMENT Cpu_rCurUsrStackCons_mp "" UWORD Ratio_045_COMPU 1 100 0.00 99.99847 FORMAT "%8.5" ECU_ADDRESS 0xD00052CE /end MEASUREMENT
/begin MEASUREMENT Cpu_rMaxCSACons_mp "" UWORD Ratio_045_COMPU 1 100 0.00 99.99847 FORMAT "%8.5" ECU_ADDRESS 0xD00052D0 /end MEASUREMENT
/begin MEASUREMENT Cpu_rMaxSysStackCons_mp "" UWORD Ratio_045_COMPU 1 100 0.00 99.99847 FORMAT "%8.5" ECU_ADDRESS 0xD00052D2 /end MEASUREMENT
/begin MEASUREMENT Cpu_rMaxUsrStackCons_mp "" UWORD Ratio_045_COMPU 1 100 0.00 99.99847 FORMAT "%8.5" ECU_ADDRESS 0xD00052D4 /end MEASUREMENT
/begin MEASUREMENT CTM_nMin "" SWORD EngN 1 100 -16384.00 16383.50 FORMAT "%8.2" ECU_ADDRESS 0xD0003482 /end MEASUREMENT
/begin MEASUREMENT CTM_trqDes "" SWORD Trq 1 100 -3276.800 3276.700 FORMAT "%8.3" ECU_ADDRESS 0xD0003484 /end MEASUREMENT
/begin MEASUREMENT CTM_trqResv "" SWORD Trq 1 100 -3276.800 3276.700 FORMAT "%8.3" ECU_ADDRESS 0xD0003486 /end MEASUREMENT
/begin MEASUREMENT dctcwAusBitsKoop1 "" UBYTE dez 1 100 0.00 255.0 FORMAT "%5.1" ECU_ADDRESS 0xD0000C35 /end MEASUREMENT
/begin MEASUREMENT dctcwLokBitsKoop1 "" UBYTE dez 1 100 0.00 255.0 FORMAT "%5.1" ECU_ADDRESS 0xD0000C33 /end MEASUREMENT
/begin MEASUREMENT dctcwLokBitsKoop2 "" UBYTE dez 1 100 0.00 255.0 FORMAT "%5.1" ECU_ADDRESS 0xD0000C34 /end MEASUREMENT
/begin MEASUREMENT DCTFAAusBitsKoop1 "" UBYTE dez 1 100 0.00 255.0 FORMAT "%5.1" ECU_ADDRESS 0xD0000C37 /end MEASUREMENT
/begin MEASUREMENT DCTFAAusBitsKoop2 "" UBYTE dez 1 100 0.00 255.0 FORMAT "%5.1" ECU_ADDRESS 0xD0000C38 /end MEASUREMENT
/begin MEASUREMENT DCTFAAusBitsKoop3 "" UBYTE dez 1 100 0.00 255.0 FORMAT "%5.1" ECU_ADDRESS 0xD0000C39 /end MEASUREMENT
/begin MEASUREMENT DCTFALocBitsKoop1 "" UBYTE dez 1 100 0.00 255.0 FORMAT "%5.1" ECU_ADDRESS 0xD0000C36 /end MEASUREMENT
/begin MEASUREMENT DDRC_St.DFC_AltMaxPwr "" ULONG DFC_OneToOne 1 100 0.00 536870911.000 BIT_MASK 0x1fffffff FORMAT "%13.3" ECU_ADDRESS 0xD0002A78 /end MEASUREMENT
/begin MEASUREMENT DDRC_St.DFC_BrkNpl "" ULONG DFC_OneToOne 1 100 0.00 536870911.000 BIT_MASK 0x1fffffff FORMAT "%13.3" ECU_ADDRESS 0xD0002A7C /end MEASUREMENT
/begin MEASUREMENT DDRC_St.DFC_Cj930SSp1Mon "" ULONG DFC_OneToOne 1 100 0.00 536870911.000 BIT_MASK 0x1fffffff FORMAT "%13.3" ECU_ADDRESS 0xD0002A80 /end MEASUREMENT
/begin MEASUREMENT DDRC_St.DFC_Cj930SSp2Mon "" ULONG DFC_OneToOne 1 100 0.00 536870911.000 BIT_MASK 0x1fffffff FORMAT "%13.3" ECU_ADDRESS 0xD0002A84 /end MEASUREMENT
/begin MEASUREMENT DDRC_St.DFC_Cj930SSp3Mon "" ULONG DFC_OneToOne 1 100 0.00 536870911.000 BIT_MASK 0x1fffffff FORMAT "%13.3" ECU_ADDRESS 0xD0002A88 /end MEASUREMENT
/begin MEASUREMENT DDRC_St.DFC_IdleChrgActrAMax "" ULONG DFC_OneToOne 1 100 0.00 536870911.000 BIT_MASK 0x1fffffff FORMAT "%13.3" ECU_ADDRESS 0xD0002A8C /end MEASUREMENT
/begin MEASUREMENT DDRC_St.DFC_IdleChrgActrAMin "" ULONG DFC_OneToOne 1 100 0.00 536870911.000 BIT_MASK 0x1fffffff FORMAT "%13.3" ECU_ADDRESS 0xD0002A90 /end MEASUREMENT
/begin MEASUREMENT DDRC_St.DFC_IdleChrgActrASig "" ULONG DFC_OneToOne 1 100 0.00 536870911.000 BIT_MASK 0x1fffffff FORMAT "%13.3" ECU_ADDRESS 0xD0002A94 /end MEASUREMENT
/begin MEASUREMENT DDRC_St.DFC_IdleChrgActrBMax "" ULONG DFC_OneToOne 1 100 0.00 536870911.000 BIT_MASK 0x1fffffff FORMAT "%13.3" ECU_ADDRESS 0xD0002A98 /end MEASUREMENT
/begin MEASUREMENT DDRC_St.DFC_IdleChrgActrBMin "" ULONG DFC_OneToOne 1 100 0.00 536870911.000 BIT_MASK 0x1fffffff FORMAT "%13.3" ECU_ADDRESS 0xD0002A9C /end MEASUREMENT
/begin MEASUREMENT DDRC_St.DFC_IdleChrgActrBSig "" ULONG DFC_OneToOne 1 100 0.00 536870911.000 BIT_MASK 0x1fffffff FORMAT "%13.3" ECU_ADDRESS 0xD0002AA0 /end MEASUREMENT
/begin MEASUREMENT DDRC_St.DFC_IdleChrgActrGovDeCold "" ULONG DFC_OneToOne 1 100 0.00 536870911.000 BIT_MASK 0x1fffffff FORMAT "%13.3" ECU_ADDRESS 0xD0002AA4 /end MEASUREMENT
/begin MEASUREMENT DDRC_St.DFC_IdleChrgActrGovDeMax "" ULONG DFC_OneToOne 1 100 0.00 536870911.000 BIT_MASK 0x1fffffff FORMAT "%13.3" ECU_ADDRESS 0xD0002AA8 /end MEASUREMENT
/begin MEASUREMENT DDRC_St.DFC_IdleChrgActrGovDeMin "" ULONG DFC_OneToOne 1 100 0.00 536870911.000 BIT_MASK 0x1fffffff FORMAT "%13.3" ECU_ADDRESS 0xD0002AAC /end MEASUREMENT
/begin MEASUREMENT DDRC_St.DFC_IdleChrgActrNAMax "" ULONG DFC_OneToOne 1 100 0.00 536870911.000 BIT_MASK 0x1fffffff FORMAT "%13.3" ECU_ADDRESS 0xD0002AB0 /end MEASUREMENT
/begin MEASUREMENT DDRC_St.DFC_IdleChrgActrNAMin "" ULONG DFC_OneToOne 1 100 0.00 536870911.000 BIT_MASK 0x1fffffff FORMAT "%13.3" ECU_ADDRESS 0xD0002AB4 /end MEASUREMENT
/begin MEASUREMENT DDRC_St.DFC_IdleChrgActrNASig "" ULONG DFC_OneToOne 1 100 0.00 536870911.000 BIT_MASK 0x1fffffff FORMAT "%13.3" ECU_ADDRESS 0xD0002AB8 /end MEASUREMENT
/begin MEASUREMENT DDRC_St.DFC_IdleChrgActrNBMax "" ULONG DFC_OneToOne 1 100 0.00 536870911.000 BIT_MASK 0x1fffffff FORMAT "%13.3" ECU_ADDRESS 0xD0002ABC /end MEASUREMENT
/begin MEASUREMENT DDRC_St.DFC_IdleChrgActrNBMin "" ULONG DFC_OneToOne 1 100 0.00 536870911.000 BIT_MASK 0x1fffffff FORMAT "%13.3" ECU_ADDRESS 0xD0002AC0 /end MEASUREMENT
/begin MEASUREMENT DDRC_St.DFC_IdleChrgActrNBSig "" ULONG DFC_OneToOne 1 100 0.00 536870911.000 BIT_MASK 0x1fffffff FORMAT "%13.3" ECU_ADDRESS 0xD0002AC4 /end MEASUREMENT
/begin MEASUREMENT DDRC_St.DFC_IdleChrgActrOverTmp "" ULONG DFC_OneToOne 1 100 0.00 536870911.000 BIT_MASK 0x1fffffff FORMAT "%13.3" ECU_ADDRESS 0xD0002AC8 /end MEASUREMENT
/begin MEASUREMENT DDRC_St.DFC_MonUMaxSupply1 "" ULONG DFC_OneToOne 1 100 0.00 536870911.000 BIT_MASK 0x1fffffff FORMAT "%13.3" ECU_ADDRESS 0xD0002ACC /end MEASUREMENT
/begin MEASUREMENT DDRC_St.DFC_MonUMinSupply1 "" ULONG DFC_OneToOne 1 100 0.00 536870911.000 BIT_MASK 0x1fffffff FORMAT "%13.3" ECU_ADDRESS 0xD0002AD0 /end MEASUREMENT
/begin MEASUREMENT DDRC_St.DFC_ClthNplClsd "" ULONG DFC_OneToOne 1 100 0.00 536870911.000 BIT_MASK 0x1fffffff FORMAT "%13.3" ECU_ADDRESS 0xD0002AD4 /end MEASUREMENT
/begin MEASUREMENT DDRC_St.DFC_ClthNplOpn "" ULONG DFC_OneToOne 1 100 0.00 536870911.000 BIT_MASK 0x1fffffff FORMAT "%13.3" ECU_ADDRESS 0xD0002AD8 /end MEASUREMENT
/begin MEASUREMENT DDRC_St.DFC_IgnClPsDevComErr1 "" ULONG DFC_OneToOne 1 100 0.00 536870911.000 BIT_MASK 0x1fffffff FORMAT "%13.3" ECU_ADDRESS 0xD0002ADC /end MEASUREMENT
/begin MEASUREMENT DDRC_St.DFC_IgnClPsOpenLoad0 "" ULONG DFC_OneToOne 1 100 0.00 536870911.000 BIT_MASK 0x1fffffff FORMAT "%13.3" ECU_ADDRESS 0xD0002AE0 /end MEASUREMENT
/begin MEASUREMENT DDRC_St.DFC_IgnClPsOpenLoad1 "" ULONG DFC_OneToOne 1 100 0.00 536870911.000 BIT_MASK 0x1fffffff FORMAT "%13.3" ECU_ADDRESS 0xD0002AE4 /end MEASUREMENT
/begin MEASUREMENT DDRC_St.DFC_IgnClPsOpenLoad2 "" ULONG DFC_OneToOne 1 100 0.00 536870911.000 BIT_MASK 0x1fffffff FORMAT "%13.3" ECU_ADDRESS 0xD0002AE8 /end MEASUREMENT
/begin MEASUREMENT DDRC_St.DFC_IgnClPsShCirBatt0 "" ULONG DFC_OneToOne 1 100 0.00 536870911.000 BIT_MASK 0x1fffffff FORMAT "%13.3" ECU_ADDRESS 0xD0002AEC /end MEASUREMENT
/begin MEASUREMENT DDRC_St.DFC_IgnClPsShCirBatt1 "" ULONG DFC_OneToOne 1 100 0.00 536870911.000 BIT_MASK 0x1fffffff FORMAT "%13.3" ECU_ADDRESS 0xD0002AF0 /end MEASUREMENT
/begin MEASUREMENT DDRC_St.DFC_IgnClPsShCirBatt2 "" ULONG DFC_OneToOne 1 100 0.00 536870911.000 BIT_MASK 0x1fffffff FORMAT "%13.3" ECU_ADDRESS 0xD0002AF4 /end MEASUREMENT
/begin MEASUREMENT DDRC_St.DFC_IgnClPsShCirGnd0 "" ULONG DFC_OneToOne 1 100 0.00 536870911.000 BIT_MASK 0x1fffffff FORMAT "%13.3" ECU_ADDRESS 0xD0002AF8 /end MEASUREMENT
/begin MEASUREMENT DDRC_St.DFC_IgnClPsShCirGnd1 "" ULONG DFC_OneToOne 1 100 0.00 536870911.000 BIT_MASK 0x1fffffff FORMAT "%13.3" ECU_ADDRESS 0xD0002AFC /end MEASUREMENT
/begin MEASUREMENT DDRC_St.DFC_IgnClPsShCirGnd2 "" ULONG DFC_OneToOne 1 100 0.00 536870911.000 BIT_MASK 0x1fffffff FORMAT "%13.3" ECU_ADDRESS 0xD0002B00 /end MEASUREMENT
/begin MEASUREMENT DDRC_St.DFC_KnDetSens1PortAMax "" ULONG DFC_OneToOne 1 100 0.00 536870911.000 BIT_MASK 0x1fffffff FORMAT "%13.3" ECU_ADDRESS 0xD0002B04 /end MEASUREMENT
/begin MEASUREMENT DDRC_St.DFC_KnDetSens1PortAMin "" ULONG DFC_OneToOne 1 100 0.00 536870911.000 BIT_MASK 0x1fffffff FORMAT "%13.3" ECU_ADDRESS 0xD0002B08 /end MEASUREMENT
/begin MEASUREMENT DDRC_St.DFC_KnDetSens1PortBMax "" ULONG DFC_OneToOne 1 100 0.00 536870911.000 BIT_MASK 0x1fffffff FORMAT "%13.3" ECU_ADDRESS 0xD0002B0C /end MEASUREMENT
/begin MEASUREMENT DDRC_St.DFC_KnDetSens1PortBMin "" ULONG DFC_OneToOne 1 100 0.00 536870911.000 BIT_MASK 0x1fffffff FORMAT "%13.3" ECU_ADDRESS 0xD0002B10 /end MEASUREMENT
/begin MEASUREMENT DDRC_St.DFC_VehVWhlErr "" ULONG DFC_OneToOne 1 100 0.00 536870911.000 BIT_MASK 0x1fffffff FORMAT "%13.3" ECU_ADDRESS 0xD0002B14 /end MEASUREMENT
/begin MEASUREMENT DDRC_St.DFC_AirCCmprOL "" ULONG DFC_OneToOne 1 100 0.00 536870911.000 BIT_MASK 0x1fffffff FORMAT "%13.3" ECU_ADDRESS 0xD0002B18 /end MEASUREMENT
/begin MEASUREMENT DDRC_St.DFC_AirCCmprOvrTemp "" ULONG DFC_OneToOne 1 100 0.00 536870911.000 BIT_MASK 0x1fffffff FORMAT "%13.3" ECU_ADDRESS 0xD0002B1C /end MEASUREMENT
/begin MEASUREMENT DDRC_St.DFC_AirCCmprSCB "" ULONG DFC_OneToOne 1 100 0.00 536870911.000 BIT_MASK 0x1fffffff FORMAT "%13.3" ECU_ADDRESS 0xD0002B20 /end MEASUREMENT
/begin MEASUREMENT DDRC_St.DFC_AirCCmprSCG "" ULONG DFC_OneToOne 1 100 0.00 536870911.000 BIT_MASK 0x1fffffff FORMAT "%13.3" ECU_ADDRESS 0xD0002B24 /end MEASUREMENT
/begin MEASUREMENT DDRC_St.DFC_AltIOLdSRCMin "" ULONG DFC_OneToOne 1 100 0.00 536870911.000 BIT_MASK 0x1fffffff FORMAT "%13.3" ECU_ADDRESS 0xD0002B28 /end MEASUREMENT
/begin MEASUREMENT DDRC_St.DFC_AltIOOL "" ULONG DFC_OneToOne 1 100 0.00 536870911.000 BIT_MASK 0x1fffffff FORMAT "%13.3" ECU_ADDRESS 0xD0002B2C /end MEASUREMENT
/begin MEASUREMENT DDRC_St.DFC_AltIOOvrTemp "" ULONG DFC_OneToOne 1 100 0.00 536870911.000 BIT_MASK 0x1fffffff FORMAT "%13.3" ECU_ADDRESS 0xD0002B30 /end MEASUREMENT
/begin MEASUREMENT DDRC_St.DFC_AltIOSCB "" ULONG DFC_OneToOne 1 100 0.00 536870911.000 BIT_MASK 0x1fffffff FORMAT "%13.3" ECU_ADDRESS 0xD0002B34 /end MEASUREMENT
/begin MEASUREMENT DDRC_St.DFC_AltIOSCG "" ULONG DFC_OneToOne 1 100 0.00 536870911.000 BIT_MASK 0x1fffffff FORMAT "%13.3" ECU_ADDRESS 0xD0002B38 /end MEASUREMENT
/begin MEASUREMENT DDRC_St.DFC_DevLibBattUHi "" ULONG DFC_OneToOne 1 100 0.00 536870911.000 BIT_MASK 0x1fffffff FORMAT "%13.3" ECU_ADDRESS 0xD0002B3C /end MEASUREMENT
/begin MEASUREMENT DDRC_St.DFC_DevLibBattULo "" ULONG DFC_OneToOne 1 100 0.00 536870911.000 BIT_MASK 0x1fffffff FORMAT "%13.3" ECU_ADDRESS 0xD0002B40 /end MEASUREMENT
/begin MEASUREMENT DDRC_St.DFC_FanDIOOL "" ULONG DFC_OneToOne 1 100 0.00 536870911.000 BIT_MASK 0x1fffffff FORMAT "%13.3" ECU_ADDRESS 0xD0002B44 /end MEASUREMENT
/begin MEASUREMENT DDRC_St.DFC_FanDIOOvrTemp "" ULONG DFC_OneToOne 1 100 0.00 536870911.000 BIT_MASK 0x1fffffff FORMAT "%13.3" ECU_ADDRESS 0xD0002B48 /end MEASUREMENT
/begin MEASUREMENT DDRC_St.DFC_FanDIOSCB "" ULONG DFC_OneToOne 1 100 0.00 536870911.000 BIT_MASK 0x1fffffff FORMAT "%13.3" ECU_ADDRESS 0xD0002B4C /end MEASUREMENT
/begin MEASUREMENT DDRC_St.DFC_FanDIOSCG "" ULONG DFC_OneToOne 1 100 0.00 536870911.000 BIT_MASK 0x1fffffff FORMAT "%13.3" ECU_ADDRESS 0xD0002B50 /end MEASUREMENT
/begin MEASUREMENT DDRC_St.DFC_FanPWMOL "" ULONG DFC_OneToOne 1 100 0.00 536870911.000 BIT_MASK 0x1fffffff FORMAT "%13.3" ECU_ADDRESS 0xD0002B54 /end MEASUREMENT
/begin MEASUREMENT DDRC_St.DFC_FanPWMOvrTemp "" ULONG DFC_OneToOne 1 100 0.00 536870911.000 BIT_MASK 0x1fffffff FORMAT "%13.3" ECU_ADDRESS 0xD0002B58 /end MEASUREMENT
/begin MEASUREMENT DDRC_St.DFC_FanPWMSCB "" ULONG DFC_OneToOne 1 100 0.00 536870911.000 BIT_MASK 0x1fffffff FORMAT "%13.3" ECU_ADDRESS 0xD0002B5C /end MEASUREMENT
/begin MEASUREMENT DDRC_St.DFC_FanPWMSCG "" ULONG DFC_OneToOne 1 100 0.00 536870911.000 BIT_MASK 0x1fffffff FORMAT "%13.3" ECU_ADDRESS 0xD0002B60 /end MEASUREMENT
/begin MEASUREMENT DDRC_St.DFC_AirCClntPAnaSRCMax "" UWORD DFC_OneToOne 1 100 0.00 8191.000 BIT_MASK 0x1fff FORMAT "%8.3" ECU_ADDRESS 0xD0003884 /end MEASUREMENT
/begin MEASUREMENT DDRC_St.DFC_AirCClntPAnaSRCMin "" UWORD DFC_OneToOne 1 100 0.00 8191.000 BIT_MASK 0x1fff FORMAT "%8.3" ECU_ADDRESS 0xD0003886 /end MEASUREMENT
/begin MEASUREMENT DDRC_St.DFC_AirCSwtNpl "" UWORD DFC_OneToOne 1 100 0.00 8191.000 BIT_MASK 0x1fff FORMAT "%8.3" ECU_ADDRESS 0xD0003888 /end MEASUREMENT
/begin MEASUREMENT DDRC_St.DFC_AirCSwtSig "" UWORD DFC_OneToOne 1 100 0.00 8191.000 BIT_MASK 0x1fff FORMAT "%8.3" ECU_ADDRESS 0xD000388A /end MEASUREMENT
/begin MEASUREMENT DDRC_St.DFC_AltIOLdSRCMax "" UWORD DFC_OneToOne 1 100 0.00 8191.000 BIT_MASK 0x1fff FORMAT "%8.3" ECU_ADDRESS 0xD000388C /end MEASUREMENT
/begin MEASUREMENT DDRC_St.DFC_BrkSig "" UWORD DFC_OneToOne 1 100 0.00 8191.000 BIT_MASK 0x1fff FORMAT "%8.3" ECU_ADDRESS 0xD000388E /end MEASUREMENT
/begin MEASUREMENT DDRC_St.DFC_ClthEPBNpl "" UWORD DFC_OneToOne 1 100 0.00 8191.000 BIT_MASK 0x1fff FORMAT "%8.3" ECU_ADDRESS 0xD0003890 /end MEASUREMENT
/begin MEASUREMENT DDRC_St.DFC_ClthEPBSensErr "" UWORD DFC_OneToOne 1 100 0.00 8191.000 BIT_MASK 0x1fff FORMAT "%8.3" ECU_ADDRESS 0xD0003892 /end MEASUREMENT
/begin MEASUREMENT DDRC_St.DFC_ClthErr "" UWORD DFC_OneToOne 1 100 0.00 8191.000 BIT_MASK 0x1fff FORMAT "%8.3" ECU_ADDRESS 0xD0003894 /end MEASUREMENT
/begin MEASUREMENT DDRC_St.DFC_ClthSig "" UWORD DFC_OneToOne 1 100 0.00 8191.000 BIT_MASK 0x1fff FORMAT "%8.3" ECU_ADDRESS 0xD0003896 /end MEASUREMENT
/begin MEASUREMENT DDRC_St.DFC_MILLmpOL "" UWORD DFC_OneToOne 1 100 0.00 8191.000 BIT_MASK 0x1fff FORMAT "%8.3" ECU_ADDRESS 0xD0003898 /end MEASUREMENT
/begin MEASUREMENT DDRC_St.DFC_MILLmpSCB "" UWORD DFC_OneToOne 1 100 0.00 8191.000 BIT_MASK 0x1fff FORMAT "%8.3" ECU_ADDRESS 0xD000389A /end MEASUREMENT
/begin MEASUREMENT DDRC_St.DFC_MILLmpSCG "" UWORD DFC_OneToOne 1 100 0.00 8191.000 BIT_MASK 0x1fff FORMAT "%8.3" ECU_ADDRESS 0xD000389C /end MEASUREMENT
/begin MEASUREMENT DDRC_St.DFC_SRCHighAPP1 "" UWORD DFC_OneToOne 1 100 0.00 8191.000 BIT_MASK 0x1fff FORMAT "%8.3" ECU_ADDRESS 0xD000389E /end MEASUREMENT
/begin MEASUREMENT DDRC_St.DFC_SRCHighAPP2 "" UWORD DFC_OneToOne 1 100 0.00 8191.000 BIT_MASK 0x1fff FORMAT "%8.3" ECU_ADDRESS 0xD00038A0 /end MEASUREMENT
/begin MEASUREMENT DDRC_St.DFC_SRCLowAPP1 "" UWORD DFC_OneToOne 1 100 0.00 8191.000 BIT_MASK 0x1fff FORMAT "%8.3" ECU_ADDRESS 0xD00038A2 /end MEASUREMENT
/begin MEASUREMENT DDRC_St.DFC_SRCLowAPP2 "" UWORD DFC_OneToOne 1 100 0.00 8191.000 BIT_MASK 0x1fff FORMAT "%8.3" ECU_ADDRESS 0xD00038A4 /end MEASUREMENT
/begin MEASUREMENT DDRC_St.DFC_SyncAPP "" UWORD DFC_OneToOne 1 100 0.00 8191.000 BIT_MASK 0x1fff FORMAT "%8.3" ECU_ADDRESS 0xD00038A6 /end MEASUREMENT
/begin MEASUREMENT DDRC_St.DFC_VehVMax "" UWORD DFC_OneToOne 1 100 0.00 8191.000 BIT_MASK 0x1fff FORMAT "%8.3" ECU_ADDRESS 0xD00038A8 /end MEASUREMENT
/begin MEASUREMENT DDRC_St.DFC_VehVPlaus "" UWORD DFC_OneToOne 1 100 0.00 8191.000 BIT_MASK 0x1fff FORMAT "%8.3" ECU_ADDRESS 0xD00038AA /end MEASUREMENT
/begin MEASUREMENT DDRC_St.DFC_VehVSig "" UWORD DFC_OneToOne 1 100 0.00 8191.000 BIT_MASK 0x1fff FORMAT "%8.3" ECU_ADDRESS 0xD00038AC /end MEASUREMENT
/begin MEASUREMENT DDRC_St.DFC_BusDiagBusOffNodeA "" UWORD DFC_OneToOne 1 100 0.00 8191.000 BIT_MASK 0x1fff FORMAT "%8.3" ECU_ADDRESS 0xD00038AE /end MEASUREMENT
/begin MEASUREMENT dekpe "" UBYTE dez 1 100 0.00 255.0 FORMAT "%5.1" ECU_ADDRESS 0xD0000C3D /end MEASUREMENT
/begin MEASUREMENT DevLib_stDigOutErr_mp "" ULONG OneToOne 1 100 0.00 4294967295.00 FORMAT "%13.2" ECU_ADDRESS 0xD0005178 /end MEASUREMENT
/begin MEASUREMENT DevLib_stPWMOutErr_mp "" ULONG OneToOne 1 100 0.00 4294967295.00 FORMAT "%13.2" ECU_ADDRESS 0xD000517C /end MEASUREMENT
/begin MEASUREMENT DevLib_stPwrStgEnaCond "" UBYTE OneToOne 1 100 0.00 255.0 FORMAT "%5.1" ECU_ADDRESS 0xD0003C43 /end MEASUREMENT
/begin MEASUREMENT DSM_xTabVersion "" UWORD DFC_OneToOne 1 100 0.00 65535.00 FORMAT "%8.2" ECU_ADDRESS 0xD0003882 /end MEASUREMENT
/begin MEASUREMENT dtsabts_w "" SWORD temp_q0p0468_K 1 100 -1536.000 1535.953 FORMAT "%8.3" ECU_ADDRESS 0xD00004F0 /end MEASUREMENT
/begin MEASUREMENT ekppz "" UBYTE dez 1 100 0.00 255.0 FORMAT "%5.1" ECU_ADDRESS 0xD0000C3E /end MEASUREMENT
/begin MEASUREMENT ESS_nMax "" SWORD EngN 1 100 -16384.00 16383.50 FORMAT "%8.2" ECU_ADDRESS 0xD00034CE /end MEASUREMENT
/begin MEASUREMENT ESS_nMin "" SWORD EngN 1 100 -16384.00 16383.50 FORMAT "%8.2" ECU_ADDRESS 0xD00034D0 /end MEASUREMENT
/begin MEASUREMENT ESS_trqDesAcs "" SWORD Trq 1 100 -3276.800 3276.700 FORMAT "%8.3" ECU_ADDRESS 0xD00034D4 /end MEASUREMENT
/begin MEASUREMENT ESS_trqResvAcs "" SWORD Trq 1 100 -3276.800 3276.700 FORMAT "%8.3" ECU_ADDRESS 0xD00034D6 /end MEASUREMENT
/begin MEASUREMENT flglrs "" UBYTE dez 1 100 0.00 255.0 FORMAT "%5.1" ECU_ADDRESS 0xD0000C31 /end MEASUREMENT
/begin MEASUREMENT flglrs2 "" UBYTE dez 1 100 0.00 255.0 FORMAT "%5.1" ECU_ADDRESS 0xD0000C32 /end MEASUREMENT
/begin MEASUREMENT flglrsn "" UBYTE dez 1 100 0.00 255.0 FORMAT "%5.1" ECU_ADDRESS 0xD0000C2F /end MEASUREMENT
/begin MEASUREMENT flglrso "" UBYTE dez 1 100 0.00 255.0 FORMAT "%5.1" ECU_ADDRESS 0xD0000C30 /end MEASUREMENT
/begin MEASUREMENT fwprs_w "" UWORD fak_uw_b32 1 100 0.00 31.99951 FORMAT "%8.5" ECU_ADDRESS 0xD00004EC /end MEASUREMENT
/begin MEASUREMENT fwpr_w "" UWORD fak_uw_b32 1 100 0.00 31.99951 FORMAT "%8.5" ECU_ADDRESS 0xD00004EA /end MEASUREMENT
/begin MEASUREMENT Hbr_DiagInfo_a "" ULONG dez 1 100 0.00 4294967295.00 FORMAT "%13.2" ARRAY_SIZE 4 ECU_ADDRESS 0xD0001E88 /end MEASUREMENT
/begin MEASUREMENT IdleChrgActr_AVal "" SWORD rel_sw_b100 1 100 -100.0000 99.99695 FORMAT "%8.4" ECU_ADDRESS 0xD00004FA /end MEASUREMENT
/begin MEASUREMENT IdleChrgActr_BVal "" SWORD rel_sw_b100 1 100 -100.0000 99.99695 FORMAT "%8.4" ECU_ADDRESS 0xD00004FC /end MEASUREMENT
/begin MEASUREMENT IdleChrgActr_cntrStepFrq "" UWORD dez 1 100 0.00 65535.00 FORMAT "%8.2" ECU_ADDRESS 0xD00004FE /end MEASUREMENT
/begin MEASUREMENT IdleChrgActr_FreqActIni "" UWORD dez 1 100 0.00 65535.00 FORMAT "%8.2" ECU_ADDRESS 0xD000050A /end MEASUREMENT
/begin MEASUREMENT IdleChrgActr_FreqTrg "" UWORD dez 1 100 0.00 65535.00 FORMAT "%8.2" ECU_ADDRESS 0xD000050C /end MEASUREMENT
/begin MEASUREMENT IdleChrgActr_frqAct "" UWORD dez 1 100 0.00 65535.00 FORMAT "%8.2" ECU_ADDRESS 0xD00035FE /end MEASUREMENT
/begin MEASUREMENT IdleChrgActr_hexStepPls "" UBYTE dez 1 100 0.00 255.0 FORMAT "%5.1" ECU_ADDRESS 0xD0000C40 /end MEASUREMENT
/begin MEASUREMENT IdleChrgActr_hexStepPlsAcc "" UBYTE dez 1 100 0.00 255.0 FORMAT "%5.1" ECU_ADDRESS 0xD0000C41 /end MEASUREMENT
/begin MEASUREMENT IdleChrgActr_nErrInfo "" ULONG dez 1 100 0.00 4294967295.00 FORMAT "%13.2" ECU_ADDRESS 0xD0001E98 /end MEASUREMENT
/begin MEASUREMENT IdleChrgActr_nErrorObser_a "" UBYTE dez 1 100 0.00 255.0 FORMAT "%5.1" ARRAY_SIZE 4 ECU_ADDRESS 0xD0000C42 /end MEASUREMENT
/begin MEASUREMENT IdleChrgActr_nErrorTyp "" UBYTE dez 1 100 0.00 255.0 FORMAT "%5.1" ECU_ADDRESS 0xD0000C46 /end MEASUREMENT
/begin MEASUREMENT IdleChrgActr_posnDesVal "" UBYTE dez 1 100 0.00 255.0 FORMAT "%5.1" ECU_ADDRESS 0xD0000C4F /end MEASUREMENT
/begin MEASUREMENT IdleChrgActr_posnStepCalc "" UBYTE dez 1 100 0.00 255.0 FORMAT "%5.1" ECU_ADDRESS 0xAFE80170 /end MEASUREMENT
/begin MEASUREMENT IdleChrgActr_PowSaveCoil "" UBYTE dez 1 100 0.00 255.0 FORMAT "%5.1" ECU_ADDRESS 0xD0000C47 /end MEASUREMENT
/begin MEASUREMENT IdleChrgActr_ratActDia "" UWORD Prc 1 100 0.00 799.9878 FORMAT "%8.4" ECU_ADDRESS 0xD000050E /end MEASUREMENT
/begin MEASUREMENT IdleChrgActr_ratActMod "" UWORD Prc 1 100 0.00 799.9878 FORMAT "%8.4" ECU_ADDRESS 0xD0003602 /end MEASUREMENT
/begin MEASUREMENT IdleChrgActr_ratActStep "" UWORD Prc 1 100 0.00 799.9878 FORMAT "%8.4" ECU_ADDRESS 0xD0003604 /end MEASUREMENT
/begin MEASUREMENT IdleChrgActr_ratActVal "" UWORD Prc 1 100 0.00 799.9878 FORMAT "%8.4" ECU_ADDRESS 0xD0003606 /end MEASUREMENT
/begin MEASUREMENT IdleChrgActr_ratActValMax "" UWORD Prc 1 100 0.00 799.9878 FORMAT "%8.4" ECU_ADDRESS 0xD0003608 /end MEASUREMENT
/begin MEASUREMENT IdleChrgActr_ratActValMin "" UWORD Prc 1 100 0.00 799.9878 FORMAT "%8.4" ECU_ADDRESS 0xD000360A /end MEASUREMENT
/begin MEASUREMENT IdleChrgActr_ratDes "" SWORD Prc 1 100 -400.0000 399.9878 FORMAT "%8.4" ECU_ADDRESS 0xD0000500 /end MEASUREMENT
/begin MEASUREMENT IdleChrgActr_ratDesVal "" UWORD Prc 1 100 0.00 799.9878 FORMAT "%8.4" ECU_ADDRESS 0xD000360C /end MEASUREMENT
/begin MEASUREMENT IdleChrgActr_ratGovrDeStepFild "" SWORD Prc 1 100 -400.0000 399.9878 FORMAT "%8.4" ECU_ADDRESS 0xD0003560 /end MEASUREMENT
/begin MEASUREMENT IdleChrgActr_stAdpnSuc "" UBYTE B_TRUE 1 100 0.00 1.00000000000 BIT_MASK 0x1 FORMAT "%13.11" ECU_ADDRESS 0xAFE80171 /end MEASUREMENT
/begin MEASUREMENT IdleChrgActr_stBattHiErr "" UBYTE B_TRUE 1 100 0.00 1.00000000000 BIT_MASK 0x8 FORMAT "%13.11" ECU_ADDRESS 0xD000007A /end MEASUREMENT
/begin MEASUREMENT IdleChrgActr_stBattLowErr "" UBYTE B_TRUE 1 100 0.00 1.00000000000 BIT_MASK 0x10 FORMAT "%13.11" ECU_ADDRESS 0xD0000099 /end MEASUREMENT
/begin MEASUREMENT IdleChrgActr_stCloseFreq "" UBYTE B_TRUE 1 100 0.00 1.00000000000 BIT_MASK 0x1 FORMAT "%13.11" ECU_ADDRESS 0xD000002F /end MEASUREMENT
/begin MEASUREMENT IdleChrgActr_stCoilOff "" UBYTE B_TRUE 1 100 0.00 1.00000000000 BIT_MASK 0x10 FORMAT "%13.11" ECU_ADDRESS 0xD000002E /end MEASUREMENT
/begin MEASUREMENT IdleChrgActr_stDiagActv "" UBYTE B_TRUE 1 100 0.00 1.00000000000 BIT_MASK 0x8 FORMAT "%13.11" ECU_ADDRESS 0xD000007C /end MEASUREMENT
/begin MEASUREMENT IdleChrgActr_stDiagCmplt "" UBYTE B_TRUE 1 100 0.00 1.00000000000 BIT_MASK 0x80 FORMAT "%13.11" ECU_ADDRESS 0xD000009D /end MEASUREMENT
/begin MEASUREMENT IdleChrgActr_stDiagMov "" UBYTE B_TRUE 1 100 0.00 1.00000000000 BIT_MASK 0x4 FORMAT "%13.11" ECU_ADDRESS 0xD0000091 /end MEASUREMENT
/begin MEASUREMENT IdleChrgActr_stDirClose "" UBYTE B_TRUE 1 100 0.00 1.00000000000 BIT_MASK 0x80 FORMAT "%13.11" ECU_ADDRESS 0xD000002E /end MEASUREMENT
/begin MEASUREMENT IdleChrgActr_stDirOpen "" UBYTE B_TRUE 1 100 0.00 1.00000000000 BIT_MASK 0x20 FORMAT "%13.11" ECU_ADDRESS 0xD000002E /end MEASUREMENT
/begin MEASUREMENT IdleChrgActr_StepAcc "" UBYTE B_TRUE 1 100 0.00 1.00000000000 BIT_MASK 0x2 FORMAT "%13.11" ECU_ADDRESS 0xD000002F /end MEASUREMENT
/begin MEASUREMENT IdleChrgActr_stErrInfo "" UBYTE B_TRUE 1 100 0.00 1.00000000000 BIT_MASK 0x8 FORMAT "%13.11" ECU_ADDRESS 0xD000005C /end MEASUREMENT
/begin MEASUREMENT IdleChrgActr_stFrstExec_a "" UBYTE default 1 100 0.00 1.000 FORMAT "%5.3" ARRAY_SIZE 4 ECU_ADDRESS 0xD0000C48 /end MEASUREMENT
/begin MEASUREMENT IdleChrgActr_stMon "" ULONG dez 1 100 0.00 4294967295.00 FORMAT "%13.2" ECU_ADDRESS 0xD0001E9C /end MEASUREMENT
/begin MEASUREMENT IdleChrgActr_stNoMov "" UBYTE B_TRUE 1 100 0.00 1.00000000000 BIT_MASK 0x8 FORMAT "%13.11" ECU_ADDRESS 0xD000002E /end MEASUREMENT
/begin MEASUREMENT IdleChrgActr_stOKSts "" UBYTE B_TRUE 1 100 0.00 1.00000000000 BIT_MASK 0x20 FORMAT "%13.11" ECU_ADDRESS 0xD000002F /end MEASUREMENT
/begin MEASUREMENT IdleChrgActr_stOpenFreq "" UBYTE B_TRUE 1 100 0.00 1.00000000000 BIT_MASK 0x40 FORMAT "%13.11" ECU_ADDRESS 0xD000002E /end MEASUREMENT
/begin MEASUREMENT IdleChrgActr_stReqCls "" UBYTE B_TRUE 1 100 0.00 1.00000000000 BIT_MASK 0x10 FORMAT "%13.11" ECU_ADDRESS 0xD000002F /end MEASUREMENT
/begin MEASUREMENT IdleChrgActr_stReqOpen "" UBYTE B_TRUE 1 100 0.00 1.00000000000 BIT_MASK 0x8 FORMAT "%13.11" ECU_ADDRESS 0xD000002F /end MEASUREMENT
/begin MEASUREMENT IdleChrgActr_stStepA "" UBYTE B_TRUE 1 100 0.00 1.00000000000 BIT_MASK 0x4 FORMAT "%13.11" ECU_ADDRESS 0xD000007E /end MEASUREMENT
/begin MEASUREMENT IdleChrgActr_stStepB "" UBYTE B_TRUE 1 100 0.00 1.00000000000 BIT_MASK 0x8 FORMAT "%13.11" ECU_ADDRESS 0xD000009A /end MEASUREMENT
/begin MEASUREMENT IdleChrgActr_stStepCmdActvt "" UBYTE B_TRUE 1 100 0.00 1.00000000000 BIT_MASK 0x4 FORMAT "%13.11" ECU_ADDRESS 0xD000002F /end MEASUREMENT
/begin MEASUREMENT IdleChrgActr_stStepSysErr "" UBYTE B_TRUE 1 100 0.00 1.00000000000 BIT_MASK 0x8 FORMAT "%13.11" ECU_ADDRESS 0xD0000097 /end MEASUREMENT
/begin MEASUREMENT IdleChrgActr_stStpMechLimOpr "" UBYTE B_TRUE 1 100 0.00 1.00000000000 BIT_MASK 0x4 FORMAT "%13.11" ECU_ADDRESS 0xD000002E /end MEASUREMENT
/begin MEASUREMENT IdleChrgActr_stStprActvDiag "" UBYTE B_TRUE 1 100 0.00 1.00000000000 BIT_MASK 0x40 FORMAT "%13.11" ECU_ADDRESS 0xD0000093 /end MEASUREMENT
/begin MEASUREMENT IdleChrgActr_tiPostDrvDly "" UWORD t_q0p001 1 100 0.00 65.53500 FORMAT "%8.5" ECU_ADDRESS 0xD0000502 /end MEASUREMENT
/begin MEASUREMENT IdleChrg_stDebStatus "" UBYTE B_TRUE 1 100 0.00 1.00000000000 BIT_MASK 0x40 FORMAT "%13.11" ECU_ADDRESS 0xD000002F /end MEASUREMENT
/begin MEASUREMENT lambtox_w "" UWORD fak_uw_b16 1 100 0.00 15.99976 FORMAT "%8.5" ECU_ADDRESS 0xD00004F2 /end MEASUREMENT
/begin MEASUREMENT msnllsm_w "" UWORD m_uw_b102p4 1 100 0.00 102.3984 FORMAT "%8.4" ECU_ADDRESS 0xD00004EE /end MEASUREMENT
/begin MEASUREMENT numdiff "" SWORD dez 1 100 -32768.00 32767.00 FORMAT "%8.2" ECU_ADDRESS 0xD0000504 /end MEASUREMENT
/begin MEASUREMENT posnDesValDiag "" UWORD dez 1 100 0.00 65535.00 FORMAT "%8.2" ECU_ADDRESS 0xD0000506 /end MEASUREMENT
/begin MEASUREMENT ratActVal "" UWORD Prc 1 100 0.00 799.9878 FORMAT "%8.4" ECU_ADDRESS 0xD0000508 /end MEASUREMENT
/begin MEASUREMENT stAdpnPostDrv "" UBYTE B_TRUE 1 100 0.00 1.00000000000 BIT_MASK 0x2 FORMAT "%13.11" ECU_ADDRESS 0xD000002E /end MEASUREMENT
/begin MEASUREMENT stAdpnStart "" UBYTE B_TRUE 1 100 0.00 1.00000000000 BIT_MASK 0x1 FORMAT "%13.11" ECU_ADDRESS 0xD000002E /end MEASUREMENT
/begin MEASUREMENT stOldRasterStMchn "" UBYTE dez 1 100 0.00 255.0 FORMAT "%5.1" ECU_ADDRESS 0xD0000C4C /end MEASUREMENT
/begin MEASUREMENT stOldStateMchn "" UBYTE dez 1 100 0.00 255.0 FORMAT "%5.1" ECU_ADDRESS 0xD0000C4D /end MEASUREMENT
/begin MEASUREMENT stStateMchn "" UBYTE dez 1 100 0.00 255.0 FORMAT "%5.1" ECU_ADDRESS 0xD0000C4E /end MEASUREMENT
/begin MEASUREMENT tans "" UBYTE temp_ub_q0p75_o48 1 100 -48.00 143.3 FORMAT "%5.1" ECU_ADDRESS 0xD0000C3A /end MEASUREMENT
/begin MEASUREMENT tansab "" UBYTE temp_ub_q0p75_o48 1 100 -48.00 143.3 FORMAT "%5.1" ECU_ADDRESS 0xAFE8016F /end MEASUREMENT
/begin MEASUREMENT tansabz "" UBYTE temp_ub_q0p75_o48 1 100 -48.00 143.3 FORMAT "%5.1" ECU_ADDRESS 0xD0000C3B /end MEASUREMENT
/begin MEASUREMENT tansk_w "" UWORD temp_q0p0234_o273 1 100 -273.1500 1262.827 FORMAT "%8.3" ECU_ADDRESS 0xD00004F6 /end MEASUREMENT
/begin MEASUREMENT tanslin "" UBYTE temp_ub_q0p75_o48 1 100 -48.00 143.3 FORMAT "%5.1" ECU_ADDRESS 0xD0000C3C /end MEASUREMENT
/begin MEASUREMENT tasrg_w "" UWORD temp_q0p0234_o273 1 100 -273.1500 1262.827 FORMAT "%8.3" ECU_ADDRESS 0xD00004F8 /end MEASUREMENT
/begin MEASUREMENT tfa1_w "" UWORD temp_q0p0234_o273 1 100 -273.1500 1262.827 FORMAT "%8.3" ECU_ADDRESS 0xD00004F4 /end MEASUREMENT
/begin MEASUREMENT TS_nMax "" SWORD EngN 1 100 -16384.00 16383.50 FORMAT "%8.2" ECU_ADDRESS 0xD000359C /end MEASUREMENT
/begin MEASUREMENT TS_nMin "" SWORD EngN 1 100 -16384.00 16383.50 FORMAT "%8.2" ECU_ADDRESS 0xD000359E /end MEASUREMENT
/begin MEASUREMENT TS_trqDesAcs "" SWORD Trq 1 100 -3276.800 3276.700 FORMAT "%8.3" ECU_ADDRESS 0xD00035A4 /end MEASUREMENT
/begin MEASUREMENT TS_trqResvAcs "" SWORD Trq 1 100 -3276.800 3276.700 FORMAT "%8.3" ECU_ADDRESS 0xD00035A6 /end MEASUREMENT
/begin MEASUREMENT vwkw "" UBYTE rel_ub_q0p1875 1 100 0.00 47.81 FORMAT "%5.2" ECU_ADDRESS 0xD0000C2B /end MEASUREMENT
/begin MEASUREMENT wpr "" UBYTE zw_ub_q6 1 100 0.00 1530. FORMAT "%5.0" ECU_ADDRESS 0xD0000C2C /end MEASUREMENT
/begin MEASUREMENT wprakt "" UBYTE zw_ub_q6 1 100 0.00 1530. FORMAT "%5.0" ECU_ADDRESS 0xD0000C2D /end MEASUREMENT
/begin MEASUREMENT wprnsp "" UBYTE zw_ub_q6 1 100 0.00 1530. FORMAT "%5.0" ECU_ADDRESS 0xD0000C2E /end MEASUREMENT
/begin FUNCTION BGWPR "2.3.0"
 /begin DEF_CHARACTERISTIC CWBGRLP CWBGWPR DRLDYNA DRLDYNE DRLMIN DTEPRU DWDKRLP DWPR DWPRNSP NMOTNSP TNSURLP WPRMX /end DEF_CHARACTERISTIC
 /begin REF_CHARACTERISTIC VPSRVDUGD /end REF_CHARACTERISTIC
 /begin IN_MEASUREMENT B_ll B_nswo2 B_st B_ugd drl_w dwdkba_w grundwert nmot_w rlp_w rl_w tef_w tnst_w tvub_w vpsrvd_w wdkbap_w wdkugd_w wea wee wessbm wgvsme_w /end IN_MEASUREMENT
 /begin OUT_MEASUREMENT B_nsp B_rlp B_tired fwprs_w vwkw wpr wprakt wprnsp /end OUT_MEASUREMENT
 /begin LOC_MEASUREMENT B_rlp100ms B_rlpns B_ugdsp fwpr_w /end LOC_MEASUREMENT
 FUNCTION_VERSION "2.3.0" /end FUNCTION
/begin FUNCTION Blwr_DD "2.0.0" /begin DEF_CHARACTERISTIC Blwr_tiDebHw2Actv_C Blwr_tiDebHw2Off_C /end DEF_CHARACTERISTIC /begin IN_MEASUREMENT ESC_tiSampling /end IN_MEASUREMENT /begin OUT_MEASUREMENT Blwr_flgHwActv /end OUT_MEASUREMENT /begin LOC_MEASUREMENT Blwr_flgHwRaw_mp /end LOC_MEASUREMENT FUNCTION_VERSION "2.0.0" /end FUNCTION
/begin FUNCTION Blwr_VD "2.0.0" /begin IN_MEASUREMENT Blwr_flgHwActv /end IN_MEASUREMENT /begin OUT_MEASUREMENT Blwr_flgActv /end OUT_MEASUREMENT FUNCTION_VERSION "2.0.0" /end FUNCTION
/begin FUNCTION BRK2MED "1.4.0" /begin IN_MEASUREMENT Brk_st /end IN_MEASUREMENT /begin OUT_MEASUREMENT B_br2k B_brems /end OUT_MEASUREMENT FUNCTION_VERSION "1.4.0" /end FUNCTION
/begin FUNCTION Brk_DD "3.1.0"
 /begin DEF_CHARACTERISTIC Brk_MnDeb.tiHiLo_C Brk_MnDeb.tiLoHi_C Brk_RedDeb.tiHiLo_C Brk_RedDeb.tiLoHi_C Brk_stDflVal_C Brk_swtSig_C /end DEF_CHARACTERISTIC
 /begin IN_MEASUREMENT BrkP_p Com_stBrk /end IN_MEASUREMENT
 /begin OUT_MEASUREMENT Brk_stMn Brk_stMnRaw Brk_stRed Brk_stRedRaw /end OUT_MEASUREMENT
 FUNCTION_VERSION "3.1.0" /end FUNCTION
/begin FUNCTION Brk_VD "3.1.0" /begin DEF_CHARACTERISTIC Brk_swtRedSensPrs_C /end DEF_CHARACTERISTIC /begin REF_CHARACTERISTIC Brk_swtSig_C /end REF_CHARACTERISTIC
 /begin IN_MEASUREMENT BrkP_p Brk_stMn Brk_stMnRaw Brk_stRed Brk_stRedRaw Com_stBrk T15_st /end IN_MEASUREMENT
 /begin OUT_MEASUREMENT Brk_pMnCyl Brk_st /end OUT_MEASUREMENT
 /begin LOC_MEASUREMENT Brk_stFreeze_mp Brk_uPedPosRawZero_mp /end LOC_MEASUREMENT
 FUNCTION_VERSION "3.1.0" /end FUNCTION
/begin FUNCTION Can "1.11.0" FUNCTION_VERSION "1.11.0" /end FUNCTION
/begin FUNCTION CBAdcI "1.12.0" FUNCTION_VERSION "1.12.0" /end FUNCTION
/begin FUNCTION Ccp "1.11.0" /begin IN_MEASUREMENT SyC_stMn /end IN_MEASUREMENT FUNCTION_VERSION "1.11.0" /end FUNCTION
/begin FUNCTION CcpAppl "99.0.0" /begin REF_CHARACTERISTIC CWCANCONF /end REF_CHARACTERISTIC /begin IN_MEASUREMENT SyC_stMn /end IN_MEASUREMENT FUNCTION_VERSION "99.0.0" /end FUNCTION
/begin FUNCTION CDrv_GlbDef "2.5.0" FUNCTION_VERSION "2.5.0" /end FUNCTION
/begin FUNCTION CDrv_Shared "2.7.0" FUNCTION_VERSION "2.7.0" /end FUNCTION
/begin FUNCTION CEL_Compu "1.10.1" FUNCTION_VERSION "1.10.1" /end FUNCTION
/begin FUNCTION CEL_Const "1.2.1" FUNCTION_VERSION "1.2.1" /end FUNCTION
/begin FUNCTION ChrCtl_IdleChrgActMdl "1.1.0" /begin REF_CHARACTERISTIC LLSPMSN /end REF_CHARACTERISTIC /begin IN_MEASUREMENT msdkds_w msndkoo_w ofmsndk_w ummsnms_w /end IN_MEASUREMENT /begin OUT_MEASUREMENT IdleChrgActr_ratActMod /end OUT_MEASUREMENT /begin LOC_MEASUREMENT msnllsm_w /end LOC_MEASUREMENT FUNCTION_VERSION "1.1.0" /end FUNCTION
/begin FUNCTION Cj930 "1.10.0" FUNCTION_VERSION "1.10.0" /end FUNCTION
/begin FUNCTION Clth2MED "1.2.0" /begin IN_MEASUREMENT Clth_st PT_stTraType /end IN_MEASUREMENT /begin OUT_MEASUREMENT B_kuppl /end OUT_MEASUREMENT FUNCTION_VERSION "1.2.0" /end FUNCTION
/begin FUNCTION Clth_DD "1.11.6"
 /begin DEF_CHARACTERISTIC Clth_Deb.tiHiLo_C Clth_Deb.tiLoHi_C Clth_rEPBThresClth_C Clth_swtDetSlipOpn_C Clth_swtEPBChk_C Clth_swtLiveValInit_C Clth_swtSig_C /end DEF_CHARACTERISTIC
 /begin IN_MEASUREMENT Clth_stDiag Com_stClth Com_stClthErr Com_stClthModlRng Gbx_stPNPos /end IN_MEASUREMENT
 /begin OUT_MEASUREMENT Clth_stEPBSigVld Clth_stIntDebVal Clth_stRaw /end OUT_MEASUREMENT
 FUNCTION_VERSION "1.11.6" /end FUNCTION
/begin FUNCTION Clth_VD "1.15.3"
 /begin DEF_CHARACTERISTIC Clth_nPlausClsd_C Clth_nPlausOpn_C Clth_stDflVal_C Clth_stDiag_C Clth_swtPNEna_C Clth_tiGearShftClsd_C Clth_tiGearShftOpn_C Clth_tiPlausEPB_C Clth_tiTestSig_C Clth_vPlausClsd_C Clth_vPlausOpnMax_C Clth_vPlausOpnMin_C /end DEF_CHARACTERISTIC
 /begin IN_MEASUREMENT BattU_u Clth_stEPBSigVld Com_rClthPos Epm_nEng Gbx_stPNPos PT_stTraType Tra_numGear VehV_v /end IN_MEASUREMENT
 /begin OUT_MEASUREMENT Clth_bDiaEna Clth_st Clth_stDiag Clth_stLastGear /end OUT_MEASUREMENT
 /begin LOC_MEASUREMENT Clth_stTstPrfm /end LOC_MEASUREMENT
 FUNCTION_VERSION "1.15.3" /end FUNCTION
/begin FUNCTION Clth_VDAutoStrt "1.21.1" /begin DEF_CHARACTERISTIC Clth_rEPBThresNoPrsd_C /end DEF_CHARACTERISTIC FUNCTION_VERSION "1.21.1" /end FUNCTION
/begin FUNCTION CoCTM_Demand "2.10.0" /begin IN_MEASUREMENT AC_trqDes AC_trqResv /end IN_MEASUREMENT /begin OUT_MEASUREMENT CTM_nMin CTM_trqDes CTM_trqResv /end OUT_MEASUREMENT FUNCTION_VERSION "2.10.0" /end FUNCTION
/begin FUNCTION CoCTM_ShutOff "2.10.0" /begin IN_MEASUREMENT CoTS_trqMaxAC /end IN_MEASUREMENT /begin OUT_MEASUREMENT CoCTM_trqMaxAC /end OUT_MEASUREMENT FUNCTION_VERSION "2.10.0" /end FUNCTION
/begin FUNCTION CodeGen "2.2.2" FUNCTION_VERSION "2.2.2" /end FUNCTION
/begin FUNCTION CoEng_StEng "2.5.1"
 /begin DEF_CHARACTERISTIC CoEng_nThresCranking_C CoEng_nThresNrml2Strt_C CoEng_tiNrml2Strt_C CoEng_tiPwrStgDiaRdy_C /end DEF_CHARACTERISTIC
 /begin IN_MEASUREMENT Epm_nEng StSys_stStrt /end IN_MEASUREMENT
 /begin OUT_MEASUREMENT CoEng_bStalEng CoEng_st CoEng_stOld CoEng_stStalEngReas CoEng_tiAfterrun CoEng_tiAfterrunRed CoEng_tiNormal CoEng_tiNormalOBD CoEng_tiNormalRed CoEng_tiStandby CoEng_tiStandbyRed CoEng_tiStart CoEng_tiStartRed /end OUT_MEASUREMENT
 /begin LOC_MEASUREMENT CoEng_stXPostDrv_mp /end LOC_MEASUREMENT
 FUNCTION_VERSION "2.5.1" /end FUNCTION
/begin FUNCTION CoESS_Dem "1.12.0"
 /begin DEF_CHARACTERISTIC CoESS_DelEngSetP.tiHiLo_C CoESS_DelEngSetP.tiLoHi_C CoESS_DelVltgBattRstP.tiHiLo_C CoESS_DelVltgBattRstP.tiLoHi_C CoESS_DelVltgBattSetP.tiHiLo_C CoESS_DelVltgBattSetP.tiLoHi_C CoESS_nIdlBattThres_C CoESS_nMax_C CoESS_nMinBatt_C CoESS_nMinThres_C CoESS_uIdlBattThresRst_C CoESS_uIdlBattThresSet_C CoESS_vMinThres_C /end DEF_CHARACTERISTIC
 /begin IN_MEASUREMENT Alt_trqDes Alt_trqResv CoEng_st Epm_nEng ESS_uBatt GlbDa_vX PT_stGrip SpdGov_nSetPLo /end IN_MEASUREMENT
 /begin OUT_MEASUREMENT ESS_nMax ESS_nMin ESS_trqDesAcs ESS_trqResvAcs /end OUT_MEASUREMENT
 /begin LOC_MEASUREMENT CoESS_stEngSet_mp CoESS_stNBattRst_mp CoESS_stNBattSet_mp CoESS_stVltgBattRst_mp CoESS_stVltgBattSet_mp /end LOC_MEASUREMENT
 FUNCTION_VERSION "1.12.0" /end FUNCTION
/begin FUNCTION CoESS_Ord "1.11.0" /begin IN_MEASUREMENT CoVeh_stAlt /end IN_MEASUREMENT /begin OUT_MEASUREMENT CoESS_stAlt /end OUT_MEASUREMENT FUNCTION_VERSION "1.11.0" /end FUNCTION
/begin FUNCTION ComCIL_Co "43.0.0" /begin DEF_CHARACTERISTIC Com_stFrmTxEna_C /end DEF_CHARACTERISTIC /begin LOC_MEASUREMENT Com_stFrmTxEna /end LOC_MEASUREMENT FUNCTION_VERSION "43.0.0" /end FUNCTION
/begin FUNCTION ComCIL_Lib "13.0.0" FUNCTION_VERSION "13.0.0" /end FUNCTION
/begin FUNCTION Common "2.1.0" FUNCTION_VERSION "2.1.0" /end FUNCTION
/begin FUNCTION ConversionSpecial_CELPrj "8.0.0" FUNCTION_VERSION "8.0.0" /end FUNCTION
/begin FUNCTION Conversion_CELPrj "8.1.0" FUNCTION_VERSION "8.1.0" /end FUNCTION
/begin FUNCTION Core_Env "1.11.0" FUNCTION_VERSION "1.11.0" /end FUNCTION
/begin FUNCTION CoTS_MechDem "2.12.0" /begin IN_MEASUREMENT CTM_nMin CTM_trqDes CTM_trqResv Fans_trqCons Fans_trqResv /end IN_MEASUREMENT /begin OUT_MEASUREMENT TS_nMax TS_nMin TS_trqDesAcs TS_trqResvAcs /end OUT_MEASUREMENT FUNCTION_VERSION "2.12.0" /end FUNCTION
/begin FUNCTION CoTS_ShutOffAcs "2.10.0" /begin IN_MEASUREMENT CoVeh_trqMaxAC /end IN_MEASUREMENT /begin OUT_MEASUREMENT CoTS_trqMaxAC /end OUT_MEASUREMENT FUNCTION_VERSION "2.10.0" /end FUNCTION
/begin FUNCTION CoTS_ThermDem "1.8.1" /begin DEF_CHARACTERISTIC CoTS_tClntEngOutDes_C CoTS_tiPT1Neg_C CoTS_tiPT1Pos_C /end DEF_CHARACTERISTIC /begin IN_MEASUREMENT CoVeh_rClgDes CoVeh_tClntDes /end IN_MEASUREMENT /begin OUT_MEASUREMENT CoTS_rClgDem CoTS_tClntEngOutDes /end OUT_MEASUREMENT FUNCTION_VERSION "1.8.1" /end FUNCTION
/begin FUNCTION CPROXY "1.7.0"
 /begin DEF_CHARACTERISTIC DTHKBTSZA DTVKBTSZA TANHKSAO TAVHKSAO TAVVKSAO TKIHKSAO TKIVKSAO VFZGSA /end DEF_CHARACTERISTIC
 /begin IN_MEASUREMENT B_evloc B_stend tanhkm_w tavhk_w tavvk_w thkmax_w tvkmax_w vfzg_w /end IN_MEASUREMENT
 /begin OUT_MEASUREMENT B_mdeebts B_sabbts B_tatmsa lambtox_w /end OUT_MEASUREMENT
 /begin LOC_MEASUREMENT dtsabts_w /end LOC_MEASUREMENT
 FUNCTION_VERSION "1.7.0" /end FUNCTION
/begin FUNCTION Cpu "1.9.0" /begin DEF_CHARACTERISTIC Cpu_swtClrEnvRAMVals_C /end DEF_CHARACTERISTIC
 /begin LOC_MEASUREMENT Cpu_rCurCSACons_mp Cpu_rCurSysStackCons_mp Cpu_rCurUsrStackCons_mp Cpu_rMaxCSACons_mp Cpu_rMaxSysStackCons_mp Cpu_rMaxUsrStackCons_mp /end LOC_MEASUREMENT
 FUNCTION_VERSION "1.9.0" /end FUNCTION
/begin FUNCTION Dcan "1.6.0" FUNCTION_VERSION "1.6.0" /end FUNCTION
/begin FUNCTION DcanAppl "15.0.0" FUNCTION_VERSION "15.0.0" /end FUNCTION
/begin FUNCTION DCFFLR "1.5.0" /begin DEF_CHARACTERISTIC CWDCFFLR /end DEF_CHARACTERISTIC /begin IN_MEASUREMENT B_eobdlr B_lrnd B_lrsetp B_pspwl B_sbbvk nmot_w /end IN_MEASUREMENT /begin OUT_MEASUREMENT flglrs flglrs2 /end OUT_MEASUREMENT /begin LOC_MEASUREMENT B_lelsxbb B_lelsxnb B_lrebwl flglrsn flglrso /end LOC_MEASUREMENT FUNCTION_VERSION "1.5.0" /end FUNCTION
/begin FUNCTION DCTCW "1.4.0" /begin DEF_CHARACTERISTIC CWDCTCW DTCWECDTH SF_TM TDTM TDTMOTRG UTCWMN UTCWMX /end DEF_CHARACTERISTIC
 /begin IN_MEASUREMENT B_emntcwcs B_emxtcwcs B_erhsctcw B_erlsctcw B_erstctcw B_hlhsctcw B_hllsctcw B_hlstctcw B_htcwcs B_tmotra utcw_w /end IN_MEASUREMENT
 /begin OUT_MEASUREMENT B_tmotgg B_tmotrg dctcwAusBitsKoop1 /end OUT_MEASUREMENT
 /begin LOC_MEASUREMENT B_emntcwec B_emxtcwec B_enptcwec B_esgtcwec B_htcwec B_pmntcwec B_pmxtcwec B_pnptcwec B_tcwcsg B_tcwpg dctcwLokBitsKoop1 dctcwLokBitsKoop2 /end LOC_MEASUREMENT
 FUNCTION_VERSION "1.4.0" /end FUNCTION
/begin FUNCTION DCTFA "1.2.0" /begin DEF_CHARACTERISTIC SF_TA SF_TASR TANSDE TTFANMOT /end DEF_CHARACTERISTIC
 /begin IN_MEASUREMENT B_eepwf B_elhltfa1 B_elmntfa1 B_elmxtfa1 B_elnptfa1 B_nmot tfa1limf tfa1lin tfa1m_w /end IN_MEASUREMENT
 /begin OUT_MEASUREMENT B_etfa1fcl B_tansgg B_tasrgg B_tfa1gg B_tfa1rg DCTFAAusBitsKoop1 DCTFAAusBitsKoop2 DCTFAAusBitsKoop3 tans tansab tansabz tansk_w tanslin tasrg_w /end OUT_MEASUREMENT
 /begin LOC_MEASUREMENT B_tansnmot B_tfastz DCTFALocBitsKoop1 tfa1_w /end LOC_MEASUREMENT
 FUNCTION_VERSION "1.2.0" /end FUNCTION
/begin FUNCTION DDKG "10.0.0" /begin DEF_CHARACTERISTIC NDDKST TDDKST /end DEF_CHARACTERISTIC /begin IN_MEASUREMENT B_mndk B_mxdk B_stend nmot /end IN_MEASUREMENT /begin OUT_MEASUREMENT B_dkpdiaend /end OUT_MEASUREMENT FUNCTION_VERSION "10.0.0" /end FUNCTION
/begin FUNCTION DDRC "2.4.0"
 /begin DEF_CHARACTERISTIC DDRC_DurDeb.AirC_tiCmprSCBDebOk_C DDRC_DurDeb.AirC_tiCmprSCBDebDef_C DDRC_DurDeb.Fan_tiDIOOvrTempDebOk_C DDRC_DurDeb.Fan_tiDIOOvrTempDebDef_C DDRC_DurDeb.DevLib_tiBattULoDebOk_C DDRC_DurDeb.DevLib_tiBattULoDebDef_C DDRC_DurDeb.Fan_tiDIOOLDebOk_C DDRC_DurDeb.Fan_tiDIOOLDebDef_C DDRC_DurDeb.Fan_tiPWMOvrTempDebOk_C DDRC_DurDeb.Fan_tiPWMOvrTempDebDef_C DDRC_DurDeb.Fan_tiPWMSCBDebOk_C DDRC_DurDeb.Fan_tiPWMSCBDebDef_C DDRC_DurDeb.Fan_tiPWMOLDebOk_C DDRC_DurDeb.Fan_tiPWMOLDebDef_C DDRC_DurDeb.AltIO_tiSCBDebOk_C DDRC_DurDeb.AltIO_tiSCBDebDef_C DDRC_DurDeb.AltIO_tiOLDebOk_C DDRC_DurDeb.AltIO_tiOLDebDef_C DDRC_DurDeb.AltIO_tiOvrTempDebOk_C DDRC_DurDeb.AltIO_tiOvrTempDebDef_C DDRC_DurDeb.AirC_tiCmprOvrTempDebOk_C DDRC_DurDeb.AirC_tiCmprOvrTempDebDef_C DDRC_DurDeb.Fan_tiDIOSCGDebOk_C DDRC_DurDeb.Fan_tiDIOSCGDebDef_C DDRC_DurDeb.Fan_tiDIOSCBDebOk_C DDRC_DurDeb.Fan_tiDIOSCBDebDef_C DDRC_DurDeb.AirC_tiCmprOLDebOk_C DDRC_DurDeb.AirC_tiCmprOLDebDef_C DDRC_DurDeb.AltIO_tiSRCMinDebOk_C DDRC_DurDeb.AltIO_tiSRCMinDebDef_C DDRC_DurDeb.DevLib_tiBattUHiDebOk_C DDRC_DurDeb.DevLib_tiBattUHiDebDef_C DDRC_DurDeb.AltIO_tiSCGDebOk_C DDRC_DurDeb.AltIO_tiSCGDebDef_C DDRC_DurDeb.Fan_tiPWMSCGDebOk_C DDRC_DurDeb.Fan_tiPWMSCGDebDef_C DDRC_DurDeb.AirC_tiCmprSCGDebOk_C DDRC_DurDeb.AirC_tiCmprSCGDebDef_C DDRC_DurDeb.AltIO_tiSRCMaxDebOk_C DDRC_DurDeb.AltIO_tiSRCMaxDebDef_C DDRC_DurDeb.Clth_tiEPBSensErrDebOk_C DDRC_DurDeb.Clth_tiEPBSensErrDebDef_C DDRC_DurDeb.Brk_tiSigDebOk_C DDRC_DurDeb.Brk_tiSigDebDef_C DDRC_DurDeb.APP_tiSRCHighDebOk_C DDRC_DurDeb.APP_tiSRCHighDebDef_C DDRC_DurDeb.AirC_tiClntSRCMaxDebOk_C DDRC_DurDeb.AirC_tiClntSRCMaxDebDef_C DDRC_DurDeb.Clth_tiErrDebOk_C DDRC_DurDeb.Clth_tiErrDebDef_C DDRC_DurDeb.VehV_tiPlaDebOk_C DDRC_DurDeb.VehV_tiPlaDebDef_C DDRC_DurDeb.VehV_tiSigDebOk_C DDRC_DurDeb.VehV_tiSigDebDef_C DDRC_DurDeb.AirC_tiSwtNplDebOk_C DDRC_DurDeb.AirC_tiSwtNplDebDef_C DDRC_DurDeb.APP_PlaAPP12DebOk_C DDRC_DurDeb.APP_PlaAPP12DebDef_C DDRC_DurDeb.MILLmp_tiSCGDebOk_C DDRC_DurDeb.MILLmp_tiSCGDebDef_C DDRC_DurDeb.Clth_tiPlausDebOk_C DDRC_DurDeb.Clth_tiPlausDebDef_C DDRC_DurDeb.APP_tiSRCLowDebOk_C DDRC_DurDeb.APP_tiSRCLowDebDef_C DDRC_DurDeb.AirC_tiClntSRCMinDebOk_C DDRC_DurDeb.AirC_tiClntSRCMinDebDef_C DDRC_DurDeb.MILLmp_tiOLDebOk_C DDRC_DurDeb.MILLmp_tiOLDebDef_C DDRC_DurDeb.Clth_tiSigDebOk_C DDRC_DurDeb.Clth_tiSigDebDef_C DDRC_DurDeb.MILLmp_tiSCBDebOk_C DDRC_DurDeb.MILLmp_tiSCBDebDef_C DDRC_DurDeb.VehV_tiMaxDebOk_C DDRC_DurDeb.VehV_tiMaxDebDef_C DDRC_DurDeb.AirC_tiSwtSigDebOk_C DDRC_DurDeb.AirC_tiSwtSigDebDef_C DDRC_DurDeb.Cj930_tiSSp1MonDebOk_C DDRC_DurDeb.Cj930_tiSSp1MonDebDef_C DDRC_DurDeb.IdleChrgActr_tiStepASigDebOk_C DDRC_DurDeb.IdleChrgActr_tiStepASigDebDef_C DDRC_DurDeb.IdleChrgActr_tiStepNBMaxDebOk_C DDRC_DurDeb.IdleChrgActr_tiStepNBMaxDebDef_C DDRC_DurDeb.IdleChrgActr_tiStepNBMinDebOk_C DDRC_DurDeb.IdleChrgActr_tiStepNBMinDebDef_C DDRC_DurDeb.IdleChrgActr_tiOverTempDebOk_C DDRC_DurDeb.IdleChrgActr_tiOverTempDebDef_C DDRC_DurDeb.IdleChrgActr_tiGovDeMaxDebOk_C DDRC_DurDeb.IdleChrgActr_tiGovDeMaxDebDef_C DDRC_DurDeb.IdleChrgActr_tiGovDeColdDebOk_C DDRC_DurDeb.IdleChrgActr_tiGovDeColdDebDef_C DDRC_DurDeb.Alt_tiAltMaxPwrDebOk_C DDRC_DurDeb.Alt_tiAltMaxPwrDebDef_C DDRC_DurDeb.IdleChrgActr_tiStepBMinDebOk_C DDRC_DurDeb.IdleChrgActr_tiStepBMinDebDef_C DDRC_DurDeb.Cj930_tiSSp2MonDebOk_C DDRC_DurDeb.Cj930_tiSSp2MonDebDef_C DDRC_DurDeb.IdleChrgActr_tiStepAMaxDebOk_C DDRC_DurDeb.IdleChrgActr_tiStepAMaxDebDef_C DDRC_DurDeb.IdleChrgActr_tiStepNASigDebOk_C DDRC_DurDeb.IdleChrgActr_tiStepNASigDebDef_C DDRC_DurDeb.Cj930_tiSSp3MonDebOk_C DDRC_DurDeb.Cj930_tiSSp3MonDebDef_C DDRC_DurDeb.IdleChrgActr_tiStepNAMinDebOk_C DDRC_DurDeb.IdleChrgActr_tiStepNAMinDebDef_C DDRC_DurDeb.IdleChrgActr_tiStepBSigDebOk_C DDRC_DurDeb.IdleChrgActr_tiStepBSigDebDef_C DDRC_DurDeb.IdleChrgActr_tiStepBMaxDebOk_C DDRC_DurDeb.IdleChrgActr_tiStepBMaxDebDef_C DDRC_DurDeb.IdleChrgActr_tiStepAMinDebOk_C DDRC_DurDeb.IdleChrgActr_tiStepAMinDebDef_C DDRC_DurDeb.MonUMinSupply1DebOk_C DDRC_DurDeb.MonUMinSupply1DebDef_C DDRC_DurDeb.MonUMaxSupply1DebOk_C DDRC_DurDeb.MonUMaxSupply1DebDef_C DDRC_DurDeb.IdleChrgActr_tiStepNBSigDebOk_C DDRC_DurDeb.IdleChrgActr_tiStepNBSigDebDef_C DDRC_DurDeb.IdleChrgActr_tiStepNAMaxDebOk_C DDRC_DurDeb.IdleChrgActr_tiStepNAMaxDebDef_C DDRC_DurDeb.Brk_tiPlaDebOk_C DDRC_DurDeb.Brk_tiPlaDebDef_C DDRC_DurDeb.IdleChrgActr_tiGovDeMinDebOk_C DDRC_DurDeb.IdleChrgActr_tiGovDeMinDebDef_C DDRC_DurDeb.Clth_numOpnDebOk_C DDRC_DurDeb.Clth_numOpnDebDef_C DDRC_DurDeb.IgnClPs_numDevComErr1DebOk_C DDRC_DurDeb.IgnClPs_numDevComErr1DebDef_C DDRC_DurDeb.IgnClPs_numShCirBatt1DebOk_C DDRC_DurDeb.IgnClPs_numShCirBatt1DebDef_C DDRC_DurDeb.KnDet_numShCirDebOk_C DDRC_DurDeb.KnDet_numShCirDebDef_C DDRC_DurDeb.IgnClPs_numShCirBatt0DebOk_C DDRC_DurDeb.IgnClPs_numShCirBatt0DebDef_C DDRC_DurDeb.IgnClPs_numShCirBatt2DebOk_C DDRC_DurDeb.IgnClPs_numShCirBatt2DebDef_C DDRC_DurDeb.Clth_numClsdDebOk_C DDRC_DurDeb.Clth_numClsdDebDef_C DDRC_DurDeb.VehV_ctWhlErrDebOk_C DDRC_DurDeb.VehV_ctWhlErrDebDef_C DDRC_DurDeb.IgnClPs_numOpenLoad1DebOk_C DDRC_DurDeb.IgnClPs_numOpenLoad1DebDef_C DDRC_DurDeb.IgnClPs_numOpenLoad2DebOk_C DDRC_DurDeb.IgnClPs_numOpenLoad2DebDef_C DDRC_DurDeb.IgnClPs_numShCirGnd0DebOk_C DDRC_DurDeb.IgnClPs_numShCirGnd0DebDef_C DDRC_DurDeb.IgnClPs_numShCirGnd1DebOk_C DDRC_DurDeb.IgnClPs_numShCirGnd1DebDef_C DDRC_DurDeb.IgnClPs_numShCirGnd2DebOk_C DDRC_DurDeb.IgnClPs_numShCirGnd2DebDef_C DDRC_DurDeb.IgnClPs_numOpenLoad0DebOk_C DDRC_DurDeb.IgnClPs_numOpenLoad0DebDef_C DDRC_DurDeb.BusDiag_tiBusOffNodeADebOk_C DDRC_DurDeb.BusDiag_tiBusOffNodeADebDef_C DDRC_RatDeb.AirC_tiCmprSCBUDRat_C DDRC_RatDeb.Fan_tiDIOOvrTempUDRat_C DDRC_RatDeb.DevLib_tiBattULoUDRat_C DDRC_RatDeb.Fan_tiDIOOLUDRat_C DDRC_RatDeb.Fan_tiPWMOvrTempUDRat_C DDRC_RatDeb.Fan_tiPWMSCBUDRat_C DDRC_RatDeb.Fan_tiPWMOLUDRat_C DDRC_RatDeb.AltIO_tiSCBUDRat_C DDRC_RatDeb.AltIO_tiOLUDRat_C DDRC_RatDeb.AltIO_tiOvrTempUDRat_C DDRC_RatDeb.AirC_tiCmprOvrTempUDRat_C DDRC_RatDeb.Fan_tiDIOSCGUDRat_C DDRC_RatDeb.Fan_tiDIOSCBUDRat_C DDRC_RatDeb.AirC_tiCmprOLUDRat_C DDRC_RatDeb.AltIO_tiSRCMinUDRat_C DDRC_RatDeb.DevLib_tiBattUHiUDRat_C DDRC_RatDeb.AltIO_tiSCGUDRat_C DDRC_RatDeb.Fan_tiPWMSCGUDRat_C DDRC_RatDeb.AirC_tiCmprSCGUDRat_C DDRC_RatDeb.AltIO_tiSRCMaxUDRat_C DDRC_RatDeb.Clth_tiEPBSensErrUDRat_C DDRC_RatDeb.Brk_tiSigUDRat_C DDRC_RatDeb.APP_tiSRCHighUDRat_C DDRC_RatDeb.AirC_tiClntSRCMaxUDRat_C DDRC_RatDeb.Clth_tiErrUDRat_C DDRC_RatDeb.VehV_tiPlaUDRat_C DDRC_RatDeb.VehV_tiSigUDRat_C DDRC_RatDeb.AirC_tiSwtNplUDRat_C DDRC_RatDeb.APP_PlaAPP12UDRat_C DDRC_RatDeb.MILLmp_tiSCGUDRat_C DDRC_RatDeb.Clth_tiPlausUDRat_C DDRC_RatDeb.APP_tiSRCLowUDRat_C DDRC_RatDeb.AirC_tiClntSRCMinUDRat_C DDRC_RatDeb.MILLmp_tiOLUDRat_C DDRC_RatDeb.Clth_tiSigUDRat_C DDRC_RatDeb.MILLmp_tiSCBUDRat_C DDRC_RatDeb.VehV_tiMaxUDRat_C DDRC_RatDeb.AirC_tiSwtSigUDRat_C /end DEF_CHARACTERISTIC
 /begin LOC_MEASUREMENT DDRC_St.DFC_AltMaxPwr DDRC_St.DFC_BrkNpl DDRC_St.DFC_Cj930SSp1Mon DDRC_St.DFC_Cj930SSp2Mon DDRC_St.DFC_Cj930SSp3Mon DDRC_St.DFC_IdleChrgActrAMax DDRC_St.DFC_IdleChrgActrAMin DDRC_St.DFC_IdleChrgActrASig DDRC_St.DFC_IdleChrgActrBMax DDRC_St.DFC_IdleChrgActrBMin DDRC_St.DFC_IdleChrgActrBSig DDRC_St.DFC_IdleChrgActrGovDeCold DDRC_St.DFC_IdleChrgActrGovDeMax DDRC_St.DFC_IdleChrgActrGovDeMin DDRC_St.DFC_IdleChrgActrNAMax DDRC_St.DFC_IdleChrgActrNAMin DDRC_St.DFC_IdleChrgActrNASig DDRC_St.DFC_IdleChrgActrNBMax DDRC_St.DFC_IdleChrgActrNBMin DDRC_St.DFC_IdleChrgActrNBSig DDRC_St.DFC_IdleChrgActrOverTmp DDRC_St.DFC_MonUMaxSupply1 DDRC_St.DFC_MonUMinSupply1 DDRC_St.DFC_ClthNplClsd DDRC_St.DFC_ClthNplOpn DDRC_St.DFC_IgnClPsDevComErr1 DDRC_St.DFC_IgnClPsOpenLoad0 DDRC_St.DFC_IgnClPsOpenLoad1 DDRC_St.DFC_IgnClPsOpenLoad2 DDRC_St.DFC_IgnClPsShCirBatt0 DDRC_St.DFC_IgnClPsShCirBatt1 DDRC_St.DFC_IgnClPsShCirBatt2 DDRC_St.DFC_IgnClPsShCirGnd0 DDRC_St.DFC_IgnClPsShCirGnd1 DDRC_St.DFC_IgnClPsShCirGnd2 DDRC_St.DFC_KnDetSens1PortAMax DDRC_St.DFC_KnDetSens1PortAMin DDRC_St.DFC_KnDetSens1PortBMax DDRC_St.DFC_KnDetSens1PortBMin DDRC_St.DFC_VehVWhlErr DDRC_St.DFC_AirCCmprOL DDRC_St.DFC_AirCCmprOvrTemp DDRC_St.DFC_AirCCmprSCB DDRC_St.DFC_AirCCmprSCG DDRC_St.DFC_AltIOLdSRCMin DDRC_St.DFC_AltIOOL DDRC_St.DFC_AltIOOvrTemp DDRC_St.DFC_AltIOSCB DDRC_St.DFC_AltIOSCG DDRC_St.DFC_DevLibBattUHi DDRC_St.DFC_DevLibBattULo DDRC_St.DFC_FanDIOOL DDRC_St.DFC_FanDIOOvrTemp DDRC_St.DFC_FanDIOSCB DDRC_St.DFC_FanDIOSCG DDRC_St.DFC_FanPWMOL DDRC_St.DFC_FanPWMOvrTemp DDRC_St.DFC_FanPWMSCB DDRC_St.DFC_FanPWMSCG DDRC_St.DFC_AirCClntPAnaSRCMax DDRC_St.DFC_AirCClntPAnaSRCMin DDRC_St.DFC_AirCSwtNpl DDRC_St.DFC_AirCSwtSig DDRC_St.DFC_AltIOLdSRCMax DDRC_St.DFC_BrkSig DDRC_St.DFC_ClthEPBNpl DDRC_St.DFC_ClthEPBSensErr DDRC_St.DFC_ClthErr DDRC_St.DFC_ClthSig DDRC_St.DFC_MILLmpOL DDRC_St.DFC_MILLmpSCB DDRC_St.DFC_MILLmpSCG DDRC_St.DFC_SRCHighAPP1 DDRC_St.DFC_SRCHighAPP2 DDRC_St.DFC_SRCLowAPP1 DDRC_St.DFC_SRCLowAPP2 DDRC_St.DFC_SyncAPP DDRC_St.DFC_VehVMax DDRC_St.DFC_VehVPlaus DDRC_St.DFC_VehVSig DDRC_St.DFC_BusDiagBusOffNodeA DSM_xTabVersion /end LOC_MEASUREMENT
 FUNCTION_VERSION "2.4.0" /end FUNCTION
/begin FUNCTION DECJ "1.60.0" /begin DEF_CHARACTERISTIC NDECJ UBCJMN /end DEF_CHARACTERISTIC /begin IN_MEASUREMENT nmot ubsq /end IN_MEASUREMENT /begin OUT_MEASUREMENT B_desee B_deseehr B_PmdInit /end OUT_MEASUREMENT FUNCTION_VERSION "1.60.0" /end FUNCTION
/begin FUNCTION DEKPE "1.3.0" /begin DEF_CHARACTERISTIC CWPSKPE EKPPA TCYCDEKPE UBDEKPMN /end DEF_CHARACTERISTIC /begin IN_MEASUREMENT MoCSOP_stRdy ubsq /end IN_MEASUREMENT /begin LOC_MEASUREMENT dekpe ekppz /end LOC_MEASUREMENT FUNCTION_VERSION "1.3.0" /end FUNCTION
/begin FUNCTION DELib_StepActr "1.3.0"
 /begin DEF_CHARACTERISTIC IdleChrgActr_deltastep_C IdleChrgActr_facSnsrMdl_C IdleChrgActr_facSnsrStep_C IdleChrgActr_frqAdptNearMechLim_C IdleChrgActr_frqAdptNrmActvtn_C IdleChrgActr_frqMaxActvtn_C IdleChrgActr_frqNearMechLim_C IdleChrgActr_frqStop_C IdleChrgActr_frqTestPul_C IdleChrgActr_hexStepCodMtrxAcc_CA IdleChrgActr_hexStepCodMtrx_CA IdleChrgActr_NoMovDelay_C IdleChrgActr_numDiagStep_C IdleChrgActr_numMechMaxLim_C IdleChrgActr_numMechMinLim_C IdleChrgActr_numStepNormFrqMaxLim_C IdleChrgActr_numStepNormFrqMinLim_C IdleChrgActr_PosDrvSetPt_C IdleChrgActr_PowCodMtrx_CA IdleChrgActr_ratActJamClsd_C IdleChrgActr_ratActLow_C IdleChrgActr_ratActValTolr_T IdleChrgActr_ratDesActr_T IdleChrgActr_ratDesValMonMax_C IdleChrgActr_ratDesValMonMin_C IdleChrgActr_ratGovDeMax_C IdleChrgActr_ratGovDeMin_C IdleChrgActr_ratSensDef_C IdleChrgActr_ratStepShOff_C IdleChrgActr_StepFrqDelta_C IdleChrgActr_stGovDeMsk_C IdleChrgActr_stMonShOffMask_C IdleChrgActr_swtConf_C IdleChrgActr_swtLrnZrPos_C IdleChrgActr_tEngCld_T IdleChrgActr_tExhCld_C IdleChrgActr_tiAftStrt_C IdleChrgActr_tiDebJamVlv_C IdleChrgActr_tiDesValFild_T IdleChrgActr_tiMaxPostDrvDly_C IdleChrgActr_uBattChkDelta_C IdleChrgActr_uBattChkLowThd_C IdleChrgActr_uBattChkUpThd_C IdleChrgActr_uStepActvnBattLowThd1_C IdleChrgActr_uStepActvnBattLowThd2_C /end DEF_CHARACTERISTIC
 /begin IN_MEASUREMENT B_kl15 B_pwf CoEng_tiNormal EnvT_t ESC_tiSampling IdleChrgActr_rat IdleChrgActr_ratActMod ubsq /end IN_MEASUREMENT
 /begin OUT_MEASUREMENT IdleChrgActr_FreqActIni IdleChrgActr_FreqTrg IdleChrgActr_frqAct IdleChrgActr_posnDesVal IdleChrgActr_posnStepCalc IdleChrgActr_ratActDia IdleChrgActr_ratActStep IdleChrgActr_ratActVal IdleChrgActr_ratActValMax IdleChrgActr_ratActValMin IdleChrgActr_ratDesVal IdleChrgActr_ratGovrDeStepFild IdleChrgActr_stAdpnSuc IdleChrgActr_stBattHiErr IdleChrgActr_stBattLowErr IdleChrgActr_stDiagActv IdleChrgActr_stDiagCmplt IdleChrgActr_stDiagMov IdleChrgActr_stErrInfo IdleChrgActr_stMon IdleChrgActr_stStepA IdleChrgActr_stStepB IdleChrgActr_stStepSysErr IdleChrgActr_stStprActvDiag /end OUT_MEASUREMENT
 /begin LOC_MEASUREMENT Hbr_DiagInfo_a IdleChrgActr_AVal IdleChrgActr_BVal IdleChrgActr_cntrStepFrq IdleChrgActr_hexStepPls IdleChrgActr_hexStepPlsAcc IdleChrgActr_nErrInfo IdleChrgActr_nErrorObser_a IdleChrgActr_nErrorTyp IdleChrgActr_PowSaveCoil IdleChrgActr_ratDes IdleChrgActr_stCloseFreq IdleChrgActr_stCoilOff IdleChrgActr_stDirClose IdleChrgActr_stDirOpen IdleChrgActr_StepAcc IdleChrgActr_stFrstExec_a IdleChrgActr_stNoMov IdleChrgActr_stOKSts IdleChrgActr_stOpenFreq IdleChrgActr_stReqCls IdleChrgActr_stReqOpen IdleChrgActr_stStepCmdActvt IdleChrgActr_stStpMechLimOpr IdleChrgActr_tiPostDrvDly IdleChrg_stDebStatus numdiff posnDesValDiag ratActVal stAdpnPostDrv stAdpnStart stOldRasterStMchn stOldStateMchn stStateMchn /end LOC_MEASUREMENT
 FUNCTION_VERSION "1.3.0" /end FUNCTION
/begin FUNCTION DEVE "17.3.0" /begin DEF_CHARACTERISTIC CWPSEVE /end DEF_CHARACTERISTIC /begin REF_CHARACTERISTIC TVP /end REF_CHARACTERISTIC /begin IN_MEASUREMENT B_desee B_sa B_stend evz_austot SyC_stSub /end IN_MEASUREMENT /begin OUT_MEASUREMENT B_eev /end OUT_MEASUREMENT FUNCTION_VERSION "17.3.0" /end FUNCTION
/begin FUNCTION DevLib_DigOut "1.4.0" FUNCTION_VERSION "1.4.0" /end FUNCTION
/begin FUNCTION DevLib_DigOutErrHndlr "1.4.0" /begin DEF_CHARACTERISTIC DevLib_DigOutDbgSig_C /end DEF_CHARACTERISTIC /begin LOC_MEASUREMENT DevLib_stDigOutErr_mp /end LOC_MEASUREMENT FUNCTION_VERSION "1.4.0" /end FUNCTION
/begin FUNCTION DevLib_PsDiag "1.4.0" FUNCTION_VERSION "1.4.0" /end FUNCTION
/begin FUNCTION DevLib_PWMOut "1.4.0" FUNCTION_VERSION "1.4.0" /end FUNCTION
/begin FUNCTION DevLib_PWMOutErrHndlr "1.4.0" /begin DEF_CHARACTERISTIC DevLib_PWMOutDbgSig_C /end DEF_CHARACTERISTIC /begin LOC_MEASUREMENT DevLib_stPWMOutErr_mp /end LOC_MEASUREMENT FUNCTION_VERSION "1.4.0" /end FUNCTION
/begin FUNCTION DevLib_PwrStgState "1.4.0"
 /begin DEF_CHARACTERISTIC Devlib_PsDisbl.facLowHysLo_C Devlib_PsDisbl.facLowHysHi_C Devlib_PsDisbl.facHighHysLo_C Devlib_PsDisbl.facHighHysHi_C Devlib_PwrStg.BattLoHysLo_C Devlib_PwrStg.BattLoHysHi_C Devlib_PwrStg.BattHiHysLo_C Devlib_PwrStg.BattHiHysHi_C /end DEF_CHARACTERISTIC
 /begin IN_MEASUREMENT BattU_facCor BattU_u SyC_stSub /end IN_MEASUREMENT
 /begin OUT_MEASUREMENT DevLib_stPwrStgEnaCond /end OUT_MEASUREMENT
 FUNCTION_VERSION "1.4.0" /end FUNCTION
/begin FUNCTION DevLib_SRC "1.4.0" FUNCTION_VERSION "1.4.0" /end FUNCTION
/begin FUNCTION DevLib_TransStage "1.4.0" FUNCTION_VERSION "1.4.0" /end FUNCTION
/begin COMPU_METHOD B_TRUE "" TAB_VERB "%6.3" "" COMPU_TAB_REF B_TRUE /end COMPU_METHOD
/begin COMPU_VTAB B_TRUE "" TAB_VERB 2 0 "----" 1 "TRUE" /end COMPU_VTAB
/begin COMPU_METHOD DDRCTime_ms "" RAT_FUNC "%6.1" "ms" COEFFS 0 1 0 0 0 10 /end COMPU_METHOD
/begin COMPU_METHOD DDRC_Ratio "" TAB_VERB "%6.3" "-" COMPU_TAB_REF DDRC_Ratio /end COMPU_METHOD
/begin COMPU_VTAB DDRC_Ratio "" TAB_VERB 4 1 "Ratio1" 2 "Ratio2" 3 "Ratio3" 4 "Ratio4" /end COMPU_VTAB
/begin COMPU_METHOD dez "" RAT_FUNC "%6.2" "" COEFFS 0 1 0 0 0 1 /end COMPU_METHOD
/begin COMPU_METHOD DFC_OneToOne "" RAT_FUNC "%6.2" "-" COEFFS 0 1 0 0 0 1 /end COMPU_METHOD
/begin COMPU_METHOD dfp_verbal "" TAB_VERB "%2.1" "-" COMPU_TAB_REF dfp_verbal /end COMPU_METHOD
/begin COMPU_VTAB dfp_verbal "" TAB_VERB 87 0 "DFP_AAA" 1 "DFP_BM" 2 "DFP_DK" 3 "DFP_DKVS" 4 "DFP_DSS" 5 "DFP_DVEV" 6 "DFP_DYLSU" 7 "DFP_DZKU0" 8 "DFP_DZKU1" 9 "DFP_DZKU2" 10 "DFP_EGFE" 11 "DFP_ENWS" 12 "DFP_ENWSE" 13 "DFP_EV1" 14 "DFP_EV2" 15 "DFP_EV3" 16 "DFP_FMAS" 17 "DFP_FP1P" 18 "DFP_FP2P" 19 "DFP_FRA" 20 "DFP_FRAU" 21 "DFP_FTDLA" 22 "DFP_HELSU" 23 "DFP_HRE" 24 "DFP_HSH" 25 "DFP_HSHE" 26 "DFP_HSV" 27 "DFP_HSVE" 28 "DFP_HSVSA" 29 "DFP_ICLSU" 30 "DFP_KAT" 31 "DFP_KATF" 32 "DFP_KPE" 33 "DFP_KRNT" 34 "DFP_KROF" 35 "DFP_KRTP" 36 "DFP_KUPPL" 37 "DFP_LASH" 38 "DFP_LLR" 39 "DFP_LLRKH" 40 "DFP_LM" 41 "DFP_LSH" 42 "DFP_LSUKS" 43 "DFP_LSUUN" 44 "DFP_LSV" 45 "DFP_LUES1E" 46 "DFP_LZSR" 47 "DFP_MD" 48 "DFP_N" 49 "DFP_NWKW" 50 "DFP_NWKWE" 51 "DFP_ORA" 52 "DFP_PH" 53 "DFP_PHE" 54 "DFP_PLLSU" 55 "DFP_PS1E" 56 "DFP_PS2E" 57 "DFP_PS3E" 58 "DFP_PSR" 59 "DFP_PSR1" 60 "DFP_PSRB" 61 "DFP_PSRE" 62 "DFP_PSRP" 63 "DFP_PVD" 64 "DFP_RKAT" 65 "DFP_RKAZ" 66 "DFP_STKLSV" 67 "DFP_TA" 68 "DFP_TACS" 69 "DFP_TAR" 70 "DFP_TASR" 71 "DFP_TASRE" 72 "DFP_TES" 73 "DFP_TEVE" 74 "DFP_THM" 75 "DFP_TM" 76 "DFP_TMCS" 77 "DFP_TME" 78 "DFP_TMKI" 79 "DFP_TMP" 80 "DFP_TUM" 81 "DFP_UB" 82 "DFP_UBR" 83 "DFP_ULSU" 84 "DFP_VFZ" 85 "DFP_VFZG" 86 "DFP_ZZZ" DEFAULT_VALUE "---" /end COMPU_VTAB
/begin COMPU_METHOD EngN "" RAT_FUNC "%6.3" "rpm" COEFFS 0 2 0 0 0 1 /end COMPU_METHOD
/begin COMPU_METHOD Fact "" RAT_FUNC "%6.5" "-" COEFFS 0 8192 0 0 0 1 /end COMPU_METHOD
/begin COMPU_METHOD FactLow "" RAT_FUNC "%6.5" "-" COEFFS 0 1024 0 0 0 1 /end COMPU_METHOD
/begin COMPU_METHOD Fact_2pwr11 "" RAT_FUNC "%6.5" "-" COEFFS 0 2048 0 0 0 1 /end COMPU_METHOD
/begin COMPU_METHOD Fac_WearSot "" RAT_FUNC "%6.3" "-" COEFFS 0 10 0 0 0 1 /end COMPU_METHOD
/begin COMPU_METHOD fak_q0p001 "" RAT_FUNC "%6.5" "-" COEFFS 0 1000 0 0 0 1 /end COMPU_METHOD
/begin COMPU_METHOD fak_q0p0625 "" RAT_FUNC "%6.4" "-" COEFFS 0 16 0 0 0 1 /end COMPU_METHOD
/begin COMPU_METHOD fak_uw_b16 "" RAT_FUNC "%6.5" "-" COEFFS 0 65536 0 0 0 16 /end COMPU_METHOD
/begin COMPU_METHOD fak_uw_b32 "" RAT_FUNC "%6.5" "-" COEFFS 0 65536 0 0 0 32 /end COMPU_METHOD
/begin COMPU_METHOD FANCTL_OXICAT_SY_Compu "" TAB_VERB "%6.3" "" COMPU_TAB_REF FANCTL_OXICAT_SY_Compu /end COMPU_METHOD
/begin COMPU_VTAB FANCTL_OXICAT_SY_Compu "" TAB_VERB 2 0 "0" 1 "1" /end COMPU_VTAB
/begin COMPU_METHOD FANCTL_VARDET_SY_Compu "" TAB_VERB "%6.3" "" COMPU_TAB_REF FANCTL_VARDET_SY_Compu /end COMPU_METHOD
/begin COMPU_VTAB FANCTL_VARDET_SY_Compu "" TAB_VERB 2 0 "False" 1 "True" /end COMPU_VTAB
/begin COMPU_METHOD FAN_ATSINTVMOD_SY_Compu "" RAT_FUNC "%6.2" "" COEFFS 0 1 0 0 0 1 /end COMPU_METHOD
/begin COMPU_METHOD FAN_NUMDIGOUT_SY_Compu "" RAT_FUNC "%6.2" "" COEFFS 0 1 0 0 0 1 /end COMPU_METHOD
/begin COMPU_METHOD FAN_NUMPWMOUT_SY_Compu "" RAT_FUNC "%6.2" "" COEFFS 0 1 0 0 0 1 /end COMPU_METHOD
/begin COMPU_METHOD FCOCMF_SY_Compu "" TAB_VERB "%6.3" "" COMPU_TAB_REF FCOCMF_SY_Compu /end COMPU_METHOD
/begin COMPU_VTAB FCOCMF_SY_Compu "" TAB_VERB 4 0 "0" 1 "1" 2 "2" 3 "3" /end COMPU_VTAB
/begin COMPU_METHOD FCONTHRES_SY_Compu "" TAB_VERB "%6.3" "" COMPU_TAB_REF FCONTHRES_SY_Compu /end COMPU_METHOD
/begin COMPU_VTAB FCONTHRES_SY_Compu "" TAB_VERB 2 0 "0" 1 "1" /end COMPU_VTAB
/begin COMPU_METHOD FEA_ETS_MSG_Compu "" TAB_VERB "%6.3" "" COMPU_TAB_REF FEA_ETS_MSG_Compu /end COMPU_METHOD
/begin COMPU_VTAB FEA_ETS_MSG_Compu "" TAB_VERB 2 0 "False" 1 "True" /end COMPU_VTAB
/begin COMPU_METHOD FEA_SY_CCP_Compu "" TAB_VERB "%6.3" "" COMPU_TAB_REF FEA_SY_CCP_Compu /end COMPU_METHOD
/begin COMPU_VTAB FEA_SY_CCP_Compu "" TAB_VERB 2 0 "No CCP" 1 "CCP" /end COMPU_VTAB
/begin COMPU_METHOD FEA_SY_ISO14229_Compu "" TAB_VERB "%6.3" "" COMPU_TAB_REF FEA_SY_ISO14229_Compu /end COMPU_METHOD
/begin COMPU_VTAB FEA_SY_ISO14229_Compu "" TAB_VERB 2 0 "NoCommunication protocol: ISO14229" 1 "Communication protocol: ISO14229" /end COMPU_VTAB
/begin COMPU_METHOD FEA_SY_MX17_Compu "" TAB_VERB "%6.3" "" COMPU_TAB_REF FEA_SY_MX17_Compu /end COMPU_METHOD
/begin COMPU_VTAB FEA_SY_MX17_Compu "" TAB_VERB 2 0 "ECU:not ME(D)17" 1 "ECU: ME(D)17" /end COMPU_VTAB
/begin COMPU_METHOD FLASH_CONFIG_SY_Compu "" RAT_FUNC "%6.2" "" COEFFS 0 1 0 0 0 1 /end COMPU_METHOD
/begin COMPU_METHOD FlConsum_l "" RAT_FUNC "%6.5" "l" COEFFS 0 1000 0 0 0 1 /end COMPU_METHOD
/begin COMPU_METHOD FlConsum_l_s "" RAT_FUNC "%8.7" "l/s" COEFFS 0 360000 0 0 0 1 /end COMPU_METHOD
/begin COMPU_METHOD FlConsum_ul "" RAT_FUNC "%6.2" "ul" COEFFS 0 1 0 0 0 1 /end COMPU_METHOD
/begin COMPU_METHOD FlConsum_ul_High_COMPU "" RAT_FUNC "%6.1" "ul" COEFFS 0 0.05 0 0 0 1 /end COMPU_METHOD
/begin COMPU_METHOD FLCPMPPRES_SY_Compu "" TAB_VERB "%6.3" "" COMPU_TAB_REF FLCPMPPRES_SY_Compu /end COMPU_METHOD
/begin COMPU_VTAB FLCPMPPRES_SY_Compu "" TAB_VERB 2 0 "False" 1 "True" /end COMPU_VTAB
/begin COMPU_METHOD FLSYS_RUNDRYPRV_SY_Compu "" TAB_VERB "%6.3" "" COMPU_TAB_REF FLSYS_RUNDRYPRV_SY_Compu /end COMPU_METHOD
/begin COMPU_VTAB FLSYS_RUNDRYPRV_SY_Compu "" TAB_VERB 2 0 "False" 1 "True" /end COMPU_VTAB
/begin COMPU_METHOD FLT_IALCK_SY_Compu "" TAB_VERB "%6.3" "" COMPU_TAB_REF FLT_IALCK_SY_Compu /end COMPU_METHOD
/begin COMPU_VTAB FLT_IALCK_SY_Compu "" TAB_VERB 2 0 "0" 1 "1" /end COMPU_VTAB
/begin COMPU_METHOD FLT_IARLS_SY_Compu "" TAB_VERB "%6.3" "" COMPU_TAB_REF FLT_IARLS_SY_Compu /end COMPU_METHOD
/begin COMPU_VTAB FLT_IARLS_SY_Compu "" TAB_VERB 2 0 "0" 1 "1" /end COMPU_VTAB
/begin COMPU_METHOD Flvol_ml_fine "" RAT_FUNC "%6.5" "ml" COEFFS 0 1000 0 0 0 1 /end COMPU_METHOD
/begin COMPU_METHOD FLXR_SY_Compu "" TAB_VERB "%6.3" "" COMPU_TAB_REF FLXR_SY_Compu /end COMPU_METHOD
/begin COMPU_VTAB FLXR_SY_Compu "" TAB_VERB 2 0 "FALSE" 1 "TRUE" /end COMPU_VTAB
/begin COMPU_METHOD Fl_L "" RAT_FUNC "%6.4" "l" COEFFS 0 100 0 0 0 1 /end COMPU_METHOD
/begin COMPU_METHOD Fl_Vol_q0p05 "" RAT_FUNC "%6.4" "l" COEFFS 0 20 0 0 0 1 /end COMPU_METHOD
/begin COMPU_METHOD FPCMSLSU_SC_Compu "" TAB_VERB "%6.3" "" COMPU_TAB_REF FPCMSLSU_SC_Compu /end COMPU_METHOD
/begin COMPU_VTAB FPCMSLSU_SC_Compu "" TAB_VERB 2 0 "False" 1 "True" /end COMPU_VTAB
/begin COMPU_METHOD FPCTS_SY_Compu "" TAB_VERB "%6.3" "" COMPU_TAB_REF FPCTS_SY_Compu /end COMPU_METHOD
/begin COMPU_VTAB FPCTS_SY_Compu "" TAB_VERB 2 0 "False" 1 "True" /end COMPU_VTAB
/begin COMPU_METHOD FricCoeff "" RAT_FUNC "%7.6" "N/(km/hr)^2" COEFFS 0 10000 0 0 0 1 /end COMPU_METHOD
/begin COMPU_METHOD Friction "" RAT_FUNC "%6.2" "kgm/s^2" COEFFS 0 1 0 0 0 1 /end COMPU_METHOD
/begin COMPU_METHOD FSNW_SY_Compu "" TAB_VERB "%6.3" "" COMPU_TAB_REF FSNW_SY_Compu /end COMPU_METHOD
/begin COMPU_VTAB FSNW_SY_Compu "" TAB_VERB 2 0 "0" 1 "1" /end COMPU_VTAB
/begin COMPU_METHOD FUEVAPOIL_SC_Compu "" TAB_VERB "%6.3" "" COMPU_TAB_REF FUEVAPOIL_SC_Compu /end COMPU_METHOD
/begin COMPU_VTAB FUEVAPOIL_SC_Compu "" TAB_VERB 4 0 "no modelling" 1 "only model" 2 "lambda adaptation" 3 "LAMKORRLL adaptation" /end COMPU_VTAB
/begin COMPU_METHOD FULCOMP_SY_Compu "" TAB_VERB "%6.3" "" COMPU_TAB_REF FULCOMP_SY_Compu /end COMPU_METHOD
/begin COMPU_VTAB FULCOMP_SY_Compu "" TAB_VERB 2 0 "False" 1 "True" /end COMPU_VTAB
/begin COMPU_METHOD GBXCSC_SY_Compu "" TAB_VERB "%6.3" "" COMPU_TAB_REF GBXCSC_SY_Compu /end COMPU_METHOD
/begin COMPU_VTAB GBXCSC_SY_Compu "" TAB_VERB 2 0 "False" 1 "True" /end COMPU_VTAB
/begin COMPU_METHOD GBXNPOS_SY_Compu "" TAB_VERB "%6.3" "" COMPU_TAB_REF GBXNPOS_SY_Compu /end COMPU_METHOD
/begin COMPU_VTAB GBXNPOS_SY_Compu "" TAB_VERB 6 2 "GBXNPOS_PWM" 0 "GBXNPOS_OFF" 1 "GBXNPOS_ADC" 3 "GBXNPOS_INTSENS" 4 "GBXNPOS_CAL" 5 "GBXNPOS_DIO" /end COMPU_VTAB
/begin COMPU_METHOD GBXPRTVAR_SY_Compu "" RAT_FUNC "%6.2" "" COEFFS 0 1 0 0 0 1 /end COMPU_METHOD
/begin COMPU_METHOD GBXPTPS_SY_Compu "" TAB_VERB "%6.3" "" COMPU_TAB_REF GBXPTPS_SY_Compu /end COMPU_METHOD
/begin COMPU_VTAB GBXPTPS_SY_Compu "" TAB_VERB 2 0 "False" 1 "True" /end COMPU_VTAB
/begin COMPU_METHOD GBXSPD_CLTHPRT_SY_Compu "" TAB_VERB "%6.3" "" COMPU_TAB_REF GBXSPD_CLTHPRT_SY_Compu /end COMPU_METHOD
/begin COMPU_VTAB GBXSPD_CLTHPRT_SY_Compu "" TAB_VERB 2 1 "TRUE" 0 "FALSE" /end COMPU_VTAB
/begin COMPU_METHOD GDI_SY_Compu "" TAB_VERB "%6.3" "" COMPU_TAB_REF GDI_SY_Compu /end COMPU_METHOD
/begin COMPU_VTAB GDI_SY_Compu "" TAB_VERB 2 0 "GDI_NO" 1 "GDI" /end COMPU_VTAB
/begin COMPU_METHOD GLBDA_NUMTRIPRCRDMAX_SY_Compu "" RAT_FUNC "%6.2" "" COEFFS 0 1 0 0 0 1 /end COMPU_METHOD
/begin COMPU_METHOD GLBDA_NUMTRIPRCRDMIN_SY_Compu "" RAT_FUNC "%6.2" "" COEFFS 0 1 0 0 0 1 /end COMPU_METHOD
/begin COMPU_METHOD GLWECU_GCU4_LIN_SY_Compu "" TAB_VERB "%6.3" "" COMPU_TAB_REF GLWECU_GCU4_LIN_SY_Compu /end COMPU_METHOD
/begin COMPU_VTAB GLWECU_GCU4_LIN_SY_Compu "" TAB_VERB 2 0 "False" 1 "True" /end COMPU_VTAB
/begin COMPU_METHOD GSH_INTVENG_SY_Compu "" TAB_VERB "%6.3" "" COMPU_TAB_REF GSH_INTVENG_SY_Compu /end COMPU_METHOD
/begin COMPU_VTAB GSH_INTVENG_SY_Compu "" TAB_VERB 2 0 "0" 1 "1" /end COMPU_VTAB
/begin COMPU_METHOD GSSYS_TYPEEXHFLW_SY_Compu "" TAB_VERB "%6.3" "" COMPU_TAB_REF GSSYS_TYPEEXHFLW_SY_Compu /end COMPU_METHOD
/begin COMPU_VTAB GSSYS_TYPEEXHFLW_SY_Compu "" TAB_VERB 2 2 "HESRV_TWFLW" 1 "HESRV_SNGLFLW" /end COMPU_VTAB
/begin COMPU_METHOD GSSYS_TYPINDVOL_SY_Compu "" TAB_VERB "%6.3" "" COMPU_TAB_REF GSSYS_TYPINDVOL_SY_Compu /end COMPU_METHOD
/begin COMPU_VTAB GSSYS_TYPINDVOL_SY_Compu "" TAB_VERB 3 1 "HESRV_SNGLFLW" 0 "HESRV_NOTUSED" 2 "HESRV_TWFLW" /end COMPU_VTAB
/begin COMPU_METHOD H2CORS2_SY_Compu "" TAB_VERB "%6.3" "" COMPU_TAB_REF H2CORS2_SY_Compu /end COMPU_METHOD
/begin COMPU_VTAB H2CORS2_SY_Compu "" TAB_VERB 2 0 "False" 1 "True" /end COMPU_VTAB
/begin COMPU_METHOD H2CORS3_SY_Compu "" TAB_VERB "%6.3" "" COMPU_TAB_REF H2CORS3_SY_Compu /end COMPU_METHOD
/begin COMPU_VTAB H2CORS3_SY_Compu "" TAB_VERB 2 0 "False" 1 "True" /end COMPU_VTAB
/begin COMPU_METHOD HDC_SY_Compu "" TAB_VERB "%6.3" "" COMPU_TAB_REF HDC_SY_Compu /end COMPU_METHOD
/begin COMPU_VTAB HDC_SY_Compu "" TAB_VERB 2 0 "False" 1 "True" /end COMPU_VTAB
/begin COMPU_METHOD HEGNS3B1_SC_Compu "" TAB_VERB "%6.3" "" COMPU_TAB_REF HEGNS3B1_SC_Compu /end COMPU_METHOD
/begin COMPU_VTAB HEGNS3B1_SC_Compu "" TAB_VERB 2 0 "False" 1 "True" /end COMPU_VTAB
/begin COMPU_METHOD HEGODDYNSIMN_SY_Compu "" TAB_VERB "%6.3" "" COMPU_TAB_REF HEGODDYNSIMN_SY_Compu /end COMPU_METHOD
/begin COMPU_VTAB HEGODDYNSIMN_SY_Compu "" TAB_VERB 2 0 "False" 1 "True" /end COMPU_VTAB
/begin COMPU_METHOD HEGODDYNUS_SY_Compu "" TAB_VERB "%6.3" "" COMPU_TAB_REF HEGODDYNUS_SY_Compu /end COMPU_METHOD
/begin COMPU_VTAB HEGODDYNUS_SY_Compu "" TAB_VERB 2 0 "False" 1 "True" /end COMPU_VTAB
/begin COMPU_METHOD HEGODSYMCTLUS_SY_Compu "" TAB_VERB "%6.3" "" COMPU_TAB_REF HEGODSYMCTLUS_SY_Compu /end COMPU_METHOD
/begin COMPU_VTAB HEGODSYMCTLUS_SY_Compu "" TAB_VERB 2 0 "False" 1 "True" /end COMPU_VTAB
/begin COMPU_METHOD HEGOFUELCOR_SY_Compu "" TAB_VERB "%6.3" "" COMPU_TAB_REF HEGOFUELCOR_SY_Compu /end COMPU_METHOD
/begin COMPU_VTAB HEGOFUELCOR_SY_Compu "" TAB_VERB 2 0 "False" 1 "True" /end COMPU_VTAB
/begin COMPU_METHOD HEGOS1B1PSID_SY_Compu "" TAB_VERB "%6.3" "" COMPU_TAB_REF HEGOS1B1PSID_SY_Compu /end COMPU_METHOD
/begin COMPU_VTAB HEGOS1B1PSID_SY_Compu "" TAB_VERB 6 0 "PS0" 1 "PS1" 2 "PS2" 3 "PS3" 4 "PS4" 5 "PS5" /end COMPU_VTAB
/begin COMPU_METHOD HEGOS1B1_SY_Compu "" TAB_VERB "%6.3" "" COMPU_TAB_REF HEGOS1B1_SY_Compu /end COMPU_METHOD
/begin COMPU_VTAB HEGOS1B1_SY_Compu "" TAB_VERB 2 0 "False" 1 "True" /end COMPU_VTAB
/begin COMPU_METHOD HEGOS1B2_SY_Compu "" TAB_VERB "%6.3" "" COMPU_TAB_REF HEGOS1B2_SY_Compu /end COMPU_METHOD
/begin COMPU_VTAB HEGOS1B2_SY_Compu "" TAB_VERB 2 0 "False" 1 "True" /end COMPU_VTAB
/begin COMPU_METHOD HEGOS1FET_SY_Compu "" TAB_VERB "%6.3" "" COMPU_TAB_REF HEGOS1FET_SY_Compu /end COMPU_METHOD
/begin COMPU_VTAB HEGOS1FET_SY_Compu "" TAB_VERB 2 0 "False" 1 "True" /end COMPU_VTAB
/begin COMPU_METHOD HEGOS2B1PSID_SY_Compu "" TAB_VERB "%6.3" "" COMPU_TAB_REF HEGOS2B1PSID_SY_Compu /end COMPU_METHOD
/begin COMPU_VTAB HEGOS2B1PSID_SY_Compu "" TAB_VERB 6 0 "PS0" 1 "PS1" 2 "PS2" 3 "PS3" 4 "PS4" 5 "PS5" /end COMPU_VTAB
/begin COMPU_METHOD HEGOS2B1_SY_Compu "" TAB_VERB "%6.3" "" COMPU_TAB_REF HEGOS2B1_SY_Compu /end COMPU_METHOD
/begin COMPU_VTAB HEGOS2B1_SY_Compu "" TAB_VERB 2 0 "False" 1 "True" /end COMPU_VTAB
/begin COMPU_METHOD HEGOS2B2_SY_Compu "" TAB_VERB "%6.3" "" COMPU_TAB_REF HEGOS2B2_SY_Compu /end COMPU_METHOD
/begin COMPU_VTAB HEGOS2B2_SY_Compu "" TAB_VERB 2 0 "False" 1 "True" /end COMPU_VTAB
/begin COMPU_METHOD HEGOS2FET_SY_Compu "" TAB_VERB "%6.3" "" COMPU_TAB_REF HEGOS2FET_SY_Compu /end COMPU_METHOD
/begin COMPU_VTAB HEGOS2FET_SY_Compu "" TAB_VERB 2 0 "False" 1 "True" /end COMPU_VTAB
/begin COMPU_METHOD HEGOS3B1_SY_Compu "" TAB_VERB "%6.3" "" COMPU_TAB_REF HEGOS3B1_SY_Compu /end COMPU_METHOD
/begin COMPU_VTAB HEGOS3B1_SY_Compu "" TAB_VERB 2 0 "False" 1 "True" /end COMPU_VTAB
/begin COMPU_METHOD HEGOS3B2_SY_Compu "" TAB_VERB "%6.3" "" COMPU_TAB_REF HEGOS3B2_SY_Compu /end COMPU_METHOD
/begin COMPU_VTAB HEGOS3B2_SY_Compu "" TAB_VERB 2 0 "False" 1 "True" /end COMPU_VTAB
/begin COMPU_METHOD HEGOS3FET_SY_Compu "" TAB_VERB "%6.3" "" COMPU_TAB_REF HEGOS3FET_SY_Compu /end COMPU_METHOD
/begin COMPU_VTAB HEGOS3FET_SY_Compu "" TAB_VERB 2 0 "False" 1 "True" /end COMPU_VTAB
/begin COMPU_METHOD HEM_SY_Compu "" TAB_VERB "%6.3" "" COMPU_TAB_REF HEM_SY_Compu /end COMPU_METHOD
/begin COMPU_VTAB HEM_SY_Compu "" TAB_VERB 3 2 "HEM_BNK" 1 "HEM_CYL" 0 "NO_HEM" /end COMPU_VTAB
/begin COMPU_METHOD HESRV_HETYP_SY_Compu "" TAB_VERB "%6.3" "" COMPU_TAB_REF HESRV_HETYP_SY_Compu /end COMPU_METHOD
/begin COMPU_VTAB HESRV_HETYP_SY_Compu "" TAB_VERB 2 1 "HESRV_MASTERSLAVE" 255 "HESRV_ONEBOX" /end COMPU_VTAB
/begin COMPU_METHOD HEVTYP_SY_Compu "" TAB_VERB "%6.3" "" COMPU_TAB_REF HEVTYP_SY_Compu /end COMPU_METHOD
/begin COMPU_VTAB HEVTYP_SY_Compu "" TAB_VERB 7 0 "0" 1 "HEVTYP_SER" 4 "HEVTYP_PARL" 2 "HEVTYP_SERPARL" 3 "HEVTYP_PWRSPLT" 5 "HEVTYP_EAD" 6 "HEVTYP_EDCT" /end COMPU_VTAB
/begin COMPU_METHOD HLN_SY_Compu "" TAB_VERB "%6.3" "" COMPU_TAB_REF HLN_SY_Compu /end COMPU_METHOD
/begin COMPU_VTAB HLN_SY_Compu "" TAB_VERB 2 0 "False" 1 "True" /end COMPU_VTAB
/begin COMPU_METHOD HLSDEMERR1_SY_Compu "" TAB_VERB "%6.3" "" COMPU_TAB_REF HLSDEMERR1_SY_Compu /end COMPU_METHOD
/begin COMPU_VTAB HLSDEMERR1_SY_Compu "" TAB_VERB 2 0 "False" 1 "True" /end COMPU_VTAB
/begin COMPU_METHOD HLSDEMERR2_SY_Compu "" TAB_VERB "%6.3" "" COMPU_TAB_REF HLSDEMERR2_SY_Compu /end COMPU_METHOD
/begin COMPU_VTAB HLSDEMERR2_SY_Compu "" TAB_VERB 2 0 "False" 1 "True" /end COMPU_VTAB
/begin COMPU_METHOD HLSDEM_GEARLIM_SY_Compu "" TAB_VERB "%6.3" "" COMPU_TAB_REF HLSDEM_GEARLIM_SY_Compu /end COMPU_METHOD
/begin COMPU_VTAB HLSDEM_GEARLIM_SY_Compu "" TAB_VERB 2 0 "False" 1 "True" /end COMPU_VTAB
/begin COMPU_METHOD HLSDEM_NMINWOTRAINTV_SY_Compu "" TAB_VERB "%6.3" "" COMPU_TAB_REF HLSDEM_NMINWOTRAINTV_SY_Compu /end COMPU_METHOD
/begin COMPU_VTAB HLSDEM_NMINWOTRAINTV_SY_Compu "" TAB_VERB 2 0 "0" 1 "1" /end COMPU_VTAB
/begin COMPU_METHOD HTGTSTRS1_SY_Compu "" TAB_VERB "%6.3" "" COMPU_TAB_REF HTGTSTRS1_SY_Compu /end COMPU_METHOD
/begin COMPU_VTAB HTGTSTRS1_SY_Compu "" TAB_VERB 2 0 "False" 1 "True" /end COMPU_VTAB
/begin COMPU_METHOD HTGTSTRS2_SY_Compu "" TAB_VERB "%6.3" "" COMPU_TAB_REF HTGTSTRS2_SY_Compu /end COMPU_METHOD
/begin COMPU_VTAB HTGTSTRS2_SY_Compu "" TAB_VERB 2 0 "False" 1 "True" /end COMPU_VTAB
/begin COMPU_METHOD HTGTSTRS3_SY_Compu "" TAB_VERB "%6.3" "" COMPU_TAB_REF HTGTSTRS3_SY_Compu /end COMPU_METHOD
/begin COMPU_VTAB HTGTSTRS3_SY_Compu "" TAB_VERB 2 0 "False" 1 "True" /end COMPU_VTAB
/begin COMPU_METHOD I14229_RDTCSEVERITY_SY_Compu "" TAB_VERB "%6.3" "" COMPU_TAB_REF I14229_RDTCSEVERITY_SY_Compu /end COMPU_METHOD
/begin COMPU_VTAB I14229_RDTCSEVERITY_SY_Compu "" TAB_VERB 2 0 "FALSE" 1 "TRUE" /end COMPU_VTAB
/begin COMPU_METHOD I15031APPL_NUMSIZETEXHFLD_SY_Compu "" RAT_FUNC "%6.2" "" COEFFS 0 1 0 0 0 1 /end COMPU_METHOD
/begin COMPU_METHOD I15031_CUSVAR_SY_Compu "" RAT_FUNC "%6.2" "" COEFFS 0 1 0 0 0 1 /end COMPU_METHOD
/begin COMPU_METHOD I15031_OBD_CNTL_SC_Compu "" TAB_VERB "%6.3" "" COMPU_TAB_REF I15031_OBD_CNTL_SC_Compu /end COMPU_METHOD
/begin COMPU_VTAB I15031_OBD_CNTL_SC_Compu "" TAB_VERB 4 0 "I15031_ACTIVE" 1 "I15031_SRV_ADJUST" 2 "I15031_INACTIVE" 3 "I15031_NOT_EXISTING" /end COMPU_VTAB
/begin COMPU_METHOD I15031_SRV8_SY_Compu "" TAB_VERB "%6.3" "" COMPU_TAB_REF I15031_SRV8_SY_Compu /end COMPU_METHOD
/begin COMPU_VTAB I15031_SRV8_SY_Compu "" TAB_VERB 2 0 "0" 1 "1" /end COMPU_VTAB
/begin COMPU_METHOD I2CEMU_SY_Compu "" TAB_VERB "%6.3" "" COMPU_TAB_REF I2CEMU_SY_Compu /end COMPU_METHOD
/begin COMPU_VTAB I2CEMU_SY_Compu "" TAB_VERB 2 1 "I2CEMU used" 0 "no I2CEMU interface" /end COMPU_VTAB
/begin COMPU_METHOD IGNARCDURMONI_SY_Compu "" TAB_VERB "%6.3" "" COMPU_TAB_REF IGNARCDURMONI_SY_Compu /end COMPU_METHOD
/begin COMPU_VTAB IGNARCDURMONI_SY_Compu "" TAB_VERB 2 0 "Spark Duration Diagnosis Ignition Output inactive" 1 "Spark Duration Diagnosis Ignition Output active" /end COMPU_VTAB
/begin COMPU_METHOD IGNARC_NUMTIM_SY_Compu "" RAT_FUNC "%6.2" "" COEFFS 0 1 0 0 0 1 /end COMPU_METHOD
/begin COMPU_METHOD IGNCLPS_STADIAENBL_SY_Compu "" TAB_VERB "%6.3" "" COMPU_TAB_REF IGNCLPS_STADIAENBL_SY_Compu /end COMPU_METHOD
/begin COMPU_VTAB IGNCLPS_STADIAENBL_SY_Compu "" TAB_VERB 2 0 "Disable" 1 "Enable" /end COMPU_VTAB
/begin COMPU_METHOD IGNCL_CLCRNTMON_SY_Compu "" TAB_VERB "%6.3" "" COMPU_TAB_REF IGNCL_CLCRNTMON_SY_Compu /end COMPU_METHOD
/begin COMPU_VTAB IGNCL_CLCRNTMON_SY_Compu "" TAB_VERB 2 0 "inaktiv (default)" 1 "aktiv" /end COMPU_VTAB
/begin COMPU_METHOD IGNCL_INTCALCNXTCHL_SC_Compu "" TAB_VERB "%6.3" "" COMPU_TAB_REF IGNCL_INTCALCNXTCHL_SC_Compu /end COMPU_METHOD
/begin COMPU_VTAB IGNCL_INTCALCNXTCHL_SC_Compu "" TAB_VERB 2 0 "False" 1 "True" /end COMPU_VTAB
/begin COMPU_METHOD IGNCL_QAG_SY_Compu "" TAB_VERB "%6.3" "" COMPU_TAB_REF IGNCL_QAG_SY_Compu /end COMPU_METHOD
/begin COMPU_VTAB IGNCL_QAG_SY_Compu "" TAB_VERB 2 1 "0.75 GradKW" 2 "0.10 GradKW" /end COMPU_VTAB
/begin COMPU_METHOD IGNINCIR_SY_Compu "" TAB_VERB "%6.3" "" COMPU_TAB_REF IGNINCIR_SY_Compu /end COMPU_METHOD
/begin COMPU_VTAB IGNINCIR_SY_Compu "" TAB_VERB 2 0 "Start Dwell Angle Recalculated Once on Intermediat" 1 "Recalculate Start Dwell Angle on every Increment I" /end COMPU_VTAB
/begin COMPU_METHOD IGNMDLRRI_SC_Compu "" TAB_VERB "%6.3" "" COMPU_TAB_REF IGNMDLRRI_SC_Compu /end COMPU_METHOD
/begin COMPU_VTAB IGNMDLRRI_SC_Compu "" TAB_VERB 3 0 "NONE" 1 "STANDARD" 2 "ENHANCED" /end COMPU_VTAB
/begin COMPU_METHOD InjMassHCI "" RAT_FUNC "%6.4" "mg" COEFFS 0 100 0 0 0 1 /end COMPU_METHOD
/begin COMPU_METHOD InjMassPerSecHCI "" RAT_FUNC "%6.3" "mg/s" COEFFS 0 10 0 0 0 1 /end COMPU_METHOD
/begin COMPU_METHOD InjMassPT "" RAT_FUNC "%6.3" "mg/hub/s" COEFFS 0 10 0 0 0 1 /end COMPU_METHOD
/begin COMPU_METHOD INJSYS_FUCNSHWPIN_SC_Compu "" TAB_VERB "%6.3" "" COMPU_TAB_REF INJSYS_FUCNSHWPIN_SC_Compu /end COMPU_METHOD
/begin COMPU_VTAB INJSYS_FUCNSHWPIN_SC_Compu "" TAB_VERB 2 0 "False" 1 "True" /end COMPU_VTAB
/begin COMPU_METHOD INJSYS_INJCRVSHOFFTST_SY_Compu "" TAB_VERB "%6.3" "" COMPU_TAB_REF INJSYS_INJCRVSHOFFTST_SY_Compu /end COMPU_METHOD
/begin COMPU_VTAB INJSYS_INJCRVSHOFFTST_SY_Compu "" TAB_VERB 2 1 "TRUE" 0 "FALSE" /end COMPU_VTAB
/begin COMPU_METHOD INJSYS_INJMODCOR_SY_Compu "" TAB_VERB "%6.3" "" COMPU_TAB_REF INJSYS_INJMODCOR_SY_Compu /end COMPU_METHOD
/begin COMPU_VTAB INJSYS_INJMODCOR_SY_Compu "" TAB_VERB 2 0 "False" 1 "True" /end COMPU_VTAB
/begin COMPU_METHOD INJSYS_IVPLAUSCOMPRTST_SY_Compu "" TAB_VERB "%6.3" "" COMPU_TAB_REF INJSYS_IVPLAUSCOMPRTST_SY_Compu /end COMPU_METHOD
/begin COMPU_VTAB INJSYS_IVPLAUSCOMPRTST_SY_Compu "" TAB_VERB 2 0 "FALSE" 1 "TRUE" /end COMPU_VTAB
/begin COMPU_METHOD INJSYS_IVPLAUSCYLFBCTST_SY_Compu "" TAB_VERB "%6.3" "" COMPU_TAB_REF INJSYS_IVPLAUSCYLFBCTST_SY_Compu /end COMPU_METHOD
/begin COMPU_VTAB INJSYS_IVPLAUSCYLFBCTST_SY_Compu "" TAB_VERB 2 0 "FALSE" 1 "TRUE" /end COMPU_VTAB
/begin COMPU_METHOD INJSYS_IVPLAUSRUNUPTST_SY_Compu "" TAB_VERB "%6.3" "" COMPU_TAB_REF INJSYS_IVPLAUSRUNUPTST_SY_Compu /end COMPU_METHOD
/begin COMPU_VTAB INJSYS_IVPLAUSRUNUPTST_SY_Compu "" TAB_VERB 2 1 "TRUE" 0 "FALSE" /end COMPU_VTAB
/begin COMPU_METHOD INJSYS_MEUNACTRTST_SY_Compu "" TAB_VERB "%6.3" "" COMPU_TAB_REF INJSYS_MEUNACTRTST_SY_Compu /end COMPU_METHOD
/begin COMPU_VTAB INJSYS_MEUNACTRTST_SY_Compu "" TAB_VERB 2 0 "FALSE" 1 "TRUE" /end COMPU_VTAB
/begin COMPU_METHOD INJSYS_PCVACTRTST_SY_Compu "" TAB_VERB "%6.3" "" COMPU_TAB_REF INJSYS_PCVACTRTST_SY_Compu /end COMPU_METHOD
/begin COMPU_VTAB INJSYS_PCVACTRTST_SY_Compu "" TAB_VERB 2 1 "TRUE" 0 "FALSE" /end COMPU_VTAB
/begin COMPU_METHOD INJSYS_RAILHIPRESTST_SY_Compu "" TAB_VERB "%6.3" "" COMPU_TAB_REF INJSYS_RAILHIPRESTST_SY_Compu /end COMPU_METHOD
/begin COMPU_VTAB INJSYS_RAILHIPRESTST_SY_Compu "" TAB_VERB 2 0 "FALSE" 1 "TRUE" /end COMPU_VTAB
/begin COMPU_METHOD InjTime_us "" RAT_FUNC "%6.3" "us" COEFFS 0 2.5 0 0 0 1 /end COMPU_METHOD
/begin COMPU_METHOD INJVLVPS_DIASMALLTI_SY_Compu "" TAB_VERB "%6.3" "" COMPU_TAB_REF INJVLVPS_DIASMALLTI_SY_Compu /end COMPU_METHOD
/begin COMPU_VTAB INJVLVPS_DIASMALLTI_SY_Compu "" TAB_VERB 3 0 "NO_DIA_SMALL_TI" 1 "DIA_SMALL_TI" 2 "DIA_SMALL_TI_AND_PIN_POINTING" /end COMPU_VTAB
/begin COMPU_METHOD INJVLV_ATS_SY_Compu "" TAB_VERB "%6.3" "" COMPU_TAB_REF INJVLV_ATS_SY_Compu /end COMPU_METHOD
/begin COMPU_VTAB INJVLV_ATS_SY_Compu "" TAB_VERB 2 0 "False" 1 "True" /end COMPU_VTAB
/begin COMPU_METHOD INJVLV_FSTRCVAFTFCO_SY_Compu "" TAB_VERB "%6.3" "" COMPU_TAB_REF INJVLV_FSTRCVAFTFCO_SY_Compu /end COMPU_METHOD
/begin COMPU_VTAB INJVLV_FSTRCVAFTFCO_SY_Compu "" TAB_VERB 2 0 "OFF" 1 "ON" /end COMPU_VTAB
/begin COMPU_METHOD INJVLV_IVLD_SY_Compu "" TAB_VERB "%6.3" "" COMPU_TAB_REF INJVLV_IVLD_SY_Compu /end COMPU_METHOD
/begin COMPU_VTAB INJVLV_IVLD_SY_Compu "" TAB_VERB 2 0 "FALSE" 1 "TRUE" /end COMPU_VTAB
/begin COMPU_METHOD InrtTrq_COMPU "" RAT_FUNC "%6.5" "kg*s^2" COEFFS 0 1024 0 0 0 1 /end COMPU_METHOD
/begin COMPU_METHOD INTERLOCK_CAN_SY_Compu "" TAB_VERB "%6.3" "" COMPU_TAB_REF INTERLOCK_CAN_SY_Compu /end COMPU_METHOD
/begin COMPU_VTAB INTERLOCK_CAN_SY_Compu "" TAB_VERB 2 0 "False" 1 "True" /end COMPU_VTAB
/begin COMPU_METHOD IUMPR_SY_Compu "" TAB_VERB "%6.3" "" COMPU_TAB_REF IUMPR_SY_Compu /end COMPU_METHOD
/begin COMPU_VTAB IUMPR_SY_Compu "" TAB_VERB 2 1 "IUMPR_ACTIVE" 0 "NO_IUMPR_ACTIVE" /end COMPU_VTAB
/begin COMPU_METHOD IUMPR_VERS_SY_Compu "" TAB_VERB "%6.3" "" COMPU_TAB_REF IUMPR_VERS_SY_Compu /end COMPU_METHOD
/begin COMPU_VTAB IUMPR_VERS_SY_Compu "" TAB_VERB 2 0 "IUMPR_2005" 1 "IUMPR_2007" /end COMPU_VTAB
/begin COMPU_METHOD Kd_1 "" RAT_FUNC "%6.4" "1/1" COEFFS 0 512 0 0 0 1 /end COMPU_METHOD
/begin COMPU_METHOD Kd_Lin_16 "" RAT_FUNC "%7.6" "1/1" COEFFS 0 32767 0 0 0 1 /end COMPU_METHOD
/begin COMPU_METHOD Ki_1 "" RAT_FUNC "%6.4" "1/s" COEFFS 0 67.108864 0 0 0 1 /end COMPU_METHOD
/begin COMPU_METHOD KL87DIAG_SY_Compu "" TAB_VERB "%6.3" "" COMPU_TAB_REF KL87DIAG_SY_Compu /end COMPU_METHOD
/begin COMPU_VTAB KL87DIAG_SY_Compu "" TAB_VERB 2 0 "False" 1 "True" /end COMPU_VTAB
/begin COMPU_METHOD KnSigPrep_SY_Compu "" TAB_VERB "%6.3" "" COMPU_TAB_REF KnSigPrep_SY_Compu /end COMPU_METHOD
/begin COMPU_VTAB KnSigPrep_SY_Compu "" TAB_VERB 2 0 "3. Stufe entfällt" 1 "3. Stufe wird gerechnet" /end COMPU_VTAB
/begin COMPU_METHOD Kp_1 "" RAT_FUNC "%6.4" "1/1" COEFFS 0 64 0 0 0 1 /end COMPU_METHOD
/begin COMPU_METHOD KRREG_SY_Compu "" TAB_VERB "%6.3" "" COMPU_TAB_REF KRREG_SY_Compu /end COMPU_METHOD
/begin COMPU_VTAB KRREG_SY_Compu "" TAB_VERB 2 1 "1" 4 "4" /end COMPU_VTAB
/begin COMPU_METHOD kw_q6 "" RAT_FUNC "%6.2" "Grad KW" COEFFS 0 1 0 0 0 6 /end COMPU_METHOD
/begin COMPU_METHOD L9929_SY_Compu "" TAB_VERB "%6.3" "" COMPU_TAB_REF L9929_SY_Compu /end COMPU_METHOD
/begin COMPU_VTAB L9929_SY_Compu "" TAB_VERB 2 1 "one L9929" 0 "no L9929" /end COMPU_VTAB
/begin COMPU_METHOD lambda "" RAT_FUNC "%6.5" "-" COEFFS 0 1000 0 0 0 1 /end COMPU_METHOD
/begin COMPU_METHOD lambdaRec "" RAT_FUNC "%7.6" "-" COEFFS 0 10000 0 0 0 1 /end COMPU_METHOD
/begin COMPU_METHOD LAMBTS_SY_Compu "" TAB_VERB "%6.3" "" COMPU_TAB_REF LAMBTS_SY_Compu /end COMPU_METHOD
/begin COMPU_VTAB LAMBTS_SY_Compu "" TAB_VERB 8 0 "0" 52 "52" 57 "57" 61 "61" 19 "19" 22 "22" 1 "1" 2 "2" /end COMPU_VTAB
/begin COMPU_METHOD LAMCTLAGSYN_SY_Compu "" TAB_VERB "%6.3" "" COMPU_TAB_REF LAMCTLAGSYN_SY_Compu /end COMPU_METHOD
/begin COMPU_VTAB LAMCTLAGSYN_SY_Compu "" TAB_VERB 2 0 "False" 1 "True" /end COMPU_VTAB
/begin COMPU_METHOD LAMDGNSCMPNPROTNACTV_SC_Compu "" TAB_VERB "%6.3" "" COMPU_TAB_REF LAMDGNSCMPNPROTNACTV_SC_Compu /end COMPU_METHOD
/begin COMPU_VTAB LAMDGNSCMPNPROTNACTV_SC_Compu "" TAB_VERB 2 0 "0" 1 "1" /end COMPU_VTAB
/begin COMPU_METHOD LASP_SY_Compu "" TAB_VERB "%6.3" "" COMPU_TAB_REF LASP_SY_Compu /end COMPU_METHOD
/begin COMPU_VTAB LASP_SY_Compu "" TAB_VERB 2 0 "Lambda-Split no active" 1 "Lambda-Split active" /end COMPU_VTAB
/begin COMPU_METHOD LengthKm1 "" RAT_FUNC "%6.2" "Km" COEFFS 0 1 0 0 0 1 /end COMPU_METHOD
/begin COMPU_METHOD LengthMm "" RAT_FUNC "%6.2" "mm" COEFFS 0 1 0 0 0 1 /end COMPU_METHOD
/begin COMPU_METHOD Length_km "" RAT_FUNC "%6.2" "km" COEFFS 0 1 0 0 0 1 /end COMPU_METHOD
/begin COMPU_METHOD Len_Km_q0p00001_COMPU "" RAT_FUNC "%8.7" "Km" COEFFS 0 100000 0 0 0 1 /end COMPU_METHOD
/begin COMPU_METHOD LIGOV_CHGEAR_SY_Compu "" TAB_VERB "%6.3" "" COMPU_TAB_REF LIGOV_CHGEAR_SY_Compu /end COMPU_METHOD
/begin COMPU_VTAB LIGOV_CHGEAR_SY_Compu "" TAB_VERB 2 0 "False" 1 "True" /end COMPU_VTAB
/begin COMPU_METHOD LIGOV_CHSTRT_SY_Compu "" TAB_VERB "%6.3" "" COMPU_TAB_REF LIGOV_CHSTRT_SY_Compu /end COMPU_METHOD
/begin COMPU_VTAB LIGOV_CHSTRT_SY_Compu "" TAB_VERB 2 0 "LIGOV_CHSTRT_SY" 1 "LIGOV_CHSTRT_SY" /end COMPU_VTAB
/begin COMPU_METHOD LIGOV_HDC_SY_Compu "" TAB_VERB "%6.3" "" COMPU_TAB_REF LIGOV_HDC_SY_Compu /end COMPU_METHOD
/begin COMPU_VTAB LIGOV_HDC_SY_Compu "" TAB_VERB 2 0 "False" 1 "True" /end COMPU_VTAB
/begin COMPU_METHOD LIGOV_INCTRQMAXCH_SY_Compu "" TAB_VERB "%6.3" "" COMPU_TAB_REF LIGOV_INCTRQMAXCH_SY_Compu /end COMPU_METHOD
/begin COMPU_VTAB LIGOV_INCTRQMAXCH_SY_Compu "" TAB_VERB 2 0 "False" 1 "True" /end COMPU_VTAB
/begin COMPU_METHOD LIGOV_NUMIPAR_SY_Compu "" RAT_FUNC "%6.2" "" COEFFS 0 1 0 0 0 1 /end COMPU_METHOD
/begin COMPU_METHOD LIGOV_NUMPPAR_SY_Compu "" RAT_FUNC "%6.2" "" COEFFS 0 1 0 0 0 1 /end COMPU_METHOD
/begin COMPU_METHOD LIGOV_PRECTLD_SY_Compu "" TAB_VERB "%6.3" "" COMPU_TAB_REF LIGOV_PRECTLD_SY_Compu /end COMPU_METHOD
/begin COMPU_VTAB LIGOV_PRECTLD_SY_Compu "" TAB_VERB 2 0 "False" 1 "True" /end COMPU_VTAB
/begin COMPU_METHOD LIGOV_SEPPRECTL_SY_Compu "" TAB_VERB "%6.3" "" COMPU_TAB_REF LIGOV_SEPPRECTL_SY_Compu /end COMPU_METHOD
/begin COMPU_VTAB LIGOV_SEPPRECTL_SY_Compu "" TAB_VERB 2 0 "False" 1 "True" /end COMPU_VTAB
/begin COMPU_METHOD LIMENGTEMP_SY_Compu "" TAB_VERB "%6.3" "" COMPU_TAB_REF LIMENGTEMP_SY_Compu /end COMPU_METHOD
/begin COMPU_VTAB LIMENGTEMP_SY_Compu "" TAB_VERB 2 0 "False" 1 "True" /end COMPU_VTAB
/begin COMPU_METHOD LIMEXHTEMP_SY_Compu "" TAB_VERB "%6.3" "" COMPU_TAB_REF LIMEXHTEMP_SY_Compu /end COMPU_METHOD
/begin COMPU_VTAB LIMEXHTEMP_SY_Compu "" TAB_VERB 2 0 "False" 1 "True" /end COMPU_VTAB
/begin COMPU_METHOD LIN_SY_Compu "" TAB_VERB "%6.3" "" COMPU_TAB_REF LIN_SY_Compu /end COMPU_METHOD
/begin COMPU_VTAB LIN_SY_Compu "" TAB_VERB 2 0 "False" 1 "True" /end COMPU_VTAB
/begin COMPU_METHOD LLIM_SPDLIMEEP_SY_Compu "" TAB_VERB "%6.3" "" COMPU_TAB_REF LLIM_SPDLIMEEP_SY_Compu /end COMPU_METHOD
/begin COMPU_VTAB LLIM_SPDLIMEEP_SY_Compu "" TAB_VERB 2 0 "FALSE" 1 "TRUE" /end COMPU_VTAB
/begin COMPU_METHOD LLIM_SPDLIM_SY_Compu "" TAB_VERB "%6.3" "" COMPU_TAB_REF LLIM_SPDLIM_SY_Compu /end COMPU_METHOD
/begin COMPU_VTAB LLIM_SPDLIM_SY_Compu "" TAB_VERB 2 0 "FALSE" 1 "TRUE" /end COMPU_VTAB
/begin COMPU_METHOD LLKE_SY_Compu "" TAB_VERB "%6.3" "" COMPU_TAB_REF LLKE_SY_Compu /end COMPU_METHOD
/begin COMPU_VTAB LLKE_SY_Compu "" TAB_VERB 2 0 "0" 1 "1" /end COMPU_VTAB
/begin COMPU_METHOD LLRNSNF_FZNSMGASIZE_SY_Compu "" RAT_FUNC "%6.2" "" COEFFS 0 1 0 0 0 1 /end COMPU_METHOD
/begin COMPU_METHOD LORNGTYP_SY_Compu "" TAB_VERB "%6.3" "" COMPU_TAB_REF LORNGTYP_SY_Compu /end COMPU_METHOD
/begin COMPU_VTAB LORNGTYP_SY_Compu "" TAB_VERB 2 0 "False" 1 "True" /end COMPU_VTAB
/begin COMPU_METHOD LORNG_SY_Compu "" TAB_VERB "%6.3" "" COMPU_TAB_REF LORNG_SY_Compu /end COMPU_METHOD
/begin COMPU_VTAB LORNG_SY_Compu "" TAB_VERB 2 1 "TRUE" 0 "FALSE" /end COMPU_VTAB
/begin COMPU_METHOD LOTEMPEGR_SY_Compu "" TAB_VERB "%6.3" "" COMPU_TAB_REF LOTEMPEGR_SY_Compu /end COMPU_METHOD
/begin COMPU_VTAB LOTEMPEGR_SY_Compu "" TAB_VERB 2 0 "0" 1 "1" /end COMPU_VTAB
/begin COMPU_METHOD LRFSSV06_SY_Compu "" TAB_VERB "%6.3" "" COMPU_TAB_REF LRFSSV06_SY_Compu /end COMPU_METHOD
/begin COMPU_VTAB LRFSSV06_SY_Compu "" TAB_VERB 2 0 "LRFSSV06_SY==0" 1 "LRFSSV06_SY==1" /end COMPU_VTAB
/begin COMPU_METHOD LRSSSV06_SY_Compu "" TAB_VERB "%6.3" "" COMPU_TAB_REF LRSSSV06_SY_Compu /end COMPU_METHOD
/begin COMPU_VTAB LRSSSV06_SY_Compu "" TAB_VERB 2 0 "LRSSSV06_SY==0" 1 "LRSSSV06_SY==1" /end COMPU_VTAB
/begin COMPU_METHOD LRTSSV06_SY_Compu "" TAB_VERB "%6.3" "" COMPU_TAB_REF LRTSSV06_SY_Compu /end COMPU_METHOD
/begin COMPU_VTAB LRTSSV06_SY_Compu "" TAB_VERB 2 0 "LRTSSV06_SY==0" 1 "LRTSSV06_SY==1" /end COMPU_VTAB
/begin COMPU_METHOD LSFX4_SY_Compu "" TAB_VERB "%6.3" "" COMPU_TAB_REF LSFX4_SY_Compu /end COMPU_METHOD
/begin COMPU_VTAB LSFX4_SY_Compu "" TAB_VERB 2 0 "False" 1 "True" /end COMPU_VTAB
/begin COMPU_METHOD LSM_SY_Compu "" TAB_VERB "%6.3" "" COMPU_TAB_REF LSM_SY_Compu /end COMPU_METHOD
/begin COMPU_VTAB LSM_SY_Compu "" TAB_VERB 2 1 "1" 0 "0" /end COMPU_VTAB
/begin COMPU_METHOD LSUADV_SY_Compu "" TAB_VERB "%6.3" "" COMPU_TAB_REF LSUADV_SY_Compu /end COMPU_METHOD
/begin COMPU_VTAB LSUADV_SY_Compu "" TAB_VERB 2 0 "False" 1 "True" /end COMPU_VTAB
/begin COMPU_METHOD LSUDYNMONINTR_SY_Compu "" TAB_VERB "%6.3" "" COMPU_TAB_REF LSUDYNMONINTR_SY_Compu /end COMPU_METHOD
/begin COMPU_VTAB LSUDYNMONINTR_SY_Compu "" TAB_VERB 2 0 "False" 1 "True" /end COMPU_VTAB
/begin COMPU_METHOD LSU_CT_SENSORS_SY_Compu "" TAB_VERB "%6.3" "" COMPU_TAB_REF LSU_CT_SENSORS_SY_Compu /end COMPU_METHOD
/begin COMPU_VTAB LSU_CT_SENSORS_SY_Compu "" TAB_VERB 5 2 "2" 3 "3" 1 "1" 4 "4" 0 "0" /end COMPU_VTAB
/begin COMPU_METHOD LVL_SY_Compu "" TAB_VERB "%6.3" "" COMPU_TAB_REF LVL_SY_Compu /end COMPU_METHOD
/begin COMPU_VTAB LVL_SY_Compu "" TAB_VERB 2 0 "0" 1 "1" /end COMPU_VTAB
/begin COMPU_METHOD MAF_SY_Compu "" TAB_VERB "%6.3" "" COMPU_TAB_REF MAF_SY_Compu /end COMPU_METHOD
/begin COMPU_VTAB MAF_SY_Compu "" TAB_VERB 2 0 "False" 1 "True" /end COMPU_VTAB
/begin COMPU_METHOD MAP_SY_Compu "" TAB_VERB "%6.3" "" COMPU_TAB_REF MAP_SY_Compu /end COMPU_METHOD
/begin COMPU_VTAB MAP_SY_Compu "" TAB_VERB 2 0 "FALSE" 1 "TRUE" /end COMPU_VTAB
/begin COMPU_METHOD mAsh_g "" RAT_FUNC "%9.8" "g" COEFFS 0 6553600 0 0 0 1 /end COMPU_METHOD
/begin COMPU_METHOD Mass "" RAT_FUNC "%6.2" "-" COEFFS 0 1 0 0 0 1 /end COMPU_METHOD
/begin COMPU_METHOD MAXRNGREQVEH_SY_Compu "" TAB_VERB "%6.3" "" COMPU_TAB_REF MAXRNGREQVEH_SY_Compu /end COMPU_METHOD
/begin COMPU_VTAB MAXRNGREQVEH_SY_Compu "" TAB_VERB 2 1 "MAXRNGREQVEHON" 0 "MAXRNGREQVEHOFF" /end COMPU_VTAB
/begin COMPU_METHOD MCTPMP_SY_Compu "" TAB_VERB "%6.3" "" COMPU_TAB_REF MCTPMP_SY_Compu /end COMPU_METHOD
/begin COMPU_VTAB MCTPMP_SY_Compu "" TAB_VERB 2 0 "FALSE" 1 "TRUE" /end COMPU_VTAB
/begin COMPU_METHOD m_uw_b102p4 "" RAT_FUNC "%6.4" "kg/h" COEFFS 0 65536 0 0 0 102.4 /end COMPU_METHOD
/begin COMPU_METHOD nmot_ub_q40 "" RAT_FUNC "%6.1" "1/min" COEFFS 0 1 0 0 0 40 /end COMPU_METHOD
/begin COMPU_METHOD nmot_uw_q0p25 "" RAT_FUNC "%6.3" "1/min" COEFFS 0 1 0 0 0 0.25 /end COMPU_METHOD
/begin COMPU_METHOD OneToOne "" RAT_FUNC "%6.2" "-" COEFFS 0 1 0 0 0 1 /end COMPU_METHOD
/begin COMPU_METHOD Prc "" RAT_FUNC "%6.4" "%" COEFFS 0 81.92 0 0 0 1 /end COMPU_METHOD
/begin COMPU_METHOD Pres_LoRes_COMPU "" RAT_FUNC "%6.4" "MPa" COEFFS 0 100 0 0 0 1 /end COMPU_METHOD
/begin COMPU_METHOD Ratio_045_COMPU "" RAT_FUNC "%6.4" "%" COEFFS 0 655.36 0 0 0 1 /end COMPU_METHOD
/begin COMPU_METHOD relDK_q0p02441 "" RAT_FUNC "%6.4" "%DK" COEFFS 0 65536 0 0 0 1600 /end COMPU_METHOD
/begin COMPU_METHOD rel_sw_b100 "" RAT_FUNC "%6.4" "%" COEFFS 0 32768 0 0 0 100 /end COMPU_METHOD
/begin COMPU_METHOD rel_sw_q0p0234 "" RAT_FUNC "%6.4" "%/seg" COEFFS 0 32 0 0 0 0.75 /end COMPU_METHOD
/begin COMPU_METHOD rel_ub_q0p1875 "" RAT_FUNC "%6.3" "KW/ms" COEFFS 0 256 0 0 0 48 /end COMPU_METHOD
/begin COMPU_METHOD spg_q0p1 "" RAT_FUNC "%6.3" "V" COEFFS 0 1 0 0 0 0.1 /end COMPU_METHOD
/begin COMPU_METHOD spg_uw_q0p00488 "" RAT_FUNC "%6.4" "V" COEFFS 0 1024 0 0 0 5 /end COMPU_METHOD
/begin COMPU_METHOD t100msxs_ub_b25p5 "" RAT_FUNC "%6.3" "s" COEFFS 0 1 0 0 0 0.1 /end COMPU_METHOD
/begin COMPU_METHOD t10msxs_uw_b655p35 "" RAT_FUNC "%6.4" "s" COEFFS 0 1 0 0 0 0.01 /end COMPU_METHOD
/begin COMPU_METHOD t1p0usxms "" RAT_FUNC "%6.5" "ms" COEFFS 0 1000 0 0 0 1 /end COMPU_METHOD
/begin COMPU_METHOD Temp_Cels "" RAT_FUNC "%6.1" "deg C" COEFFS 0 10 2731.4 0 0 1 /end COMPU_METHOD
/begin COMPU_METHOD temp_q0p0234 "" RAT_FUNC "%6.4" "K" COEFFS 0 256 0 0 0 6 /end COMPU_METHOD
/begin COMPU_METHOD temp_q0p0234_o273 "" RAT_FUNC "%6.1" "Grad C" COEFFS 0 1 273.15 0 0 0.0234375 /end COMPU_METHOD
/begin COMPU_METHOD temp_q0p0468_K "" RAT_FUNC "%6.4" "Grad K" COEFFS 0 256 0 0 0 12 /end COMPU_METHOD
/begin COMPU_METHOD temp_ub_q0p75_o48 "" RAT_FUNC "%6.2" "Grad C" COEFFS 0 1 48 0 0 0.75 /end COMPU_METHOD
/begin COMPU_METHOD TimeDeb "" RAT_FUNC "%6.1" "ms" COEFFS 0 0.1 0 0 0 1 /end COMPU_METHOD
/begin COMPU_METHOD TimeDelay_s "" RAT_FUNC "%12.4" "s" COEFFS 0 0 1 0 0.00023283064365387 0 /end COMPU_METHOD
/begin COMPU_METHOD TimeRed "" RAT_FUNC "%6.3" "s" COEFFS 0 6.25 0 0 0 1 /end COMPU_METHOD
/begin COMPU_METHOD Time_ms "" RAT_FUNC "%6.1" "ms" COEFFS 0 0.1 0 0 0 1 /end COMPU_METHOD
/begin COMPU_METHOD Time_s "" RAT_FUNC "%6.4" "s" COEFFS 0 100 0 0 0 1 /end COMPU_METHOD
/begin COMPU_METHOD Time_sec_q1_COMPU "" RAT_FUNC "%6.2" "s" COEFFS 0 1 0 0 0 1 /end COMPU_METHOD
/begin COMPU_METHOD Trq "" RAT_FUNC "%6.3" "Nm" COEFFS 0 10 0 0 0 1 /end COMPU_METHOD
/begin COMPU_METHOD t_q0p001 "" RAT_FUNC "%6.5" "s" COEFFS 0 1000 0 0 0 1 /end COMPU_METHOD
/begin COMPU_METHOD t_q0p1 "" RAT_FUNC "%6.3" "s" COEFFS 0 10 0 0 0 1 /end COMPU_METHOD
/begin COMPU_METHOD Vel "" RAT_FUNC "%6.4" "km/h" COEFFS 0 100 0 0 0 1 /end COMPU_METHOD
/begin COMPU_METHOD vfzg_uw_b512 "" RAT_FUNC "%6.4" "km/h" COEFFS 0 65536 0 0 0 512 /end COMPU_METHOD
/begin COMPU_METHOD Volt "" RAT_FUNC "%6.3" "mV" COEFFS 0 5 0 0 0 1 /end COMPU_METHOD
/begin COMPU_METHOD Volt_Batt "" RAT_FUNC "%6.1" "mV" COEFFS 0 0.05 0 0 0 1 /end COMPU_METHOD
/begin COMPU_METHOD zw_ub_q6 "" RAT_FUNC "%6.2" "Grad KW" COEFFS 0 255 0 0 0 1530 /end COMPU_METHOD
/begin COMPU_METHOD default "" RAT_FUNC "%6.2" "" COEFFS 0 1 0 0 0 1 /end COMPU_METHOD
/begin RECORD_LAYOUT KlAxU8SstxS16WS16 NO_AXIS_PTS_X 1 SWORD AXIS_PTS_X 2 SWORD INDEX_INCR DIRECT FNC_VALUES 3 SWORD COLUMN_DIR DIRECT /end RECORD_LAYOUT
/begin RECORD_LAYOUT KlAxU8SstxU16WS16 NO_AXIS_PTS_X 1 UWORD AXIS_PTS_X 2 UWORD INDEX_INCR DIRECT FNC_VALUES 3 SWORD COLUMN_DIR DIRECT /end RECORD_LAYOUT
/begin RECORD_LAYOUT KlAxU8SstxU16WU16 NO_AXIS_PTS_X 1 UWORD AXIS_PTS_X 2 UWORD INDEX_INCR DIRECT FNC_VALUES 3 UWORD COLUMN_DIR DIRECT /end RECORD_LAYOUT
/begin RECORD_LAYOUT KwbWU16 FNC_VALUES 1 UWORD COLUMN_DIR DIRECT /end RECORD_LAYOUT
/begin RECORD_LAYOUT KwbWU8 FNC_VALUES 1 UBYTE COLUMN_DIR DIRECT /end RECORD_LAYOUT
/begin RECORD_LAYOUT KwSb FNC_VALUES 1 SBYTE COLUMN_DIR DIRECT /end RECORD_LAYOUT
/begin RECORD_LAYOUT KwSw FNC_VALUES 1 SWORD COLUMN_DIR DIRECT /end RECORD_LAYOUT
/begin RECORD_LAYOUT KwUb FNC_VALUES 1 UBYTE COLUMN_DIR DIRECT /end RECORD_LAYOUT
/begin RECORD_LAYOUT KwUw FNC_VALUES 1 UWORD COLUMN_DIR DIRECT /end RECORD_LAYOUT
/begin RECORD_LAYOUT KwWS16 FNC_VALUES 1 SWORD COLUMN_DIR DIRECT /end RECORD_LAYOUT
/begin RECORD_LAYOUT KwWU16 FNC_VALUES 1 UWORD COLUMN_DIR DIRECT /end RECORD_LAYOUT
/begin RECORD_LAYOUT KwWU32 FNC_VALUES 1 ULONG COLUMN_DIR DIRECT /end RECORD_LAYOUT
/begin RECORD_LAYOUT KwWU8 FNC_VALUES 1 UBYTE COLUMN_DIR DIRECT /end RECORD_LAYOUT
/begin RECORD_LAYOUT Kw_Ws16 FNC_VALUES 1 SWORD COLUMN_DIR DIRECT /end RECORD_LAYOUT
/begin RECORD_LAYOUT Val_Ws16 FNC_VALUES 1 SWORD COLUMN_DIR DIRECT /end RECORD_LAYOUT
/begin RECORD_LAYOUT Val_Ws32 FNC_VALUES 1 SLONG COLUMN_DIR DIRECT /end RECORD_LAYOUT
/begin RECORD_LAYOUT Val_Wu16 FNC_VALUES 1 UWORD COLUMN_DIR DIRECT /end RECORD_LAYOUT
/begin RECORD_LAYOUT Val_Wu8 FNC_VALUES 1 UBYTE COLUMN_DIR DIRECT /end RECORD_LAYOUT
/end MODULE
/end PROJECT
