ASAP2_VERSION 1 4
/begin PROJECT M17955S3CC411_110Y0320 "M17955S3CC411_110Y0320"
/begin HEADER "" VERSION "M17955S3CC411_110Y0320" PROJECT_NO M17955S3CC411_110Y0320 /end HEADER
/begin MODULE DIM ""
/begin MOD_COMMON "" BYTE_ORDER MSB_LAST ALIGNMENT_BYTE 1 ALIGNMENT_WORD 2 ALIGNMENT_LONG 4 ALIGNMENT_FLOAT32_IEEE 4 /end MOD_COMMON
/begin CHARACTERISTIC DFC_CtlMsk2.DFC_Unused_C "" VALUE 0x80040246 Val_Wu8 255.0 DFES_OneToOne 0.00 255.0 FORMAT "%5.1" READ_ONLY /end CHARACTERISTIC
/begin CHARACTERISTIC DFC_CtlMsk2.DFC_AltMaxPwr_C "" VALUE 0x80040247 Val_Wu8 255.0 DFES_OneToOne 0.00 255.0 FORMAT "%5.1" /end CHARACTERISTIC
/begin CHARACTERISTIC DFC_CtlMsk2.DFC_BrkNpl_C "" VALUE 0x80040248 Val_Wu8 255.0 DFES_OneToOne 0.00 255.0 FORMAT "%5.1" /end CHARACTERISTIC
/begin CHARACTERISTIC DFC_CtlMsk2.DFC_Cj930SSp1Mon_C "" VALUE 0x80040249 Val_Wu8 255.0 DFES_OneToOne 0.00 255.0 FORMAT "%5.1" /end CHARACTERISTIC
/begin CHARACTERISTIC DFC_CtlMsk2.DFC_Cj930SSp2Mon_C "" VALUE 0x8004024A Val_Wu8 255.0 DFES_OneToOne 0.00 255.0 FORMAT "%5.1" /end CHARACTERISTIC
/begin CHARACTERISTIC DFC_CtlMsk2.DFC_Cj930SSp3Mon_C "" VALUE 0x8004024B Val_Wu8 255.0 DFES_OneToOne 0.00 255.0 FORMAT "%5.1" /end CHARACTERISTIC
/begin CHARACTERISTIC DFC_CtlMsk2.DFC_IdleChrgActrAMax_C "" VALUE 0x8004024C Val_Wu8 255.0 DFES_OneToOne 0.00 255.0 FORMAT "%5.1" /end CHARACTERISTIC
/begin CHARACTERISTIC DFC_CtlMsk2.DFC_IdleChrgActrAMin_C "" VALUE 0x8004024D Val_Wu8 255.0 DFES_OneToOne 0.00 255.0 FORMAT "%5.1" /end CHARACTERISTIC
/begin CHARACTERISTIC DFC_CtlMsk2.DFC_IdleChrgActrASig_C "" VALUE 0x8004024E Val_Wu8 255.0 DFES_OneToOne 0.00 255.0 FORMAT "%5.1" /end CHARACTERISTIC
/begin CHARACTERISTIC DFC_CtlMsk2.DFC_IdleChrgActrBMax_C "" VALUE 0x8004024F Val_Wu8 255.0 DFES_OneToOne 0.00 255.0 FORMAT "%5.1" /end CHARACTERISTIC
/begin CHARACTERISTIC DFC_CtlMsk2.DFC_IdleChrgActrBMin_C "" VALUE 0x80040250 Val_Wu8 255.0 DFES_OneToOne 0.00 255.0 FORMAT "%5.1" /end CHARACTERISTIC
/begin CHARACTERISTIC DFC_CtlMsk2.DFC_IdleChrgActrBSig_C "" VALUE 0x80040251 Val_Wu8 255.0 DFES_OneToOne 0.00 255.0 FORMAT "%5.1" /end CHARACTERISTIC
/begin CHARACTERISTIC DFC_CtlMsk2.DFC_IdleChrgActrGovDeCold_C "" VALUE 0x80040252 Val_Wu8 255.0 DFES_OneToOne 0.00 255.0 FORMAT "%5.1" /end CHARACTERISTIC
/begin CHARACTERISTIC DFC_CtlMsk2.DFC_IdleChrgActrGovDeMax_C "" VALUE 0x80040253 Val_Wu8 255.0 DFES_OneToOne 0.00 255.0 FORMAT "%5.1" /end CHARACTERISTIC
/begin CHARACTERISTIC DFC_CtlMsk2.DFC_IdleChrgActrGovDeMin_C "" VALUE 0x80040254 Val_Wu8 255.0 DFES_OneToOne 0.00 255.0 FORMAT "%5.1" /end CHARACTERISTIC
/begin CHARACTERISTIC DFC_CtlMsk2.DFC_IdleChrgActrNAMax_C "" VALUE 0x80040255 Val_Wu8 255.0 DFES_OneToOne 0.00 255.0 FORMAT "%5.1" /end CHARACTERISTIC
/begin CHARACTERISTIC DFC_CtlMsk2.DFC_IdleChrgActrNAMin_C "" VALUE 0x80040256 Val_Wu8 255.0 DFES_OneToOne 0.00 255.0 FORMAT "%5.1" /end CHARACTERISTIC
/begin CHARACTERISTIC DFC_CtlMsk2.DFC_IdleChrgActrNASig_C "" VALUE 0x80040257 Val_Wu8 255.0 DFES_OneToOne 0.00 255.0 FORMAT "%5.1" /end CHARACTERISTIC
/begin CHARACTERISTIC DFC_CtlMsk2.DFC_IdleChrgActrNBMax_C "" VALUE 0x80040258 Val_Wu8 255.0 DFES_OneToOne 0.00 255.0 FORMAT "%5.1" /end CHARACTERISTIC
/begin CHARACTERISTIC DFC_CtlMsk2.DFC_IdleChrgActrNBMin_C "" VALUE 0x80040259 Val_Wu8 255.0 DFES_OneToOne 0.00 255.0 FORMAT "%5.1" /end CHARACTERISTIC
/begin CHARACTERISTIC DFC_CtlMsk2.DFC_IdleChrgActrNBSig_C "" VALUE 0x8004025A Val_Wu8 255.0 DFES_OneToOne 0.00 255.0 FORMAT "%5.1" /end CHARACTERISTIC
/begin CHARACTERISTIC DFC_CtlMsk2.DFC_IdleChrgActrOverTmp_C "" VALUE 0x8004025B Val_Wu8 255.0 DFES_OneToOne 0.00 255.0 FORMAT "%5.1" /end CHARACTERISTIC
/begin CHARACTERISTIC DFC_CtlMsk2.DFC_MonUMaxSupply1_C "" VALUE 0x8004025C Val_Wu8 255.0 DFES_OneToOne 0.00 255.0 FORMAT "%5.1" /end CHARACTERISTIC
/begin CHARACTERISTIC DFC_CtlMsk2.DFC_MonUMinSupply1_C "" VALUE 0x8004025D Val_Wu8 255.0 DFES_OneToOne 0.00 255.0 FORMAT "%5.1" /end CHARACTERISTIC
/begin CHARACTERISTIC DFC_CtlMsk2.DFC_ClthNplClsd_C "" VALUE 0x8004025E Val_Wu8 255.0 DFES_OneToOne 0.00 255.0 FORMAT "%5.1" /end CHARACTERISTIC
/begin CHARACTERISTIC DFC_CtlMsk2.DFC_ClthNplOpn_C "" VALUE 0x8004025F Val_Wu8 255.0 DFES_OneToOne 0.00 255.0 FORMAT "%5.1" /end CHARACTERISTIC
/begin CHARACTERISTIC DFC_CtlMsk2.DFC_IgnClPsDevComErr1_C "" VALUE 0x80040260 Val_Wu8 255.0 DFES_OneToOne 0.00 255.0 FORMAT "%5.1" /end CHARACTERISTIC
/begin CHARACTERISTIC DFC_CtlMsk2.DFC_IgnClPsOpenLoad0_C "" VALUE 0x80040261 Val_Wu8 255.0 DFES_OneToOne 0.00 255.0 FORMAT "%5.1" /end CHARACTERISTIC
/begin CHARACTERISTIC DFC_CtlMsk2.DFC_IgnClPsOpenLoad1_C "" VALUE 0x80040262 Val_Wu8 255.0 DFES_OneToOne 0.00 255.0 FORMAT "%5.1" /end CHARACTERISTIC
/begin CHARACTERISTIC DFC_CtlMsk2.DFC_IgnClPsOpenLoad2_C "" VALUE 0x80040263 Val_Wu8 255.0 DFES_OneToOne 0.00 255.0 FORMAT "%5.1" /end CHARACTERISTIC
/begin CHARACTERISTIC DFC_CtlMsk2.DFC_IgnClPsShCirBatt0_C "" VALUE 0x80040264 Val_Wu8 255.0 DFES_OneToOne 0.00 255.0 FORMAT "%5.1" /end CHARACTERISTIC
/begin CHARACTERISTIC DFC_CtlMsk2.DFC_IgnClPsShCirBatt1_C "" VALUE 0x80040265 Val_Wu8 255.0 DFES_OneToOne 0.00 255.0 FORMAT "%5.1" /end CHARACTERISTIC
/begin CHARACTERISTIC DFC_CtlMsk2.DFC_IgnClPsShCirBatt2_C "" VALUE 0x80040266 Val_Wu8 255.0 DFES_OneToOne 0.00 255.0 FORMAT "%5.1" /end CHARACTERISTIC
/begin CHARACTERISTIC DFC_CtlMsk2.DFC_IgnClPsShCirGnd0_C "" VALUE 0x80040267 Val_Wu8 255.0 DFES_OneToOne 0.00 255.0 FORMAT "%5.1" /end CHARACTERISTIC
/begin CHARACTERISTIC DFC_CtlMsk2.DFC_IgnClPsShCirGnd1_C "" VALUE 0x80040268 Val_Wu8 255.0 DFES_OneToOne 0.00 255.0 FORMAT "%5.1" /end CHARACTERISTIC
/begin CHARACTERISTIC DFC_CtlMsk2.DFC_IgnClPsShCirGnd2_C "" VALUE 0x80040269 Val_Wu8 255.0 DFES_OneToOne 0.00 255.0 FORMAT "%5.1" /end CHARACTERISTIC
/begin CHARACTERISTIC DFC_CtlMsk2.DFC_KnDetSens1PortAMax_C "" VALUE 0x8004026A Val_Wu8 255.0 DFES_OneToOne 0.00 255.0 FORMAT "%5.1" /end CHARACTERISTIC
/begin CHARACTERISTIC DFC_CtlMsk2.DFC_KnDetSens1PortAMin_C "" VALUE 0x8004026B Val_Wu8 255.0 DFES_OneToOne 0.00 255.0 FORMAT "%5.1" /end CHARACTERISTIC
/begin CHARACTERISTIC DFC_CtlMsk2.DFC_KnDetSens1PortBMax_C "" VALUE 0x8004026C Val_Wu8 255.0 DFES_OneToOne 0.00 255.0 FORMAT "%5.1" /end CHARACTERISTIC
/begin CHARACTERISTIC DFC_CtlMsk2.DFC_KnDetSens1PortBMin_C "" VALUE 0x8004026D Val_Wu8 255.0 DFES_OneToOne 0.00 255.0 FORMAT "%5.1" /end CHARACTERISTIC
/begin CHARACTERISTIC DFC_CtlMsk2.DFC_VehVWhlErr_C "" VALUE 0x8004026E Val_Wu8 255.0 DFES_OneToOne 0.00 255.0 FORMAT "%5.1" /end CHARACTERISTIC
/begin CHARACTERISTIC DFC_CtlMsk2.DFC_AirCCmprOL_C "" VALUE 0x8004026F Val_Wu8 255.0 DFES_OneToOne 0.00 255.0 FORMAT "%5.1" /end CHARACTERISTIC
/begin CHARACTERISTIC DFC_CtlMsk2.DFC_AirCCmprOvrTemp_C "" VALUE 0x80040270 Val_Wu8 255.0 DFES_OneToOne 0.00 255.0 FORMAT "%5.1" /end CHARACTERISTIC
/begin CHARACTERISTIC DFC_CtlMsk2.DFC_AirCCmprSCB_C "" VALUE 0x80040271 Val_Wu8 255.0 DFES_OneToOne 0.00 255.0 FORMAT "%5.1" /end CHARACTERISTIC
/begin CHARACTERISTIC DFC_CtlMsk2.DFC_AirCCmprSCG_C "" VALUE 0x80040272 Val_Wu8 255.0 DFES_OneToOne 0.00 255.0 FORMAT "%5.1" /end CHARACTERISTIC
/begin CHARACTERISTIC DFC_CtlMsk2.DFC_AltIOLdSRCMin_C "" VALUE 0x80040273 Val_Wu8 255.0 DFES_OneToOne 0.00 255.0 FORMAT "%5.1" /end CHARACTERISTIC
/begin CHARACTERISTIC DFC_CtlMsk2.DFC_AltIOOL_C "" VALUE 0x80040274 Val_Wu8 255.0 DFES_OneToOne 0.00 255.0 FORMAT "%5.1" /end CHARACTERISTIC
/begin CHARACTERISTIC DFC_CtlMsk2.DFC_AltIOOvrTemp_C "" VALUE 0x80040275 Val_Wu8 255.0 DFES_OneToOne 0.00 255.0 FORMAT "%5.1" /end CHARACTERISTIC
/begin CHARACTERISTIC DFC_CtlMsk2.DFC_AltIOSCB_C "" VALUE 0x80040276 Val_Wu8 255.0 DFES_OneToOne 0.00 255.0 FORMAT "%5.1" /end CHARACTERISTIC
/begin CHARACTERISTIC DFC_CtlMsk2.DFC_AltIOSCG_C "" VALUE 0x80040277 Val_Wu8 255.0 DFES_OneToOne 0.00 255.0 FORMAT "%5.1" /end CHARACTERISTIC
/begin CHARACTERISTIC DFC_CtlMsk2.DFC_DevLibBattUHi_C "" VALUE 0x80040278 Val_Wu8 255.0 DFES_OneToOne 0.00 255.0 FORMAT "%5.1" /end CHARACTERISTIC
/begin CHARACTERISTIC DFC_CtlMsk2.DFC_DevLibBattULo_C "" VALUE 0x80040279 Val_Wu8 255.0 DFES_OneToOne 0.00 255.0 FORMAT "%5.1" /end CHARACTERISTIC
/begin CHARACTERISTIC DFC_CtlMsk2.DFC_FanDIOOL_C "" VALUE 0x8004027A Val_Wu8 255.0 DFES_OneToOne 0.00 255.0 FORMAT "%5.1" /end CHARACTERISTIC
/begin CHARACTERISTIC DFC_CtlMsk2.DFC_FanDIOOvrTemp_C "" VALUE 0x8004027B Val_Wu8 255.0 DFES_OneToOne 0.00 255.0 FORMAT "%5.1" /end CHARACTERISTIC
/begin CHARACTERISTIC DFC_CtlMsk2.DFC_FanDIOSCB_C "" VALUE 0x8004027C Val_Wu8 255.0 DFES_OneToOne 0.00 255.0 FORMAT "%5.1" /end CHARACTERISTIC
/begin CHARACTERISTIC DFC_CtlMsk2.DFC_FanDIOSCG_C "" VALUE 0x8004027D Val_Wu8 255.0 DFES_OneToOne 0.00 255.0 FORMAT "%5.1" /end CHARACTERISTIC
/begin CHARACTERISTIC DFC_CtlMsk2.DFC_FanPWMOL_C "" VALUE 0x8004027E Val_Wu8 255.0 DFES_OneToOne 0.00 255.0 FORMAT "%5.1" /end CHARACTERISTIC
/begin CHARACTERISTIC DFC_CtlMsk2.DFC_FanPWMOvrTemp_C "" VALUE 0x8004027F Val_Wu8 255.0 DFES_OneToOne 0.00 255.0 FORMAT "%5.1" /end CHARACTERISTIC
/begin CHARACTERISTIC DFC_CtlMsk2.DFC_FanPWMSCB_C "" VALUE 0x80040280 Val_Wu8 255.0 DFES_OneToOne 0.00 255.0 FORMAT "%5.1" /end CHARACTERISTIC
/begin CHARACTERISTIC DFC_CtlMsk2.DFC_FanPWMSCG_C "" VALUE 0x80040281 Val_Wu8 255.0 DFES_OneToOne 0.00 255.0 FORMAT "%5.1" /end CHARACTERISTIC
/begin CHARACTERISTIC DFC_CtlMsk2.DFC_AirCClntPAnaSRCMax_C "" VALUE 0x80040282 Val_Wu8 255.0 DFES_OneToOne 0.00 255.0 FORMAT "%5.1" /end CHARACTERISTIC
/begin CHARACTERISTIC DFC_CtlMsk2.DFC_AirCClntPAnaSRCMin_C "" VALUE 0x80040283 Val_Wu8 255.0 DFES_OneToOne 0.00 255.0 FORMAT "%5.1" /end CHARACTERISTIC
/begin CHARACTERISTIC DFC_CtlMsk2.DFC_AirCSwtNpl_C "" VALUE 0x80040284 Val_Wu8 255.0 DFES_OneToOne 0.00 255.0 FORMAT "%5.1" /end CHARACTERISTIC
/begin CHARACTERISTIC DFC_CtlMsk2.DFC_AirCSwtSig_C "" VALUE 0x80040285 Val_Wu8 255.0 DFES_OneToOne 0.00 255.0 FORMAT "%5.1" /end CHARACTERISTIC
/begin CHARACTERISTIC DFC_CtlMsk2.DFC_AltIOLdSRCMax_C "" VALUE 0x80040286 Val_Wu8 255.0 DFES_OneToOne 0.00 255.0 FORMAT "%5.1" /end CHARACTERISTIC
/begin CHARACTERISTIC DFC_CtlMsk2.DFC_BrkSig_C "" VALUE 0x80040287 Val_Wu8 255.0 DFES_OneToOne 0.00 255.0 FORMAT "%5.1" /end CHARACTERISTIC
/begin CHARACTERISTIC DFC_CtlMsk2.DFC_ClthEPBNpl_C "" VALUE 0x80040288 Val_Wu8 255.0 DFES_OneToOne 0.00 255.0 FORMAT "%5.1" /end CHARACTERISTIC
/begin CHARACTERISTIC DFC_CtlMsk2.DFC_ClthEPBSensErr_C "" VALUE 0x80040289 Val_Wu8 255.0 DFES_OneToOne 0.00 255.0 FORMAT "%5.1" /end CHARACTERISTIC
/begin CHARACTERISTIC DFC_CtlMsk2.DFC_ClthErr_C "" VALUE 0x8004028A Val_Wu8 255.0 DFES_OneToOne 0.00 255.0 FORMAT "%5.1" /end CHARACTERISTIC
/begin CHARACTERISTIC DFC_CtlMsk2.DFC_ClthSig_C "" VALUE 0x8004028B Val_Wu8 255.0 DFES_OneToOne 0.00 255.0 FORMAT "%5.1" /end CHARACTERISTIC
/begin CHARACTERISTIC DFC_CtlMsk2.DFC_MILLmpOL_C "" VALUE 0x8004028C Val_Wu8 255.0 DFES_OneToOne 0.00 255.0 FORMAT "%5.1" /end CHARACTERISTIC
/begin CHARACTERISTIC DFC_CtlMsk2.DFC_MILLmpSCB_C "" VALUE 0x8004028D Val_Wu8 255.0 DFES_OneToOne 0.00 255.0 FORMAT "%5.1" /end CHARACTERISTIC
/begin CHARACTERISTIC DFC_CtlMsk2.DFC_MILLmpSCG_C "" VALUE 0x8004028E Val_Wu8 255.0 DFES_OneToOne 0.00 255.0 FORMAT "%5.1" /end CHARACTERISTIC
/begin CHARACTERISTIC DFC_CtlMsk2.DFC_SRCHighAPP1_C "" VALUE 0x8004028F Val_Wu8 255.0 DFES_OneToOne 0.00 255.0 FORMAT "%5.1" /end CHARACTERISTIC
/begin CHARACTERISTIC DFC_CtlMsk2.DFC_SRCHighAPP2_C "" VALUE 0x80040290 Val_Wu8 255.0 DFES_OneToOne 0.00 255.0 FORMAT "%5.1" /end CHARACTERISTIC
/begin CHARACTERISTIC DFC_CtlMsk2.DFC_SRCLowAPP1_C "" VALUE 0x80040291 Val_Wu8 255.0 DFES_OneToOne 0.00 255.0 FORMAT "%5.1" /end CHARACTERISTIC
/begin CHARACTERISTIC DFC_CtlMsk2.DFC_SRCLowAPP2_C "" VALUE 0x80040292 Val_Wu8 255.0 DFES_OneToOne 0.00 255.0 FORMAT "%5.1" /end CHARACTERISTIC
/begin CHARACTERISTIC DFC_CtlMsk2.DFC_SyncAPP_C "" VALUE 0x80040293 Val_Wu8 255.0 DFES_OneToOne 0.00 255.0 FORMAT "%5.1" /end CHARACTERISTIC
/begin CHARACTERISTIC DFC_CtlMsk2.DFC_VehVMax_C "" VALUE 0x80040294 Val_Wu8 255.0 DFES_OneToOne 0.00 255.0 FORMAT "%5.1" /end CHARACTERISTIC
/begin CHARACTERISTIC DFC_CtlMsk2.DFC_VehVPlaus_C "" VALUE 0x80040295 Val_Wu8 255.0 DFES_OneToOne 0.00 255.0 FORMAT "%5.1" /end CHARACTERISTIC
/begin CHARACTERISTIC DFC_CtlMsk2.DFC_VehVSig_C "" VALUE 0x80040296 Val_Wu8 255.0 DFES_OneToOne 0.00 255.0 FORMAT "%5.1" /end CHARACTERISTIC
/begin CHARACTERISTIC DFC_CtlMsk2.DFC_BusDiagBusOffNodeA_C "" VALUE 0x80040297 Val_Wu8 255.0 DFES_OneToOne 0.00 255.0 FORMAT "%5.1" /end CHARACTERISTIC
/begin CHARACTERISTIC DFC_CtlMsk2.DFC_ComACSensTO_C "" VALUE 0x80040298 Val_Wu8 255.0 DFES_OneToOne 0.00 255.0 FORMAT "%5.1" /end CHARACTERISTIC
/begin CHARACTERISTIC DFC_CtlMsk2.DFC_ComAWD1TO_C "" VALUE 0x80040299 Val_Wu8 255.0 DFES_OneToOne 0.00 255.0 FORMAT "%5.1" /end CHARACTERISTIC
/begin CHARACTERISTIC DFC_CtlMsk2.DFC_ComBRK10TO_C "" VALUE 0x8004029A Val_Wu8 255.0 DFES_OneToOne 0.00 255.0 FORMAT "%5.1" /end CHARACTERISTIC
/begin CHARACTERISTIC DFC_CtlMsk2.DFC_ComGW11TO_C "" VALUE 0x8004029B Val_Wu8 255.0 DFES_OneToOne 0.00 255.0 FORMAT "%5.1" /end CHARACTERISTIC
/begin CHARACTERISTIC DFC_CtlMsk2.DFC_ComLVL1TO_C "" VALUE 0x8004029C Val_Wu8 255.0 DFES_OneToOne 0.00 255.0 FORMAT "%5.1" /end CHARACTERISTIC
/begin CHARACTERISTIC DFC_CtlMsk2.DFC_ComPRKA01TO_C "" VALUE 0x8004029D Val_Wu8 255.0 DFES_OneToOne 0.00 255.0 FORMAT "%5.1" /end CHARACTERISTIC
/begin CHARACTERISTIC DFC_CtlMsk2.DFC_ComPRKH01TO_C "" VALUE 0x8004029E Val_Wu8 255.0 DFES_OneToOne 0.00 255.0 FORMAT "%5.1" /end CHARACTERISTIC
/begin CHARACTERISTIC DFC_CtlMsk2.DFC_ComPRKH1TO_C "" VALUE 0x8004029F Val_Wu8 255.0 DFES_OneToOne 0.00 255.0 FORMAT "%5.1" /end CHARACTERISTIC
/begin CHARACTERISTIC DFC_CtlMsk2.DFC_ComTRBCH1TO_C "" VALUE 0x800402A0 Val_Wu8 255.0 DFES_OneToOne 0.00 255.0 FORMAT "%5.1" /end CHARACTERISTIC
/begin CHARACTERISTIC DFC_CtlMsk2.DFC_ComTRBCH2TO_C "" VALUE 0x800402A1 Val_Wu8 255.0 DFES_OneToOne 0.00 255.0 FORMAT "%5.1" /end CHARACTERISTIC
/begin CHARACTERISTIC DFC_CtlMsk2.DFC_DK_C "" VALUE 0x800402A2 Val_Wu8 255.0 DFES_OneToOne 0.00 255.0 FORMAT "%5.1" /end CHARACTERISTIC
/begin CHARACTERISTIC DFC_CtlMsk2.DFC_DKRSA_C "" VALUE 0x800402A3 Val_Wu8 255.0 DFES_OneToOne 0.00 255.0 FORMAT "%5.1" /end CHARACTERISTIC
/begin CHARACTERISTIC DFC_CtlMsk2.DFC_DKVSmax_C "" VALUE 0x800402A4 Val_Wu8 255.0 DFES_OneToOne 0.00 255.0 FORMAT "%5.1" /end CHARACTERISTIC
/begin CHARACTERISTIC DFC_CtlMsk2.DFC_DKmax_C "" VALUE 0x800402A5 Val_Wu8 255.0 DFES_OneToOne 0.00 255.0 FORMAT "%5.1" /end CHARACTERISTIC
/begin CHARACTERISTIC DFC_CtlMsk2.DFC_DKmin_C "" VALUE 0x800402A6 Val_Wu8 255.0 DFES_OneToOne 0.00 255.0 FORMAT "%5.1" /end CHARACTERISTIC
/begin CHARACTERISTIC DFC_CtlMsk2.DFC_DSSmax_C "" VALUE 0x800402A7 Val_Wu8 255.0 DFES_OneToOne 0.00 255.0 FORMAT "%5.1" /end CHARACTERISTIC
/begin CHARACTERISTIC DFC_CtlMsk2.DFC_EEPEraseErr_C "" VALUE 0x800402A8 Val_Wu8 255.0 DFES_OneToOne 0.00 255.0 FORMAT "%5.1" /end CHARACTERISTIC
/begin CHARACTERISTIC DFC_CtlMsk2.DFC_EEPRdErr_C "" VALUE 0x800402A9 Val_Wu8 255.0 DFES_OneToOne 0.00 255.0 FORMAT "%5.1" /end CHARACTERISTIC
/begin CHARACTERISTIC DFC_CtlMsk2.DFC_EEPWrErr_C "" VALUE 0x800402AA Val_Wu8 255.0 DFES_OneToOne 0.00 255.0 FORMAT "%5.1" /end CHARACTERISTIC
/begin CHARACTERISTIC DFC_CtlMsk2.DFC_EV1max_C "" VALUE 0x800402AB Val_Wu8 255.0 DFES_OneToOne 0.00 255.0 FORMAT "%5.1" /end CHARACTERISTIC
/begin CHARACTERISTIC DFC_CtlMsk2.DFC_EV1min_C "" VALUE 0x800402AC Val_Wu8 255.0 DFES_OneToOne 0.00 255.0 FORMAT "%5.1" /end CHARACTERISTIC
/begin CHARACTERISTIC DFC_CtlMsk2.DFC_EV1sig_C "" VALUE 0x800402AD Val_Wu8 255.0 DFES_OneToOne 0.00 255.0 FORMAT "%5.1" /end CHARACTERISTIC
/begin CHARACTERISTIC DFC_CtlMsk2.DFC_EV2max_C "" VALUE 0x800402AE Val_Wu8 255.0 DFES_OneToOne 0.00 255.0 FORMAT "%5.1" /end CHARACTERISTIC
/begin CHARACTERISTIC DFC_CtlMsk2.DFC_EV2min_C "" VALUE 0x800402AF Val_Wu8 255.0 DFES_OneToOne 0.00 255.0 FORMAT "%5.1" /end CHARACTERISTIC
/begin CHARACTERISTIC DFC_CtlMsk2.DFC_EV2sig_C "" VALUE 0x800402B0 Val_Wu8 255.0 DFES_OneToOne 0.00 255.0 FORMAT "%5.1" /end CHARACTERISTIC
/begin CHARACTERISTIC DFC_CtlMsk2.DFC_EV3max_C "" VALUE 0x800402B1 Val_Wu8 255.0 DFES_OneToOne 0.00 255.0 FORMAT "%5.1" /end CHARACTERISTIC
/begin CHARACTERISTIC DFC_CtlMsk2.DFC_EV3min_C "" VALUE 0x800402B2 Val_Wu8 255.0 DFES_OneToOne 0.00 255.0 FORMAT "%5.1" /end CHARACTERISTIC
/begin CHARACTERISTIC DFC_CtlMsk2.DFC_EV3sig_C "" VALUE 0x800402B3 Val_Wu8 255.0 DFES_OneToOne 0.00 255.0 FORMAT "%5.1" /end CHARACTERISTIC
/begin CHARACTERISTIC DFC_CtlMsk2.DFC_EpmCaSI1ErrSig_C "" VALUE 0x800402B4 Val_Wu8 255.0 DFES_OneToOne 0.00 255.0 FORMAT "%5.1" /end CHARACTERISTIC
/begin CHARACTERISTIC DFC_CtlMsk2.DFC_EpmCaSI1NoSig_C "" VALUE 0x800402B5 Val_Wu8 255.0 DFES_OneToOne 0.00 255.0 FORMAT "%5.1" /end CHARACTERISTIC
/begin CHARACTERISTIC DFC_CtlMsk2.DFC_EpmCaSI1NoSigMax_C "" VALUE 0x800402B6 Val_Wu8 255.0 DFES_OneToOne 0.00 255.0 FORMAT "%5.1" /end CHARACTERISTIC
/begin CHARACTERISTIC DFC_CtlMsk2.DFC_EpmCaSI1NoSigMin_C "" VALUE 0x800402B7 Val_Wu8 255.0 DFES_OneToOne 0.00 255.0 FORMAT "%5.1" /end CHARACTERISTIC
/begin CHARACTERISTIC DFC_CtlMsk2.DFC_EpmCaSI1OfsErr_C "" VALUE 0x800402B8 Val_Wu8 255.0 DFES_OneToOne 0.00 255.0 FORMAT "%5.1" /end CHARACTERISTIC
/begin CHARACTERISTIC DFC_CtlMsk2.DFC_EpmCrSErrSig_C "" VALUE 0x800402B9 Val_Wu8 255.0 DFES_OneToOne 0.00 255.0 FORMAT "%5.1" /end CHARACTERISTIC
/begin CHARACTERISTIC DFC_CtlMsk2.DFC_EpmCrSNoSig_C "" VALUE 0x800402BA Val_Wu8 255.0 DFES_OneToOne 0.00 255.0 FORMAT "%5.1" /end CHARACTERISTIC
/begin CHARACTERISTIC DFC_CtlMsk2.DFC_FRAmax_C "" VALUE 0x800402BB Val_Wu8 255.0 DFES_OneToOne 0.00 255.0 FORMAT "%5.1" /end CHARACTERISTIC
/begin CHARACTERISTIC DFC_CtlMsk2.DFC_FRAmin_C "" VALUE 0x800402BC Val_Wu8 255.0 DFES_OneToOne 0.00 255.0 FORMAT "%5.1" /end CHARACTERISTIC
/begin CHARACTERISTIC DFC_CtlMsk2.DFC_HEGOS1B1ElecMax_C "" VALUE 0x800402BD Val_Wu8 255.0 DFES_OneToOne 0.00 255.0 FORMAT "%5.1" /end CHARACTERISTIC
/begin CHARACTERISTIC DFC_CtlMsk2.DFC_HEGOS1B1ElecMin_C "" VALUE 0x800402BE Val_Wu8 255.0 DFES_OneToOne 0.00 255.0 FORMAT "%5.1" /end CHARACTERISTIC
/begin CHARACTERISTIC DFC_CtlMsk2.DFC_HEGOS1B1ElecNpl_C "" VALUE 0x800402BF Val_Wu8 255.0 DFES_OneToOne 0.00 255.0 FORMAT "%5.1" /end CHARACTERISTIC
/begin CHARACTERISTIC DFC_CtlMsk2.DFC_HEGOS1B1ElecSig_C "" VALUE 0x800402C0 Val_Wu8 255.0 DFES_OneToOne 0.00 255.0 FORMAT "%5.1" /end CHARACTERISTIC
/begin CHARACTERISTIC DFC_CtlMsk2.DFC_HEGOS1B1HtgNpl_C "" VALUE 0x800402C1 Val_Wu8 255.0 DFES_OneToOne 0.00 255.0 FORMAT "%5.1" /end CHARACTERISTIC
/begin CHARACTERISTIC DFC_CtlMsk2.DFC_HEGOS1B1HtrPsMax_C "" VALUE 0x800402C2 Val_Wu8 255.0 DFES_OneToOne 0.00 255.0 FORMAT "%5.1" /end CHARACTERISTIC
/begin CHARACTERISTIC DFC_CtlMsk2.DFC_HEGOS1B1HtrPsMin_C "" VALUE 0x800402C3 Val_Wu8 255.0 DFES_OneToOne 0.00 255.0 FORMAT "%5.1" /end CHARACTERISTIC
/begin CHARACTERISTIC DFC_CtlMsk2.DFC_HEGOS1B1HtrPsSig_C "" VALUE 0x800402C4 Val_Wu8 255.0 DFES_OneToOne 0.00 255.0 FORMAT "%5.1" /end CHARACTERISTIC
/begin CHARACTERISTIC DFC_CtlMsk2.DFC_HEGOS1B1StkMax_C "" VALUE 0x800402C5 Val_Wu8 255.0 DFES_OneToOne 0.00 255.0 FORMAT "%5.1" /end CHARACTERISTIC
/begin CHARACTERISTIC DFC_CtlMsk2.DFC_HEGOS1B1StkMin_C "" VALUE 0x800402C6 Val_Wu8 255.0 DFES_OneToOne 0.00 255.0 FORMAT "%5.1" /end CHARACTERISTIC
/begin CHARACTERISTIC DFC_CtlMsk2.DFC_HEGOS2B1RstrcnLean_C "" VALUE 0x800402C7 Val_Wu8 255.0 DFES_OneToOne 0.00 255.0 FORMAT "%5.1" /end CHARACTERISTIC
/begin CHARACTERISTIC DFC_CtlMsk2.DFC_HEGOS2B1RstrcnRich_C "" VALUE 0x800402C8 Val_Wu8 255.0 DFES_OneToOne 0.00 255.0 FORMAT "%5.1" /end CHARACTERISTIC
/begin CHARACTERISTIC DFC_CtlMsk2.DFC_IdleChrgActrJamVlvClsd_C "" VALUE 0x800402C9 Val_Wu8 255.0 DFES_OneToOne 0.00 255.0 FORMAT "%5.1" /end CHARACTERISTIC
/begin CHARACTERISTIC DFC_CtlMsk2.DFC_IdleChrgActrJamVlvOpn_C "" VALUE 0x800402CA Val_Wu8 255.0 DFES_OneToOne 0.00 255.0 FORMAT "%5.1" /end CHARACTERISTIC
/begin CHARACTERISTIC DFC_CtlMsk2.DFC_IgnClPsDevOscErr1_C "" VALUE 0x800402CB Val_Wu8 255.0 DFES_OneToOne 0.00 255.0 FORMAT "%5.1" /end CHARACTERISTIC
/begin CHARACTERISTIC DFC_CtlMsk2.DFC_KPEmax_C "" VALUE 0x800402CC Val_Wu8 255.0 DFES_OneToOne 0.00 255.0 FORMAT "%5.1" /end CHARACTERISTIC
/begin CHARACTERISTIC DFC_CtlMsk2.DFC_KPEmin_C "" VALUE 0x800402CD Val_Wu8 255.0 DFES_OneToOne 0.00 255.0 FORMAT "%5.1" /end CHARACTERISTIC
/begin CHARACTERISTIC DFC_CtlMsk2.DFC_KPEsig_C "" VALUE 0x800402CE Val_Wu8 255.0 DFES_OneToOne 0.00 255.0 FORMAT "%5.1" /end CHARACTERISTIC
/begin CHARACTERISTIC DFC_CtlMsk2.DFC_KS1max_C "" VALUE 0x800402CF Val_Wu8 255.0 DFES_OneToOne 0.00 255.0 FORMAT "%5.1" /end CHARACTERISTIC
/begin CHARACTERISTIC DFC_CtlMsk2.DFC_KS1min_C "" VALUE 0x800402D0 Val_Wu8 255.0 DFES_OneToOne 0.00 255.0 FORMAT "%5.1" /end CHARACTERISTIC
/begin CHARACTERISTIC DFC_CtlMsk2.DFC_LLRKHmax_C "" VALUE 0x800402D1 Val_Wu8 255.0 DFES_OneToOne 0.00 255.0 FORMAT "%5.1" /end CHARACTERISTIC
/begin CHARACTERISTIC DFC_CtlMsk2.DFC_LLRKHmin_C "" VALUE 0x800402D2 Val_Wu8 255.0 DFES_OneToOne 0.00 255.0 FORMAT "%5.1" /end CHARACTERISTIC
/begin CHARACTERISTIC DFC_CtlMsk2.DFC_LLRKHnpl_C "" VALUE 0x800402D3 Val_Wu8 255.0 DFES_OneToOne 0.00 255.0 FORMAT "%5.1" /end CHARACTERISTIC
/begin CHARACTERISTIC DFC_CtlMsk2.DFC_LLRmax_C "" VALUE 0x800402D4 Val_Wu8 255.0 DFES_OneToOne 0.00 255.0 FORMAT "%5.1" /end CHARACTERISTIC
/begin CHARACTERISTIC DFC_CtlMsk2.DFC_LLRmin_C "" VALUE 0x800402D5 Val_Wu8 255.0 DFES_OneToOne 0.00 255.0 FORMAT "%5.1" /end CHARACTERISTIC
/begin CHARACTERISTIC DFC_CtlMsk2.DFC_LLRnpl_C "" VALUE 0x800402D6 Val_Wu8 255.0 DFES_OneToOne 0.00 255.0 FORMAT "%5.1" /end CHARACTERISTIC
/begin CHARACTERISTIC DFC_CtlMsk2.DFC_LMmax_C "" VALUE 0x800402D7 Val_Wu8 255.0 DFES_OneToOne 0.00 255.0 FORMAT "%5.1" /end CHARACTERISTIC
/begin CHARACTERISTIC DFC_CtlMsk2.DFC_LZSRnpl_C "" VALUE 0x800402D8 Val_Wu8 255.0 DFES_OneToOne 0.00 255.0 FORMAT "%5.1" /end CHARACTERISTIC
/begin CHARACTERISTIC DFC_CtlMsk2.DFC_MD_C "" VALUE 0x800402D9 Val_Wu8 255.0 DFES_OneToOne 0.00 255.0 FORMAT "%5.1" /end CHARACTERISTIC
/begin CHARACTERISTIC DFC_CtlMsk2.DFC_MD00min_C "" VALUE 0x800402DA Val_Wu8 255.0 DFES_OneToOne 0.00 255.0 FORMAT "%5.1" /end CHARACTERISTIC
/begin CHARACTERISTIC DFC_CtlMsk2.DFC_MD00npl_C "" VALUE 0x800402DB Val_Wu8 255.0 DFES_OneToOne 0.00 255.0 FORMAT "%5.1" /end CHARACTERISTIC
/begin CHARACTERISTIC DFC_CtlMsk2.DFC_MD01min_C "" VALUE 0x800402DC Val_Wu8 255.0 DFES_OneToOne 0.00 255.0 FORMAT "%5.1" /end CHARACTERISTIC
/begin CHARACTERISTIC DFC_CtlMsk2.DFC_MD01npl_C "" VALUE 0x800402DD Val_Wu8 255.0 DFES_OneToOne 0.00 255.0 FORMAT "%5.1" /end CHARACTERISTIC
/begin CHARACTERISTIC DFC_CtlMsk2.DFC_MD02min_C "" VALUE 0x800402DE Val_Wu8 255.0 DFES_OneToOne 0.00 255.0 FORMAT "%5.1" /end CHARACTERISTIC
/begin CHARACTERISTIC DFC_CtlMsk2.DFC_MD02npl_C "" VALUE 0x800402DF Val_Wu8 255.0 DFES_OneToOne 0.00 255.0 FORMAT "%5.1" /end CHARACTERISTIC
/begin CHARACTERISTIC DFC_CtlMsk2.DFC_MD03min_C "" VALUE 0x800402E0 Val_Wu8 255.0 DFES_OneToOne 0.00 255.0 FORMAT "%5.1" /end CHARACTERISTIC
/begin CHARACTERISTIC DFC_CtlMsk2.DFC_MD03npl_C "" VALUE 0x800402E1 Val_Wu8 255.0 DFES_OneToOne 0.00 255.0 FORMAT "%5.1" /end CHARACTERISTIC
/begin CHARACTERISTIC DFC_CtlMsk2.DFC_MD04min_C "" VALUE 0x800402E2 Val_Wu8 255.0 DFES_OneToOne 0.00 255.0 FORMAT "%5.1" /end CHARACTERISTIC
/begin CHARACTERISTIC DFC_CtlMsk2.DFC_MD04npl_C "" VALUE 0x800402E3 Val_Wu8 255.0 DFES_OneToOne 0.00 255.0 FORMAT "%5.1" /end CHARACTERISTIC
/begin CHARACTERISTIC DFC_CtlMsk2.DFC_MDCyl_0_C "" VALUE 0x800402E4 Val_Wu8 255.0 DFES_OneToOne 0.00 255.0 FORMAT "%5.1" /end CHARACTERISTIC
/begin CHARACTERISTIC DFC_CtlMsk2.DFC_MDCyl_1_C "" VALUE 0x800402E5 Val_Wu8 255.0 DFES_OneToOne 0.00 255.0 FORMAT "%5.1" /end CHARACTERISTIC
/begin CHARACTERISTIC DFC_CtlMsk2.DFC_MDCyl_2_C "" VALUE 0x800402E6 Val_Wu8 255.0 DFES_OneToOne 0.00 255.0 FORMAT "%5.1" /end CHARACTERISTIC
/begin CHARACTERISTIC DFC_CtlMsk2.DFC_MDFC_C "" VALUE 0x800402E7 Val_Wu8 255.0 DFES_OneToOne 0.00 255.0 FORMAT "%5.1" /end CHARACTERISTIC
/begin CHARACTERISTIC DFC_CtlMsk2.DFC_MDmin_C "" VALUE 0x800402E8 Val_Wu8 255.0 DFES_OneToOne 0.00 255.0 FORMAT "%5.1" /end CHARACTERISTIC
/begin CHARACTERISTIC DFC_CtlMsk2.DFC_MDnpl_C "" VALUE 0x800402E9 Val_Wu8 255.0 DFES_OneToOne 0.00 255.0 FORMAT "%5.1" /end CHARACTERISTIC
/begin CHARACTERISTIC DFC_CtlMsk2.DFC_MoCADCNTP_C "" VALUE 0x800402EA Val_Wu8 255.0 DFES_OneToOne 0.00 255.0 FORMAT "%5.1" /end CHARACTERISTIC
/begin CHARACTERISTIC DFC_CtlMsk2.DFC_MoCADCTst_C "" VALUE 0x800402EB Val_Wu8 255.0 DFES_OneToOne 0.00 255.0 FORMAT "%5.1" /end CHARACTERISTIC
/begin CHARACTERISTIC DFC_CtlMsk2.DFC_MoCComctErrMM_C "" VALUE 0x800402EC Val_Wu8 255.0 DFES_OneToOne 0.00 255.0 FORMAT "%5.1" /end CHARACTERISTIC
/begin CHARACTERISTIC DFC_CtlMsk2.DFC_OCWDAActv_C "" VALUE 0x800402ED Val_Wu8 255.0 DFES_OneToOne 0.00 255.0 FORMAT "%5.1" /end CHARACTERISTIC
/begin CHARACTERISTIC DFC_CtlMsk2.DFC_OCWDACom_C "" VALUE 0x800402EE Val_Wu8 255.0 DFES_OneToOne 0.00 255.0 FORMAT "%5.1" /end CHARACTERISTIC
/begin CHARACTERISTIC DFC_CtlMsk2.DFC_ORAmax_C "" VALUE 0x800402EF Val_Wu8 255.0 DFES_OneToOne 0.00 255.0 FORMAT "%5.1" /end CHARACTERISTIC
/begin CHARACTERISTIC DFC_CtlMsk2.DFC_ORAmin_C "" VALUE 0x800402F0 Val_Wu8 255.0 DFES_OneToOne 0.00 255.0 FORMAT "%5.1" /end CHARACTERISTIC
/begin CHARACTERISTIC DFC_CtlMsk2.DFC_PSR1max_C "" VALUE 0x800402F1 Val_Wu8 255.0 DFES_OneToOne 0.00 255.0 FORMAT "%5.1" /end CHARACTERISTIC
/begin CHARACTERISTIC DFC_CtlMsk2.DFC_PSRBmax_C "" VALUE 0x800402F2 Val_Wu8 255.0 DFES_OneToOne 0.00 255.0 FORMAT "%5.1" /end CHARACTERISTIC
/begin CHARACTERISTIC DFC_CtlMsk2.DFC_PSRBmin_C "" VALUE 0x800402F3 Val_Wu8 255.0 DFES_OneToOne 0.00 255.0 FORMAT "%5.1" /end CHARACTERISTIC
/begin CHARACTERISTIC DFC_CtlMsk2.DFC_PSREmax_C "" VALUE 0x800402F4 Val_Wu8 255.0 DFES_OneToOne 0.00 255.0 FORMAT "%5.1" /end CHARACTERISTIC
/begin CHARACTERISTIC DFC_CtlMsk2.DFC_PSREmin_C "" VALUE 0x800402F5 Val_Wu8 255.0 DFES_OneToOne 0.00 255.0 FORMAT "%5.1" /end CHARACTERISTIC
/begin CHARACTERISTIC DFC_CtlMsk2.DFC_PSRPmax_C "" VALUE 0x800402F6 Val_Wu8 255.0 DFES_OneToOne 0.00 255.0 FORMAT "%5.1" /end CHARACTERISTIC
/begin CHARACTERISTIC DFC_CtlMsk2.DFC_PSRPmin_C "" VALUE 0x800402F7 Val_Wu8 255.0 DFES_OneToOne 0.00 255.0 FORMAT "%5.1" /end CHARACTERISTIC
/begin CHARACTERISTIC DFC_CtlMsk2.DFC_PSRPsig_C "" VALUE 0x800402F8 Val_Wu8 255.0 DFES_OneToOne 0.00 255.0 FORMAT "%5.1" /end CHARACTERISTIC
/begin CHARACTERISTIC DFC_CtlMsk2.DFC_PSRmax_C "" VALUE 0x800402F9 Val_Wu8 255.0 DFES_OneToOne 0.00 255.0 FORMAT "%5.1" /end CHARACTERISTIC
/begin CHARACTERISTIC DFC_CtlMsk2.DFC_SSpMon1_C "" VALUE 0x800402FA Val_Wu8 255.0 DFES_OneToOne 0.00 255.0 FORMAT "%5.1" /end CHARACTERISTIC
/begin CHARACTERISTIC DFC_CtlMsk2.DFC_SSpMon2_C "" VALUE 0x800402FB Val_Wu8 255.0 DFES_OneToOne 0.00 255.0 FORMAT "%5.1" /end CHARACTERISTIC
/begin CHARACTERISTIC DFC_CtlMsk2.DFC_SSpMon3_C "" VALUE 0x800402FC Val_Wu8 255.0 DFES_OneToOne 0.00 255.0 FORMAT "%5.1" /end CHARACTERISTIC
/begin CHARACTERISTIC DFC_CtlMsk2.DFC_SWReset_0_C "" VALUE 0x800402FD Val_Wu8 255.0 DFES_OneToOne 0.00 255.0 FORMAT "%5.1" /end CHARACTERISTIC
/begin CHARACTERISTIC DFC_CtlMsk2.DFC_SWReset_1_C "" VALUE 0x800402FE Val_Wu8 255.0 DFES_OneToOne 0.00 255.0 FORMAT "%5.1" /end CHARACTERISTIC
/begin CHARACTERISTIC DFC_CtlMsk2.DFC_SWReset_2_C "" VALUE 0x800402FF Val_Wu8 255.0 DFES_OneToOne 0.00 255.0 FORMAT "%5.1" /end CHARACTERISTIC
/begin CHARACTERISTIC DFC_CtlMsk2.DFC_TASREmax_C "" VALUE 0x80040300 Val_Wu8 255.0 DFES_OneToOne 0.00 255.0 FORMAT "%5.1" /end CHARACTERISTIC
/begin CHARACTERISTIC DFC_CtlMsk2.DFC_TASREmin_C "" VALUE 0x80040301 Val_Wu8 255.0 DFES_OneToOne 0.00 255.0 FORMAT "%5.1" /end CHARACTERISTIC
/begin CHARACTERISTIC DFC_CtlMsk2.DFC_TASREnpl_C "" VALUE 0x80040302 Val_Wu8 255.0 DFES_OneToOne 0.00 255.0 FORMAT "%5.1" /end CHARACTERISTIC
/begin CHARACTERISTIC DFC_CtlMsk2.DFC_TASRmax_C "" VALUE 0x80040303 Val_Wu8 255.0 DFES_OneToOne 0.00 255.0 FORMAT "%5.1" /end CHARACTERISTIC
/begin CHARACTERISTIC DFC_CtlMsk2.DFC_TAmax_C "" VALUE 0x80040304 Val_Wu8 255.0 DFES_OneToOne 0.00 255.0 FORMAT "%5.1" /end CHARACTERISTIC
/begin CHARACTERISTIC DFC_CtlMsk2.DFC_TEVEmax_C "" VALUE 0x80040305 Val_Wu8 255.0 DFES_OneToOne 0.00 255.0 FORMAT "%5.1" /end CHARACTERISTIC
/begin CHARACTERISTIC DFC_CtlMsk2.DFC_TEVEmin_C "" VALUE 0x80040306 Val_Wu8 255.0 DFES_OneToOne 0.00 255.0 FORMAT "%5.1" /end CHARACTERISTIC
/begin CHARACTERISTIC DFC_CtlMsk2.DFC_TEVEsig_C "" VALUE 0x80040307 Val_Wu8 255.0 DFES_OneToOne 0.00 255.0 FORMAT "%5.1" /end CHARACTERISTIC
/begin CHARACTERISTIC DFC_CtlMsk2.DFC_TMCSmax_C "" VALUE 0x80040308 Val_Wu8 255.0 DFES_OneToOne 0.00 255.0 FORMAT "%5.1" /end CHARACTERISTIC
/begin CHARACTERISTIC DFC_CtlMsk2.DFC_TMCSmin_C "" VALUE 0x80040309 Val_Wu8 255.0 DFES_OneToOne 0.00 255.0 FORMAT "%5.1" /end CHARACTERISTIC
/begin CHARACTERISTIC DFC_CtlMsk2.DFC_TMEmax_C "" VALUE 0x8004030A Val_Wu8 255.0 DFES_OneToOne 0.00 255.0 FORMAT "%5.1" /end CHARACTERISTIC
/begin CHARACTERISTIC DFC_CtlMsk2.DFC_TMEmin_C "" VALUE 0x8004030B Val_Wu8 255.0 DFES_OneToOne 0.00 255.0 FORMAT "%5.1" /end CHARACTERISTIC
/begin CHARACTERISTIC DFC_CtlMsk2.DFC_TMEnpl_C "" VALUE 0x8004030C Val_Wu8 255.0 DFES_OneToOne 0.00 255.0 FORMAT "%5.1" /end CHARACTERISTIC
/begin CHARACTERISTIC DFC_CtlMsk2.DFC_TMEsig_C "" VALUE 0x8004030D Val_Wu8 255.0 DFES_OneToOne 0.00 255.0 FORMAT "%5.1" /end CHARACTERISTIC
/begin CHARACTERISTIC DFC_CtlMsk2.DFC_TMPmax_C "" VALUE 0x8004030E Val_Wu8 255.0 DFES_OneToOne 0.00 255.0 FORMAT "%5.1" /end CHARACTERISTIC
/begin CHARACTERISTIC DFC_CtlMsk2.DFC_TMPmin_C "" VALUE 0x8004030F Val_Wu8 255.0 DFES_OneToOne 0.00 255.0 FORMAT "%5.1" /end CHARACTERISTIC
/begin CHARACTERISTIC DFC_CtlMsk2.DFC_TMPnpl_C "" VALUE 0x80040310 Val_Wu8 255.0 DFES_OneToOne 0.00 255.0 FORMAT "%5.1" /end CHARACTERISTIC
/begin CHARACTERISTIC DFC_CtlMsk2.DFC_TMmax_C "" VALUE 0x80040311 Val_Wu8 255.0 DFES_OneToOne 0.00 255.0 FORMAT "%5.1" /end CHARACTERISTIC
/begin CHARACTERISTIC DFC_CtlMsk2.DFC_TUMmax_C "" VALUE 0x80040312 Val_Wu8 255.0 DFES_OneToOne 0.00 255.0 FORMAT "%5.1" /end CHARACTERISTIC
/begin CHARACTERISTIC DFC_CtlMsk2.DFC_TWCCTrimMaxB1_C "" VALUE 0x80040313 Val_Wu8 255.0 DFES_OneToOne 0.00 255.0 FORMAT "%5.1" /end CHARACTERISTIC
/begin CHARACTERISTIC DFC_CtlMsk2.DFC_TWCCTrimMinB1_C "" VALUE 0x80040314 Val_Wu8 255.0 DFES_OneToOne 0.00 255.0 FORMAT "%5.1" /end CHARACTERISTIC
/begin CHARACTERISTIC DFC_CtlMsk2.DFC_TWCDPriCatB1_C "" VALUE 0x80040315 Val_Wu8 255.0 DFES_OneToOne 0.00 255.0 FORMAT "%5.1" /end CHARACTERISTIC
/begin CHARACTERISTIC DFC_CtlMsk2.DFC_UBRmax_C "" VALUE 0x80040316 Val_Wu8 255.0 DFES_OneToOne 0.00 255.0 FORMAT "%5.1" /end CHARACTERISTIC
/begin CHARACTERISTIC DFC_CtlMsk2.DFC_UBmax_C "" VALUE 0x80040317 Val_Wu8 255.0 DFES_OneToOne 0.00 255.0 FORMAT "%5.1" /end CHARACTERISTIC
/begin CHARACTERISTIC DFC_CtlMsk2.DFC_UBmin_C "" VALUE 0x80040318 Val_Wu8 255.0 DFES_OneToOne 0.00 255.0 FORMAT "%5.1" /end CHARACTERISTIC
/begin CHARACTERISTIC DFC_CtlMsk2.DFC_UBnpl_C "" VALUE 0x80040319 Val_Wu8 255.0 DFES_OneToOne 0.00 255.0 FORMAT "%5.1" /end CHARACTERISTIC
/begin CHARACTERISTIC DFC_DisblMsk2.DFC_Unused_C "" VALUE 0x80040DB6 Val_Wu8 255.0 DFES_OneToOne 0.00 255.0 FORMAT "%5.1" READ_ONLY /end CHARACTERISTIC
/begin CHARACTERISTIC DFC_DisblMsk2.DFC_AltMaxPwr_C "" VALUE 0x80040DB7 Val_Wu8 255.0 DFES_OneToOne 0.00 255.0 FORMAT "%5.1" /end CHARACTERISTIC
/begin CHARACTERISTIC DFC_DisblMsk2.DFC_BrkNpl_C "" VALUE 0x80040DB8 Val_Wu8 255.0 DFES_OneToOne 0.00 255.0 FORMAT "%5.1" /end CHARACTERISTIC
/begin CHARACTERISTIC DFC_DisblMsk2.DFC_Cj930SSp1Mon_C "" VALUE 0x80040DB9 Val_Wu8 255.0 DFES_OneToOne 0.00 255.0 FORMAT "%5.1" /end CHARACTERISTIC
/begin CHARACTERISTIC DFC_DisblMsk2.DFC_Cj930SSp2Mon_C "" VALUE 0x80040DBA Val_Wu8 255.0 DFES_OneToOne 0.00 255.0 FORMAT "%5.1" /end CHARACTERISTIC
/begin CHARACTERISTIC DFC_DisblMsk2.DFC_Cj930SSp3Mon_C "" VALUE 0x80040DBB Val_Wu8 255.0 DFES_OneToOne 0.00 255.0 FORMAT "%5.1" /end CHARACTERISTIC
/begin CHARACTERISTIC DFC_DisblMsk2.DFC_IdleChrgActrAMax_C "" VALUE 0x80040DBC Val_Wu8 255.0 DFES_OneToOne 0.00 255.0 FORMAT "%5.1" /end CHARACTERISTIC
/begin CHARACTERISTIC DFC_DisblMsk2.DFC_IdleChrgActrAMin_C "" VALUE 0x80040DBD Val_Wu8 255.0 DFES_OneToOne 0.00 255.0 FORMAT "%5.1" /end CHARACTERISTIC
/begin CHARACTERISTIC DFC_DisblMsk2.DFC_IdleChrgActrASig_C "" VALUE 0x80040DBE Val_Wu8 255.0 DFES_OneToOne 0.00 255.0 FORMAT "%5.1" /end CHARACTERISTIC
/begin CHARACTERISTIC DFC_DisblMsk2.DFC_IdleChrgActrBMax_C "" VALUE 0x80040DBF Val_Wu8 255.0 DFES_OneToOne 0.00 255.0 FORMAT "%5.1" /end CHARACTERISTIC
/begin CHARACTERISTIC DFC_DisblMsk2.DFC_IdleChrgActrBMin_C "" VALUE 0x80040DC0 Val_Wu8 255.0 DFES_OneToOne 0.00 255.0 FORMAT "%5.1" /end CHARACTERISTIC
/begin CHARACTERISTIC DFC_DisblMsk2.DFC_IdleChrgActrBSig_C "" VALUE 0x80040DC1 Val_Wu8 255.0 DFES_OneToOne 0.00 255.0 FORMAT "%5.1" /end CHARACTERISTIC
/begin CHARACTERISTIC DFC_DisblMsk2.DFC_IdleChrgActrGovDeCold_C "" VALUE 0x80040DC2 Val_Wu8 255.0 DFES_OneToOne 0.00 255.0 FORMAT "%5.1" /end CHARACTERISTIC
/begin CHARACTERISTIC DFC_DisblMsk2.DFC_IdleChrgActrGovDeMax_C "" VALUE 0x80040DC3 Val_Wu8 255.0 DFES_OneToOne 0.00 255.0 FORMAT "%5.1" /end CHARACTERISTIC
/begin CHARACTERISTIC DFC_DisblMsk2.DFC_IdleChrgActrGovDeMin_C "" VALUE 0x80040DC4 Val_Wu8 255.0 DFES_OneToOne 0.00 255.0 FORMAT "%5.1" /end CHARACTERISTIC
/begin CHARACTERISTIC DFC_DisblMsk2.DFC_IdleChrgActrNAMax_C "" VALUE 0x80040DC5 Val_Wu8 255.0 DFES_OneToOne 0.00 255.0 FORMAT "%5.1" /end CHARACTERISTIC
/begin CHARACTERISTIC DFC_DisblMsk2.DFC_IdleChrgActrNAMin_C "" VALUE 0x80040DC6 Val_Wu8 255.0 DFES_OneToOne 0.00 255.0 FORMAT "%5.1" /end CHARACTERISTIC
/begin CHARACTERISTIC DFC_DisblMsk2.DFC_IdleChrgActrNASig_C "" VALUE 0x80040DC7 Val_Wu8 255.0 DFES_OneToOne 0.00 255.0 FORMAT "%5.1" /end CHARACTERISTIC
/begin CHARACTERISTIC DFC_DisblMsk2.DFC_IdleChrgActrNBMax_C "" VALUE 0x80040DC8 Val_Wu8 255.0 DFES_OneToOne 0.00 255.0 FORMAT "%5.1" /end CHARACTERISTIC
/begin CHARACTERISTIC DFC_DisblMsk2.DFC_IdleChrgActrNBMin_C "" VALUE 0x80040DC9 Val_Wu8 255.0 DFES_OneToOne 0.00 255.0 FORMAT "%5.1" /end CHARACTERISTIC
/begin CHARACTERISTIC DFC_DisblMsk2.DFC_IdleChrgActrNBSig_C "" VALUE 0x80040DCA Val_Wu8 255.0 DFES_OneToOne 0.00 255.0 FORMAT "%5.1" /end CHARACTERISTIC
/begin CHARACTERISTIC DFC_DisblMsk2.DFC_IdleChrgActrOverTmp_C "" VALUE 0x80040DCB Val_Wu8 255.0 DFES_OneToOne 0.00 255.0 FORMAT "%5.1" /end CHARACTERISTIC
/begin CHARACTERISTIC DFC_DisblMsk2.DFC_MonUMaxSupply1_C "" VALUE 0x80040DCC Val_Wu8 255.0 DFES_OneToOne 0.00 255.0 FORMAT "%5.1" /end CHARACTERISTIC
/begin CHARACTERISTIC DFC_DisblMsk2.DFC_MonUMinSupply1_C "" VALUE 0x80040DCD Val_Wu8 255.0 DFES_OneToOne 0.00 255.0 FORMAT "%5.1" /end CHARACTERISTIC
/begin CHARACTERISTIC DFC_DisblMsk2.DFC_ClthNplClsd_C "" VALUE 0x80040DCE Val_Wu8 255.0 DFES_OneToOne 0.00 255.0 FORMAT "%5.1" /end CHARACTERISTIC
/begin CHARACTERISTIC DFC_DisblMsk2.DFC_ClthNplOpn_C "" VALUE 0x80040DCF Val_Wu8 255.0 DFES_OneToOne 0.00 255.0 FORMAT "%5.1" /end CHARACTERISTIC
/begin CHARACTERISTIC DFC_DisblMsk2.DFC_IgnClPsDevComErr1_C "" VALUE 0x80040DD0 Val_Wu8 255.0 DFES_OneToOne 0.00 255.0 FORMAT "%5.1" /end CHARACTERISTIC
/begin CHARACTERISTIC DFC_DisblMsk2.DFC_IgnClPsOpenLoad0_C "" VALUE 0x80040DD1 Val_Wu8 255.0 DFES_OneToOne 0.00 255.0 FORMAT "%5.1" /end CHARACTERISTIC
/begin CHARACTERISTIC DFC_DisblMsk2.DFC_IgnClPsOpenLoad1_C "" VALUE 0x80040DD2 Val_Wu8 255.0 DFES_OneToOne 0.00 255.0 FORMAT "%5.1" /end CHARACTERISTIC
/begin CHARACTERISTIC DFC_DisblMsk2.DFC_IgnClPsOpenLoad2_C "" VALUE 0x80040DD3 Val_Wu8 255.0 DFES_OneToOne 0.00 255.0 FORMAT "%5.1" /end CHARACTERISTIC
/begin CHARACTERISTIC DFC_DisblMsk2.DFC_IgnClPsShCirBatt0_C "" VALUE 0x80040DD4 Val_Wu8 255.0 DFES_OneToOne 0.00 255.0 FORMAT "%5.1" /end CHARACTERISTIC
/begin CHARACTERISTIC DFC_DisblMsk2.DFC_IgnClPsShCirBatt1_C "" VALUE 0x80040DD5 Val_Wu8 255.0 DFES_OneToOne 0.00 255.0 FORMAT "%5.1" /end CHARACTERISTIC
/begin CHARACTERISTIC DFC_DisblMsk2.DFC_IgnClPsShCirBatt2_C "" VALUE 0x80040DD6 Val_Wu8 255.0 DFES_OneToOne 0.00 255.0 FORMAT "%5.1" /end CHARACTERISTIC
/begin CHARACTERISTIC DFC_DisblMsk2.DFC_IgnClPsShCirGnd0_C "" VALUE 0x80040DD7 Val_Wu8 255.0 DFES_OneToOne 0.00 255.0 FORMAT "%5.1" /end CHARACTERISTIC
/begin CHARACTERISTIC DFC_DisblMsk2.DFC_IgnClPsShCirGnd1_C "" VALUE 0x80040DD8 Val_Wu8 255.0 DFES_OneToOne 0.00 255.0 FORMAT "%5.1" /end CHARACTERISTIC
/begin CHARACTERISTIC DFC_DisblMsk2.DFC_IgnClPsShCirGnd2_C "" VALUE 0x80040DD9 Val_Wu8 255.0 DFES_OneToOne 0.00 255.0 FORMAT "%5.1" /end CHARACTERISTIC
/begin CHARACTERISTIC DFC_DisblMsk2.DFC_KnDetSens1PortAMax_C "" VALUE 0x80040DDA Val_Wu8 255.0 DFES_OneToOne 0.00 255.0 FORMAT "%5.1" /end CHARACTERISTIC
/begin CHARACTERISTIC DFC_DisblMsk2.DFC_KnDetSens1PortAMin_C "" VALUE 0x80040DDB Val_Wu8 255.0 DFES_OneToOne 0.00 255.0 FORMAT "%5.1" /end CHARACTERISTIC
/begin CHARACTERISTIC DFC_DisblMsk2.DFC_KnDetSens1PortBMax_C "" VALUE 0x80040DDC Val_Wu8 255.0 DFES_OneToOne 0.00 255.0 FORMAT "%5.1" /end CHARACTERISTIC
/begin CHARACTERISTIC DFC_DisblMsk2.DFC_KnDetSens1PortBMin_C "" VALUE 0x80040DDD Val_Wu8 255.0 DFES_OneToOne 0.00 255.0 FORMAT "%5.1" /end CHARACTERISTIC
/begin CHARACTERISTIC DFC_DisblMsk2.DFC_VehVWhlErr_C "" VALUE 0x80040DDE Val_Wu8 255.0 DFES_OneToOne 0.00 255.0 FORMAT "%5.1" /end CHARACTERISTIC
/begin CHARACTERISTIC DFC_DisblMsk2.DFC_AirCCmprOL_C "" VALUE 0x80040DDF Val_Wu8 255.0 DFES_OneToOne 0.00 255.0 FORMAT "%5.1" /end CHARACTERISTIC
/begin CHARACTERISTIC DFC_DisblMsk2.DFC_AirCCmprOvrTemp_C "" VALUE 0x80040DE0 Val_Wu8 255.0 DFES_OneToOne 0.00 255.0 FORMAT "%5.1" /end CHARACTERISTIC
/begin CHARACTERISTIC DFC_DisblMsk2.DFC_AirCCmprSCB_C "" VALUE 0x80040DE1 Val_Wu8 255.0 DFES_OneToOne 0.00 255.0 FORMAT "%5.1" /end CHARACTERISTIC
/begin CHARACTERISTIC DFC_DisblMsk2.DFC_AirCCmprSCG_C "" VALUE 0x80040DE2 Val_Wu8 255.0 DFES_OneToOne 0.00 255.0 FORMAT "%5.1" /end CHARACTERISTIC
/begin CHARACTERISTIC DFC_DisblMsk2.DFC_AltIOLdSRCMin_C "" VALUE 0x80040DE3 Val_Wu8 255.0 DFES_OneToOne 0.00 255.0 FORMAT "%5.1" /end CHARACTERISTIC
/begin CHARACTERISTIC DFC_DisblMsk2.DFC_AltIOOL_C "" VALUE 0x80040DE4 Val_Wu8 255.0 DFES_OneToOne 0.00 255.0 FORMAT "%5.1" /end CHARACTERISTIC
/begin CHARACTERISTIC DFC_DisblMsk2.DFC_AltIOOvrTemp_C "" VALUE 0x80040DE5 Val_Wu8 255.0 DFES_OneToOne 0.00 255.0 FORMAT "%5.1" /end CHARACTERISTIC
/begin CHARACTERISTIC DFC_DisblMsk2.DFC_AltIOSCB_C "" VALUE 0x80040DE6 Val_Wu8 255.0 DFES_OneToOne 0.00 255.0 FORMAT "%5.1" /end CHARACTERISTIC
/begin CHARACTERISTIC DFC_DisblMsk2.DFC_AltIOSCG_C "" VALUE 0x80040DE7 Val_Wu8 255.0 DFES_OneToOne 0.00 255.0 FORMAT "%5.1" /end CHARACTERISTIC
/begin CHARACTERISTIC DFC_DisblMsk2.DFC_DevLibBattUHi_C "" VALUE 0x80040DE8 Val_Wu8 255.0 DFES_OneToOne 0.00 255.0 FORMAT "%5.1" /end CHARACTERISTIC
/begin CHARACTERISTIC DFC_DisblMsk2.DFC_DevLibBattULo_C "" VALUE 0x80040DE9 Val_Wu8 255.0 DFES_OneToOne 0.00 255.0 FORMAT "%5.1" /end CHARACTERISTIC
/begin CHARACTERISTIC DFC_DisblMsk2.DFC_FanDIOOL_C "" VALUE 0x80040DEA Val_Wu8 255.0 DFES_OneToOne 0.00 255.0 FORMAT "%5.1" /end CHARACTERISTIC
/begin CHARACTERISTIC DFC_DisblMsk2.DFC_FanDIOOvrTemp_C "" VALUE 0x80040DEB Val_Wu8 255.0 DFES_OneToOne 0.00 255.0 FORMAT "%5.1" /end CHARACTERISTIC
/begin CHARACTERISTIC DFC_DisblMsk2.DFC_FanDIOSCB_C "" VALUE 0x80040DEC Val_Wu8 255.0 DFES_OneToOne 0.00 255.0 FORMAT "%5.1" /end CHARACTERISTIC
/begin CHARACTERISTIC DFC_DisblMsk2.DFC_FanDIOSCG_C "" VALUE 0x80040DED Val_Wu8 255.0 DFES_OneToOne 0.00 255.0 FORMAT "%5.1" /end CHARACTERISTIC
/begin CHARACTERISTIC DFC_DisblMsk2.DFC_FanPWMOL_C "" VALUE 0x80040DEE Val_Wu8 255.0 DFES_OneToOne 0.00 255.0 FORMAT "%5.1" /end CHARACTERISTIC
/begin CHARACTERISTIC DFC_DisblMsk2.DFC_FanPWMOvrTemp_C "" VALUE 0x80040DEF Val_Wu8 255.0 DFES_OneToOne 0.00 255.0 FORMAT "%5.1" /end CHARACTERISTIC
/begin CHARACTERISTIC DFC_DisblMsk2.DFC_FanPWMSCB_C "" VALUE 0x80040DF0 Val_Wu8 255.0 DFES_OneToOne 0.00 255.0 FORMAT "%5.1" /end CHARACTERISTIC
/begin CHARACTERISTIC DFC_DisblMsk2.DFC_FanPWMSCG_C "" VALUE 0x80040DF1 Val_Wu8 255.0 DFES_OneToOne 0.00 255.0 FORMAT "%5.1" /end CHARACTERISTIC
/begin CHARACTERISTIC DFC_DisblMsk2.DFC_AirCClntPAnaSRCMax_C "" VALUE 0x80040DF2 Val_Wu8 255.0 DFES_OneToOne 0.00 255.0 FORMAT "%5.1" /end CHARACTERISTIC
/begin CHARACTERISTIC DFC_DisblMsk2.DFC_AirCClntPAnaSRCMin_C "" VALUE 0x80040DF3 Val_Wu8 255.0 DFES_OneToOne 0.00 255.0 FORMAT "%5.1" /end CHARACTERISTIC
/begin CHARACTERISTIC DFC_DisblMsk2.DFC_AirCSwtNpl_C "" VALUE 0x80040DF4 Val_Wu8 255.0 DFES_OneToOne 0.00 255.0 FORMAT "%5.1" /end CHARACTERISTIC
/begin CHARACTERISTIC DFC_DisblMsk2.DFC_AirCSwtSig_C "" VALUE 0x80040DF5 Val_Wu8 255.0 DFES_OneToOne 0.00 255.0 FORMAT "%5.1" /end CHARACTERISTIC
/begin CHARACTERISTIC DFC_DisblMsk2.DFC_AltIOLdSRCMax_C "" VALUE 0x80040DF6 Val_Wu8 255.0 DFES_OneToOne 0.00 255.0 FORMAT "%5.1" /end CHARACTERISTIC
/begin CHARACTERISTIC DFC_DisblMsk2.DFC_BrkSig_C "" VALUE 0x80040DF7 Val_Wu8 255.0 DFES_OneToOne 0.00 255.0 FORMAT "%5.1" /end CHARACTERISTIC
/begin CHARACTERISTIC DFC_DisblMsk2.DFC_ClthEPBNpl_C "" VALUE 0x80040DF8 Val_Wu8 255.0 DFES_OneToOne 0.00 255.0 FORMAT "%5.1" /end CHARACTERISTIC
/begin CHARACTERISTIC DFC_DisblMsk2.DFC_ClthEPBSensErr_C "" VALUE 0x80040DF9 Val_Wu8 255.0 DFES_OneToOne 0.00 255.0 FORMAT "%5.1" /end CHARACTERISTIC
/begin CHARACTERISTIC DFC_DisblMsk2.DFC_ClthErr_C "" VALUE 0x80040DFA Val_Wu8 255.0 DFES_OneToOne 0.00 255.0 FORMAT "%5.1" /end CHARACTERISTIC
/begin CHARACTERISTIC DFC_DisblMsk2.DFC_ClthSig_C "" VALUE 0x80040DFB Val_Wu8 255.0 DFES_OneToOne 0.00 255.0 FORMAT "%5.1" /end CHARACTERISTIC
/begin CHARACTERISTIC DFC_DisblMsk2.DFC_MILLmpOL_C "" VALUE 0x80040DFC Val_Wu8 255.0 DFES_OneToOne 0.00 255.0 FORMAT "%5.1" /end CHARACTERISTIC
/begin CHARACTERISTIC DFC_DisblMsk2.DFC_MILLmpSCB_C "" VALUE 0x80040DFD Val_Wu8 255.0 DFES_OneToOne 0.00 255.0 FORMAT "%5.1" /end CHARACTERISTIC
/begin CHARACTERISTIC DFC_DisblMsk2.DFC_MILLmpSCG_C "" VALUE 0x80040DFE Val_Wu8 255.0 DFES_OneToOne 0.00 255.0 FORMAT "%5.1" /end CHARACTERISTIC
/begin CHARACTERISTIC DFC_DisblMsk2.DFC_SRCHighAPP1_C "" VALUE 0x80040DFF Val_Wu8 255.0 DFES_OneToOne 0.00 255.0 FORMAT "%5.1" /end CHARACTERISTIC
/begin CHARACTERISTIC DFC_DisblMsk2.DFC_SRCHighAPP2_C "" VALUE 0x80040E00 Val_Wu8 255.0 DFES_OneToOne 0.00 255.0 FORMAT "%5.1" /end CHARACTERISTIC
/begin CHARACTERISTIC DFC_DisblMsk2.DFC_SRCLowAPP1_C "" VALUE 0x80040E01 Val_Wu8 255.0 DFES_OneToOne 0.00 255.0 FORMAT "%5.1" /end CHARACTERISTIC
/begin CHARACTERISTIC DFC_DisblMsk2.DFC_SRCLowAPP2_C "" VALUE 0x80040E02 Val_Wu8 255.0 DFES_OneToOne 0.00 255.0 FORMAT "%5.1" /end CHARACTERISTIC
/begin CHARACTERISTIC DFC_DisblMsk2.DFC_SyncAPP_C "" VALUE 0x80040E03 Val_Wu8 255.0 DFES_OneToOne 0.00 255.0 FORMAT "%5.1" /end CHARACTERISTIC
/begin CHARACTERISTIC DFC_DisblMsk2.DFC_VehVMax_C "" VALUE 0x80040E04 Val_Wu8 255.0 DFES_OneToOne 0.00 255.0 FORMAT "%5.1" /end CHARACTERISTIC
/begin CHARACTERISTIC DFC_DisblMsk2.DFC_VehVPlaus_C "" VALUE 0x80040E05 Val_Wu8 255.0 DFES_OneToOne 0.00 255.0 FORMAT "%5.1" /end CHARACTERISTIC
/begin CHARACTERISTIC DFC_DisblMsk2.DFC_VehVSig_C "" VALUE 0x80040E06 Val_Wu8 255.0 DFES_OneToOne 0.00 255.0 FORMAT "%5.1" /end CHARACTERISTIC
/begin CHARACTERISTIC DFC_DisblMsk2.DFC_BusDiagBusOffNodeA_C "" VALUE 0x80040E07 Val_Wu8 255.0 DFES_OneToOne 0.00 255.0 FORMAT "%5.1" /end CHARACTERISTIC
/begin CHARACTERISTIC DFC_DisblMsk2.DFC_ComACSensTO_C "" VALUE 0x80040E08 Val_Wu8 255.0 DFES_OneToOne 0.00 255.0 FORMAT "%5.1" /end CHARACTERISTIC
/begin CHARACTERISTIC DFC_DisblMsk2.DFC_ComAWD1TO_C "" VALUE 0x80040E09 Val_Wu8 255.0 DFES_OneToOne 0.00 255.0 FORMAT "%5.1" /end CHARACTERISTIC
/begin CHARACTERISTIC DFC_DisblMsk2.DFC_ComBRK10TO_C "" VALUE 0x80040E0A Val_Wu8 255.0 DFES_OneToOne 0.00 255.0 FORMAT "%5.1" /end CHARACTERISTIC
/begin CHARACTERISTIC DFC_DisblMsk2.DFC_ComGW11TO_C "" VALUE 0x80040E0B Val_Wu8 255.0 DFES_OneToOne 0.00 255.0 FORMAT "%5.1" /end CHARACTERISTIC
/begin CHARACTERISTIC DFC_DisblMsk2.DFC_ComLVL1TO_C "" VALUE 0x80040E0C Val_Wu8 255.0 DFES_OneToOne 0.00 255.0 FORMAT "%5.1" /end CHARACTERISTIC
/begin CHARACTERISTIC DFC_DisblMsk2.DFC_ComPRKA01TO_C "" VALUE 0x80040E0D Val_Wu8 255.0 DFES_OneToOne 0.00 255.0 FORMAT "%5.1" /end CHARACTERISTIC
/begin CHARACTERISTIC DFC_DisblMsk2.DFC_ComPRKH01TO_C "" VALUE 0x80040E0E Val_Wu8 255.0 DFES_OneToOne 0.00 255.0 FORMAT "%5.1" /end CHARACTERISTIC
/begin CHARACTERISTIC DFC_DisblMsk2.DFC_ComPRKH1TO_C "" VALUE 0x80040E0F Val_Wu8 255.0 DFES_OneToOne 0.00 255.0 FORMAT "%5.1" /end CHARACTERISTIC
/begin CHARACTERISTIC DFC_DisblMsk2.DFC_ComTRBCH1TO_C "" VALUE 0x80040E10 Val_Wu8 255.0 DFES_OneToOne 0.00 255.0 FORMAT "%5.1" /end CHARACTERISTIC
/begin CHARACTERISTIC DFC_DisblMsk2.DFC_ComTRBCH2TO_C "" VALUE 0x80040E11 Val_Wu8 255.0 DFES_OneToOne 0.00 255.0 FORMAT "%5.1" /end CHARACTERISTIC
/begin CHARACTERISTIC DFC_DisblMsk2.DFC_DK_C "" VALUE 0x80040E12 Val_Wu8 255.0 DFES_OneToOne 0.00 255.0 FORMAT "%5.1" /end CHARACTERISTIC
/begin CHARACTERISTIC DFC_DisblMsk2.DFC_DKRSA_C "" VALUE 0x80040E13 Val_Wu8 255.0 DFES_OneToOne 0.00 255.0 FORMAT "%5.1" /end CHARACTERISTIC
/begin CHARACTERISTIC DFC_DisblMsk2.DFC_DKVSmax_C "" VALUE 0x80040E14 Val_Wu8 255.0 DFES_OneToOne 0.00 255.0 FORMAT "%5.1" /end CHARACTERISTIC
/begin CHARACTERISTIC DFC_DisblMsk2.DFC_DKmax_C "" VALUE 0x80040E15 Val_Wu8 255.0 DFES_OneToOne 0.00 255.0 FORMAT "%5.1" /end CHARACTERISTIC
/begin CHARACTERISTIC DFC_DisblMsk2.DFC_DKmin_C "" VALUE 0x80040E16 Val_Wu8 255.0 DFES_OneToOne 0.00 255.0 FORMAT "%5.1" /end CHARACTERISTIC
/begin CHARACTERISTIC DFC_DisblMsk2.DFC_DSSmax_C "" VALUE 0x80040E17 Val_Wu8 255.0 DFES_OneToOne 0.00 255.0 FORMAT "%5.1" /end CHARACTERISTIC
/begin CHARACTERISTIC DFC_DisblMsk2.DFC_EEPEraseErr_C "" VALUE 0x80040E18 Val_Wu8 255.0 DFES_OneToOne 0.00 255.0 FORMAT "%5.1" /end CHARACTERISTIC
/begin CHARACTERISTIC DFC_DisblMsk2.DFC_EEPRdErr_C "" VALUE 0x80040E19 Val_Wu8 255.0 DFES_OneToOne 0.00 255.0 FORMAT "%5.1" /end CHARACTERISTIC
/begin CHARACTERISTIC DFC_DisblMsk2.DFC_EEPWrErr_C "" VALUE 0x80040E1A Val_Wu8 255.0 DFES_OneToOne 0.00 255.0 FORMAT "%5.1" /end CHARACTERISTIC
/begin CHARACTERISTIC DFC_DisblMsk2.DFC_EV1max_C "" VALUE 0x80040E1B Val_Wu8 255.0 DFES_OneToOne 0.00 255.0 FORMAT "%5.1" /end CHARACTERISTIC
/begin CHARACTERISTIC DFC_DisblMsk2.DFC_EV1min_C "" VALUE 0x80040E1C Val_Wu8 255.0 DFES_OneToOne 0.00 255.0 FORMAT "%5.1" /end CHARACTERISTIC
/begin CHARACTERISTIC DFC_DisblMsk2.DFC_EV1sig_C "" VALUE 0x80040E1D Val_Wu8 255.0 DFES_OneToOne 0.00 255.0 FORMAT "%5.1" /end CHARACTERISTIC
/begin CHARACTERISTIC DFC_DisblMsk2.DFC_EV2max_C "" VALUE 0x80040E1E Val_Wu8 255.0 DFES_OneToOne 0.00 255.0 FORMAT "%5.1" /end CHARACTERISTIC
/begin CHARACTERISTIC DFC_DisblMsk2.DFC_EV2min_C "" VALUE 0x80040E1F Val_Wu8 255.0 DFES_OneToOne 0.00 255.0 FORMAT "%5.1" /end CHARACTERISTIC
/begin CHARACTERISTIC DFC_DisblMsk2.DFC_EV2sig_C "" VALUE 0x80040E20 Val_Wu8 255.0 DFES_OneToOne 0.00 255.0 FORMAT "%5.1" /end CHARACTERISTIC
/begin CHARACTERISTIC DFC_DisblMsk2.DFC_EV3max_C "" VALUE 0x80040E21 Val_Wu8 255.0 DFES_OneToOne 0.00 255.0 FORMAT "%5.1" /end CHARACTERISTIC
/begin CHARACTERISTIC DFC_DisblMsk2.DFC_EV3min_C "" VALUE 0x80040E22 Val_Wu8 255.0 DFES_OneToOne 0.00 255.0 FORMAT "%5.1" /end CHARACTERISTIC
/begin CHARACTERISTIC DFC_DisblMsk2.DFC_EV3sig_C "" VALUE 0x80040E23 Val_Wu8 255.0 DFES_OneToOne 0.00 255.0 FORMAT "%5.1" /end CHARACTERISTIC
/begin CHARACTERISTIC DFC_DisblMsk2.DFC_EpmCaSI1ErrSig_C "" VALUE 0x80040E24 Val_Wu8 255.0 DFES_OneToOne 0.00 255.0 FORMAT "%5.1" /end CHARACTERISTIC
/begin CHARACTERISTIC DFC_DisblMsk2.DFC_EpmCaSI1NoSig_C "" VALUE 0x80040E25 Val_Wu8 255.0 DFES_OneToOne 0.00 255.0 FORMAT "%5.1" /end CHARACTERISTIC
/begin CHARACTERISTIC DFC_DisblMsk2.DFC_EpmCaSI1NoSigMax_C "" VALUE 0x80040E26 Val_Wu8 255.0 DFES_OneToOne 0.00 255.0 FORMAT "%5.1" /end CHARACTERISTIC
/begin CHARACTERISTIC DFC_DisblMsk2.DFC_EpmCaSI1NoSigMin_C "" VALUE 0x80040E27 Val_Wu8 255.0 DFES_OneToOne 0.00 255.0 FORMAT "%5.1" /end CHARACTERISTIC
/begin CHARACTERISTIC DFC_DisblMsk2.DFC_EpmCaSI1OfsErr_C "" VALUE 0x80040E28 Val_Wu8 255.0 DFES_OneToOne 0.00 255.0 FORMAT "%5.1" /end CHARACTERISTIC
/begin CHARACTERISTIC DFC_DisblMsk2.DFC_EpmCrSErrSig_C "" VALUE 0x80040E29 Val_Wu8 255.0 DFES_OneToOne 0.00 255.0 FORMAT "%5.1" /end CHARACTERISTIC
/begin CHARACTERISTIC DFC_DisblMsk2.DFC_EpmCrSNoSig_C "" VALUE 0x80040E2A Val_Wu8 255.0 DFES_OneToOne 0.00 255.0 FORMAT "%5.1" /end CHARACTERISTIC
/begin CHARACTERISTIC DFC_DisblMsk2.DFC_FRAmax_C "" VALUE 0x80040E2B Val_Wu8 255.0 DFES_OneToOne 0.00 255.0 FORMAT "%5.1" /end CHARACTERISTIC
/begin CHARACTERISTIC DFC_DisblMsk2.DFC_FRAmin_C "" VALUE 0x80040E2C Val_Wu8 255.0 DFES_OneToOne 0.00 255.0 FORMAT "%5.1" /end CHARACTERISTIC
/begin CHARACTERISTIC DFC_DisblMsk2.DFC_HEGOS1B1ElecMax_C "" VALUE 0x80040E2D Val_Wu8 255.0 DFES_OneToOne 0.00 255.0 FORMAT "%5.1" /end CHARACTERISTIC
/begin CHARACTERISTIC DFC_DisblMsk2.DFC_HEGOS1B1ElecMin_C "" VALUE 0x80040E2E Val_Wu8 255.0 DFES_OneToOne 0.00 255.0 FORMAT "%5.1" /end CHARACTERISTIC
/begin CHARACTERISTIC DFC_DisblMsk2.DFC_HEGOS1B1ElecNpl_C "" VALUE 0x80040E2F Val_Wu8 255.0 DFES_OneToOne 0.00 255.0 FORMAT "%5.1" /end CHARACTERISTIC
/begin CHARACTERISTIC DFC_DisblMsk2.DFC_HEGOS1B1ElecSig_C "" VALUE 0x80040E30 Val_Wu8 255.0 DFES_OneToOne 0.00 255.0 FORMAT "%5.1" /end CHARACTERISTIC
/begin CHARACTERISTIC DFC_DisblMsk2.DFC_HEGOS1B1HtgNpl_C "" VALUE 0x80040E31 Val_Wu8 255.0 DFES_OneToOne 0.00 255.0 FORMAT "%5.1" /end CHARACTERISTIC
/begin CHARACTERISTIC DFC_DisblMsk2.DFC_HEGOS1B1HtrPsMax_C "" VALUE 0x80040E32 Val_Wu8 255.0 DFES_OneToOne 0.00 255.0 FORMAT "%5.1" /end CHARACTERISTIC
/begin CHARACTERISTIC DFC_DisblMsk2.DFC_HEGOS1B1HtrPsMin_C "" VALUE 0x80040E33 Val_Wu8 255.0 DFES_OneToOne 0.00 255.0 FORMAT "%5.1" /end CHARACTERISTIC
/begin CHARACTERISTIC DFC_DisblMsk2.DFC_HEGOS1B1HtrPsSig_C "" VALUE 0x80040E34 Val_Wu8 255.0 DFES_OneToOne 0.00 255.0 FORMAT "%5.1" /end CHARACTERISTIC
/begin CHARACTERISTIC DFC_DisblMsk2.DFC_HEGOS1B1StkMax_C "" VALUE 0x80040E35 Val_Wu8 255.0 DFES_OneToOne 0.00 255.0 FORMAT "%5.1" /end CHARACTERISTIC
/begin CHARACTERISTIC DFC_DisblMsk2.DFC_HEGOS1B1StkMin_C "" VALUE 0x80040E36 Val_Wu8 255.0 DFES_OneToOne 0.00 255.0 FORMAT "%5.1" /end CHARACTERISTIC
/begin CHARACTERISTIC DFC_DisblMsk2.DFC_HEGOS2B1RstrcnLean_C "" VALUE 0x80040E37 Val_Wu8 255.0 DFES_OneToOne 0.00 255.0 FORMAT "%5.1" /end CHARACTERISTIC
/begin CHARACTERISTIC DFC_DisblMsk2.DFC_HEGOS2B1RstrcnRich_C "" VALUE 0x80040E38 Val_Wu8 255.0 DFES_OneToOne 0.00 255.0 FORMAT "%5.1" /end CHARACTERISTIC
/begin CHARACTERISTIC DFC_DisblMsk2.DFC_IdleChrgActrJamVlvClsd_C "" VALUE 0x80040E39 Val_Wu8 255.0 DFES_OneToOne 0.00 255.0 FORMAT "%5.1" /end CHARACTERISTIC
/begin CHARACTERISTIC DFC_DisblMsk2.DFC_IdleChrgActrJamVlvOpn_C "" VALUE 0x80040E3A Val_Wu8 255.0 DFES_OneToOne 0.00 255.0 FORMAT "%5.1" /end CHARACTERISTIC
/begin CHARACTERISTIC DFC_DisblMsk2.DFC_IgnClPsDevOscErr1_C "" VALUE 0x80040E3B Val_Wu8 255.0 DFES_OneToOne 0.00 255.0 FORMAT "%5.1" /end CHARACTERISTIC
/begin CHARACTERISTIC DFC_DisblMsk2.DFC_KPEmax_C "" VALUE 0x80040E3C Val_Wu8 255.0 DFES_OneToOne 0.00 255.0 FORMAT "%5.1" /end CHARACTERISTIC
/begin CHARACTERISTIC DFC_DisblMsk2.DFC_KPEmin_C "" VALUE 0x80040E3D Val_Wu8 255.0 DFES_OneToOne 0.00 255.0 FORMAT "%5.1" /end CHARACTERISTIC
/begin CHARACTERISTIC DFC_DisblMsk2.DFC_KPEsig_C "" VALUE 0x80040E3E Val_Wu8 255.0 DFES_OneToOne 0.00 255.0 FORMAT "%5.1" /end CHARACTERISTIC
/begin CHARACTERISTIC DFC_DisblMsk2.DFC_KS1max_C "" VALUE 0x80040E3F Val_Wu8 255.0 DFES_OneToOne 0.00 255.0 FORMAT "%5.1" /end CHARACTERISTIC
/begin CHARACTERISTIC DFC_DisblMsk2.DFC_KS1min_C "" VALUE 0x80040E40 Val_Wu8 255.0 DFES_OneToOne 0.00 255.0 FORMAT "%5.1" /end CHARACTERISTIC
/begin CHARACTERISTIC DFC_DisblMsk2.DFC_LLRKHmax_C "" VALUE 0x80040E41 Val_Wu8 255.0 DFES_OneToOne 0.00 255.0 FORMAT "%5.1" /end CHARACTERISTIC
/begin CHARACTERISTIC DFC_DisblMsk2.DFC_LLRKHmin_C "" VALUE 0x80040E42 Val_Wu8 255.0 DFES_OneToOne 0.00 255.0 FORMAT "%5.1" /end CHARACTERISTIC
/begin CHARACTERISTIC DFC_DisblMsk2.DFC_LLRKHnpl_C "" VALUE 0x80040E43 Val_Wu8 255.0 DFES_OneToOne 0.00 255.0 FORMAT "%5.1" /end CHARACTERISTIC
/begin CHARACTERISTIC DFC_DisblMsk2.DFC_LLRmax_C "" VALUE 0x80040E44 Val_Wu8 255.0 DFES_OneToOne 0.00 255.0 FORMAT "%5.1" /end CHARACTERISTIC
/begin CHARACTERISTIC DFC_DisblMsk2.DFC_LLRmin_C "" VALUE 0x80040E45 Val_Wu8 255.0 DFES_OneToOne 0.00 255.0 FORMAT "%5.1" /end CHARACTERISTIC
/begin CHARACTERISTIC DFC_DisblMsk2.DFC_LLRnpl_C "" VALUE 0x80040E46 Val_Wu8 255.0 DFES_OneToOne 0.00 255.0 FORMAT "%5.1" /end CHARACTERISTIC
/begin CHARACTERISTIC DFC_DisblMsk2.DFC_LMmax_C "" VALUE 0x80040E47 Val_Wu8 255.0 DFES_OneToOne 0.00 255.0 FORMAT "%5.1" /end CHARACTERISTIC
/begin CHARACTERISTIC DFC_DisblMsk2.DFC_LZSRnpl_C "" VALUE 0x80040E48 Val_Wu8 255.0 DFES_OneToOne 0.00 255.0 FORMAT "%5.1" /end CHARACTERISTIC
/begin CHARACTERISTIC DFC_DisblMsk2.DFC_MD_C "" VALUE 0x80040E49 Val_Wu8 255.0 DFES_OneToOne 0.00 255.0 FORMAT "%5.1" /end CHARACTERISTIC
/begin CHARACTERISTIC DFC_DisblMsk2.DFC_MD00min_C "" VALUE 0x80040E4A Val_Wu8 255.0 DFES_OneToOne 0.00 255.0 FORMAT "%5.1" /end CHARACTERISTIC
/begin CHARACTERISTIC DFC_DisblMsk2.DFC_MD00npl_C "" VALUE 0x80040E4B Val_Wu8 255.0 DFES_OneToOne 0.00 255.0 FORMAT "%5.1" /end CHARACTERISTIC
/begin CHARACTERISTIC DFC_DisblMsk2.DFC_MD01min_C "" VALUE 0x80040E4C Val_Wu8 255.0 DFES_OneToOne 0.00 255.0 FORMAT "%5.1" /end CHARACTERISTIC
/begin CHARACTERISTIC DFC_DisblMsk2.DFC_MD01npl_C "" VALUE 0x80040E4D Val_Wu8 255.0 DFES_OneToOne 0.00 255.0 FORMAT "%5.1" /end CHARACTERISTIC
/begin CHARACTERISTIC DFC_DisblMsk2.DFC_MD02min_C "" VALUE 0x80040E4E Val_Wu8 255.0 DFES_OneToOne 0.00 255.0 FORMAT "%5.1" /end CHARACTERISTIC
/begin CHARACTERISTIC DFC_DisblMsk2.DFC_MD02npl_C "" VALUE 0x80040E4F Val_Wu8 255.0 DFES_OneToOne 0.00 255.0 FORMAT "%5.1" /end CHARACTERISTIC
/begin CHARACTERISTIC DFC_DisblMsk2.DFC_MD03min_C "" VALUE 0x80040E50 Val_Wu8 255.0 DFES_OneToOne 0.00 255.0 FORMAT "%5.1" /end CHARACTERISTIC
/begin CHARACTERISTIC DFC_DisblMsk2.DFC_MD03npl_C "" VALUE 0x80040E51 Val_Wu8 255.0 DFES_OneToOne 0.00 255.0 FORMAT "%5.1" /end CHARACTERISTIC
/begin CHARACTERISTIC DFC_DisblMsk2.DFC_MD04min_C "" VALUE 0x80040E52 Val_Wu8 255.0 DFES_OneToOne 0.00 255.0 FORMAT "%5.1" /end CHARACTERISTIC
/begin CHARACTERISTIC DFC_DisblMsk2.DFC_MD04npl_C "" VALUE 0x80040E53 Val_Wu8 255.0 DFES_OneToOne 0.00 255.0 FORMAT "%5.1" /end CHARACTERISTIC
/begin CHARACTERISTIC DFC_DisblMsk2.DFC_MDCyl_0_C "" VALUE 0x80040E54 Val_Wu8 255.0 DFES_OneToOne 0.00 255.0 FORMAT "%5.1" /end CHARACTERISTIC
/begin CHARACTERISTIC DFC_DisblMsk2.DFC_MDCyl_1_C "" VALUE 0x80040E55 Val_Wu8 255.0 DFES_OneToOne 0.00 255.0 FORMAT "%5.1" /end CHARACTERISTIC
/begin CHARACTERISTIC DFC_DisblMsk2.DFC_MDCyl_2_C "" VALUE 0x80040E56 Val_Wu8 255.0 DFES_OneToOne 0.00 255.0 FORMAT "%5.1" /end CHARACTERISTIC
/begin CHARACTERISTIC DFC_DisblMsk2.DFC_MDFC_C "" VALUE 0x80040E57 Val_Wu8 255.0 DFES_OneToOne 0.00 255.0 FORMAT "%5.1" /end CHARACTERISTIC
/begin CHARACTERISTIC DFC_DisblMsk2.DFC_MDmin_C "" VALUE 0x80040E58 Val_Wu8 255.0 DFES_OneToOne 0.00 255.0 FORMAT "%5.1" /end CHARACTERISTIC
/begin CHARACTERISTIC DFC_DisblMsk2.DFC_MDnpl_C "" VALUE 0x80040E59 Val_Wu8 255.0 DFES_OneToOne 0.00 255.0 FORMAT "%5.1" /end CHARACTERISTIC
/begin CHARACTERISTIC DFC_DisblMsk2.DFC_MoCADCNTP_C "" VALUE 0x80040E5A Val_Wu8 255.0 DFES_OneToOne 0.00 255.0 FORMAT "%5.1" /end CHARACTERISTIC
/begin CHARACTERISTIC DFC_DisblMsk2.DFC_MoCADCTst_C "" VALUE 0x80040E5B Val_Wu8 255.0 DFES_OneToOne 0.00 255.0 FORMAT "%5.1" /end CHARACTERISTIC
/begin CHARACTERISTIC DFC_DisblMsk2.DFC_MoCComctErrMM_C "" VALUE 0x80040E5C Val_Wu8 255.0 DFES_OneToOne 0.00 255.0 FORMAT "%5.1" /end CHARACTERISTIC
/begin CHARACTERISTIC DFC_DisblMsk2.DFC_OCWDAActv_C "" VALUE 0x80040E5D Val_Wu8 255.0 DFES_OneToOne 0.00 255.0 FORMAT "%5.1" /end CHARACTERISTIC
/begin CHARACTERISTIC DFC_DisblMsk2.DFC_OCWDACom_C "" VALUE 0x80040E5E Val_Wu8 255.0 DFES_OneToOne 0.00 255.0 FORMAT "%5.1" /end CHARACTERISTIC
/begin CHARACTERISTIC DFC_DisblMsk2.DFC_ORAmax_C "" VALUE 0x80040E5F Val_Wu8 255.0 DFES_OneToOne 0.00 255.0 FORMAT "%5.1" /end CHARACTERISTIC
/begin CHARACTERISTIC DFC_DisblMsk2.DFC_ORAmin_C "" VALUE 0x80040E60 Val_Wu8 255.0 DFES_OneToOne 0.00 255.0 FORMAT "%5.1" /end CHARACTERISTIC
/begin CHARACTERISTIC DFC_DisblMsk2.DFC_PSR1max_C "" VALUE 0x80040E61 Val_Wu8 255.0 DFES_OneToOne 0.00 255.0 FORMAT "%5.1" /end CHARACTERISTIC
/begin CHARACTERISTIC DFC_DisblMsk2.DFC_PSRBmax_C "" VALUE 0x80040E62 Val_Wu8 255.0 DFES_OneToOne 0.00 255.0 FORMAT "%5.1" /end CHARACTERISTIC
/begin CHARACTERISTIC DFC_DisblMsk2.DFC_PSRBmin_C "" VALUE 0x80040E63 Val_Wu8 255.0 DFES_OneToOne 0.00 255.0 FORMAT "%5.1" /end CHARACTERISTIC
/begin CHARACTERISTIC DFC_DisblMsk2.DFC_PSREmax_C "" VALUE 0x80040E64 Val_Wu8 255.0 DFES_OneToOne 0.00 255.0 FORMAT "%5.1" /end CHARACTERISTIC
/begin CHARACTERISTIC DFC_DisblMsk2.DFC_PSREmin_C "" VALUE 0x80040E65 Val_Wu8 255.0 DFES_OneToOne 0.00 255.0 FORMAT "%5.1" /end CHARACTERISTIC
/begin CHARACTERISTIC DFC_DisblMsk2.DFC_PSRPmax_C "" VALUE 0x80040E66 Val_Wu8 255.0 DFES_OneToOne 0.00 255.0 FORMAT "%5.1" /end CHARACTERISTIC
/begin CHARACTERISTIC DFC_DisblMsk2.DFC_PSRPmin_C "" VALUE 0x80040E67 Val_Wu8 255.0 DFES_OneToOne 0.00 255.0 FORMAT "%5.1" /end CHARACTERISTIC
/begin CHARACTERISTIC DFC_DisblMsk2.DFC_PSRPsig_C "" VALUE 0x80040E68 Val_Wu8 255.0 DFES_OneToOne 0.00 255.0 FORMAT "%5.1" /end CHARACTERISTIC
/begin CHARACTERISTIC DFC_DisblMsk2.DFC_PSRmax_C "" VALUE 0x80040E69 Val_Wu8 255.0 DFES_OneToOne 0.00 255.0 FORMAT "%5.1" /end CHARACTERISTIC
/begin CHARACTERISTIC DFC_DisblMsk2.DFC_SSpMon1_C "" VALUE 0x80040E6A Val_Wu8 255.0 DFES_OneToOne 0.00 255.0 FORMAT "%5.1" /end CHARACTERISTIC
/begin CHARACTERISTIC DFC_DisblMsk2.DFC_SSpMon2_C "" VALUE 0x80040E6B Val_Wu8 255.0 DFES_OneToOne 0.00 255.0 FORMAT "%5.1" /end CHARACTERISTIC
/begin CHARACTERISTIC DFC_DisblMsk2.DFC_SSpMon3_C "" VALUE 0x80040E6C Val_Wu8 255.0 DFES_OneToOne 0.00 255.0 FORMAT "%5.1" /end CHARACTERISTIC
/begin CHARACTERISTIC DFC_DisblMsk2.DFC_SWReset_0_C "" VALUE 0x80040E6D Val_Wu8 255.0 DFES_OneToOne 0.00 255.0 FORMAT "%5.1" /end CHARACTERISTIC
/begin CHARACTERISTIC DFC_DisblMsk2.DFC_SWReset_1_C "" VALUE 0x80040E6E Val_Wu8 255.0 DFES_OneToOne 0.00 255.0 FORMAT "%5.1" /end CHARACTERISTIC
/begin CHARACTERISTIC DFC_DisblMsk2.DFC_SWReset_2_C "" VALUE 0x80040E6F Val_Wu8 255.0 DFES_OneToOne 0.00 255.0 FORMAT "%5.1" /end CHARACTERISTIC
/begin CHARACTERISTIC DFC_DisblMsk2.DFC_TASREmax_C "" VALUE 0x80040E70 Val_Wu8 255.0 DFES_OneToOne 0.00 255.0 FORMAT "%5.1" /end CHARACTERISTIC
/begin CHARACTERISTIC DFC_DisblMsk2.DFC_TASREmin_C "" VALUE 0x80040E71 Val_Wu8 255.0 DFES_OneToOne 0.00 255.0 FORMAT "%5.1" /end CHARACTERISTIC
/begin CHARACTERISTIC DFC_DisblMsk2.DFC_TASREnpl_C "" VALUE 0x80040E72 Val_Wu8 255.0 DFES_OneToOne 0.00 255.0 FORMAT "%5.1" /end CHARACTERISTIC
/begin CHARACTERISTIC DFC_DisblMsk2.DFC_TASRmax_C "" VALUE 0x80040E73 Val_Wu8 255.0 DFES_OneToOne 0.00 255.0 FORMAT "%5.1" /end CHARACTERISTIC
/begin CHARACTERISTIC DFC_DisblMsk2.DFC_TAmax_C "" VALUE 0x80040E74 Val_Wu8 255.0 DFES_OneToOne 0.00 255.0 FORMAT "%5.1" /end CHARACTERISTIC
/begin CHARACTERISTIC DFC_DisblMsk2.DFC_TEVEmax_C "" VALUE 0x80040E75 Val_Wu8 255.0 DFES_OneToOne 0.00 255.0 FORMAT "%5.1" /end CHARACTERISTIC
/begin CHARACTERISTIC DFC_DisblMsk2.DFC_TEVEmin_C "" VALUE 0x80040E76 Val_Wu8 255.0 DFES_OneToOne 0.00 255.0 FORMAT "%5.1" /end CHARACTERISTIC
/begin CHARACTERISTIC DFC_DisblMsk2.DFC_TEVEsig_C "" VALUE 0x80040E77 Val_Wu8 255.0 DFES_OneToOne 0.00 255.0 FORMAT "%5.1" /end CHARACTERISTIC
/begin CHARACTERISTIC DFC_DisblMsk2.DFC_TMCSmax_C "" VALUE 0x80040E78 Val_Wu8 255.0 DFES_OneToOne 0.00 255.0 FORMAT "%5.1" /end CHARACTERISTIC
/begin CHARACTERISTIC DFC_DisblMsk2.DFC_TMCSmin_C "" VALUE 0x80040E79 Val_Wu8 255.0 DFES_OneToOne 0.00 255.0 FORMAT "%5.1" /end CHARACTERISTIC
/begin CHARACTERISTIC DFC_DisblMsk2.DFC_TMEmax_C "" VALUE 0x80040E7A Val_Wu8 255.0 DFES_OneToOne 0.00 255.0 FORMAT "%5.1" /end CHARACTERISTIC
/begin CHARACTERISTIC DFC_DisblMsk2.DFC_TMEmin_C "" VALUE 0x80040E7B Val_Wu8 255.0 DFES_OneToOne 0.00 255.0 FORMAT "%5.1" /end CHARACTERISTIC
/begin CHARACTERISTIC DFC_DisblMsk2.DFC_TMEnpl_C "" VALUE 0x80040E7C Val_Wu8 255.0 DFES_OneToOne 0.00 255.0 FORMAT "%5.1" /end CHARACTERISTIC
/begin CHARACTERISTIC DFC_DisblMsk2.DFC_TMEsig_C "" VALUE 0x80040E7D Val_Wu8 255.0 DFES_OneToOne 0.00 255.0 FORMAT "%5.1" /end CHARACTERISTIC
/begin CHARACTERISTIC DFC_DisblMsk2.DFC_TMPmax_C "" VALUE 0x80040E7E Val_Wu8 255.0 DFES_OneToOne 0.00 255.0 FORMAT "%5.1" /end CHARACTERISTIC
/begin CHARACTERISTIC DFC_DisblMsk2.DFC_TMPmin_C "" VALUE 0x80040E7F Val_Wu8 255.0 DFES_OneToOne 0.00 255.0 FORMAT "%5.1" /end CHARACTERISTIC
/begin CHARACTERISTIC DFC_DisblMsk2.DFC_TMPnpl_C "" VALUE 0x80040E80 Val_Wu8 255.0 DFES_OneToOne 0.00 255.0 FORMAT "%5.1" /end CHARACTERISTIC
/begin CHARACTERISTIC DFC_DisblMsk2.DFC_TMmax_C "" VALUE 0x80040E81 Val_Wu8 255.0 DFES_OneToOne 0.00 255.0 FORMAT "%5.1" /end CHARACTERISTIC
/begin CHARACTERISTIC DFC_DisblMsk2.DFC_TUMmax_C "" VALUE 0x80040E82 Val_Wu8 255.0 DFES_OneToOne 0.00 255.0 FORMAT "%5.1" /end CHARACTERISTIC
/begin CHARACTERISTIC DFC_DisblMsk2.DFC_TWCCTrimMaxB1_C "" VALUE 0x80040E83 Val_Wu8 255.0 DFES_OneToOne 0.00 255.0 FORMAT "%5.1" /end CHARACTERISTIC
/begin CHARACTERISTIC DFC_DisblMsk2.DFC_TWCCTrimMinB1_C "" VALUE 0x80040E84 Val_Wu8 255.0 DFES_OneToOne 0.00 255.0 FORMAT "%5.1" /end CHARACTERISTIC
/begin CHARACTERISTIC DFC_DisblMsk2.DFC_TWCDPriCatB1_C "" VALUE 0x80040E85 Val_Wu8 255.0 DFES_OneToOne 0.00 255.0 FORMAT "%5.1" /end CHARACTERISTIC
/begin CHARACTERISTIC DFC_DisblMsk2.DFC_UBRmax_C "" VALUE 0x80040E86 Val_Wu8 255.0 DFES_OneToOne 0.00 255.0 FORMAT "%5.1" /end CHARACTERISTIC
/begin CHARACTERISTIC DFC_DisblMsk2.DFC_UBmax_C "" VALUE 0x80040E87 Val_Wu8 255.0 DFES_OneToOne 0.00 255.0 FORMAT "%5.1" /end CHARACTERISTIC
/begin CHARACTERISTIC DFC_DisblMsk2.DFC_UBmin_C "" VALUE 0x80040E88 Val_Wu8 255.0 DFES_OneToOne 0.00 255.0 FORMAT "%5.1" /end CHARACTERISTIC
/begin CHARACTERISTIC DFC_DisblMsk2.DFC_UBnpl_C "" VALUE 0x80040E89 Val_Wu8 255.0 DFES_OneToOne 0.00 255.0 FORMAT "%5.1" /end CHARACTERISTIC
/begin CHARACTERISTIC DFES_Cls.DFC_Unused_C "" VALUE 0x8004031A Val_Wu8 19.00 DFES_OneToOne 0.00 19.00 FORMAT "%5.2" READ_ONLY /end CHARACTERISTIC
/begin CHARACTERISTIC DFES_Cls.DFC_AltMaxPwr_C "" VALUE 0x8004031B Val_Wu8 19.00 DFES_OneToOne 0.00 19.00 FORMAT "%5.2" /end CHARACTERISTIC
/begin CHARACTERISTIC DFES_Cls.DFC_BrkNpl_C "" VALUE 0x8004031C Val_Wu8 19.00 DFES_OneToOne 0.00 19.00 FORMAT "%5.2" /end CHARACTERISTIC
/begin CHARACTERISTIC DFES_Cls.DFC_Cj930SSp1Mon_C "" VALUE 0x8004031D Val_Wu8 19.00 DFES_OneToOne 0.00 19.00 FORMAT "%5.2" /end CHARACTERISTIC
/begin CHARACTERISTIC DFES_Cls.DFC_Cj930SSp2Mon_C "" VALUE 0x8004031E Val_Wu8 19.00 DFES_OneToOne 0.00 19.00 FORMAT "%5.2" /end CHARACTERISTIC
/begin CHARACTERISTIC DFES_Cls.DFC_Cj930SSp3Mon_C "" VALUE 0x8004031F Val_Wu8 19.00 DFES_OneToOne 0.00 19.00 FORMAT "%5.2" /end CHARACTERISTIC
/begin CHARACTERISTIC DFES_Cls.DFC_IdleChrgActrAMax_C "" VALUE 0x80040320 Val_Wu8 19.00 DFES_OneToOne 0.00 19.00 FORMAT "%5.2" /end CHARACTERISTIC
/begin CHARACTERISTIC DFES_Cls.DFC_IdleChrgActrAMin_C "" VALUE 0x80040321 Val_Wu8 19.00 DFES_OneToOne 0.00 19.00 FORMAT "%5.2" /end CHARACTERISTIC
/begin CHARACTERISTIC DFES_Cls.DFC_IdleChrgActrASig_C "" VALUE 0x80040322 Val_Wu8 19.00 DFES_OneToOne 0.00 19.00 FORMAT "%5.2" /end CHARACTERISTIC
/begin CHARACTERISTIC DFES_Cls.DFC_IdleChrgActrBMax_C "" VALUE 0x80040323 Val_Wu8 19.00 DFES_OneToOne 0.00 19.00 FORMAT "%5.2" /end CHARACTERISTIC
/begin CHARACTERISTIC DFES_Cls.DFC_IdleChrgActrBMin_C "" VALUE 0x80040324 Val_Wu8 19.00 DFES_OneToOne 0.00 19.00 FORMAT "%5.2" /end CHARACTERISTIC
/begin CHARACTERISTIC DFES_Cls.DFC_IdleChrgActrBSig_C "" VALUE 0x80040325 Val_Wu8 19.00 DFES_OneToOne 0.00 19.00 FORMAT "%5.2" /end CHARACTERISTIC
/begin CHARACTERISTIC DFES_Cls.DFC_IdleChrgActrGovDeCold_C "" VALUE 0x80040326 Val_Wu8 19.00 DFES_OneToOne 0.00 19.00 FORMAT "%5.2" /end CHARACTERISTIC
/begin CHARACTERISTIC DFES_Cls.DFC_IdleChrgActrGovDeMax_C "" VALUE 0x80040327 Val_Wu8 19.00 DFES_OneToOne 0.00 19.00 FORMAT "%5.2" /end CHARACTERISTIC
/begin CHARACTERISTIC DFES_Cls.DFC_IdleChrgActrGovDeMin_C "" VALUE 0x80040328 Val_Wu8 19.00 DFES_OneToOne 0.00 19.00 FORMAT "%5.2" /end CHARACTERISTIC
/begin CHARACTERISTIC DFES_Cls.DFC_IdleChrgActrNAMax_C "" VALUE 0x80040329 Val_Wu8 19.00 DFES_OneToOne 0.00 19.00 FORMAT "%5.2" /end CHARACTERISTIC
/begin CHARACTERISTIC DFES_Cls.DFC_IdleChrgActrNAMin_C "" VALUE 0x8004032A Val_Wu8 19.00 DFES_OneToOne 0.00 19.00 FORMAT "%5.2" /end CHARACTERISTIC
/begin CHARACTERISTIC DFES_Cls.DFC_IdleChrgActrNASig_C "" VALUE 0x8004032B Val_Wu8 19.00 DFES_OneToOne 0.00 19.00 FORMAT "%5.2" /end CHARACTERISTIC
/begin CHARACTERISTIC DFES_Cls.DFC_IdleChrgActrNBMax_C "" VALUE 0x8004032C Val_Wu8 19.00 DFES_OneToOne 0.00 19.00 FORMAT "%5.2" /end CHARACTERISTIC
/begin CHARACTERISTIC DFES_Cls.DFC_IdleChrgActrNBMin_C "" VALUE 0x8004032D Val_Wu8 19.00 DFES_OneToOne 0.00 19.00 FORMAT "%5.2" /end CHARACTERISTIC
/begin CHARACTERISTIC DFES_Cls.DFC_IdleChrgActrNBSig_C "" VALUE 0x8004032E Val_Wu8 19.00 DFES_OneToOne 0.00 19.00 FORMAT "%5.2" /end CHARACTERISTIC
/begin CHARACTERISTIC DFES_Cls.DFC_IdleChrgActrOverTmp_C "" VALUE 0x8004032F Val_Wu8 19.00 DFES_OneToOne 0.00 19.00 FORMAT "%5.2" /end CHARACTERISTIC
/begin CHARACTERISTIC DFES_Cls.DFC_MonUMaxSupply1_C "" VALUE 0x80040330 Val_Wu8 19.00 DFES_OneToOne 0.00 19.00 FORMAT "%5.2" /end CHARACTERISTIC
/begin CHARACTERISTIC DFES_Cls.DFC_MonUMinSupply1_C "" VALUE 0x80040331 Val_Wu8 19.00 DFES_OneToOne 0.00 19.00 FORMAT "%5.2" /end CHARACTERISTIC
/begin CHARACTERISTIC DFES_Cls.DFC_ClthNplClsd_C "" VALUE 0x80040332 Val_Wu8 19.00 DFES_OneToOne 0.00 19.00 FORMAT "%5.2" /end CHARACTERISTIC
/begin CHARACTERISTIC DFES_Cls.DFC_ClthNplOpn_C "" VALUE 0x80040333 Val_Wu8 19.00 DFES_OneToOne 0.00 19.00 FORMAT "%5.2" /end CHARACTERISTIC
/begin CHARACTERISTIC DFES_Cls.DFC_IgnClPsDevComErr1_C "" VALUE 0x80040334 Val_Wu8 19.00 DFES_OneToOne 0.00 19.00 FORMAT "%5.2" /end CHARACTERISTIC
/begin CHARACTERISTIC DFES_Cls.DFC_IgnClPsOpenLoad0_C "" VALUE 0x80040335 Val_Wu8 19.00 DFES_OneToOne 0.00 19.00 FORMAT "%5.2" /end CHARACTERISTIC
/begin CHARACTERISTIC DFES_Cls.DFC_IgnClPsOpenLoad1_C "" VALUE 0x80040336 Val_Wu8 19.00 DFES_OneToOne 0.00 19.00 FORMAT "%5.2" /end CHARACTERISTIC
/begin CHARACTERISTIC DFES_Cls.DFC_IgnClPsOpenLoad2_C "" VALUE 0x80040337 Val_Wu8 19.00 DFES_OneToOne 0.00 19.00 FORMAT "%5.2" /end CHARACTERISTIC
/begin CHARACTERISTIC DFES_Cls.DFC_IgnClPsShCirBatt0_C "" VALUE 0x80040338 Val_Wu8 19.00 DFES_OneToOne 0.00 19.00 FORMAT "%5.2" /end CHARACTERISTIC
/begin CHARACTERISTIC DFES_Cls.DFC_IgnClPsShCirBatt1_C "" VALUE 0x80040339 Val_Wu8 19.00 DFES_OneToOne 0.00 19.00 FORMAT "%5.2" /end CHARACTERISTIC
/begin CHARACTERISTIC DFES_Cls.DFC_IgnClPsShCirBatt2_C "" VALUE 0x8004033A Val_Wu8 19.00 DFES_OneToOne 0.00 19.00 FORMAT "%5.2" /end CHARACTERISTIC
/begin CHARACTERISTIC DFES_Cls.DFC_IgnClPsShCirGnd0_C "" VALUE 0x8004033B Val_Wu8 19.00 DFES_OneToOne 0.00 19.00 FORMAT "%5.2" /end CHARACTERISTIC
/begin CHARACTERISTIC DFES_Cls.DFC_IgnClPsShCirGnd1_C "" VALUE 0x8004033C Val_Wu8 19.00 DFES_OneToOne 0.00 19.00 FORMAT "%5.2" /end CHARACTERISTIC
/begin CHARACTERISTIC DFES_Cls.DFC_IgnClPsShCirGnd2_C "" VALUE 0x8004033D Val_Wu8 19.00 DFES_OneToOne 0.00 19.00 FORMAT "%5.2" /end CHARACTERISTIC
/begin CHARACTERISTIC DFES_Cls.DFC_KnDetSens1PortAMax_C "" VALUE 0x8004033E Val_Wu8 19.00 DFES_OneToOne 0.00 19.00 FORMAT "%5.2" /end CHARACTERISTIC
/begin CHARACTERISTIC DFES_Cls.DFC_KnDetSens1PortAMin_C "" VALUE 0x8004033F Val_Wu8 19.00 DFES_OneToOne 0.00 19.00 FORMAT "%5.2" /end CHARACTERISTIC
/begin CHARACTERISTIC DFES_Cls.DFC_KnDetSens1PortBMax_C "" VALUE 0x80040340 Val_Wu8 19.00 DFES_OneToOne 0.00 19.00 FORMAT "%5.2" /end CHARACTERISTIC
/begin CHARACTERISTIC DFES_Cls.DFC_KnDetSens1PortBMin_C "" VALUE 0x80040341 Val_Wu8 19.00 DFES_OneToOne 0.00 19.00 FORMAT "%5.2" /end CHARACTERISTIC
/begin CHARACTERISTIC DFES_Cls.DFC_VehVWhlErr_C "" VALUE 0x80040342 Val_Wu8 19.00 DFES_OneToOne 0.00 19.00 FORMAT "%5.2" /end CHARACTERISTIC
/begin CHARACTERISTIC DFES_Cls.DFC_AirCCmprOL_C "" VALUE 0x80040343 Val_Wu8 19.00 DFES_OneToOne 0.00 19.00 FORMAT "%5.2" /end CHARACTERISTIC
/begin CHARACTERISTIC DFES_Cls.DFC_AirCCmprOvrTemp_C "" VALUE 0x80040344 Val_Wu8 19.00 DFES_OneToOne 0.00 19.00 FORMAT "%5.2" /end CHARACTERISTIC
/begin CHARACTERISTIC DFES_Cls.DFC_AirCCmprSCB_C "" VALUE 0x80040345 Val_Wu8 19.00 DFES_OneToOne 0.00 19.00 FORMAT "%5.2" /end CHARACTERISTIC
/begin CHARACTERISTIC DFES_Cls.DFC_AirCCmprSCG_C "" VALUE 0x80040346 Val_Wu8 19.00 DFES_OneToOne 0.00 19.00 FORMAT "%5.2" /end CHARACTERISTIC
/begin CHARACTERISTIC DFES_Cls.DFC_AltIOLdSRCMin_C "" VALUE 0x80040347 Val_Wu8 19.00 DFES_OneToOne 0.00 19.00 FORMAT "%5.2" /end CHARACTERISTIC
/begin CHARACTERISTIC DFES_Cls.DFC_AltIOOL_C "" VALUE 0x80040348 Val_Wu8 19.00 DFES_OneToOne 0.00 19.00 FORMAT "%5.2" /end CHARACTERISTIC
/begin CHARACTERISTIC DFES_Cls.DFC_AltIOOvrTemp_C "" VALUE 0x80040349 Val_Wu8 19.00 DFES_OneToOne 0.00 19.00 FORMAT "%5.2" /end CHARACTERISTIC
/begin CHARACTERISTIC DFES_Cls.DFC_AltIOSCB_C "" VALUE 0x8004034A Val_Wu8 19.00 DFES_OneToOne 0.00 19.00 FORMAT "%5.2" /end CHARACTERISTIC
/begin CHARACTERISTIC DFES_Cls.DFC_AltIOSCG_C "" VALUE 0x8004034B Val_Wu8 19.00 DFES_OneToOne 0.00 19.00 FORMAT "%5.2" /end CHARACTERISTIC
/begin CHARACTERISTIC DFES_Cls.DFC_DevLibBattUHi_C "" VALUE 0x8004034C Val_Wu8 19.00 DFES_OneToOne 0.00 19.00 FORMAT "%5.2" /end CHARACTERISTIC
/begin CHARACTERISTIC DFES_Cls.DFC_DevLibBattULo_C "" VALUE 0x8004034D Val_Wu8 19.00 DFES_OneToOne 0.00 19.00 FORMAT "%5.2" /end CHARACTERISTIC
/begin CHARACTERISTIC DFES_Cls.DFC_FanDIOOL_C "" VALUE 0x8004034E Val_Wu8 19.00 DFES_OneToOne 0.00 19.00 FORMAT "%5.2" /end CHARACTERISTIC
/begin CHARACTERISTIC DFES_Cls.DFC_FanDIOOvrTemp_C "" VALUE 0x8004034F Val_Wu8 19.00 DFES_OneToOne 0.00 19.00 FORMAT "%5.2" /end CHARACTERISTIC
/begin CHARACTERISTIC DFES_Cls.DFC_FanDIOSCB_C "" VALUE 0x80040350 Val_Wu8 19.00 DFES_OneToOne 0.00 19.00 FORMAT "%5.2" /end CHARACTERISTIC
/begin CHARACTERISTIC DFES_Cls.DFC_FanDIOSCG_C "" VALUE 0x80040351 Val_Wu8 19.00 DFES_OneToOne 0.00 19.00 FORMAT "%5.2" /end CHARACTERISTIC
/begin CHARACTERISTIC DFES_Cls.DFC_FanPWMOL_C "" VALUE 0x80040352 Val_Wu8 19.00 DFES_OneToOne 0.00 19.00 FORMAT "%5.2" /end CHARACTERISTIC
/begin CHARACTERISTIC DFES_Cls.DFC_FanPWMOvrTemp_C "" VALUE 0x80040353 Val_Wu8 19.00 DFES_OneToOne 0.00 19.00 FORMAT "%5.2" /end CHARACTERISTIC
/begin CHARACTERISTIC DFES_Cls.DFC_FanPWMSCB_C "" VALUE 0x80040354 Val_Wu8 19.00 DFES_OneToOne 0.00 19.00 FORMAT "%5.2" /end CHARACTERISTIC
/begin CHARACTERISTIC DFES_Cls.DFC_FanPWMSCG_C "" VALUE 0x80040355 Val_Wu8 19.00 DFES_OneToOne 0.00 19.00 FORMAT "%5.2" /end CHARACTERISTIC
/begin CHARACTERISTIC DFES_Cls.DFC_AirCClntPAnaSRCMax_C "" VALUE 0x80040356 Val_Wu8 19.00 DFES_OneToOne 0.00 19.00 FORMAT "%5.2" /end CHARACTERISTIC
/begin CHARACTERISTIC DFES_Cls.DFC_AirCClntPAnaSRCMin_C "" VALUE 0x80040357 Val_Wu8 19.00 DFES_OneToOne 0.00 19.00 FORMAT "%5.2" /end CHARACTERISTIC
/begin CHARACTERISTIC DFES_Cls.DFC_AirCSwtNpl_C "" VALUE 0x80040358 Val_Wu8 19.00 DFES_OneToOne 0.00 19.00 FORMAT "%5.2" /end CHARACTERISTIC
/begin CHARACTERISTIC DFES_Cls.DFC_AirCSwtSig_C "" VALUE 0x80040359 Val_Wu8 19.00 DFES_OneToOne 0.00 19.00 FORMAT "%5.2" /end CHARACTERISTIC
/begin CHARACTERISTIC DFES_Cls.DFC_AltIOLdSRCMax_C "" VALUE 0x8004035A Val_Wu8 19.00 DFES_OneToOne 0.00 19.00 FORMAT "%5.2" /end CHARACTERISTIC
/begin CHARACTERISTIC DFES_Cls.DFC_BrkSig_C "" VALUE 0x8004035B Val_Wu8 19.00 DFES_OneToOne 0.00 19.00 FORMAT "%5.2" /end CHARACTERISTIC
/begin CHARACTERISTIC DFES_Cls.DFC_ClthEPBNpl_C "" VALUE 0x8004035C Val_Wu8 19.00 DFES_OneToOne 0.00 19.00 FORMAT "%5.2" /end CHARACTERISTIC
/begin CHARACTERISTIC DFES_Cls.DFC_ClthEPBSensErr_C "" VALUE 0x8004035D Val_Wu8 19.00 DFES_OneToOne 0.00 19.00 FORMAT "%5.2" /end CHARACTERISTIC
/begin CHARACTERISTIC DFES_Cls.DFC_ClthErr_C "" VALUE 0x8004035E Val_Wu8 19.00 DFES_OneToOne 0.00 19.00 FORMAT "%5.2" /end CHARACTERISTIC
/begin CHARACTERISTIC DFES_Cls.DFC_ClthSig_C "" VALUE 0x8004035F Val_Wu8 19.00 DFES_OneToOne 0.00 19.00 FORMAT "%5.2" /end CHARACTERISTIC
/begin CHARACTERISTIC DFES_Cls.DFC_MILLmpOL_C "" VALUE 0x80040360 Val_Wu8 19.00 DFES_OneToOne 0.00 19.00 FORMAT "%5.2" /end CHARACTERISTIC
/begin CHARACTERISTIC DFES_Cls.DFC_MILLmpSCB_C "" VALUE 0x80040361 Val_Wu8 19.00 DFES_OneToOne 0.00 19.00 FORMAT "%5.2" /end CHARACTERISTIC
/begin CHARACTERISTIC DFES_Cls.DFC_MILLmpSCG_C "" VALUE 0x80040362 Val_Wu8 19.00 DFES_OneToOne 0.00 19.00 FORMAT "%5.2" /end CHARACTERISTIC
/begin CHARACTERISTIC DFES_Cls.DFC_SRCHighAPP1_C "" VALUE 0x80040363 Val_Wu8 19.00 DFES_OneToOne 0.00 19.00 FORMAT "%5.2" /end CHARACTERISTIC
/begin CHARACTERISTIC DFES_Cls.DFC_SRCHighAPP2_C "" VALUE 0x80040364 Val_Wu8 19.00 DFES_OneToOne 0.00 19.00 FORMAT "%5.2" /end CHARACTERISTIC
/begin CHARACTERISTIC DFES_Cls.DFC_SRCLowAPP1_C "" VALUE 0x80040365 Val_Wu8 19.00 DFES_OneToOne 0.00 19.00 FORMAT "%5.2" /end CHARACTERISTIC
/begin CHARACTERISTIC DFES_Cls.DFC_SRCLowAPP2_C "" VALUE 0x80040366 Val_Wu8 19.00 DFES_OneToOne 0.00 19.00 FORMAT "%5.2" /end CHARACTERISTIC
/begin CHARACTERISTIC DFES_Cls.DFC_SyncAPP_C "" VALUE 0x80040367 Val_Wu8 19.00 DFES_OneToOne 0.00 19.00 FORMAT "%5.2" /end CHARACTERISTIC
/begin CHARACTERISTIC DFES_Cls.DFC_VehVMax_C "" VALUE 0x80040368 Val_Wu8 19.00 DFES_OneToOne 0.00 19.00 FORMAT "%5.2" /end CHARACTERISTIC
/begin CHARACTERISTIC DFES_Cls.DFC_VehVPlaus_C "" VALUE 0x80040369 Val_Wu8 19.00 DFES_OneToOne 0.00 19.00 FORMAT "%5.2" /end CHARACTERISTIC
/begin CHARACTERISTIC DFES_Cls.DFC_VehVSig_C "" VALUE 0x8004036A Val_Wu8 19.00 DFES_OneToOne 0.00 19.00 FORMAT "%5.2" /end CHARACTERISTIC
/begin CHARACTERISTIC DFES_Cls.DFC_BusDiagBusOffNodeA_C "" VALUE 0x8004036B Val_Wu8 19.00 DFES_OneToOne 0.00 19.00 FORMAT "%5.2" /end CHARACTERISTIC
/begin CHARACTERISTIC DFES_Cls.DFC_ComACSensTO_C "" VALUE 0x8004036C Val_Wu8 19.00 DFES_OneToOne 0.00 19.00 FORMAT "%5.2" /end CHARACTERISTIC
/begin CHARACTERISTIC DFES_Cls.DFC_ComAWD1TO_C "" VALUE 0x8004036D Val_Wu8 19.00 DFES_OneToOne 0.00 19.00 FORMAT "%5.2" /end CHARACTERISTIC
/begin CHARACTERISTIC DFES_Cls.DFC_ComBRK10TO_C "" VALUE 0x8004036E Val_Wu8 19.00 DFES_OneToOne 0.00 19.00 FORMAT "%5.2" /end CHARACTERISTIC
/begin CHARACTERISTIC DFES_Cls.DFC_ComGW11TO_C "" VALUE 0x8004036F Val_Wu8 19.00 DFES_OneToOne 0.00 19.00 FORMAT "%5.2" /end CHARACTERISTIC
/begin CHARACTERISTIC DFES_Cls.DFC_ComLVL1TO_C "" VALUE 0x80040370 Val_Wu8 19.00 DFES_OneToOne 0.00 19.00 FORMAT "%5.2" /end CHARACTERISTIC
/begin CHARACTERISTIC DFES_Cls.DFC_ComPRKA01TO_C "" VALUE 0x80040371 Val_Wu8 19.00 DFES_OneToOne 0.00 19.00 FORMAT "%5.2" /end CHARACTERISTIC
/begin CHARACTERISTIC DFES_Cls.DFC_ComPRKH01TO_C "" VALUE 0x80040372 Val_Wu8 19.00 DFES_OneToOne 0.00 19.00 FORMAT "%5.2" /end CHARACTERISTIC
/begin CHARACTERISTIC DFES_Cls.DFC_ComPRKH1TO_C "" VALUE 0x80040373 Val_Wu8 19.00 DFES_OneToOne 0.00 19.00 FORMAT "%5.2" /end CHARACTERISTIC
/begin CHARACTERISTIC DFES_Cls.DFC_ComTRBCH1TO_C "" VALUE 0x80040374 Val_Wu8 19.00 DFES_OneToOne 0.00 19.00 FORMAT "%5.2" /end CHARACTERISTIC
/begin CHARACTERISTIC DFES_Cls.DFC_ComTRBCH2TO_C "" VALUE 0x80040375 Val_Wu8 19.00 DFES_OneToOne 0.00 19.00 FORMAT "%5.2" /end CHARACTERISTIC
/begin CHARACTERISTIC DFES_Cls.DFC_DK_C "" VALUE 0x80040376 Val_Wu8 19.00 DFES_OneToOne 0.00 19.00 FORMAT "%5.2" /end CHARACTERISTIC
/begin CHARACTERISTIC DFES_Cls.DFC_DKRSA_C "" VALUE 0x80040377 Val_Wu8 19.00 DFES_OneToOne 0.00 19.00 FORMAT "%5.2" /end CHARACTERISTIC
/begin CHARACTERISTIC DFES_Cls.DFC_DKVSmax_C "" VALUE 0x80040378 Val_Wu8 19.00 DFES_OneToOne 0.00 19.00 FORMAT "%5.2" /end CHARACTERISTIC
/begin CHARACTERISTIC DFES_Cls.DFC_DKmax_C "" VALUE 0x80040379 Val_Wu8 19.00 DFES_OneToOne 0.00 19.00 FORMAT "%5.2" /end CHARACTERISTIC
/begin CHARACTERISTIC DFES_Cls.DFC_DKmin_C "" VALUE 0x8004037A Val_Wu8 19.00 DFES_OneToOne 0.00 19.00 FORMAT "%5.2" /end CHARACTERISTIC
/begin CHARACTERISTIC DFES_Cls.DFC_DSSmax_C "" VALUE 0x8004037B Val_Wu8 19.00 DFES_OneToOne 0.00 19.00 FORMAT "%5.2" /end CHARACTERISTIC
/begin CHARACTERISTIC DFES_Cls.DFC_EEPEraseErr_C "" VALUE 0x8004037C Val_Wu8 19.00 DFES_OneToOne 0.00 19.00 FORMAT "%5.2" /end CHARACTERISTIC
/begin CHARACTERISTIC DFES_Cls.DFC_EEPRdErr_C "" VALUE 0x8004037D Val_Wu8 19.00 DFES_OneToOne 0.00 19.00 FORMAT "%5.2" /end CHARACTERISTIC
/begin CHARACTERISTIC DFES_Cls.DFC_EEPWrErr_C "" VALUE 0x8004037E Val_Wu8 19.00 DFES_OneToOne 0.00 19.00 FORMAT "%5.2" /end CHARACTERISTIC
/begin CHARACTERISTIC DFES_Cls.DFC_EV1max_C "" VALUE 0x8004037F Val_Wu8 19.00 DFES_OneToOne 0.00 19.00 FORMAT "%5.2" /end CHARACTERISTIC
/begin CHARACTERISTIC DFES_Cls.DFC_EV1min_C "" VALUE 0x80040380 Val_Wu8 19.00 DFES_OneToOne 0.00 19.00 FORMAT "%5.2" /end CHARACTERISTIC
/begin CHARACTERISTIC DFES_Cls.DFC_EV1sig_C "" VALUE 0x80040381 Val_Wu8 19.00 DFES_OneToOne 0.00 19.00 FORMAT "%5.2" /end CHARACTERISTIC
/begin CHARACTERISTIC DFES_Cls.DFC_EV2max_C "" VALUE 0x80040382 Val_Wu8 19.00 DFES_OneToOne 0.00 19.00 FORMAT "%5.2" /end CHARACTERISTIC
/begin CHARACTERISTIC DFES_Cls.DFC_EV2min_C "" VALUE 0x80040383 Val_Wu8 19.00 DFES_OneToOne 0.00 19.00 FORMAT "%5.2" /end CHARACTERISTIC
/begin CHARACTERISTIC DFES_Cls.DFC_EV2sig_C "" VALUE 0x80040384 Val_Wu8 19.00 DFES_OneToOne 0.00 19.00 FORMAT "%5.2" /end CHARACTERISTIC
/begin CHARACTERISTIC DFES_Cls.DFC_EV3max_C "" VALUE 0x80040385 Val_Wu8 19.00 DFES_OneToOne 0.00 19.00 FORMAT "%5.2" /end CHARACTERISTIC
/begin CHARACTERISTIC DFES_Cls.DFC_EV3min_C "" VALUE 0x80040386 Val_Wu8 19.00 DFES_OneToOne 0.00 19.00 FORMAT "%5.2" /end CHARACTERISTIC
/begin CHARACTERISTIC DFES_Cls.DFC_EV3sig_C "" VALUE 0x80040387 Val_Wu8 19.00 DFES_OneToOne 0.00 19.00 FORMAT "%5.2" /end CHARACTERISTIC
/begin CHARACTERISTIC DFES_Cls.DFC_EpmCaSI1ErrSig_C "" VALUE 0x80040388 Val_Wu8 19.00 DFES_OneToOne 0.00 19.00 FORMAT "%5.2" /end CHARACTERISTIC
/begin CHARACTERISTIC DFES_Cls.DFC_EpmCaSI1NoSig_C "" VALUE 0x80040389 Val_Wu8 19.00 DFES_OneToOne 0.00 19.00 FORMAT "%5.2" /end CHARACTERISTIC
/begin CHARACTERISTIC DFES_Cls.DFC_EpmCaSI1NoSigMax_C "" VALUE 0x8004038A Val_Wu8 19.00 DFES_OneToOne 0.00 19.00 FORMAT "%5.2" /end CHARACTERISTIC
/begin CHARACTERISTIC DFES_Cls.DFC_EpmCaSI1NoSigMin_C "" VALUE 0x8004038B Val_Wu8 19.00 DFES_OneToOne 0.00 19.00 FORMAT "%5.2" /end CHARACTERISTIC
/begin CHARACTERISTIC DFES_Cls.DFC_EpmCaSI1OfsErr_C "" VALUE 0x8004038C Val_Wu8 19.00 DFES_OneToOne 0.00 19.00 FORMAT "%5.2" /end CHARACTERISTIC
/begin CHARACTERISTIC DFES_Cls.DFC_EpmCrSErrSig_C "" VALUE 0x8004038D Val_Wu8 19.00 DFES_OneToOne 0.00 19.00 FORMAT "%5.2" /end CHARACTERISTIC
/begin CHARACTERISTIC DFES_Cls.DFC_EpmCrSNoSig_C "" VALUE 0x8004038E Val_Wu8 19.00 DFES_OneToOne 0.00 19.00 FORMAT "%5.2" /end CHARACTERISTIC
/begin CHARACTERISTIC DFES_Cls.DFC_FRAmax_C "" VALUE 0x8004038F Val_Wu8 19.00 DFES_OneToOne 0.00 19.00 FORMAT "%5.2" /end CHARACTERISTIC
/begin CHARACTERISTIC DFES_Cls.DFC_FRAmin_C "" VALUE 0x80040390 Val_Wu8 19.00 DFES_OneToOne 0.00 19.00 FORMAT "%5.2" /end CHARACTERISTIC
/begin CHARACTERISTIC DFES_Cls.DFC_HEGOS1B1ElecMax_C "" VALUE 0x80040391 Val_Wu8 19.00 DFES_OneToOne 0.00 19.00 FORMAT "%5.2" /end CHARACTERISTIC
/begin CHARACTERISTIC DFES_Cls.DFC_HEGOS1B1ElecMin_C "" VALUE 0x80040392 Val_Wu8 19.00 DFES_OneToOne 0.00 19.00 FORMAT "%5.2" /end CHARACTERISTIC
/begin CHARACTERISTIC DFES_Cls.DFC_HEGOS1B1ElecNpl_C "" VALUE 0x80040393 Val_Wu8 19.00 DFES_OneToOne 0.00 19.00 FORMAT "%5.2" /end CHARACTERISTIC
/begin CHARACTERISTIC DFES_Cls.DFC_HEGOS1B1ElecSig_C "" VALUE 0x80040394 Val_Wu8 19.00 DFES_OneToOne 0.00 19.00 FORMAT "%5.2" /end CHARACTERISTIC
/begin CHARACTERISTIC DFES_Cls.DFC_HEGOS1B1HtgNpl_C "" VALUE 0x80040395 Val_Wu8 19.00 DFES_OneToOne 0.00 19.00 FORMAT "%5.2" /end CHARACTERISTIC
/begin CHARACTERISTIC DFES_Cls.DFC_HEGOS1B1HtrPsMax_C "" VALUE 0x80040396 Val_Wu8 19.00 DFES_OneToOne 0.00 19.00 FORMAT "%5.2" /end CHARACTERISTIC
/begin CHARACTERISTIC DFES_Cls.DFC_HEGOS1B1HtrPsMin_C "" VALUE 0x80040397 Val_Wu8 19.00 DFES_OneToOne 0.00 19.00 FORMAT "%5.2" /end CHARACTERISTIC
/begin CHARACTERISTIC DFES_Cls.DFC_HEGOS1B1HtrPsSig_C "" VALUE 0x80040398 Val_Wu8 19.00 DFES_OneToOne 0.00 19.00 FORMAT "%5.2" /end CHARACTERISTIC
/begin CHARACTERISTIC DFES_Cls.DFC_HEGOS1B1StkMax_C "" VALUE 0x80040399 Val_Wu8 19.00 DFES_OneToOne 0.00 19.00 FORMAT "%5.2" /end CHARACTERISTIC
/begin CHARACTERISTIC DFES_Cls.DFC_HEGOS1B1StkMin_C "" VALUE 0x8004039A Val_Wu8 19.00 DFES_OneToOne 0.00 19.00 FORMAT "%5.2" /end CHARACTERISTIC
/begin CHARACTERISTIC DFES_Cls.DFC_HEGOS2B1RstrcnLean_C "" VALUE 0x8004039B Val_Wu8 19.00 DFES_OneToOne 0.00 19.00 FORMAT "%5.2" /end CHARACTERISTIC
/begin CHARACTERISTIC DFES_Cls.DFC_HEGOS2B1RstrcnRich_C "" VALUE 0x8004039C Val_Wu8 19.00 DFES_OneToOne 0.00 19.00 FORMAT "%5.2" /end CHARACTERISTIC
/begin CHARACTERISTIC DFES_Cls.DFC_IdleChrgActrJamVlvClsd_C "" VALUE 0x8004039D Val_Wu8 19.00 DFES_OneToOne 0.00 19.00 FORMAT "%5.2" /end CHARACTERISTIC
/begin CHARACTERISTIC DFES_Cls.DFC_IdleChrgActrJamVlvOpn_C "" VALUE 0x8004039E Val_Wu8 19.00 DFES_OneToOne 0.00 19.00 FORMAT "%5.2" /end CHARACTERISTIC
/begin CHARACTERISTIC DFES_Cls.DFC_IgnClPsDevOscErr1_C "" VALUE 0x8004039F Val_Wu8 19.00 DFES_OneToOne 0.00 19.00 FORMAT "%5.2" /end CHARACTERISTIC
/begin CHARACTERISTIC DFES_Cls.DFC_KPEmax_C "" VALUE 0x800403A0 Val_Wu8 19.00 DFES_OneToOne 0.00 19.00 FORMAT "%5.2" /end CHARACTERISTIC
/begin CHARACTERISTIC DFES_Cls.DFC_KPEmin_C "" VALUE 0x800403A1 Val_Wu8 19.00 DFES_OneToOne 0.00 19.00 FORMAT "%5.2" /end CHARACTERISTIC
/begin CHARACTERISTIC DFES_Cls.DFC_KPEsig_C "" VALUE 0x800403A2 Val_Wu8 19.00 DFES_OneToOne 0.00 19.00 FORMAT "%5.2" /end CHARACTERISTIC
/begin CHARACTERISTIC DFES_Cls.DFC_KS1max_C "" VALUE 0x800403A3 Val_Wu8 19.00 DFES_OneToOne 0.00 19.00 FORMAT "%5.2" /end CHARACTERISTIC
/begin CHARACTERISTIC DFES_Cls.DFC_KS1min_C "" VALUE 0x800403A4 Val_Wu8 19.00 DFES_OneToOne 0.00 19.00 FORMAT "%5.2" /end CHARACTERISTIC
/begin CHARACTERISTIC DFES_Cls.DFC_LLRKHmax_C "" VALUE 0x800403A5 Val_Wu8 19.00 DFES_OneToOne 0.00 19.00 FORMAT "%5.2" /end CHARACTERISTIC
/begin CHARACTERISTIC DFES_Cls.DFC_LLRKHmin_C "" VALUE 0x800403A6 Val_Wu8 19.00 DFES_OneToOne 0.00 19.00 FORMAT "%5.2" /end CHARACTERISTIC
/begin CHARACTERISTIC DFES_Cls.DFC_LLRKHnpl_C "" VALUE 0x800403A7 Val_Wu8 19.00 DFES_OneToOne 0.00 19.00 FORMAT "%5.2" /end CHARACTERISTIC
/begin CHARACTERISTIC DFES_Cls.DFC_LLRmax_C "" VALUE 0x800403A8 Val_Wu8 19.00 DFES_OneToOne 0.00 19.00 FORMAT "%5.2" /end CHARACTERISTIC
/begin CHARACTERISTIC DFES_Cls.DFC_LLRmin_C "" VALUE 0x800403A9 Val_Wu8 19.00 DFES_OneToOne 0.00 19.00 FORMAT "%5.2" /end CHARACTERISTIC
/begin CHARACTERISTIC DFES_Cls.DFC_LLRnpl_C "" VALUE 0x800403AA Val_Wu8 19.00 DFES_OneToOne 0.00 19.00 FORMAT "%5.2" /end CHARACTERISTIC
/begin CHARACTERISTIC DFES_Cls.DFC_LMmax_C "" VALUE 0x800403AB Val_Wu8 19.00 DFES_OneToOne 0.00 19.00 FORMAT "%5.2" /end CHARACTERISTIC
/begin CHARACTERISTIC DFES_Cls.DFC_LZSRnpl_C "" VALUE 0x800403AC Val_Wu8 19.00 DFES_OneToOne 0.00 19.00 FORMAT "%5.2" /end CHARACTERISTIC
/begin CHARACTERISTIC DFES_Cls.DFC_MD_C "" VALUE 0x800403AD Val_Wu8 19.00 DFES_OneToOne 0.00 19.00 FORMAT "%5.2" /end CHARACTERISTIC
/begin CHARACTERISTIC DFES_Cls.DFC_MD00min_C "" VALUE 0x800403AE Val_Wu8 19.00 DFES_OneToOne 0.00 19.00 FORMAT "%5.2" /end CHARACTERISTIC
/begin CHARACTERISTIC DFES_Cls.DFC_MD00npl_C "" VALUE 0x800403AF Val_Wu8 19.00 DFES_OneToOne 0.00 19.00 FORMAT "%5.2" /end CHARACTERISTIC
/begin CHARACTERISTIC DFES_Cls.DFC_MD01min_C "" VALUE 0x800403B0 Val_Wu8 19.00 DFES_OneToOne 0.00 19.00 FORMAT "%5.2" /end CHARACTERISTIC
/begin CHARACTERISTIC DFES_Cls.DFC_MD01npl_C "" VALUE 0x800403B1 Val_Wu8 19.00 DFES_OneToOne 0.00 19.00 FORMAT "%5.2" /end CHARACTERISTIC
/begin CHARACTERISTIC DFES_Cls.DFC_MD02min_C "" VALUE 0x800403B2 Val_Wu8 19.00 DFES_OneToOne 0.00 19.00 FORMAT "%5.2" /end CHARACTERISTIC
/begin CHARACTERISTIC DFES_Cls.DFC_MD02npl_C "" VALUE 0x800403B3 Val_Wu8 19.00 DFES_OneToOne 0.00 19.00 FORMAT "%5.2" /end CHARACTERISTIC
/begin CHARACTERISTIC DFES_Cls.DFC_MD03min_C "" VALUE 0x800403B4 Val_Wu8 19.00 DFES_OneToOne 0.00 19.00 FORMAT "%5.2" /end CHARACTERISTIC
/begin CHARACTERISTIC DFES_Cls.DFC_MD03npl_C "" VALUE 0x800403B5 Val_Wu8 19.00 DFES_OneToOne 0.00 19.00 FORMAT "%5.2" /end CHARACTERISTIC
/begin CHARACTERISTIC DFES_Cls.DFC_MD04min_C "" VALUE 0x800403B6 Val_Wu8 19.00 DFES_OneToOne 0.00 19.00 FORMAT "%5.2" /end CHARACTERISTIC
/begin CHARACTERISTIC DFES_Cls.DFC_MD04npl_C "" VALUE 0x800403B7 Val_Wu8 19.00 DFES_OneToOne 0.00 19.00 FORMAT "%5.2" /end CHARACTERISTIC
/begin CHARACTERISTIC DFES_Cls.DFC_MDCyl_0_C "" VALUE 0x800403B8 Val_Wu8 19.00 DFES_OneToOne 0.00 19.00 FORMAT "%5.2" /end CHARACTERISTIC
/begin CHARACTERISTIC DFES_Cls.DFC_MDCyl_1_C "" VALUE 0x800403B9 Val_Wu8 19.00 DFES_OneToOne 0.00 19.00 FORMAT "%5.2" /end CHARACTERISTIC
/begin CHARACTERISTIC DFES_Cls.DFC_MDCyl_2_C "" VALUE 0x800403BA Val_Wu8 19.00 DFES_OneToOne 0.00 19.00 FORMAT "%5.2" /end CHARACTERISTIC
/begin CHARACTERISTIC DFES_Cls.DFC_MDFC_C "" VALUE 0x800403BB Val_Wu8 19.00 DFES_OneToOne 0.00 19.00 FORMAT "%5.2" /end CHARACTERISTIC
/begin CHARACTERISTIC DFES_Cls.DFC_MDmin_C "" VALUE 0x800403BC Val_Wu8 19.00 DFES_OneToOne 0.00 19.00 FORMAT "%5.2" /end CHARACTERISTIC
/begin CHARACTERISTIC DFES_Cls.DFC_MDnpl_C "" VALUE 0x800403BD Val_Wu8 19.00 DFES_OneToOne 0.00 19.00 FORMAT "%5.2" /end CHARACTERISTIC
/begin CHARACTERISTIC DFES_Cls.DFC_MoCADCNTP_C "" VALUE 0x800403BE Val_Wu8 19.00 DFES_OneToOne 0.00 19.00 FORMAT "%5.2" /end CHARACTERISTIC
/begin CHARACTERISTIC DFES_Cls.DFC_MoCADCTst_C "" VALUE 0x800403BF Val_Wu8 19.00 DFES_OneToOne 0.00 19.00 FORMAT "%5.2" /end CHARACTERISTIC
/begin CHARACTERISTIC DFES_Cls.DFC_MoCComctErrMM_C "" VALUE 0x800403C0 Val_Wu8 19.00 DFES_OneToOne 0.00 19.00 FORMAT "%5.2" /end CHARACTERISTIC
/begin CHARACTERISTIC DFES_Cls.DFC_OCWDAActv_C "" VALUE 0x800403C1 Val_Wu8 19.00 DFES_OneToOne 0.00 19.00 FORMAT "%5.2" /end CHARACTERISTIC
/begin CHARACTERISTIC DFES_Cls.DFC_OCWDACom_C "" VALUE 0x800403C2 Val_Wu8 19.00 DFES_OneToOne 0.00 19.00 FORMAT "%5.2" /end CHARACTERISTIC
/begin CHARACTERISTIC DFES_Cls.DFC_ORAmax_C "" VALUE 0x800403C3 Val_Wu8 19.00 DFES_OneToOne 0.00 19.00 FORMAT "%5.2" /end CHARACTERISTIC
/begin CHARACTERISTIC DFES_Cls.DFC_ORAmin_C "" VALUE 0x800403C4 Val_Wu8 19.00 DFES_OneToOne 0.00 19.00 FORMAT "%5.2" /end CHARACTERISTIC
/begin CHARACTERISTIC DFES_Cls.DFC_PSR1max_C "" VALUE 0x800403C5 Val_Wu8 19.00 DFES_OneToOne 0.00 19.00 FORMAT "%5.2" /end CHARACTERISTIC
/begin CHARACTERISTIC DFES_Cls.DFC_PSRBmax_C "" VALUE 0x800403C6 Val_Wu8 19.00 DFES_OneToOne 0.00 19.00 FORMAT "%5.2" /end CHARACTERISTIC
/begin CHARACTERISTIC DFES_Cls.DFC_PSRBmin_C "" VALUE 0x800403C7 Val_Wu8 19.00 DFES_OneToOne 0.00 19.00 FORMAT "%5.2" /end CHARACTERISTIC
/begin CHARACTERISTIC DFES_Cls.DFC_PSREmax_C "" VALUE 0x800403C8 Val_Wu8 19.00 DFES_OneToOne 0.00 19.00 FORMAT "%5.2" /end CHARACTERISTIC
/begin CHARACTERISTIC DFES_Cls.DFC_PSREmin_C "" VALUE 0x800403C9 Val_Wu8 19.00 DFES_OneToOne 0.00 19.00 FORMAT "%5.2" /end CHARACTERISTIC
/begin CHARACTERISTIC DFES_Cls.DFC_PSRPmax_C "" VALUE 0x800403CA Val_Wu8 19.00 DFES_OneToOne 0.00 19.00 FORMAT "%5.2" /end CHARACTERISTIC
/begin CHARACTERISTIC DFES_Cls.DFC_PSRPmin_C "" VALUE 0x800403CB Val_Wu8 19.00 DFES_OneToOne 0.00 19.00 FORMAT "%5.2" /end CHARACTERISTIC
/begin CHARACTERISTIC DFES_Cls.DFC_PSRPsig_C "" VALUE 0x800403CC Val_Wu8 19.00 DFES_OneToOne 0.00 19.00 FORMAT "%5.2" /end CHARACTERISTIC
/begin CHARACTERISTIC DFES_Cls.DFC_PSRmax_C "" VALUE 0x800403CD Val_Wu8 19.00 DFES_OneToOne 0.00 19.00 FORMAT "%5.2" /end CHARACTERISTIC
/begin CHARACTERISTIC DFES_Cls.DFC_SSpMon1_C "" VALUE 0x800403CE Val_Wu8 19.00 DFES_OneToOne 0.00 19.00 FORMAT "%5.2" /end CHARACTERISTIC
/begin CHARACTERISTIC DFES_Cls.DFC_SSpMon2_C "" VALUE 0x800403CF Val_Wu8 19.00 DFES_OneToOne 0.00 19.00 FORMAT "%5.2" /end CHARACTERISTIC
/begin CHARACTERISTIC DFES_Cls.DFC_SSpMon3_C "" VALUE 0x800403D0 Val_Wu8 19.00 DFES_OneToOne 0.00 19.00 FORMAT "%5.2" /end CHARACTERISTIC
/begin CHARACTERISTIC DFES_Cls.DFC_SWReset_0_C "" VALUE 0x800403D1 Val_Wu8 19.00 DFES_OneToOne 0.00 19.00 FORMAT "%5.2" /end CHARACTERISTIC
/begin CHARACTERISTIC DFES_Cls.DFC_SWReset_1_C "" VALUE 0x800403D2 Val_Wu8 19.00 DFES_OneToOne 0.00 19.00 FORMAT "%5.2" /end CHARACTERISTIC
/begin CHARACTERISTIC DFES_Cls.DFC_SWReset_2_C "" VALUE 0x800403D3 Val_Wu8 19.00 DFES_OneToOne 0.00 19.00 FORMAT "%5.2" /end CHARACTERISTIC
/begin CHARACTERISTIC DFES_Cls.DFC_TASREmax_C "" VALUE 0x800403D4 Val_Wu8 19.00 DFES_OneToOne 0.00 19.00 FORMAT "%5.2" /end CHARACTERISTIC
/begin CHARACTERISTIC DFES_Cls.DFC_TASREmin_C "" VALUE 0x800403D5 Val_Wu8 19.00 DFES_OneToOne 0.00 19.00 FORMAT "%5.2" /end CHARACTERISTIC
/begin CHARACTERISTIC DFES_Cls.DFC_TASREnpl_C "" VALUE 0x800403D6 Val_Wu8 19.00 DFES_OneToOne 0.00 19.00 FORMAT "%5.2" /end CHARACTERISTIC
/begin CHARACTERISTIC DFES_Cls.DFC_TASRmax_C "" VALUE 0x800403D7 Val_Wu8 19.00 DFES_OneToOne 0.00 19.00 FORMAT "%5.2" /end CHARACTERISTIC
/begin CHARACTERISTIC DFES_Cls.DFC_TAmax_C "" VALUE 0x800403D8 Val_Wu8 19.00 DFES_OneToOne 0.00 19.00 FORMAT "%5.2" /end CHARACTERISTIC
/begin CHARACTERISTIC DFES_Cls.DFC_TEVEmax_C "" VALUE 0x800403D9 Val_Wu8 19.00 DFES_OneToOne 0.00 19.00 FORMAT "%5.2" /end CHARACTERISTIC
/begin CHARACTERISTIC DFES_Cls.DFC_TEVEmin_C "" VALUE 0x800403DA Val_Wu8 19.00 DFES_OneToOne 0.00 19.00 FORMAT "%5.2" /end CHARACTERISTIC
/begin CHARACTERISTIC DFES_Cls.DFC_TEVEsig_C "" VALUE 0x800403DB Val_Wu8 19.00 DFES_OneToOne 0.00 19.00 FORMAT "%5.2" /end CHARACTERISTIC
/begin CHARACTERISTIC DFES_Cls.DFC_TMCSmax_C "" VALUE 0x800403DC Val_Wu8 19.00 DFES_OneToOne 0.00 19.00 FORMAT "%5.2" /end CHARACTERISTIC
/begin CHARACTERISTIC DFES_Cls.DFC_TMCSmin_C "" VALUE 0x800403DD Val_Wu8 19.00 DFES_OneToOne 0.00 19.00 FORMAT "%5.2" /end CHARACTERISTIC
/begin CHARACTERISTIC DFES_Cls.DFC_TMEmax_C "" VALUE 0x800403DE Val_Wu8 19.00 DFES_OneToOne 0.00 19.00 FORMAT "%5.2" /end CHARACTERISTIC
/begin CHARACTERISTIC DFES_Cls.DFC_TMEmin_C "" VALUE 0x800403DF Val_Wu8 19.00 DFES_OneToOne 0.00 19.00 FORMAT "%5.2" /end CHARACTERISTIC
/begin CHARACTERISTIC DFES_Cls.DFC_TMEnpl_C "" VALUE 0x800403E0 Val_Wu8 19.00 DFES_OneToOne 0.00 19.00 FORMAT "%5.2" /end CHARACTERISTIC
/begin CHARACTERISTIC DFES_Cls.DFC_TMEsig_C "" VALUE 0x800403E1 Val_Wu8 19.00 DFES_OneToOne 0.00 19.00 FORMAT "%5.2" /end CHARACTERISTIC
/begin CHARACTERISTIC DFES_Cls.DFC_TMPmax_C "" VALUE 0x800403E2 Val_Wu8 19.00 DFES_OneToOne 0.00 19.00 FORMAT "%5.2" /end CHARACTERISTIC
/begin CHARACTERISTIC DFES_Cls.DFC_TMPmin_C "" VALUE 0x800403E3 Val_Wu8 19.00 DFES_OneToOne 0.00 19.00 FORMAT "%5.2" /end CHARACTERISTIC
/begin CHARACTERISTIC DFES_Cls.DFC_TMPnpl_C "" VALUE 0x800403E4 Val_Wu8 19.00 DFES_OneToOne 0.00 19.00 FORMAT "%5.2" /end CHARACTERISTIC
/begin CHARACTERISTIC DFES_Cls.DFC_TMmax_C "" VALUE 0x800403E5 Val_Wu8 19.00 DFES_OneToOne 0.00 19.00 FORMAT "%5.2" /end CHARACTERISTIC
/begin CHARACTERISTIC DFES_Cls.DFC_TUMmax_C "" VALUE 0x800403E6 Val_Wu8 19.00 DFES_OneToOne 0.00 19.00 FORMAT "%5.2" /end CHARACTERISTIC
/begin CHARACTERISTIC DFES_Cls.DFC_TWCCTrimMaxB1_C "" VALUE 0x800403E7 Val_Wu8 19.00 DFES_OneToOne 0.00 19.00 FORMAT "%5.2" /end CHARACTERISTIC
/begin CHARACTERISTIC DFES_Cls.DFC_TWCCTrimMinB1_C "" VALUE 0x800403E8 Val_Wu8 19.00 DFES_OneToOne 0.00 19.00 FORMAT "%5.2" /end CHARACTERISTIC
/begin CHARACTERISTIC DFES_Cls.DFC_TWCDPriCatB1_C "" VALUE 0x800403E9 Val_Wu8 19.00 DFES_OneToOne 0.00 19.00 FORMAT "%5.2" /end CHARACTERISTIC
/begin CHARACTERISTIC DFES_Cls.DFC_UBRmax_C "" VALUE 0x800403EA Val_Wu8 19.00 DFES_OneToOne 0.00 19.00 FORMAT "%5.2" /end CHARACTERISTIC
/begin CHARACTERISTIC DFES_Cls.DFC_UBmax_C "" VALUE 0x800403EB Val_Wu8 19.00 DFES_OneToOne 0.00 19.00 FORMAT "%5.2" /end CHARACTERISTIC
/begin CHARACTERISTIC DFES_Cls.DFC_UBmin_C "" VALUE 0x800403EC Val_Wu8 19.00 DFES_OneToOne 0.00 19.00 FORMAT "%5.2" /end CHARACTERISTIC
/begin CHARACTERISTIC DFES_Cls.DFC_UBnpl_C "" VALUE 0x800403ED Val_Wu8 19.00 DFES_OneToOne 0.00 19.00 FORMAT "%5.2" /end CHARACTERISTIC
/begin CHARACTERISTIC DFES_DbLv.DFC_Unused_C "" VALUE 0x8004181E Val_Wu8 15.00 DFES_OneToOne 0.00 15.00 FORMAT "%5.2" READ_ONLY /end CHARACTERISTIC
/begin CHARACTERISTIC DFES_DbLv.DFC_AltMaxPwr_C "" VALUE 0x8004181F Val_Wu8 15.00 DFES_OneToOne 0.00 15.00 FORMAT "%5.2" /end CHARACTERISTIC
/begin CHARACTERISTIC DFES_DbLv.DFC_BrkNpl_C "" VALUE 0x80041820 Val_Wu8 15.00 DFES_OneToOne 0.00 15.00 FORMAT "%5.2" /end CHARACTERISTIC
/begin CHARACTERISTIC DFES_DbLv.DFC_Cj930SSp1Mon_C "" VALUE 0x80041821 Val_Wu8 15.00 DFES_OneToOne 0.00 15.00 FORMAT "%5.2" /end CHARACTERISTIC
/begin CHARACTERISTIC DFES_DbLv.DFC_Cj930SSp2Mon_C "" VALUE 0x80041822 Val_Wu8 15.00 DFES_OneToOne 0.00 15.00 FORMAT "%5.2" /end CHARACTERISTIC
/begin CHARACTERISTIC DFES_DbLv.DFC_Cj930SSp3Mon_C "" VALUE 0x80041823 Val_Wu8 15.00 DFES_OneToOne 0.00 15.00 FORMAT "%5.2" /end CHARACTERISTIC
/begin CHARACTERISTIC DFES_DbLv.DFC_IdleChrgActrAMax_C "" VALUE 0x80041824 Val_Wu8 15.00 DFES_OneToOne 0.00 15.00 FORMAT "%5.2" /end CHARACTERISTIC
/begin CHARACTERISTIC DFES_DbLv.DFC_IdleChrgActrAMin_C "" VALUE 0x80041825 Val_Wu8 15.00 DFES_OneToOne 0.00 15.00 FORMAT "%5.2" /end CHARACTERISTIC
/begin CHARACTERISTIC DFES_DbLv.DFC_IdleChrgActrASig_C "" VALUE 0x80041826 Val_Wu8 15.00 DFES_OneToOne 0.00 15.00 FORMAT "%5.2" /end CHARACTERISTIC
/begin CHARACTERISTIC DFES_DbLv.DFC_IdleChrgActrBMax_C "" VALUE 0x80041827 Val_Wu8 15.00 DFES_OneToOne 0.00 15.00 FORMAT "%5.2" /end CHARACTERISTIC
/begin CHARACTERISTIC DFES_DbLv.DFC_IdleChrgActrBMin_C "" VALUE 0x80041828 Val_Wu8 15.00 DFES_OneToOne 0.00 15.00 FORMAT "%5.2" /end CHARACTERISTIC
/begin CHARACTERISTIC DFES_DbLv.DFC_IdleChrgActrBSig_C "" VALUE 0x80041829 Val_Wu8 15.00 DFES_OneToOne 0.00 15.00 FORMAT "%5.2" /end CHARACTERISTIC
/begin CHARACTERISTIC DFES_DbLv.DFC_IdleChrgActrGovDeCold_C "" VALUE 0x8004182A Val_Wu8 15.00 DFES_OneToOne 0.00 15.00 FORMAT "%5.2" /end CHARACTERISTIC
/begin CHARACTERISTIC DFES_DbLv.DFC_IdleChrgActrGovDeMax_C "" VALUE 0x8004182B Val_Wu8 15.00 DFES_OneToOne 0.00 15.00 FORMAT "%5.2" /end CHARACTERISTIC
/begin CHARACTERISTIC DFES_DbLv.DFC_IdleChrgActrGovDeMin_C "" VALUE 0x8004182C Val_Wu8 15.00 DFES_OneToOne 0.00 15.00 FORMAT "%5.2" /end CHARACTERISTIC
/begin CHARACTERISTIC DFES_DbLv.DFC_IdleChrgActrNAMax_C "" VALUE 0x8004182D Val_Wu8 15.00 DFES_OneToOne 0.00 15.00 FORMAT "%5.2" /end CHARACTERISTIC
/begin CHARACTERISTIC DFES_DbLv.DFC_IdleChrgActrNAMin_C "" VALUE 0x8004182E Val_Wu8 15.00 DFES_OneToOne 0.00 15.00 FORMAT "%5.2" /end CHARACTERISTIC
/begin CHARACTERISTIC DFES_DbLv.DFC_IdleChrgActrNASig_C "" VALUE 0x8004182F Val_Wu8 15.00 DFES_OneToOne 0.00 15.00 FORMAT "%5.2" /end CHARACTERISTIC
/begin CHARACTERISTIC DFES_DbLv.DFC_IdleChrgActrNBMax_C "" VALUE 0x80041830 Val_Wu8 15.00 DFES_OneToOne 0.00 15.00 FORMAT "%5.2" /end CHARACTERISTIC
/begin CHARACTERISTIC DFES_DbLv.DFC_IdleChrgActrNBMin_C "" VALUE 0x80041831 Val_Wu8 15.00 DFES_OneToOne 0.00 15.00 FORMAT "%5.2" /end CHARACTERISTIC
/begin CHARACTERISTIC DFES_DbLv.DFC_IdleChrgActrNBSig_C "" VALUE 0x80041832 Val_Wu8 15.00 DFES_OneToOne 0.00 15.00 FORMAT "%5.2" /end CHARACTERISTIC
/begin CHARACTERISTIC DFES_DbLv.DFC_IdleChrgActrOverTmp_C "" VALUE 0x80041833 Val_Wu8 15.00 DFES_OneToOne 0.00 15.00 FORMAT "%5.2" /end CHARACTERISTIC
/begin CHARACTERISTIC DFES_DbLv.DFC_MonUMaxSupply1_C "" VALUE 0x80041834 Val_Wu8 15.00 DFES_OneToOne 0.00 15.00 FORMAT "%5.2" /end CHARACTERISTIC
/begin CHARACTERISTIC DFES_DbLv.DFC_MonUMinSupply1_C "" VALUE 0x80041835 Val_Wu8 15.00 DFES_OneToOne 0.00 15.00 FORMAT "%5.2" /end CHARACTERISTIC
/begin CHARACTERISTIC DFES_DbLv.DFC_ClthNplClsd_C "" VALUE 0x80041836 Val_Wu8 15.00 DFES_OneToOne 0.00 15.00 FORMAT "%5.2" /end CHARACTERISTIC
/begin CHARACTERISTIC DFES_DbLv.DFC_ClthNplOpn_C "" VALUE 0x80041837 Val_Wu8 15.00 DFES_OneToOne 0.00 15.00 FORMAT "%5.2" /end CHARACTERISTIC
/begin CHARACTERISTIC DFES_DbLv.DFC_IgnClPsDevComErr1_C "" VALUE 0x80041838 Val_Wu8 15.00 DFES_OneToOne 0.00 15.00 FORMAT "%5.2" /end CHARACTERISTIC
/begin CHARACTERISTIC DFES_DbLv.DFC_IgnClPsOpenLoad0_C "" VALUE 0x80041839 Val_Wu8 15.00 DFES_OneToOne 0.00 15.00 FORMAT "%5.2" /end CHARACTERISTIC
/begin CHARACTERISTIC DFES_DbLv.DFC_IgnClPsOpenLoad1_C "" VALUE 0x8004183A Val_Wu8 15.00 DFES_OneToOne 0.00 15.00 FORMAT "%5.2" /end CHARACTERISTIC
/begin CHARACTERISTIC DFES_DbLv.DFC_IgnClPsOpenLoad2_C "" VALUE 0x8004183B Val_Wu8 15.00 DFES_OneToOne 0.00 15.00 FORMAT "%5.2" /end CHARACTERISTIC
/begin CHARACTERISTIC DFES_DbLv.DFC_IgnClPsShCirBatt0_C "" VALUE 0x8004183C Val_Wu8 15.00 DFES_OneToOne 0.00 15.00 FORMAT "%5.2" /end CHARACTERISTIC
/begin CHARACTERISTIC DFES_DbLv.DFC_IgnClPsShCirBatt1_C "" VALUE 0x8004183D Val_Wu8 15.00 DFES_OneToOne 0.00 15.00 FORMAT "%5.2" /end CHARACTERISTIC
/begin CHARACTERISTIC DFES_DbLv.DFC_IgnClPsShCirBatt2_C "" VALUE 0x8004183E Val_Wu8 15.00 DFES_OneToOne 0.00 15.00 FORMAT "%5.2" /end CHARACTERISTIC
/begin CHARACTERISTIC DFES_DbLv.DFC_IgnClPsShCirGnd0_C "" VALUE 0x8004183F Val_Wu8 15.00 DFES_OneToOne 0.00 15.00 FORMAT "%5.2" /end CHARACTERISTIC
/begin CHARACTERISTIC DFES_DbLv.DFC_IgnClPsShCirGnd1_C "" VALUE 0x80041840 Val_Wu8 15.00 DFES_OneToOne 0.00 15.00 FORMAT "%5.2" /end CHARACTERISTIC
/begin CHARACTERISTIC DFES_DbLv.DFC_IgnClPsShCirGnd2_C "" VALUE 0x80041841 Val_Wu8 15.00 DFES_OneToOne 0.00 15.00 FORMAT "%5.2" /end CHARACTERISTIC
/begin CHARACTERISTIC DFES_DbLv.DFC_KnDetSens1PortAMax_C "" VALUE 0x80041842 Val_Wu8 15.00 DFES_OneToOne 0.00 15.00 FORMAT "%5.2" /end CHARACTERISTIC
/begin CHARACTERISTIC DFES_DbLv.DFC_KnDetSens1PortAMin_C "" VALUE 0x80041843 Val_Wu8 15.00 DFES_OneToOne 0.00 15.00 FORMAT "%5.2" /end CHARACTERISTIC
/begin CHARACTERISTIC DFES_DbLv.DFC_KnDetSens1PortBMax_C "" VALUE 0x80041844 Val_Wu8 15.00 DFES_OneToOne 0.00 15.00 FORMAT "%5.2" /end CHARACTERISTIC
/begin CHARACTERISTIC DFES_DbLv.DFC_KnDetSens1PortBMin_C "" VALUE 0x80041845 Val_Wu8 15.00 DFES_OneToOne 0.00 15.00 FORMAT "%5.2" /end CHARACTERISTIC
/begin CHARACTERISTIC DFES_DbLv.DFC_VehVWhlErr_C "" VALUE 0x80041846 Val_Wu8 15.00 DFES_OneToOne 0.00 15.00 FORMAT "%5.2" /end CHARACTERISTIC
/begin CHARACTERISTIC DFES_DbLv.DFC_AirCCmprOL_C "" VALUE 0x80041847 Val_Wu8 15.00 DFES_OneToOne 0.00 15.00 FORMAT "%5.2" /end CHARACTERISTIC
/begin CHARACTERISTIC DFES_DbLv.DFC_AirCCmprOvrTemp_C "" VALUE 0x80041848 Val_Wu8 15.00 DFES_OneToOne 0.00 15.00 FORMAT "%5.2" /end CHARACTERISTIC
/begin CHARACTERISTIC DFES_DbLv.DFC_AirCCmprSCB_C "" VALUE 0x80041849 Val_Wu8 15.00 DFES_OneToOne 0.00 15.00 FORMAT "%5.2" /end CHARACTERISTIC
/begin CHARACTERISTIC DFES_DbLv.DFC_AirCCmprSCG_C "" VALUE 0x8004184A Val_Wu8 15.00 DFES_OneToOne 0.00 15.00 FORMAT "%5.2" /end CHARACTERISTIC
/begin CHARACTERISTIC DFES_DbLv.DFC_AltIOLdSRCMin_C "" VALUE 0x8004184B Val_Wu8 15.00 DFES_OneToOne 0.00 15.00 FORMAT "%5.2" /end CHARACTERISTIC
/begin CHARACTERISTIC DFES_DbLv.DFC_AltIOOL_C "" VALUE 0x8004184C Val_Wu8 15.00 DFES_OneToOne 0.00 15.00 FORMAT "%5.2" /end CHARACTERISTIC
/begin CHARACTERISTIC DFES_DbLv.DFC_AltIOOvrTemp_C "" VALUE 0x8004184D Val_Wu8 15.00 DFES_OneToOne 0.00 15.00 FORMAT "%5.2" /end CHARACTERISTIC
/begin CHARACTERISTIC DFES_DbLv.DFC_AltIOSCB_C "" VALUE 0x8004184E Val_Wu8 15.00 DFES_OneToOne 0.00 15.00 FORMAT "%5.2" /end CHARACTERISTIC
/begin CHARACTERISTIC DFES_DbLv.DFC_AltIOSCG_C "" VALUE 0x8004184F Val_Wu8 15.00 DFES_OneToOne 0.00 15.00 FORMAT "%5.2" /end CHARACTERISTIC
/begin CHARACTERISTIC DFES_DbLv.DFC_DevLibBattUHi_C "" VALUE 0x80041850 Val_Wu8 15.00 DFES_OneToOne 0.00 15.00 FORMAT "%5.2" /end CHARACTERISTIC
/begin CHARACTERISTIC DFES_DbLv.DFC_DevLibBattULo_C "" VALUE 0x80041851 Val_Wu8 15.00 DFES_OneToOne 0.00 15.00 FORMAT "%5.2" /end CHARACTERISTIC
/begin CHARACTERISTIC DFES_DbLv.DFC_FanDIOOL_C "" VALUE 0x80041852 Val_Wu8 15.00 DFES_OneToOne 0.00 15.00 FORMAT "%5.2" /end CHARACTERISTIC
/begin CHARACTERISTIC DFES_DbLv.DFC_FanDIOOvrTemp_C "" VALUE 0x80041853 Val_Wu8 15.00 DFES_OneToOne 0.00 15.00 FORMAT "%5.2" /end CHARACTERISTIC
/begin CHARACTERISTIC DFES_DbLv.DFC_FanDIOSCB_C "" VALUE 0x80041854 Val_Wu8 15.00 DFES_OneToOne 0.00 15.00 FORMAT "%5.2" /end CHARACTERISTIC
/begin CHARACTERISTIC DFES_DbLv.DFC_FanDIOSCG_C "" VALUE 0x80041855 Val_Wu8 15.00 DFES_OneToOne 0.00 15.00 FORMAT "%5.2" /end CHARACTERISTIC
/begin CHARACTERISTIC DFES_DbLv.DFC_FanPWMOL_C "" VALUE 0x80041856 Val_Wu8 15.00 DFES_OneToOne 0.00 15.00 FORMAT "%5.2" /end CHARACTERISTIC
/begin CHARACTERISTIC DFES_DbLv.DFC_FanPWMOvrTemp_C "" VALUE 0x80041857 Val_Wu8 15.00 DFES_OneToOne 0.00 15.00 FORMAT "%5.2" /end CHARACTERISTIC
/begin CHARACTERISTIC DFES_DbLv.DFC_FanPWMSCB_C "" VALUE 0x80041858 Val_Wu8 15.00 DFES_OneToOne 0.00 15.00 FORMAT "%5.2" /end CHARACTERISTIC
/begin CHARACTERISTIC DFES_DbLv.DFC_FanPWMSCG_C "" VALUE 0x80041859 Val_Wu8 15.00 DFES_OneToOne 0.00 15.00 FORMAT "%5.2" /end CHARACTERISTIC
/begin CHARACTERISTIC DFES_DbLv.DFC_AirCClntPAnaSRCMax_C "" VALUE 0x8004185A Val_Wu8 15.00 DFES_OneToOne 0.00 15.00 FORMAT "%5.2" /end CHARACTERISTIC
/begin CHARACTERISTIC DFES_DbLv.DFC_AirCClntPAnaSRCMin_C "" VALUE 0x8004185B Val_Wu8 15.00 DFES_OneToOne 0.00 15.00 FORMAT "%5.2" /end CHARACTERISTIC
/begin MEASUREMENT DFC_st.DFC_Unused "" UBYTE DFC_OneToOne 1 100 0.00 255.0 FORMAT "%5.1" ECU_ADDRESS 0xAFE80401 /end MEASUREMENT
/begin MEASUREMENT DFC_st.DFC_AltMaxPwr "" UBYTE DFC_OneToOne 1 100 0.00 255.0 FORMAT "%5.1" ECU_ADDRESS 0xAFE80402 /end MEASUREMENT
/begin MEASUREMENT DFC_st.DFC_BrkNpl "" UBYTE DFC_OneToOne 1 100 0.00 255.0 FORMAT "%5.1" ECU_ADDRESS 0xAFE80403 /end MEASUREMENT
/begin MEASUREMENT DFC_st.DFC_Cj930SSp1Mon "" UBYTE DFC_OneToOne 1 100 0.00 255.0 FORMAT "%5.1" ECU_ADDRESS 0xAFE80404 /end MEASUREMENT
/begin MEASUREMENT DFC_st.DFC_Cj930SSp2Mon "" UBYTE DFC_OneToOne 1 100 0.00 255.0 FORMAT "%5.1" ECU_ADDRESS 0xAFE80405 /end MEASUREMENT
/begin MEASUREMENT DFC_st.DFC_Cj930SSp3Mon "" UBYTE DFC_OneToOne 1 100 0.00 255.0 FORMAT "%5.1" ECU_ADDRESS 0xAFE80406 /end MEASUREMENT
/begin MEASUREMENT DFC_st.DFC_IdleChrgActrAMax "" UBYTE DFC_OneToOne 1 100 0.00 255.0 FORMAT "%5.1" ECU_ADDRESS 0xAFE80407 /end MEASUREMENT
/begin MEASUREMENT DFC_st.DFC_IdleChrgActrAMin "" UBYTE DFC_OneToOne 1 100 0.00 255.0 FORMAT "%5.1" ECU_ADDRESS 0xAFE80408 /end MEASUREMENT
/begin MEASUREMENT DFC_st.DFC_IdleChrgActrASig "" UBYTE DFC_OneToOne 1 100 0.00 255.0 FORMAT "%5.1" ECU_ADDRESS 0xAFE80409 /end MEASUREMENT
/begin MEASUREMENT DFC_st.DFC_IdleChrgActrBMax "" UBYTE DFC_OneToOne 1 100 0.00 255.0 FORMAT "%5.1" ECU_ADDRESS 0xAFE8040A /end MEASUREMENT
/begin MEASUREMENT DFC_st.DFC_IdleChrgActrBMin "" UBYTE DFC_OneToOne 1 100 0.00 255.0 FORMAT "%5.1" ECU_ADDRESS 0xAFE8040B /end MEASUREMENT
/begin MEASUREMENT DFC_st.DFC_IdleChrgActrBSig "" UBYTE DFC_OneToOne 1 100 0.00 255.0 FORMAT "%5.1" ECU_ADDRESS 0xAFE8040C /end MEASUREMENT
/begin MEASUREMENT DFC_st.DFC_IdleChrgActrGovDeCold "" UBYTE DFC_OneToOne 1 100 0.00 255.0 FORMAT "%5.1" ECU_ADDRESS 0xAFE8040D /end MEASUREMENT
/begin MEASUREMENT DFC_st.DFC_IdleChrgActrGovDeMax "" UBYTE DFC_OneToOne 1 100 0.00 255.0 FORMAT "%5.1" ECU_ADDRESS 0xAFE8040E /end MEASUREMENT
/begin MEASUREMENT DFC_st.DFC_IdleChrgActrGovDeMin "" UBYTE DFC_OneToOne 1 100 0.00 255.0 FORMAT "%5.1" ECU_ADDRESS 0xAFE8040F /end MEASUREMENT
/begin MEASUREMENT DFC_st.DFC_IdleChrgActrNAMax "" UBYTE DFC_OneToOne 1 100 0.00 255.0 FORMAT "%5.1" ECU_ADDRESS 0xAFE80410 /end MEASUREMENT
/begin MEASUREMENT DFC_st.DFC_IdleChrgActrNAMin "" UBYTE DFC_OneToOne 1 100 0.00 255.0 FORMAT "%5.1" ECU_ADDRESS 0xAFE80411 /end MEASUREMENT
/begin MEASUREMENT DFC_st.DFC_IdleChrgActrNASig "" UBYTE DFC_OneToOne 1 100 0.00 255.0 FORMAT "%5.1" ECU_ADDRESS 0xAFE80412 /end MEASUREMENT
/begin MEASUREMENT DFC_st.DFC_IdleChrgActrNBMax "" UBYTE DFC_OneToOne 1 100 0.00 255.0 FORMAT "%5.1" ECU_ADDRESS 0xAFE80413 /end MEASUREMENT
/begin MEASUREMENT DFC_st.DFC_IdleChrgActrNBMin "" UBYTE DFC_OneToOne 1 100 0.00 255.0 FORMAT "%5.1" ECU_ADDRESS 0xAFE80414 /end MEASUREMENT
/begin MEASUREMENT DFC_st.DFC_IdleChrgActrNBSig "" UBYTE DFC_OneToOne 1 100 0.00 255.0 FORMAT "%5.1" ECU_ADDRESS 0xAFE80415 /end MEASUREMENT
/begin MEASUREMENT DFC_st.DFC_IdleChrgActrOverTmp "" UBYTE DFC_OneToOne 1 100 0.00 255.0 FORMAT "%5.1" ECU_ADDRESS 0xAFE80416 /end MEASUREMENT
/begin MEASUREMENT DFC_st.DFC_MonUMaxSupply1 "" UBYTE DFC_OneToOne 1 100 0.00 255.0 FORMAT "%5.1" ECU_ADDRESS 0xAFE80417 /end MEASUREMENT
/begin MEASUREMENT DFC_st.DFC_MonUMinSupply1 "" UBYTE DFC_OneToOne 1 100 0.00 255.0 FORMAT "%5.1" ECU_ADDRESS 0xAFE80418 /end MEASUREMENT
/begin MEASUREMENT DFC_st.DFC_ClthNplClsd "" UBYTE DFC_OneToOne 1 100 0.00 255.0 FORMAT "%5.1" ECU_ADDRESS 0xAFE80419 /end MEASUREMENT
/begin MEASUREMENT DFC_st.DFC_ClthNplOpn "" UBYTE DFC_OneToOne 1 100 0.00 255.0 FORMAT "%5.1" ECU_ADDRESS 0xAFE8041A /end MEASUREMENT
/begin MEASUREMENT DFC_st.DFC_IgnClPsDevComErr1 "" UBYTE DFC_OneToOne 1 100 0.00 255.0 FORMAT "%5.1" ECU_ADDRESS 0xAFE8041B /end MEASUREMENT
/begin MEASUREMENT DFC_st.DFC_IgnClPsOpenLoad0 "" UBYTE DFC_OneToOne 1 100 0.00 255.0 FORMAT "%5.1" ECU_ADDRESS 0xAFE8041C /end MEASUREMENT
/begin MEASUREMENT DFC_st.DFC_IgnClPsOpenLoad1 "" UBYTE DFC_OneToOne 1 100 0.00 255.0 FORMAT "%5.1" ECU_ADDRESS 0xAFE8041D /end MEASUREMENT
/begin MEASUREMENT DFC_st.DFC_IgnClPsOpenLoad2 "" UBYTE DFC_OneToOne 1 100 0.00 255.0 FORMAT "%5.1" ECU_ADDRESS 0xAFE8041E /end MEASUREMENT
/begin MEASUREMENT DFC_st.DFC_IgnClPsShCirBatt0 "" UBYTE DFC_OneToOne 1 100 0.00 255.0 FORMAT "%5.1" ECU_ADDRESS 0xAFE8041F /end MEASUREMENT
/begin MEASUREMENT DFC_st.DFC_IgnClPsShCirBatt1 "" UBYTE DFC_OneToOne 1 100 0.00 255.0 FORMAT "%5.1" ECU_ADDRESS 0xAFE80420 /end MEASUREMENT
/begin MEASUREMENT DFC_st.DFC_IgnClPsShCirBatt2 "" UBYTE DFC_OneToOne 1 100 0.00 255.0 FORMAT "%5.1" ECU_ADDRESS 0xAFE80421 /end MEASUREMENT
/begin MEASUREMENT DFC_st.DFC_IgnClPsShCirGnd0 "" UBYTE DFC_OneToOne 1 100 0.00 255.0 FORMAT "%5.1" ECU_ADDRESS 0xAFE80422 /end MEASUREMENT
/begin MEASUREMENT DFC_st.DFC_IgnClPsShCirGnd1 "" UBYTE DFC_OneToOne 1 100 0.00 255.0 FORMAT "%5.1" ECU_ADDRESS 0xAFE80423 /end MEASUREMENT
/begin MEASUREMENT DFC_st.DFC_IgnClPsShCirGnd2 "" UBYTE DFC_OneToOne 1 100 0.00 255.0 FORMAT "%5.1" ECU_ADDRESS 0xAFE80424 /end MEASUREMENT
/begin MEASUREMENT DFC_st.DFC_KnDetSens1PortAMax "" UBYTE DFC_OneToOne 1 100 0.00 255.0 FORMAT "%5.1" ECU_ADDRESS 0xAFE80425 /end MEASUREMENT
/begin MEASUREMENT DFC_st.DFC_KnDetSens1PortAMin "" UBYTE DFC_OneToOne 1 100 0.00 255.0 FORMAT "%5.1" ECU_ADDRESS 0xAFE80426 /end MEASUREMENT
/begin MEASUREMENT DFC_st.DFC_KnDetSens1PortBMax "" UBYTE DFC_OneToOne 1 100 0.00 255.0 FORMAT "%5.1" ECU_ADDRESS 0xAFE80427 /end MEASUREMENT
/begin MEASUREMENT DFC_st.DFC_KnDetSens1PortBMin "" UBYTE DFC_OneToOne 1 100 0.00 255.0 FORMAT "%5.1" ECU_ADDRESS 0xAFE80428 /end MEASUREMENT
/begin MEASUREMENT DFC_st.DFC_VehVWhlErr "" UBYTE DFC_OneToOne 1 100 0.00 255.0 FORMAT "%5.1" ECU_ADDRESS 0xAFE80429 /end MEASUREMENT
/begin MEASUREMENT DFC_st.DFC_AirCCmprOL "" UBYTE DFC_OneToOne 1 100 0.00 255.0 FORMAT "%5.1" ECU_ADDRESS 0xAFE8042A /end MEASUREMENT
/begin MEASUREMENT DFC_st.DFC_AirCCmprOvrTemp "" UBYTE DFC_OneToOne 1 100 0.00 255.0 FORMAT "%5.1" ECU_ADDRESS 0xAFE8042B /end MEASUREMENT
/begin MEASUREMENT DFC_st.DFC_AirCCmprSCB "" UBYTE DFC_OneToOne 1 100 0.00 255.0 FORMAT "%5.1" ECU_ADDRESS 0xAFE8042C /end MEASUREMENT
/begin MEASUREMENT DFC_st.DFC_AirCCmprSCG "" UBYTE DFC_OneToOne 1 100 0.00 255.0 FORMAT "%5.1" ECU_ADDRESS 0xAFE8042D /end MEASUREMENT
/begin MEASUREMENT DFC_st.DFC_AltIOLdSRCMin "" UBYTE DFC_OneToOne 1 100 0.00 255.0 FORMAT "%5.1" ECU_ADDRESS 0xAFE8042E /end MEASUREMENT
/begin MEASUREMENT DFC_st.DFC_AltIOOL "" UBYTE DFC_OneToOne 1 100 0.00 255.0 FORMAT "%5.1" ECU_ADDRESS 0xAFE8042F /end MEASUREMENT
/begin MEASUREMENT DFC_st.DFC_AltIOOvrTemp "" UBYTE DFC_OneToOne 1 100 0.00 255.0 FORMAT "%5.1" ECU_ADDRESS 0xAFE80430 /end MEASUREMENT
/begin MEASUREMENT DFC_st.DFC_AltIOSCB "" UBYTE DFC_OneToOne 1 100 0.00 255.0 FORMAT "%5.1" ECU_ADDRESS 0xAFE80431 /end MEASUREMENT
/begin MEASUREMENT DFC_st.DFC_AltIOSCG "" UBYTE DFC_OneToOne 1 100 0.00 255.0 FORMAT "%5.1" ECU_ADDRESS 0xAFE80432 /end MEASUREMENT
/begin MEASUREMENT DFC_st.DFC_DevLibBattUHi "" UBYTE DFC_OneToOne 1 100 0.00 255.0 FORMAT "%5.1" ECU_ADDRESS 0xAFE80433 /end MEASUREMENT
/begin MEASUREMENT DFC_st.DFC_DevLibBattULo "" UBYTE DFC_OneToOne 1 100 0.00 255.0 FORMAT "%5.1" ECU_ADDRESS 0xAFE80434 /end MEASUREMENT
/begin MEASUREMENT DFC_st.DFC_FanDIOOL "" UBYTE DFC_OneToOne 1 100 0.00 255.0 FORMAT "%5.1" ECU_ADDRESS 0xAFE80435 /end MEASUREMENT
/begin MEASUREMENT DFC_st.DFC_FanDIOOvrTemp "" UBYTE DFC_OneToOne 1 100 0.00 255.0 FORMAT "%5.1" ECU_ADDRESS 0xAFE80436 /end MEASUREMENT
/begin MEASUREMENT DFC_st.DFC_FanDIOSCB "" UBYTE DFC_OneToOne 1 100 0.00 255.0 FORMAT "%5.1" ECU_ADDRESS 0xAFE80437 /end MEASUREMENT
/begin MEASUREMENT DFC_st.DFC_FanDIOSCG "" UBYTE DFC_OneToOne 1 100 0.00 255.0 FORMAT "%5.1" ECU_ADDRESS 0xAFE80438 /end MEASUREMENT
/begin MEASUREMENT DFC_st.DFC_FanPWMOL "" UBYTE DFC_OneToOne 1 100 0.00 255.0 FORMAT "%5.1" ECU_ADDRESS 0xAFE80439 /end MEASUREMENT
/begin MEASUREMENT DFC_st.DFC_FanPWMOvrTemp "" UBYTE DFC_OneToOne 1 100 0.00 255.0 FORMAT "%5.1" ECU_ADDRESS 0xAFE8043A /end MEASUREMENT
/begin MEASUREMENT DFC_st.DFC_FanPWMSCB "" UBYTE DFC_OneToOne 1 100 0.00 255.0 FORMAT "%5.1" ECU_ADDRESS 0xAFE8043B /end MEASUREMENT
/begin MEASUREMENT DFC_st.DFC_FanPWMSCG "" UBYTE DFC_OneToOne 1 100 0.00 255.0 FORMAT "%5.1" ECU_ADDRESS 0xAFE8043C /end MEASUREMENT
/begin MEASUREMENT DFC_st.DFC_AirCClntPAnaSRCMax "" UBYTE DFC_OneToOne 1 100 0.00 255.0 FORMAT "%5.1" ECU_ADDRESS 0xAFE8043D /end MEASUREMENT
/begin MEASUREMENT DFC_st.DFC_AirCClntPAnaSRCMin "" UBYTE DFC_OneToOne 1 100 0.00 255.0 FORMAT "%5.1" ECU_ADDRESS 0xAFE8043E /end MEASUREMENT
/begin MEASUREMENT DFC_st.DFC_AirCSwtNpl "" UBYTE DFC_OneToOne 1 100 0.00 255.0 FORMAT "%5.1" ECU_ADDRESS 0xAFE8043F /end MEASUREMENT
/begin MEASUREMENT DFC_st.DFC_AirCSwtSig "" UBYTE DFC_OneToOne 1 100 0.00 255.0 FORMAT "%5.1" ECU_ADDRESS 0xAFE80440 /end MEASUREMENT
/begin MEASUREMENT DFC_st.DFC_AltIOLdSRCMax "" UBYTE DFC_OneToOne 1 100 0.00 255.0 FORMAT "%5.1" ECU_ADDRESS 0xAFE80441 /end MEASUREMENT
/begin MEASUREMENT DFC_st.DFC_BrkSig "" UBYTE DFC_OneToOne 1 100 0.00 255.0 FORMAT "%5.1" ECU_ADDRESS 0xAFE80442 /end MEASUREMENT
/begin MEASUREMENT DFC_st.DFC_ClthEPBNpl "" UBYTE DFC_OneToOne 1 100 0.00 255.0 FORMAT "%5.1" ECU_ADDRESS 0xAFE80443 /end MEASUREMENT
/begin MEASUREMENT DFC_st.DFC_ClthEPBSensErr "" UBYTE DFC_OneToOne 1 100 0.00 255.0 FORMAT "%5.1" ECU_ADDRESS 0xAFE80444 /end MEASUREMENT
/begin MEASUREMENT DFC_st.DFC_ClthErr "" UBYTE DFC_OneToOne 1 100 0.00 255.0 FORMAT "%5.1" ECU_ADDRESS 0xAFE80445 /end MEASUREMENT
/begin MEASUREMENT DFC_st.DFC_ClthSig "" UBYTE DFC_OneToOne 1 100 0.00 255.0 FORMAT "%5.1" ECU_ADDRESS 0xAFE80446 /end MEASUREMENT
/begin MEASUREMENT DFC_st.DFC_MILLmpOL "" UBYTE DFC_OneToOne 1 100 0.00 255.0 FORMAT "%5.1" ECU_ADDRESS 0xAFE80447 /end MEASUREMENT
/begin MEASUREMENT DFC_st.DFC_MILLmpSCB "" UBYTE DFC_OneToOne 1 100 0.00 255.0 FORMAT "%5.1" ECU_ADDRESS 0xAFE80448 /end MEASUREMENT
/begin MEASUREMENT DFC_st.DFC_MILLmpSCG "" UBYTE DFC_OneToOne 1 100 0.00 255.0 FORMAT "%5.1" ECU_ADDRESS 0xAFE80449 /end MEASUREMENT
/begin MEASUREMENT DFC_st.DFC_SRCHighAPP1 "" UBYTE DFC_OneToOne 1 100 0.00 255.0 FORMAT "%5.1" ECU_ADDRESS 0xAFE8044A /end MEASUREMENT
/begin MEASUREMENT DFC_st.DFC_SRCHighAPP2 "" UBYTE DFC_OneToOne 1 100 0.00 255.0 FORMAT "%5.1" ECU_ADDRESS 0xAFE8044B /end MEASUREMENT
/begin MEASUREMENT DFC_st.DFC_SRCLowAPP1 "" UBYTE DFC_OneToOne 1 100 0.00 255.0 FORMAT "%5.1" ECU_ADDRESS 0xAFE8044C /end MEASUREMENT
/begin MEASUREMENT DFC_st.DFC_SRCLowAPP2 "" UBYTE DFC_OneToOne 1 100 0.00 255.0 FORMAT "%5.1" ECU_ADDRESS 0xAFE8044D /end MEASUREMENT
/begin MEASUREMENT DFC_st.DFC_SyncAPP "" UBYTE DFC_OneToOne 1 100 0.00 255.0 FORMAT "%5.1" ECU_ADDRESS 0xAFE8044E /end MEASUREMENT
/begin MEASUREMENT DFC_st.DFC_VehVMax "" UBYTE DFC_OneToOne 1 100 0.00 255.0 FORMAT "%5.1" ECU_ADDRESS 0xAFE8044F /end MEASUREMENT
/begin MEASUREMENT DFC_st.DFC_VehVPlaus "" UBYTE DFC_OneToOne 1 100 0.00 255.0 FORMAT "%5.1" ECU_ADDRESS 0xAFE80450 /end MEASUREMENT
/begin MEASUREMENT DFC_st.DFC_VehVSig "" UBYTE DFC_OneToOne 1 100 0.00 255.0 FORMAT "%5.1" ECU_ADDRESS 0xAFE80451 /end MEASUREMENT
/begin MEASUREMENT DFC_st.DFC_BusDiagBusOffNodeA "" UBYTE DFC_OneToOne 1 100 0.00 255.0 FORMAT "%5.1" ECU_ADDRESS 0xAFE80452 /end MEASUREMENT
/begin MEASUREMENT DFC_st.DFC_ComACSensTO "" UBYTE DFC_OneToOne 1 100 0.00 255.0 FORMAT "%5.1" ECU_ADDRESS 0xAFE80453 /end MEASUREMENT
/begin MEASUREMENT DFC_st.DFC_ComAWD1TO "" UBYTE DFC_OneToOne 1 100 0.00 255.0 FORMAT "%5.1" ECU_ADDRESS 0xAFE80454 /end MEASUREMENT
/begin MEASUREMENT DFC_st.DFC_ComBRK10TO "" UBYTE DFC_OneToOne 1 100 0.00 255.0 FORMAT "%5.1" ECU_ADDRESS 0xAFE80455 /end MEASUREMENT
/begin MEASUREMENT DFC_st.DFC_ComGW11TO "" UBYTE DFC_OneToOne 1 100 0.00 255.0 FORMAT "%5.1" ECU_ADDRESS 0xAFE80456 /end MEASUREMENT
/begin MEASUREMENT DFC_st.DFC_ComLVL1TO "" UBYTE DFC_OneToOne 1 100 0.00 255.0 FORMAT "%5.1" ECU_ADDRESS 0xAFE80457 /end MEASUREMENT
/begin MEASUREMENT DFC_st.DFC_ComPRKA01TO "" UBYTE DFC_OneToOne 1 100 0.00 255.0 FORMAT "%5.1" ECU_ADDRESS 0xAFE80458 /end MEASUREMENT
/begin MEASUREMENT DFC_st.DFC_ComPRKH01TO "" UBYTE DFC_OneToOne 1 100 0.00 255.0 FORMAT "%5.1" ECU_ADDRESS 0xAFE80459 /end MEASUREMENT
/begin MEASUREMENT DFC_st.DFC_ComPRKH1TO "" UBYTE DFC_OneToOne 1 100 0.00 255.0 FORMAT "%5.1" ECU_ADDRESS 0xAFE8045A /end MEASUREMENT
/begin MEASUREMENT DFC_st.DFC_ComTRBCH1TO "" UBYTE DFC_OneToOne 1 100 0.00 255.0 FORMAT "%5.1" ECU_ADDRESS 0xAFE8045B /end MEASUREMENT
/begin MEASUREMENT DFC_st.DFC_ComTRBCH2TO "" UBYTE DFC_OneToOne 1 100 0.00 255.0 FORMAT "%5.1" ECU_ADDRESS 0xAFE8045C /end MEASUREMENT
/begin MEASUREMENT DFC_st.DFC_DK "" UBYTE DFC_OneToOne 1 100 0.00 255.0 FORMAT "%5.1" ECU_ADDRESS 0xAFE8045D /end MEASUREMENT
/begin MEASUREMENT DFC_st.DFC_DKRSA "" UBYTE DFC_OneToOne 1 100 0.00 255.0 FORMAT "%5.1" ECU_ADDRESS 0xAFE8045E /end MEASUREMENT
/begin MEASUREMENT DFC_st.DFC_DKVSmax "" UBYTE DFC_OneToOne 1 100 0.00 255.0 FORMAT "%5.1" ECU_ADDRESS 0xAFE8045F /end MEASUREMENT
/begin MEASUREMENT DFC_st.DFC_DKmax "" UBYTE DFC_OneToOne 1 100 0.00 255.0 FORMAT "%5.1" ECU_ADDRESS 0xAFE80460 /end MEASUREMENT
/begin MEASUREMENT DFC_st.DFC_DKmin "" UBYTE DFC_OneToOne 1 100 0.00 255.0 FORMAT "%5.1" ECU_ADDRESS 0xAFE80461 /end MEASUREMENT
/begin MEASUREMENT DFC_st.DFC_DSSmax "" UBYTE DFC_OneToOne 1 100 0.00 255.0 FORMAT "%5.1" ECU_ADDRESS 0xAFE80462 /end MEASUREMENT
/begin MEASUREMENT DFC_st.DFC_EEPEraseErr "" UBYTE DFC_OneToOne 1 100 0.00 255.0 FORMAT "%5.1" ECU_ADDRESS 0xAFE80463 /end MEASUREMENT
/begin MEASUREMENT DFC_st.DFC_EEPRdErr "" UBYTE DFC_OneToOne 1 100 0.00 255.0 FORMAT "%5.1" ECU_ADDRESS 0xAFE80464 /end MEASUREMENT
/begin MEASUREMENT DFC_st.DFC_EEPWrErr "" UBYTE DFC_OneToOne 1 100 0.00 255.0 FORMAT "%5.1" ECU_ADDRESS 0xAFE80465 /end MEASUREMENT
/begin MEASUREMENT DFC_st.DFC_EV1max "" UBYTE DFC_OneToOne 1 100 0.00 255.0 FORMAT "%5.1" ECU_ADDRESS 0xAFE80466 /end MEASUREMENT
/begin MEASUREMENT DFC_st.DFC_EV1min "" UBYTE DFC_OneToOne 1 100 0.00 255.0 FORMAT "%5.1" ECU_ADDRESS 0xAFE80467 /end MEASUREMENT
/begin MEASUREMENT DFC_st.DFC_EV1sig "" UBYTE DFC_OneToOne 1 100 0.00 255.0 FORMAT "%5.1" ECU_ADDRESS 0xAFE80468 /end MEASUREMENT
/begin MEASUREMENT DFC_st.DFC_EV2max "" UBYTE DFC_OneToOne 1 100 0.00 255.0 FORMAT "%5.1" ECU_ADDRESS 0xAFE80469 /end MEASUREMENT
/begin MEASUREMENT DFC_st.DFC_EV2min "" UBYTE DFC_OneToOne 1 100 0.00 255.0 FORMAT "%5.1" ECU_ADDRESS 0xAFE8046A /end MEASUREMENT
/begin MEASUREMENT DFC_st.DFC_EV2sig "" UBYTE DFC_OneToOne 1 100 0.00 255.0 FORMAT "%5.1" ECU_ADDRESS 0xAFE8046B /end MEASUREMENT
/begin MEASUREMENT DFC_st.DFC_EV3max "" UBYTE DFC_OneToOne 1 100 0.00 255.0 FORMAT "%5.1" ECU_ADDRESS 0xAFE8046C /end MEASUREMENT
/begin MEASUREMENT DFC_st.DFC_EV3min "" UBYTE DFC_OneToOne 1 100 0.00 255.0 FORMAT "%5.1" ECU_ADDRESS 0xAFE8046D /end MEASUREMENT
/begin MEASUREMENT DFC_st.DFC_EV3sig "" UBYTE DFC_OneToOne 1 100 0.00 255.0 FORMAT "%5.1" ECU_ADDRESS 0xAFE8046E /end MEASUREMENT
/begin MEASUREMENT DFC_st.DFC_EpmCaSI1ErrSig "" UBYTE DFC_OneToOne 1 100 0.00 255.0 FORMAT "%5.1" ECU_ADDRESS 0xAFE8046F /end MEASUREMENT
/begin MEASUREMENT DFC_st.DFC_EpmCaSI1NoSig "" UBYTE DFC_OneToOne 1 100 0.00 255.0 FORMAT "%5.1" ECU_ADDRESS 0xAFE80470 /end MEASUREMENT
/begin MEASUREMENT DFC_st.DFC_EpmCaSI1NoSigMax "" UBYTE DFC_OneToOne 1 100 0.00 255.0 FORMAT "%5.1" ECU_ADDRESS 0xAFE80471 /end MEASUREMENT
/begin MEASUREMENT DFC_st.DFC_EpmCaSI1NoSigMin "" UBYTE DFC_OneToOne 1 100 0.00 255.0 FORMAT "%5.1" ECU_ADDRESS 0xAFE80472 /end MEASUREMENT
/begin MEASUREMENT DFC_st.DFC_EpmCaSI1OfsErr "" UBYTE DFC_OneToOne 1 100 0.00 255.0 FORMAT "%5.1" ECU_ADDRESS 0xAFE80473 /end MEASUREMENT
/begin MEASUREMENT DFC_st.DFC_EpmCrSErrSig "" UBYTE DFC_OneToOne 1 100 0.00 255.0 FORMAT "%5.1" ECU_ADDRESS 0xAFE80474 /end MEASUREMENT
/begin MEASUREMENT DFC_st.DFC_EpmCrSNoSig "" UBYTE DFC_OneToOne 1 100 0.00 255.0 FORMAT "%5.1" ECU_ADDRESS 0xAFE80475 /end MEASUREMENT
/begin MEASUREMENT DFC_st.DFC_FRAmax "" UBYTE DFC_OneToOne 1 100 0.00 255.0 FORMAT "%5.1" ECU_ADDRESS 0xAFE80476 /end MEASUREMENT
/begin MEASUREMENT DFC_st.DFC_FRAmin "" UBYTE DFC_OneToOne 1 100 0.00 255.0 FORMAT "%5.1" ECU_ADDRESS 0xAFE80477 /end MEASUREMENT
/begin MEASUREMENT DFC_st.DFC_HEGOS1B1ElecMax "" UBYTE DFC_OneToOne 1 100 0.00 255.0 FORMAT "%5.1" ECU_ADDRESS 0xAFE80478 /end MEASUREMENT
/begin MEASUREMENT DFC_st.DFC_HEGOS1B1ElecMin "" UBYTE DFC_OneToOne 1 100 0.00 255.0 FORMAT "%5.1" ECU_ADDRESS 0xAFE80479 /end MEASUREMENT
/begin MEASUREMENT DFC_st.DFC_HEGOS1B1ElecNpl "" UBYTE DFC_OneToOne 1 100 0.00 255.0 FORMAT "%5.1" ECU_ADDRESS 0xAFE8047A /end MEASUREMENT
/begin MEASUREMENT DFC_st.DFC_HEGOS1B1ElecSig "" UBYTE DFC_OneToOne 1 100 0.00 255.0 FORMAT "%5.1" ECU_ADDRESS 0xAFE8047B /end MEASUREMENT
/begin MEASUREMENT DFC_st.DFC_HEGOS1B1HtgNpl "" UBYTE DFC_OneToOne 1 100 0.00 255.0 FORMAT "%5.1" ECU_ADDRESS 0xAFE8047C /end MEASUREMENT
/begin MEASUREMENT DFC_st.DFC_HEGOS1B1HtrPsMax "" UBYTE DFC_OneToOne 1 100 0.00 255.0 FORMAT "%5.1" ECU_ADDRESS 0xAFE8047D /end MEASUREMENT
/begin MEASUREMENT DFC_st.DFC_HEGOS1B1HtrPsMin "" UBYTE DFC_OneToOne 1 100 0.00 255.0 FORMAT "%5.1" ECU_ADDRESS 0xAFE8047E /end MEASUREMENT
/begin MEASUREMENT DFC_st.DFC_HEGOS1B1HtrPsSig "" UBYTE DFC_OneToOne 1 100 0.00 255.0 FORMAT "%5.1" ECU_ADDRESS 0xAFE8047F /end MEASUREMENT
/begin MEASUREMENT DFC_st.DFC_HEGOS1B1StkMax "" UBYTE DFC_OneToOne 1 100 0.00 255.0 FORMAT "%5.1" ECU_ADDRESS 0xAFE80480 /end MEASUREMENT
/begin MEASUREMENT DFC_st.DFC_HEGOS1B1StkMin "" UBYTE DFC_OneToOne 1 100 0.00 255.0 FORMAT "%5.1" ECU_ADDRESS 0xAFE80481 /end MEASUREMENT
/begin MEASUREMENT DFC_st.DFC_HEGOS2B1RstrcnLean "" UBYTE DFC_OneToOne 1 100 0.00 255.0 FORMAT "%5.1" ECU_ADDRESS 0xAFE80482 /end MEASUREMENT
/begin MEASUREMENT DFC_st.DFC_HEGOS2B1RstrcnRich "" UBYTE DFC_OneToOne 1 100 0.00 255.0 FORMAT "%5.1" ECU_ADDRESS 0xAFE80483 /end MEASUREMENT
/begin MEASUREMENT DFC_st.DFC_IdleChrgActrJamVlvClsd "" UBYTE DFC_OneToOne 1 100 0.00 255.0 FORMAT "%5.1" ECU_ADDRESS 0xAFE80484 /end MEASUREMENT
/begin MEASUREMENT DFC_st.DFC_IdleChrgActrJamVlvOpn "" UBYTE DFC_OneToOne 1 100 0.00 255.0 FORMAT "%5.1" ECU_ADDRESS 0xAFE80485 /end MEASUREMENT
/begin MEASUREMENT DFC_st.DFC_IgnClPsDevOscErr1 "" UBYTE DFC_OneToOne 1 100 0.00 255.0 FORMAT "%5.1" ECU_ADDRESS 0xAFE80486 /end MEASUREMENT
/begin MEASUREMENT DFC_st.DFC_KPEmax "" UBYTE DFC_OneToOne 1 100 0.00 255.0 FORMAT "%5.1" ECU_ADDRESS 0xAFE80487 /end MEASUREMENT
/begin MEASUREMENT DFC_st.DFC_KPEmin "" UBYTE DFC_OneToOne 1 100 0.00 255.0 FORMAT "%5.1" ECU_ADDRESS 0xAFE80488 /end MEASUREMENT
/begin MEASUREMENT DFC_st.DFC_KPEsig "" UBYTE DFC_OneToOne 1 100 0.00 255.0 FORMAT "%5.1" ECU_ADDRESS 0xAFE80489 /end MEASUREMENT
/begin MEASUREMENT DFC_st.DFC_KS1max "" UBYTE DFC_OneToOne 1 100 0.00 255.0 FORMAT "%5.1" ECU_ADDRESS 0xAFE8048A /end MEASUREMENT
/begin MEASUREMENT DFC_st.DFC_KS1min "" UBYTE DFC_OneToOne 1 100 0.00 255.0 FORMAT "%5.1" ECU_ADDRESS 0xAFE8048B /end MEASUREMENT
/begin MEASUREMENT DFC_st.DFC_LLRKHmax "" UBYTE DFC_OneToOne 1 100 0.00 255.0 FORMAT "%5.1" ECU_ADDRESS 0xAFE8048C /end MEASUREMENT
/begin MEASUREMENT DFC_st.DFC_LLRKHmin "" UBYTE DFC_OneToOne 1 100 0.00 255.0 FORMAT "%5.1" ECU_ADDRESS 0xAFE8048D /end MEASUREMENT
/begin MEASUREMENT DFC_st.DFC_LLRKHnpl "" UBYTE DFC_OneToOne 1 100 0.00 255.0 FORMAT "%5.1" ECU_ADDRESS 0xAFE8048E /end MEASUREMENT
/begin MEASUREMENT DFC_st.DFC_LLRmax "" UBYTE DFC_OneToOne 1 100 0.00 255.0 FORMAT "%5.1" ECU_ADDRESS 0xAFE8048F /end MEASUREMENT
/begin MEASUREMENT DFC_st.DFC_LLRmin "" UBYTE DFC_OneToOne 1 100 0.00 255.0 FORMAT "%5.1" ECU_ADDRESS 0xAFE80490 /end MEASUREMENT
/begin MEASUREMENT DFC_st.DFC_LLRnpl "" UBYTE DFC_OneToOne 1 100 0.00 255.0 FORMAT "%5.1" ECU_ADDRESS 0xAFE80491 /end MEASUREMENT
/begin MEASUREMENT DFC_st.DFC_LMmax "" UBYTE DFC_OneToOne 1 100 0.00 255.0 FORMAT "%5.1" ECU_ADDRESS 0xAFE80492 /end MEASUREMENT
/begin MEASUREMENT DFC_st.DFC_LZSRnpl "" UBYTE DFC_OneToOne 1 100 0.00 255.0 FORMAT "%5.1" ECU_ADDRESS 0xAFE80493 /end MEASUREMENT
/begin MEASUREMENT DFC_st.DFC_MD "" UBYTE DFC_OneToOne 1 100 0.00 255.0 FORMAT "%5.1" ECU_ADDRESS 0xAFE80494 /end MEASUREMENT
/begin MEASUREMENT DFC_st.DFC_MD00min "" UBYTE DFC_OneToOne 1 100 0.00 255.0 FORMAT "%5.1" ECU_ADDRESS 0xAFE80495 /end MEASUREMENT
/begin MEASUREMENT DFC_st.DFC_MD00npl "" UBYTE DFC_OneToOne 1 100 0.00 255.0 FORMAT "%5.1" ECU_ADDRESS 0xAFE80496 /end MEASUREMENT
/begin MEASUREMENT DFC_st.DFC_MD01min "" UBYTE DFC_OneToOne 1 100 0.00 255.0 FORMAT "%5.1" ECU_ADDRESS 0xAFE80497 /end MEASUREMENT
/begin MEASUREMENT DFC_st.DFC_MD01npl "" UBYTE DFC_OneToOne 1 100 0.00 255.0 FORMAT "%5.1" ECU_ADDRESS 0xAFE80498 /end MEASUREMENT
/begin MEASUREMENT DFC_st.DFC_MD02min "" UBYTE DFC_OneToOne 1 100 0.00 255.0 FORMAT "%5.1" ECU_ADDRESS 0xAFE80499 /end MEASUREMENT
/begin MEASUREMENT DFC_st.DFC_MD02npl "" UBYTE DFC_OneToOne 1 100 0.00 255.0 FORMAT "%5.1" ECU_ADDRESS 0xAFE8049A /end MEASUREMENT
/begin MEASUREMENT DFC_st.DFC_MD03min "" UBYTE DFC_OneToOne 1 100 0.00 255.0 FORMAT "%5.1" ECU_ADDRESS 0xAFE8049B /end MEASUREMENT
/begin MEASUREMENT DFC_st.DFC_MD03npl "" UBYTE DFC_OneToOne 1 100 0.00 255.0 FORMAT "%5.1" ECU_ADDRESS 0xAFE8049C /end MEASUREMENT
/begin MEASUREMENT DFC_st.DFC_MD04min "" UBYTE DFC_OneToOne 1 100 0.00 255.0 FORMAT "%5.1" ECU_ADDRESS 0xAFE8049D /end MEASUREMENT
/begin MEASUREMENT DFC_st.DFC_MD04npl "" UBYTE DFC_OneToOne 1 100 0.00 255.0 FORMAT "%5.1" ECU_ADDRESS 0xAFE8049E /end MEASUREMENT
/begin MEASUREMENT DFC_st.DFC_MDCyl_0 "" UBYTE DFC_OneToOne 1 100 0.00 255.0 FORMAT "%5.1" ECU_ADDRESS 0xAFE8049F /end MEASUREMENT
/begin MEASUREMENT DFC_st.DFC_MDCyl_1 "" UBYTE DFC_OneToOne 1 100 0.00 255.0 FORMAT "%5.1" ECU_ADDRESS 0xAFE804A0 /end MEASUREMENT
/begin MEASUREMENT DFC_st.DFC_MDCyl_2 "" UBYTE DFC_OneToOne 1 100 0.00 255.0 FORMAT "%5.1" ECU_ADDRESS 0xAFE804A1 /end MEASUREMENT
/begin MEASUREMENT DFC_st.DFC_MDFC "" UBYTE DFC_OneToOne 1 100 0.00 255.0 FORMAT "%5.1" ECU_ADDRESS 0xAFE804A2 /end MEASUREMENT
/begin MEASUREMENT DFC_st.DFC_MDmin "" UBYTE DFC_OneToOne 1 100 0.00 255.0 FORMAT "%5.1" ECU_ADDRESS 0xAFE804A3 /end MEASUREMENT
/begin MEASUREMENT DFC_st.DFC_MDnpl "" UBYTE DFC_OneToOne 1 100 0.00 255.0 FORMAT "%5.1" ECU_ADDRESS 0xAFE804A4 /end MEASUREMENT
/begin MEASUREMENT DFC_st.DFC_MoCADCNTP "" UBYTE DFC_OneToOne 1 100 0.00 255.0 FORMAT "%5.1" ECU_ADDRESS 0xAFE804A5 /end MEASUREMENT
/begin MEASUREMENT DFC_st.DFC_MoCADCTst "" UBYTE DFC_OneToOne 1 100 0.00 255.0 FORMAT "%5.1" ECU_ADDRESS 0xAFE804A6 /end MEASUREMENT
/begin MEASUREMENT DFC_st.DFC_MoCComctErrMM "" UBYTE DFC_OneToOne 1 100 0.00 255.0 FORMAT "%5.1" ECU_ADDRESS 0xAFE804A7 /end MEASUREMENT
/begin MEASUREMENT DFC_st.DFC_OCWDAActv "" UBYTE DFC_OneToOne 1 100 0.00 255.0 FORMAT "%5.1" ECU_ADDRESS 0xAFE804A8 /end MEASUREMENT
/begin MEASUREMENT DFC_st.DFC_OCWDACom "" UBYTE DFC_OneToOne 1 100 0.00 255.0 FORMAT "%5.1" ECU_ADDRESS 0xAFE804A9 /end MEASUREMENT
/begin MEASUREMENT DFC_st.DFC_ORAmax "" UBYTE DFC_OneToOne 1 100 0.00 255.0 FORMAT "%5.1" ECU_ADDRESS 0xAFE804AA /end MEASUREMENT
/begin MEASUREMENT DFC_st.DFC_ORAmin "" UBYTE DFC_OneToOne 1 100 0.00 255.0 FORMAT "%5.1" ECU_ADDRESS 0xAFE804AB /end MEASUREMENT
/begin MEASUREMENT DFC_st.DFC_PSR1max "" UBYTE DFC_OneToOne 1 100 0.00 255.0 FORMAT "%5.1" ECU_ADDRESS 0xAFE804AC /end MEASUREMENT
/begin MEASUREMENT DFC_st.DFC_PSRBmax "" UBYTE DFC_OneToOne 1 100 0.00 255.0 FORMAT "%5.1" ECU_ADDRESS 0xAFE804AD /end MEASUREMENT
/begin MEASUREMENT DFC_st.DFC_PSRBmin "" UBYTE DFC_OneToOne 1 100 0.00 255.0 FORMAT "%5.1" ECU_ADDRESS 0xAFE804AE /end MEASUREMENT
/begin MEASUREMENT DFC_st.DFC_PSREmax "" UBYTE DFC_OneToOne 1 100 0.00 255.0 FORMAT "%5.1" ECU_ADDRESS 0xAFE804AF /end MEASUREMENT
/begin MEASUREMENT DFC_st.DFC_PSREmin "" UBYTE DFC_OneToOne 1 100 0.00 255.0 FORMAT "%5.1" ECU_ADDRESS 0xAFE804B0 /end MEASUREMENT
/begin MEASUREMENT DFC_st.DFC_PSRPmax "" UBYTE DFC_OneToOne 1 100 0.00 255.0 FORMAT "%5.1" ECU_ADDRESS 0xAFE804B1 /end MEASUREMENT
/begin MEASUREMENT DFC_st.DFC_PSRPmin "" UBYTE DFC_OneToOne 1 100 0.00 255.0 FORMAT "%5.1" ECU_ADDRESS 0xAFE804B2 /end MEASUREMENT
/begin MEASUREMENT DFC_st.DFC_PSRPsig "" UBYTE DFC_OneToOne 1 100 0.00 255.0 FORMAT "%5.1" ECU_ADDRESS 0xAFE804B3 /end MEASUREMENT
/begin MEASUREMENT DFC_st.DFC_PSRmax "" UBYTE DFC_OneToOne 1 100 0.00 255.0 FORMAT "%5.1" ECU_ADDRESS 0xAFE804B4 /end MEASUREMENT
/begin MEASUREMENT DFC_st.DFC_SSpMon1 "" UBYTE DFC_OneToOne 1 100 0.00 255.0 FORMAT "%5.1" ECU_ADDRESS 0xAFE804B5 /end MEASUREMENT
/begin MEASUREMENT DFC_st.DFC_SSpMon2 "" UBYTE DFC_OneToOne 1 100 0.00 255.0 FORMAT "%5.1" ECU_ADDRESS 0xAFE804B6 /end MEASUREMENT
/begin MEASUREMENT DFC_st.DFC_SSpMon3 "" UBYTE DFC_OneToOne 1 100 0.00 255.0 FORMAT "%5.1" ECU_ADDRESS 0xAFE804B7 /end MEASUREMENT
/begin MEASUREMENT DFC_st.DFC_SWReset_0 "" UBYTE DFC_OneToOne 1 100 0.00 255.0 FORMAT "%5.1" ECU_ADDRESS 0xAFE804B8 /end MEASUREMENT
/begin MEASUREMENT DFC_st.DFC_SWReset_1 "" UBYTE DFC_OneToOne 1 100 0.00 255.0 FORMAT "%5.1" ECU_ADDRESS 0xAFE804B9 /end MEASUREMENT
/begin MEASUREMENT DFC_st.DFC_SWReset_2 "" UBYTE DFC_OneToOne 1 100 0.00 255.0 FORMAT "%5.1" ECU_ADDRESS 0xAFE804BA /end MEASUREMENT
/begin MEASUREMENT DFC_st.DFC_TASREmax "" UBYTE DFC_OneToOne 1 100 0.00 255.0 FORMAT "%5.1" ECU_ADDRESS 0xAFE804BB /end MEASUREMENT
/begin MEASUREMENT DFC_st.DFC_TASREmin "" UBYTE DFC_OneToOne 1 100 0.00 255.0 FORMAT "%5.1" ECU_ADDRESS 0xAFE804BC /end MEASUREMENT
/begin MEASUREMENT DFC_st.DFC_TASREnpl "" UBYTE DFC_OneToOne 1 100 0.00 255.0 FORMAT "%5.1" ECU_ADDRESS 0xAFE804BD /end MEASUREMENT
/begin MEASUREMENT DFC_st.DFC_TASRmax "" UBYTE DFC_OneToOne 1 100 0.00 255.0 FORMAT "%5.1" ECU_ADDRESS 0xAFE804BE /end MEASUREMENT
/begin MEASUREMENT DFC_st.DFC_TAmax "" UBYTE DFC_OneToOne 1 100 0.00 255.0 FORMAT "%5.1" ECU_ADDRESS 0xAFE804BF /end MEASUREMENT
/begin MEASUREMENT DFC_st.DFC_TEVEmax "" UBYTE DFC_OneToOne 1 100 0.00 255.0 FORMAT "%5.1" ECU_ADDRESS 0xAFE804C0 /end MEASUREMENT
/begin MEASUREMENT DFC_st.DFC_TEVEmin "" UBYTE DFC_OneToOne 1 100 0.00 255.0 FORMAT "%5.1" ECU_ADDRESS 0xAFE804C1 /end MEASUREMENT
/begin MEASUREMENT DFC_st.DFC_TEVEsig "" UBYTE DFC_OneToOne 1 100 0.00 255.0 FORMAT "%5.1" ECU_ADDRESS 0xAFE804C2 /end MEASUREMENT
/begin MEASUREMENT DFC_st.DFC_TMCSmax "" UBYTE DFC_OneToOne 1 100 0.00 255.0 FORMAT "%5.1" ECU_ADDRESS 0xAFE804C3 /end MEASUREMENT
/begin MEASUREMENT DFC_st.DFC_TMCSmin "" UBYTE DFC_OneToOne 1 100 0.00 255.0 FORMAT "%5.1" ECU_ADDRESS 0xAFE804C4 /end MEASUREMENT
/begin MEASUREMENT DFC_st.DFC_TMEmax "" UBYTE DFC_OneToOne 1 100 0.00 255.0 FORMAT "%5.1" ECU_ADDRESS 0xAFE804C5 /end MEASUREMENT
/begin MEASUREMENT DFC_st.DFC_TMEmin "" UBYTE DFC_OneToOne 1 100 0.00 255.0 FORMAT "%5.1" ECU_ADDRESS 0xAFE804C6 /end MEASUREMENT
/begin MEASUREMENT DFC_st.DFC_TMEnpl "" UBYTE DFC_OneToOne 1 100 0.00 255.0 FORMAT "%5.1" ECU_ADDRESS 0xAFE804C7 /end MEASUREMENT
/begin MEASUREMENT DFC_st.DFC_TMEsig "" UBYTE DFC_OneToOne 1 100 0.00 255.0 FORMAT "%5.1" ECU_ADDRESS 0xAFE804C8 /end MEASUREMENT
/begin MEASUREMENT DFC_st.DFC_TMPmax "" UBYTE DFC_OneToOne 1 100 0.00 255.0 FORMAT "%5.1" ECU_ADDRESS 0xAFE804C9 /end MEASUREMENT
/begin MEASUREMENT DFC_st.DFC_TMPmin "" UBYTE DFC_OneToOne 1 100 0.00 255.0 FORMAT "%5.1" ECU_ADDRESS 0xAFE804CA /end MEASUREMENT
/begin MEASUREMENT DFC_st.DFC_TMPnpl "" UBYTE DFC_OneToOne 1 100 0.00 255.0 FORMAT "%5.1" ECU_ADDRESS 0xAFE804CB /end MEASUREMENT
/begin MEASUREMENT DFC_st.DFC_TMmax "" UBYTE DFC_OneToOne 1 100 0.00 255.0 FORMAT "%5.1" ECU_ADDRESS 0xAFE804CC /end MEASUREMENT
/begin MEASUREMENT DFC_st.DFC_TUMmax "" UBYTE DFC_OneToOne 1 100 0.00 255.0 FORMAT "%5.1" ECU_ADDRESS 0xAFE804CD /end MEASUREMENT
/begin MEASUREMENT DFC_st.DFC_TWCCTrimMaxB1 "" UBYTE DFC_OneToOne 1 100 0.00 255.0 FORMAT "%5.1" ECU_ADDRESS 0xAFE804CE /end MEASUREMENT
/begin MEASUREMENT DFC_st.DFC_TWCCTrimMinB1 "" UBYTE DFC_OneToOne 1 100 0.00 255.0 FORMAT "%5.1" ECU_ADDRESS 0xAFE804CF /end MEASUREMENT
/begin MEASUREMENT DFC_st.DFC_TWCDPriCatB1 "" UBYTE DFC_OneToOne 1 100 0.00 255.0 FORMAT "%5.1" ECU_ADDRESS 0xAFE804D0 /end MEASUREMENT
/begin MEASUREMENT DFC_st.DFC_UBRmax "" UBYTE DFC_OneToOne 1 100 0.00 255.0 FORMAT "%5.1" ECU_ADDRESS 0xAFE804D1 /end MEASUREMENT
/begin MEASUREMENT DFC_st.DFC_UBmax "" UBYTE DFC_OneToOne 1 100 0.00 255.0 FORMAT "%5.1" ECU_ADDRESS 0xAFE804D2 /end MEASUREMENT
/begin MEASUREMENT DFC_st.DFC_UBmin "" UBYTE DFC_OneToOne 1 100 0.00 255.0 FORMAT "%5.1" ECU_ADDRESS 0xAFE804D3 /end MEASUREMENT
/begin MEASUREMENT DFC_st.DFC_UBnpl "" UBYTE DFC_OneToOne 1 100 0.00 255.0 FORMAT "%5.1" ECU_ADDRESS 0xAFE804D4 /end MEASUREMENT
/begin MEASUREMENT DFC_stFinal "" UWORD DFC_OneToOne 1 100 0.00 65535.00 FORMAT "%8.2" ARRAY_SIZE 14 ECU_ADDRESS 0xD000384A /end MEASUREMENT
/begin MEASUREMENT DFC_stMaxFlt "" UWORD DFC_OneToOne 1 100 0.00 65535.00 FORMAT "%8.2" ARRAY_SIZE 14 ECU_ADDRESS 0xD0003866 /end MEASUREMENT
/begin MEASUREMENT DFC_stRun "" UWORD DFC_OneToOne 1 100 0.00 65535.00 FORMAT "%8.2" ARRAY_SIZE 14 ECU_ADDRESS 0xD000382E /end MEASUREMENT
/begin MEASUREMENT DFES_ChkLstDltDemExCond_mp "" UBYTE OneToOne 1 100 0.00 255.0 FORMAT "%5.1" ECU_ADDRESS 0xD00053C5 /end MEASUREMENT
/begin MEASUREMENT DFES_ctDef "" UBYTE DFES_OneToOne 1 100 0.00 255.0 FORMAT "%5.1" ARRAY_SIZE 10 ECU_ADDRESS 0xAFE802AC /end MEASUREMENT
/begin MEASUREMENT DFES_ctDel "" UBYTE DFES_OneToOne 1 100 0.00 255.0 FORMAT "%5.1" ARRAY_SIZE 10 ECU_ADDRESS 0xAFE802D4 /end MEASUREMENT
/begin MEASUREMENT DFES_ctEntry "" UBYTE DFES_OneToOne 1 100 0.00 255.0 FORMAT "%5.1" ECU_ADDRESS 0xD00045AA /end MEASUREMENT
/begin MEASUREMENT DFES_ctFrq "" UBYTE DFES_OneToOne 1 100 0.00 255.0 FORMAT "%5.1" ARRAY_SIZE 10 ECU_ADDRESS 0xAFE802DE /end MEASUREMENT
/begin MEASUREMENT DFES_ctManuDef "" UBYTE DFES_OneToOne 1 100 0.00 255.0 FORMAT "%5.1" ARRAY_SIZE 10 ECU_ADDRESS 0xAFE802C0 /end MEASUREMENT
/begin MEASUREMENT DFES_ctManuOk "" UBYTE DFES_OneToOne 1 100 0.00 255.0 FORMAT "%5.1" ARRAY_SIZE 10 ECU_ADDRESS 0xAFE802CA /end MEASUREMENT
/begin MEASUREMENT DFES_ctMIL "" UBYTE DFES_OneToOne 1 100 0.00 255.0 FORMAT "%5.1" ECU_ADDRESS 0xD00045A8 /end MEASUREMENT
/begin MEASUREMENT DFES_ctOBD "" UBYTE DFES_OneToOne 1 100 0.00 255.0 FORMAT "%5.1" ECU_ADDRESS 0xD00045A6 /end MEASUREMENT
/begin MEASUREMENT DFES_ctOBDPend "" UBYTE DFES_OneToOne 1 100 0.00 255.0 FORMAT "%5.1" ECU_ADDRESS 0xD00045A7 /end MEASUREMENT
/begin MEASUREMENT DFES_ctOk "" UBYTE DFES_OneToOne 1 100 0.00 255.0 FORMAT "%5.1" ARRAY_SIZE 10 ECU_ADDRESS 0xAFE802B6 /end MEASUREMENT
/begin MEASUREMENT DFES_ctSrv "" UBYTE DFES_OneToOne 1 100 0.00 255.0 FORMAT "%5.1" ECU_ADDRESS 0xD00045A9 /end MEASUREMENT
/begin MEASUREMENT DFES_EnvBlock "" UBYTE DFES_OneToOne 1 100 0.00 255.0 FORMAT "%5.1" ARRAY_SIZE 40 ECU_ADDRESS 0xAFE803CE /end MEASUREMENT
/begin MEASUREMENT DFES_FrzFrVal "" UBYTE DFES_OneToOne 1 100 0.00 255.0 FORMAT "%5.1" ARRAY_SIZE 230 ECU_ADDRESS 0xAFE802E8 /end MEASUREMENT
/begin MEASUREMENT DFES_idxHash "" UBYTE DFES_OneToOne 1 100 0.00 255.0 FORMAT "%5.1" ARRAY_SIZE 11 ECU_ADDRESS 0xD00045EF /end MEASUREMENT
/begin MEASUREMENT DFES_idxLink "" UBYTE DFES_OneToOne 1 100 0.00 255.0 FORMAT "%5.1" ARRAY_SIZE 10 ECU_ADDRESS 0xD00045DB /end MEASUREMENT
/begin MEASUREMENT DFES_idxPrioQueue "" UBYTE DFES_OneToOne 1 100 0.00 255.0 FORMAT "%5.1" ARRAY_SIZE 10 ECU_ADDRESS 0xD00045E5 /end MEASUREMENT
/begin MEASUREMENT DFES_idxSequence "" UBYTE DFES_OneToOne 1 100 0.00 255.0 FORMAT "%5.1" ARRAY_SIZE 10 ECU_ADDRESS 0xAFE803F6 /end MEASUREMENT
/begin MEASUREMENT DFES_idxVisible "" UBYTE DFES_OneToOne 1 100 0.00 255.0 FORMAT "%5.1" ARRAY_SIZE 10 ECU_ADDRESS 0xD00045BD /end MEASUREMENT
/begin MEASUREMENT DFES_ISOFrstCnfDFC "" UWORD DFCDFP_Verb 1 100 0.00 298. FORMAT "%2.0" ECU_ADDRESS 0xAFE8026C /end MEASUREMENT
/begin MEASUREMENT DFES_ISOFrstFailDFC "" UWORD DFCDFP_Verb 1 100 0.00 298. FORMAT "%2.0" ECU_ADDRESS 0xAFE80268 /end MEASUREMENT
/begin MEASUREMENT DFES_ISORcntCnfDFC "" UWORD DFCDFP_Verb 1 100 0.00 298. FORMAT "%2.0" ECU_ADDRESS 0xAFE8026E /end MEASUREMENT
/begin MEASUREMENT DFES_ISORcntFailDFC "" UWORD DFCDFP_Verb 1 100 0.00 298. FORMAT "%2.0" ECU_ADDRESS 0xAFE8026A /end MEASUREMENT
/begin MEASUREMENT DFES_MonEvnt "" UWORD DFES_Mon_Verb 1 100 0.00 32783.0000000 FORMAT "%13.7" ARRAY_SIZE 2 ECU_ADDRESS 0xAFE8025C /end MEASUREMENT
/begin MEASUREMENT DFES_MonObjt "" UWORD OneToOne 1 100 0.00 65535.00 FORMAT "%8.2" ARRAY_SIZE 2 ECU_ADDRESS 0xAFE80260 /end MEASUREMENT
/begin MEASUREMENT DFES_MonParm "" UWORD OneToOne 1 100 0.00 65535.00 FORMAT "%8.2" ARRAY_SIZE 2 ECU_ADDRESS 0xAFE80264 /end MEASUREMENT
/begin MEASUREMENT DFES_MonPtr "" UBYTE DFES_OneToOne 1 100 0.00 255.0 FORMAT "%5.1" ECU_ADDRESS 0xAFE8025A /end MEASUREMENT
/begin MEASUREMENT DFES_numDFC "" UWORD DFCDFP_Verb 1 100 0.00 298. FORMAT "%2.0" ARRAY_SIZE 10 ECU_ADDRESS 0xAFE80270 /end MEASUREMENT
/begin MEASUREMENT DFES_numEntryAvl "" UBYTE DFES_OneToOne 1 100 0.00 255.0 FORMAT "%5.1" ECU_ADDRESS 0xD00045AB /end MEASUREMENT
/begin MEASUREMENT DFES_numEnvSize "" UBYTE DFES_OneToOne 1 100 0.00 255.0 FORMAT "%5.1" ECU_ADDRESS 0xD00045AE /end MEASUREMENT
/begin MEASUREMENT DFES_numExtdFrzFrmSize "" UBYTE DFES_OneToOne 1 100 0.00 255.0 FORMAT "%5.1" ECU_ADDRESS 0xD00045AD /end MEASUREMENT
/begin MEASUREMENT DFES_numFrzFrmSize "" UBYTE DFES_OneToOne 1 100 0.00 255.0 FORMAT "%5.1" ECU_ADDRESS 0xD00045AC /end MEASUREMENT
/begin MEASUREMENT DFES_Order "" UWORD DFES_OneToOne 1 100 0.00 65535.00 FORMAT "%8.2" ARRAY_SIZE 10 ECU_ADDRESS 0xD0003800 /end MEASUREMENT
/begin MEASUREMENT DFES_OutLamps "" UBYTE DFES_OneToOne 1 100 0.00 255.0 FORMAT "%5.1" ARRAY_SIZE 10 ECU_ADDRESS 0xD00045C7 /end MEASUREMENT
/begin MEASUREMENT DFES_OutTester "" UBYTE DFES_OneToOne 1 100 0.00 255.0 FORMAT "%5.1" ARRAY_SIZE 10 ECU_ADDRESS 0xD00045D1 /end MEASUREMENT
/begin MEASUREMENT DFES_PDTCStore "" UBYTE OneToOne 1 100 0.00 1.000 BIT_MASK 0x80 FORMAT "%5.3" ECU_ADDRESS 0xD0000082 /end MEASUREMENT
/begin MEASUREMENT DFES_stChk "" UBYTE DFES_stCheck_Verb 1 100 0.00 247.000000000 FORMAT "%13.9" ARRAY_SIZE 10 ECU_ADDRESS 0xAFE8028E /end MEASUREMENT
/begin MEASUREMENT DFES_stChkFault "" UBYTE DFES_OneToOne 1 100 0.00 255.0 FORMAT "%5.1" ARRAY_SIZE 10 ECU_ADDRESS 0xAFE80298 /end MEASUREMENT
/begin MEASUREMENT DFES_stCounters "" UBYTE DFES_stCnt_Verb 1 100 0.00 85.0000000000 FORMAT "%13.10" ARRAY_SIZE 10 ECU_ADDRESS 0xAFE802A2 /end MEASUREMENT
/begin MEASUREMENT DFES_stCtlSetting "" UBYTE OneToOne 1 100 0.00 255.0 FORMAT "%5.1" ECU_ADDRESS 0xD00045B8 /end MEASUREMENT
/begin MEASUREMENT DFES_stDTCRecUpdt "" UBYTE OneToOne 1 100 0.00 255.0 FORMAT "%5.1" ECU_ADDRESS 0xD00045B9 /end MEASUREMENT
/begin MEASUREMENT DFES_stDTCStorage "" UBYTE OneToOne 1 100 0.00 255.0 FORMAT "%5.1" ECU_ADDRESS 0xD00045BA /end MEASUREMENT
/begin MEASUREMENT DFES_stEntry "" UBYTE DFES_stEntry_Verb 1 100 0.00 254.000000000 FORMAT "%13.9" ARRAY_SIZE 10 ECU_ADDRESS 0xAFE80284 /end MEASUREMENT
/begin MEASUREMENT DFES_stErrDia "" UBYTE DFES_OneToOne 1 100 0.00 255.0 FORMAT "%5.1" ECU_ADDRESS 0xD00045A5 /end MEASUREMENT
/begin MEASUREMENT DFES_stErrLamp "" UBYTE DFES_OneToOne 1 100 0.00 255.0 FORMAT "%5.1" ECU_ADDRESS 0xD00045A4 /end MEASUREMENT
/begin MEASUREMENT DFES_stFltr "" UBYTE DFES_OneToOne 1 100 0.00 255.0 FORMAT "%5.1" ARRAY_SIZE 10 ECU_ADDRESS 0xD0004615 /end MEASUREMENT
/begin MEASUREMENT DFES_stOutstate "" UBYTE DFES_OneToOne 1 100 0.00 255.0 FORMAT "%5.1" ECU_ADDRESS 0xD00045AF /end MEASUREMENT
/begin MEASUREMENT DFES_stPrgEvt "" UBYTE OneToOne 1 100 0.00 1.000 BIT_MASK 0x8 FORMAT "%5.3" ECU_ADDRESS 0xD0000081 /end MEASUREMENT
/begin MEASUREMENT DSQ_st.DSQ_ACClntP "" UBYTE DFC_OneToOne 1 100 0.00 255.0 FORMAT "%5.1" ECU_ADDRESS 0xD0003DD0 /end MEASUREMENT
/begin MEASUREMENT DSQ_st.DSQ_AirCCmprActr "" UBYTE DFC_OneToOne 1 100 0.00 255.0 FORMAT "%5.1" ECU_ADDRESS 0xD0003DD1 /end MEASUREMENT
/begin MEASUREMENT DSQ_st.DSQ_AltIOActr "" UBYTE DFC_OneToOne 1 100 0.00 255.0 FORMAT "%5.1" ECU_ADDRESS 0xD0003DD2 /end MEASUREMENT
/begin MEASUREMENT DSQ_st.DSQ_AltIOLoad "" UBYTE DFC_OneToOne 1 100 0.00 255.0 FORMAT "%5.1" ECU_ADDRESS 0xD0003DD3 /end MEASUREMENT
/begin MEASUREMENT DSQ_st.DSQ_AltTrqDes "" UBYTE DFC_OneToOne 1 100 0.00 255.0 FORMAT "%5.1" ECU_ADDRESS 0xD0003DD4 /end MEASUREMENT
/begin MEASUREMENT DSQ_st.DSQ_BattUSSpThrVlv "" UBYTE DFC_OneToOne 1 100 0.00 255.0 FORMAT "%5.1" ECU_ADDRESS 0xD0003DD5 /end MEASUREMENT
/begin MEASUREMENT DSQ_st.DSQ_CEngDsT "" UBYTE DFC_OneToOne 1 100 0.00 255.0 FORMAT "%5.1" ECU_ADDRESS 0xD0003DD6 /end MEASUREMENT
/begin MEASUREMENT DSQ_st.DSQ_Clth "" UBYTE DFC_OneToOne 1 100 0.00 255.0 FORMAT "%5.1" ECU_ADDRESS 0xD0003DD7 /end MEASUREMENT
/begin MEASUREMENT DSQ_st.DSQ_DSMInhibitAlways "" UBYTE DFC_OneToOne 1 100 0.00 255.0 FORMAT "%5.1" ECU_ADDRESS 0xD0003DD8 /end MEASUREMENT
/begin MEASUREMENT DSQ_st.DSQ_EpmReverseRun "" UBYTE DFC_OneToOne 1 100 0.00 255.0 FORMAT "%5.1" ECU_ADDRESS 0xD0003DD9 /end MEASUREMENT
/begin MEASUREMENT DSQ_st.DSQ_FanDIO "" UBYTE DFC_OneToOne 1 100 0.00 255.0 FORMAT "%5.1" ECU_ADDRESS 0xD0003DDA /end MEASUREMENT
/begin MEASUREMENT DSQ_st.DSQ_FanPWM "" UBYTE DFC_OneToOne 1 100 0.00 255.0 FORMAT "%5.1" ECU_ADDRESS 0xD0003DDB /end MEASUREMENT
/begin MEASUREMENT DSQ_st.DSQ_IdleChrgActMod "" UBYTE DFC_OneToOne 1 100 0.00 255.0 FORMAT "%5.1" ECU_ADDRESS 0xD0003DDC /end MEASUREMENT
/begin MEASUREMENT DSQ_st.DSQ_VehV "" UBYTE DFC_OneToOne 1 100 0.00 255.0 FORMAT "%5.1" ECU_ADDRESS 0xD0003DDD /end MEASUREMENT
/begin MEASUREMENT DSQ_st.DSQ_stAPP "" UBYTE DFC_OneToOne 1 100 0.00 255.0 FORMAT "%5.1" ECU_ADDRESS 0xD0003DDE /end MEASUREMENT
/begin MEASUREMENT DSQ_st.DSQ_stAPP1 "" UBYTE DFC_OneToOne 1 100 0.00 255.0 FORMAT "%5.1" ECU_ADDRESS 0xD0003DDF /end MEASUREMENT
/begin MEASUREMENT DSQ_st.DSQ_stAPP2 "" UBYTE DFC_OneToOne 1 100 0.00 255.0 FORMAT "%5.1" ECU_ADDRESS 0xD0003DE0 /end MEASUREMENT
/begin FUNCTION DFC "2.3.1"
 /begin DEF_CHARACTERISTIC DFC_CtlMsk2.DFC_Unused_C DFC_CtlMsk2.DFC_AltMaxPwr_C DFC_CtlMsk2.DFC_BrkNpl_C DFC_CtlMsk2.DFC_Cj930SSp1Mon_C DFC_CtlMsk2.DFC_Cj930SSp2Mon_C DFC_CtlMsk2.DFC_Cj930SSp3Mon_C DFC_CtlMsk2.DFC_IdleChrgActrAMax_C DFC_CtlMsk2.DFC_IdleChrgActrAMin_C DFC_CtlMsk2.DFC_IdleChrgActrASig_C DFC_CtlMsk2.DFC_IdleChrgActrBMax_C DFC_CtlMsk2.DFC_IdleChrgActrBMin_C DFC_CtlMsk2.DFC_IdleChrgActrBSig_C DFC_CtlMsk2.DFC_IdleChrgActrGovDeCold_C DFC_CtlMsk2.DFC_IdleChrgActrGovDeMax_C DFC_CtlMsk2.DFC_IdleChrgActrGovDeMin_C DFC_CtlMsk2.DFC_IdleChrgActrNAMax_C DFC_CtlMsk2.DFC_IdleChrgActrNAMin_C DFC_CtlMsk2.DFC_IdleChrgActrNASig_C DFC_CtlMsk2.DFC_IdleChrgActrNBMax_C DFC_CtlMsk2.DFC_IdleChrgActrNBMin_C DFC_CtlMsk2.DFC_IdleChrgActrNBSig_C DFC_CtlMsk2.DFC_IdleChrgActrOverTmp_C DFC_CtlMsk2.DFC_MonUMaxSupply1_C DFC_CtlMsk2.DFC_MonUMinSupply1_C DFC_CtlMsk2.DFC_ClthNplClsd_C DFC_CtlMsk2.DFC_ClthNplOpn_C DFC_CtlMsk2.DFC_IgnClPsDevComErr1_C DFC_CtlMsk2.DFC_IgnClPsOpenLoad0_C DFC_CtlMsk2.DFC_IgnClPsOpenLoad1_C DFC_CtlMsk2.DFC_IgnClPsOpenLoad2_C DFC_CtlMsk2.DFC_IgnClPsShCirBatt0_C DFC_CtlMsk2.DFC_IgnClPsShCirBatt1_C DFC_CtlMsk2.DFC_IgnClPsShCirBatt2_C DFC_CtlMsk2.DFC_IgnClPsShCirGnd0_C DFC_CtlMsk2.DFC_IgnClPsShCirGnd1_C DFC_CtlMsk2.DFC_IgnClPsShCirGnd2_C DFC_CtlMsk2.DFC_KnDetSens1PortAMax_C DFC_CtlMsk2.DFC_KnDetSens1PortAMin_C DFC_CtlMsk2.DFC_KnDetSens1PortBMax_C DFC_CtlMsk2.DFC_KnDetSens1PortBMin_C DFC_CtlMsk2.DFC_VehVWhlErr_C DFC_CtlMsk2.DFC_AirCCmprOL_C DFC_CtlMsk2.DFC_AirCCmprOvrTemp_C DFC_CtlMsk2.DFC_AirCCmprSCB_C DFC_CtlMsk2.DFC_AirCCmprSCG_C DFC_CtlMsk2.DFC_AltIOLdSRCMin_C DFC_CtlMsk2.DFC_AltIOOL_C DFC_CtlMsk2.DFC_AltIOOvrTemp_C DFC_CtlMsk2.DFC_AltIOSCB_C DFC_CtlMsk2.DFC_AltIOSCG_C DFC_CtlMsk2.DFC_DevLibBattUHi_C DFC_CtlMsk2.DFC_DevLibBattULo_C DFC_CtlMsk2.DFC_FanDIOOL_C DFC_CtlMsk2.DFC_FanDIOOvrTemp_C DFC_CtlMsk2.DFC_FanDIOSCB_C DFC_CtlMsk2.DFC_FanDIOSCG_C DFC_CtlMsk2.DFC_FanPWMOL_C DFC_CtlMsk2.DFC_FanPWMOvrTemp_C DFC_CtlMsk2.DFC_FanPWMSCB_C DFC_CtlMsk2.DFC_FanPWMSCG_C DFC_CtlMsk2.DFC_AirCClntPAnaSRCMax_C DFC_CtlMsk2.DFC_AirCClntPAnaSRCMin_C DFC_CtlMsk2.DFC_AirCSwtNpl_C DFC_CtlMsk2.DFC_AirCSwtSig_C DFC_CtlMsk2.DFC_AltIOLdSRCMax_C DFC_CtlMsk2.DFC_BrkSig_C DFC_CtlMsk2.DFC_ClthEPBNpl_C DFC_CtlMsk2.DFC_ClthEPBSensErr_C DFC_CtlMsk2.DFC_ClthErr_C DFC_CtlMsk2.DFC_ClthSig_C DFC_CtlMsk2.DFC_MILLmpOL_C DFC_CtlMsk2.DFC_MILLmpSCB_C DFC_CtlMsk2.DFC_MILLmpSCG_C DFC_CtlMsk2.DFC_SRCHighAPP1_C DFC_CtlMsk2.DFC_SRCHighAPP2_C DFC_CtlMsk2.DFC_SRCLowAPP1_C DFC_CtlMsk2.DFC_SRCLowAPP2_C DFC_CtlMsk2.DFC_SyncAPP_C DFC_CtlMsk2.DFC_VehVMax_C DFC_CtlMsk2.DFC_VehVPlaus_C DFC_CtlMsk2.DFC_VehVSig_C DFC_CtlMsk2.DFC_BusDiagBusOffNodeA_C DFC_CtlMsk2.DFC_ComACSensTO_C DFC_CtlMsk2.DFC_ComAWD1TO_C DFC_CtlMsk2.DFC_ComBRK10TO_C DFC_CtlMsk2.DFC_ComGW11TO_C DFC_CtlMsk2.DFC_ComLVL1TO_C DFC_CtlMsk2.DFC_ComPRKA01TO_C DFC_CtlMsk2.DFC_ComPRKH01TO_C DFC_CtlMsk2.DFC_ComPRKH1TO_C DFC_CtlMsk2.DFC_ComTRBCH1TO_C DFC_CtlMsk2.DFC_ComTRBCH2TO_C DFC_CtlMsk2.DFC_DK_C DFC_CtlMsk2.DFC_DKRSA_C DFC_CtlMsk2.DFC_DKVSmax_C DFC_CtlMsk2.DFC_DKmax_C DFC_CtlMsk2.DFC_DKmin_C DFC_CtlMsk2.DFC_DSSmax_C DFC_CtlMsk2.DFC_EEPEraseErr_C DFC_CtlMsk2.DFC_EEPRdErr_C DFC_CtlMsk2.DFC_EEPWrErr_C DFC_CtlMsk2.DFC_EV1max_C DFC_CtlMsk2.DFC_EV1min_C DFC_CtlMsk2.DFC_EV1sig_C DFC_CtlMsk2.DFC_EV2max_C DFC_CtlMsk2.DFC_EV2min_C DFC_CtlMsk2.DFC_EV2sig_C DFC_CtlMsk2.DFC_EV3max_C DFC_CtlMsk2.DFC_EV3min_C DFC_CtlMsk2.DFC_EV3sig_C DFC_CtlMsk2.DFC_EpmCaSI1ErrSig_C DFC_CtlMsk2.DFC_EpmCaSI1NoSig_C DFC_CtlMsk2.DFC_EpmCaSI1NoSigMax_C DFC_CtlMsk2.DFC_EpmCaSI1NoSigMin_C DFC_CtlMsk2.DFC_EpmCaSI1OfsErr_C DFC_CtlMsk2.DFC_EpmCrSErrSig_C DFC_CtlMsk2.DFC_EpmCrSNoSig_C DFC_CtlMsk2.DFC_FRAmax_C DFC_CtlMsk2.DFC_FRAmin_C DFC_CtlMsk2.DFC_HEGOS1B1ElecMax_C DFC_CtlMsk2.DFC_HEGOS1B1ElecMin_C DFC_CtlMsk2.DFC_HEGOS1B1ElecNpl_C DFC_CtlMsk2.DFC_HEGOS1B1ElecSig_C DFC_CtlMsk2.DFC_HEGOS1B1HtgNpl_C DFC_CtlMsk2.DFC_HEGOS1B1HtrPsMax_C DFC_CtlMsk2.DFC_HEGOS1B1HtrPsMin_C DFC_CtlMsk2.DFC_HEGOS1B1HtrPsSig_C DFC_CtlMsk2.DFC_HEGOS1B1StkMax_C DFC_CtlMsk2.DFC_HEGOS1B1StkMin_C DFC_CtlMsk2.DFC_HEGOS2B1RstrcnLean_C DFC_CtlMsk2.DFC_HEGOS2B1RstrcnRich_C DFC_CtlMsk2.DFC_IdleChrgActrJamVlvClsd_C DFC_CtlMsk2.DFC_IdleChrgActrJamVlvOpn_C DFC_CtlMsk2.DFC_IgnClPsDevOscErr1_C DFC_CtlMsk2.DFC_KPEmax_C DFC_CtlMsk2.DFC_KPEmin_C DFC_CtlMsk2.DFC_KPEsig_C DFC_CtlMsk2.DFC_KS1max_C DFC_CtlMsk2.DFC_KS1min_C DFC_CtlMsk2.DFC_LLRKHmax_C DFC_CtlMsk2.DFC_LLRKHmin_C DFC_CtlMsk2.DFC_LLRKHnpl_C DFC_CtlMsk2.DFC_LLRmax_C DFC_CtlMsk2.DFC_LLRmin_C DFC_CtlMsk2.DFC_LLRnpl_C DFC_CtlMsk2.DFC_LMmax_C DFC_CtlMsk2.DFC_LZSRnpl_C DFC_CtlMsk2.DFC_MD_C DFC_CtlMsk2.DFC_MD00min_C DFC_CtlMsk2.DFC_MD00npl_C DFC_CtlMsk2.DFC_MD01min_C DFC_CtlMsk2.DFC_MD01npl_C DFC_CtlMsk2.DFC_MD02min_C DFC_CtlMsk2.DFC_MD02npl_C DFC_CtlMsk2.DFC_MD03min_C DFC_CtlMsk2.DFC_MD03npl_C DFC_CtlMsk2.DFC_MD04min_C DFC_CtlMsk2.DFC_MD04npl_C DFC_CtlMsk2.DFC_MDCyl_0_C DFC_CtlMsk2.DFC_MDCyl_1_C DFC_CtlMsk2.DFC_MDCyl_2_C DFC_CtlMsk2.DFC_MDFC_C DFC_CtlMsk2.DFC_MDmin_C DFC_CtlMsk2.DFC_MDnpl_C DFC_CtlMsk2.DFC_MoCADCNTP_C DFC_CtlMsk2.DFC_MoCADCTst_C DFC_CtlMsk2.DFC_MoCComctErrMM_C DFC_CtlMsk2.DFC_OCWDAActv_C DFC_CtlMsk2.DFC_OCWDACom_C DFC_CtlMsk2.DFC_ORAmax_C DFC_CtlMsk2.DFC_ORAmin_C DFC_CtlMsk2.DFC_PSR1max_C DFC_CtlMsk2.DFC_PSRBmax_C DFC_CtlMsk2.DFC_PSRBmin_C DFC_CtlMsk2.DFC_PSREmax_C DFC_CtlMsk2.DFC_PSREmin_C DFC_CtlMsk2.DFC_PSRPmax_C DFC_CtlMsk2.DFC_PSRPmin_C DFC_CtlMsk2.DFC_PSRPsig_C DFC_CtlMsk2.DFC_PSRmax_C DFC_CtlMsk2.DFC_SSpMon1_C DFC_CtlMsk2.DFC_SSpMon2_C DFC_CtlMsk2.DFC_SSpMon3_C DFC_CtlMsk2.DFC_SWReset_0_C DFC_CtlMsk2.DFC_SWReset_1_C DFC_CtlMsk2.DFC_SWReset_2_C DFC_CtlMsk2.DFC_TASREmax_C DFC_CtlMsk2.DFC_TASREmin_C DFC_CtlMsk2.DFC_TASREnpl_C DFC_CtlMsk2.DFC_TASRmax_C DFC_CtlMsk2.DFC_TAmax_C DFC_CtlMsk2.DFC_TEVEmax_C DFC_CtlMsk2.DFC_TEVEmin_C DFC_CtlMsk2.DFC_TEVEsig_C DFC_CtlMsk2.DFC_TMCSmax_C DFC_CtlMsk2.DFC_TMCSmin_C DFC_CtlMsk2.DFC_TMEmax_C DFC_CtlMsk2.DFC_TMEmin_C DFC_CtlMsk2.DFC_TMEnpl_C DFC_CtlMsk2.DFC_TMEsig_C DFC_CtlMsk2.DFC_TMPmax_C DFC_CtlMsk2.DFC_TMPmin_C DFC_CtlMsk2.DFC_TMPnpl_C DFC_CtlMsk2.DFC_TMmax_C DFC_CtlMsk2.DFC_TUMmax_C DFC_CtlMsk2.DFC_TWCCTrimMaxB1_C DFC_CtlMsk2.DFC_TWCCTrimMinB1_C DFC_CtlMsk2.DFC_TWCDPriCatB1_C DFC_CtlMsk2.DFC_UBRmax_C DFC_CtlMsk2.DFC_UBmax_C DFC_CtlMsk2.DFC_UBmin_C DFC_CtlMsk2.DFC_UBnpl_C DFC_DisblMsk2.DFC_Unused_C DFC_DisblMsk2.DFC_AltMaxPwr_C DFC_DisblMsk2.DFC_BrkNpl_C DFC_DisblMsk2.DFC_Cj930SSp1Mon_C DFC_DisblMsk2.DFC_Cj930SSp2Mon_C DFC_DisblMsk2.DFC_Cj930SSp3Mon_C DFC_DisblMsk2.DFC_IdleChrgActrAMax_C DFC_DisblMsk2.DFC_IdleChrgActrAMin_C DFC_DisblMsk2.DFC_IdleChrgActrASig_C DFC_DisblMsk2.DFC_IdleChrgActrBMax_C DFC_DisblMsk2.DFC_IdleChrgActrBMin_C DFC_DisblMsk2.DFC_IdleChrgActrBSig_C DFC_DisblMsk2.DFC_IdleChrgActrGovDeCold_C DFC_DisblMsk2.DFC_IdleChrgActrGovDeMax_C DFC_DisblMsk2.DFC_IdleChrgActrGovDeMin_C DFC_DisblMsk2.DFC_IdleChrgActrNAMax_C DFC_DisblMsk2.DFC_IdleChrgActrNAMin_C DFC_DisblMsk2.DFC_IdleChrgActrNASig_C DFC_DisblMsk2.DFC_IdleChrgActrNBMax_C DFC_DisblMsk2.DFC_IdleChrgActrNBMin_C DFC_DisblMsk2.DFC_IdleChrgActrNBSig_C DFC_DisblMsk2.DFC_IdleChrgActrOverTmp_C DFC_DisblMsk2.DFC_MonUMaxSupply1_C DFC_DisblMsk2.DFC_MonUMinSupply1_C DFC_DisblMsk2.DFC_ClthNplClsd_C DFC_DisblMsk2.DFC_ClthNplOpn_C DFC_DisblMsk2.DFC_IgnClPsDevComErr1_C DFC_DisblMsk2.DFC_IgnClPsOpenLoad0_C DFC_DisblMsk2.DFC_IgnClPsOpenLoad1_C DFC_DisblMsk2.DFC_IgnClPsOpenLoad2_C DFC_DisblMsk2.DFC_IgnClPsShCirBatt0_C DFC_DisblMsk2.DFC_IgnClPsShCirBatt1_C DFC_DisblMsk2.DFC_IgnClPsShCirBatt2_C DFC_DisblMsk2.DFC_IgnClPsShCirGnd0_C DFC_DisblMsk2.DFC_IgnClPsShCirGnd1_C DFC_DisblMsk2.DFC_IgnClPsShCirGnd2_C DFC_DisblMsk2.DFC_KnDetSens1PortAMax_C DFC_DisblMsk2.DFC_KnDetSens1PortAMin_C DFC_DisblMsk2.DFC_KnDetSens1PortBMax_C DFC_DisblMsk2.DFC_KnDetSens1PortBMin_C DFC_DisblMsk2.DFC_VehVWhlErr_C DFC_DisblMsk2.DFC_AirCCmprOL_C DFC_DisblMsk2.DFC_AirCCmprOvrTemp_C DFC_DisblMsk2.DFC_AirCCmprSCB_C DFC_DisblMsk2.DFC_AirCCmprSCG_C DFC_DisblMsk2.DFC_AltIOLdSRCMin_C DFC_DisblMsk2.DFC_AltIOOL_C DFC_DisblMsk2.DFC_AltIOOvrTemp_C DFC_DisblMsk2.DFC_AltIOSCB_C DFC_DisblMsk2.DFC_AltIOSCG_C DFC_DisblMsk2.DFC_DevLibBattUHi_C DFC_DisblMsk2.DFC_DevLibBattULo_C DFC_DisblMsk2.DFC_FanDIOOL_C DFC_DisblMsk2.DFC_FanDIOOvrTemp_C DFC_DisblMsk2.DFC_FanDIOSCB_C DFC_DisblMsk2.DFC_FanDIOSCG_C DFC_DisblMsk2.DFC_FanPWMOL_C DFC_DisblMsk2.DFC_FanPWMOvrTemp_C DFC_DisblMsk2.DFC_FanPWMSCB_C DFC_DisblMsk2.DFC_FanPWMSCG_C DFC_DisblMsk2.DFC_AirCClntPAnaSRCMax_C DFC_DisblMsk2.DFC_AirCClntPAnaSRCMin_C DFC_DisblMsk2.DFC_AirCSwtNpl_C DFC_DisblMsk2.DFC_AirCSwtSig_C DFC_DisblMsk2.DFC_AltIOLdSRCMax_C DFC_DisblMsk2.DFC_BrkSig_C DFC_DisblMsk2.DFC_ClthEPBNpl_C DFC_DisblMsk2.DFC_ClthEPBSensErr_C DFC_DisblMsk2.DFC_ClthErr_C DFC_DisblMsk2.DFC_ClthSig_C DFC_DisblMsk2.DFC_MILLmpOL_C DFC_DisblMsk2.DFC_MILLmpSCB_C DFC_DisblMsk2.DFC_MILLmpSCG_C DFC_DisblMsk2.DFC_SRCHighAPP1_C DFC_DisblMsk2.DFC_SRCHighAPP2_C DFC_DisblMsk2.DFC_SRCLowAPP1_C DFC_DisblMsk2.DFC_SRCLowAPP2_C DFC_DisblMsk2.DFC_SyncAPP_C DFC_DisblMsk2.DFC_VehVMax_C DFC_DisblMsk2.DFC_VehVPlaus_C DFC_DisblMsk2.DFC_VehVSig_C DFC_DisblMsk2.DFC_BusDiagBusOffNodeA_C DFC_DisblMsk2.DFC_ComACSensTO_C DFC_DisblMsk2.DFC_ComAWD1TO_C DFC_DisblMsk2.DFC_ComBRK10TO_C DFC_DisblMsk2.DFC_ComGW11TO_C DFC_DisblMsk2.DFC_ComLVL1TO_C DFC_DisblMsk2.DFC_ComPRKA01TO_C DFC_DisblMsk2.DFC_ComPRKH01TO_C DFC_DisblMsk2.DFC_ComPRKH1TO_C DFC_DisblMsk2.DFC_ComTRBCH1TO_C DFC_DisblMsk2.DFC_ComTRBCH2TO_C DFC_DisblMsk2.DFC_DK_C DFC_DisblMsk2.DFC_DKRSA_C DFC_DisblMsk2.DFC_DKVSmax_C DFC_DisblMsk2.DFC_DKmax_C DFC_DisblMsk2.DFC_DKmin_C DFC_DisblMsk2.DFC_DSSmax_C DFC_DisblMsk2.DFC_EEPEraseErr_C DFC_DisblMsk2.DFC_EEPRdErr_C DFC_DisblMsk2.DFC_EEPWrErr_C DFC_DisblMsk2.DFC_EV1max_C DFC_DisblMsk2.DFC_EV1min_C DFC_DisblMsk2.DFC_EV1sig_C DFC_DisblMsk2.DFC_EV2max_C DFC_DisblMsk2.DFC_EV2min_C DFC_DisblMsk2.DFC_EV2sig_C DFC_DisblMsk2.DFC_EV3max_C DFC_DisblMsk2.DFC_EV3min_C DFC_DisblMsk2.DFC_EV3sig_C DFC_DisblMsk2.DFC_EpmCaSI1ErrSig_C DFC_DisblMsk2.DFC_EpmCaSI1NoSig_C DFC_DisblMsk2.DFC_EpmCaSI1NoSigMax_C DFC_DisblMsk2.DFC_EpmCaSI1NoSigMin_C DFC_DisblMsk2.DFC_EpmCaSI1OfsErr_C DFC_DisblMsk2.DFC_EpmCrSErrSig_C DFC_DisblMsk2.DFC_EpmCrSNoSig_C DFC_DisblMsk2.DFC_FRAmax_C DFC_DisblMsk2.DFC_FRAmin_C DFC_DisblMsk2.DFC_HEGOS1B1ElecMax_C DFC_DisblMsk2.DFC_HEGOS1B1ElecMin_C DFC_DisblMsk2.DFC_HEGOS1B1ElecNpl_C DFC_DisblMsk2.DFC_HEGOS1B1ElecSig_C DFC_DisblMsk2.DFC_HEGOS1B1HtgNpl_C DFC_DisblMsk2.DFC_HEGOS1B1HtrPsMax_C DFC_DisblMsk2.DFC_HEGOS1B1HtrPsMin_C DFC_DisblMsk2.DFC_HEGOS1B1HtrPsSig_C DFC_DisblMsk2.DFC_HEGOS1B1StkMax_C DFC_DisblMsk2.DFC_HEGOS1B1StkMin_C DFC_DisblMsk2.DFC_HEGOS2B1RstrcnLean_C DFC_DisblMsk2.DFC_HEGOS2B1RstrcnRich_C DFC_DisblMsk2.DFC_IdleChrgActrJamVlvClsd_C DFC_DisblMsk2.DFC_IdleChrgActrJamVlvOpn_C DFC_DisblMsk2.DFC_IgnClPsDevOscErr1_C DFC_DisblMsk2.DFC_KPEmax_C DFC_DisblMsk2.DFC_KPEmin_C DFC_DisblMsk2.DFC_KPEsig_C DFC_DisblMsk2.DFC_KS1max_C DFC_DisblMsk2.DFC_KS1min_C DFC_DisblMsk2.DFC_LLRKHmax_C DFC_DisblMsk2.DFC_LLRKHmin_C DFC_DisblMsk2.DFC_LLRKHnpl_C DFC_DisblMsk2.DFC_LLRmax_C DFC_DisblMsk2.DFC_LLRmin_C DFC_DisblMsk2.DFC_LLRnpl_C DFC_DisblMsk2.DFC_LMmax_C DFC_DisblMsk2.DFC_LZSRnpl_C DFC_DisblMsk2.DFC_MD_C DFC_DisblMsk2.DFC_MD00min_C DFC_DisblMsk2.DFC_MD00npl_C DFC_DisblMsk2.DFC_MD01min_C DFC_DisblMsk2.DFC_MD01npl_C DFC_DisblMsk2.DFC_MD02min_C DFC_DisblMsk2.DFC_MD02npl_C DFC_DisblMsk2.DFC_MD03min_C DFC_DisblMsk2.DFC_MD03npl_C DFC_DisblMsk2.DFC_MD04min_C DFC_DisblMsk2.DFC_MD04npl_C DFC_DisblMsk2.DFC_MDCyl_0_C DFC_DisblMsk2.DFC_MDCyl_1_C DFC_DisblMsk2.DFC_MDCyl_2_C DFC_DisblMsk2.DFC_MDFC_C DFC_DisblMsk2.DFC_MDmin_C DFC_DisblMsk2.DFC_MDnpl_C DFC_DisblMsk2.DFC_MoCADCNTP_C DFC_DisblMsk2.DFC_MoCADCTst_C DFC_DisblMsk2.DFC_MoCComctErrMM_C DFC_DisblMsk2.DFC_OCWDAActv_C DFC_DisblMsk2.DFC_OCWDACom_C DFC_DisblMsk2.DFC_ORAmax_C DFC_DisblMsk2.DFC_ORAmin_C DFC_DisblMsk2.DFC_PSR1max_C DFC_DisblMsk2.DFC_PSRBmax_C DFC_DisblMsk2.DFC_PSRBmin_C DFC_DisblMsk2.DFC_PSREmax_C DFC_DisblMsk2.DFC_PSREmin_C DFC_DisblMsk2.DFC_PSRPmax_C DFC_DisblMsk2.DFC_PSRPmin_C DFC_DisblMsk2.DFC_PSRPsig_C DFC_DisblMsk2.DFC_PSRmax_C DFC_DisblMsk2.DFC_SSpMon1_C DFC_DisblMsk2.DFC_SSpMon2_C DFC_DisblMsk2.DFC_SSpMon3_C DFC_DisblMsk2.DFC_SWReset_0_C DFC_DisblMsk2.DFC_SWReset_1_C DFC_DisblMsk2.DFC_SWReset_2_C DFC_DisblMsk2.DFC_TASREmax_C DFC_DisblMsk2.DFC_TASREmin_C DFC_DisblMsk2.DFC_TASREnpl_C DFC_DisblMsk2.DFC_TASRmax_C DFC_DisblMsk2.DFC_TAmax_C DFC_DisblMsk2.DFC_TEVEmax_C DFC_DisblMsk2.DFC_TEVEmin_C DFC_DisblMsk2.DFC_TEVEsig_C DFC_DisblMsk2.DFC_TMCSmax_C DFC_DisblMsk2.DFC_TMCSmin_C DFC_DisblMsk2.DFC_TMEmax_C DFC_DisblMsk2.DFC_TMEmin_C DFC_DisblMsk2.DFC_TMEnpl_C DFC_DisblMsk2.DFC_TMEsig_C DFC_DisblMsk2.DFC_TMPmax_C DFC_DisblMsk2.DFC_TMPmin_C DFC_DisblMsk2.DFC_TMPnpl_C DFC_DisblMsk2.DFC_TMmax_C DFC_DisblMsk2.DFC_TUMmax_C DFC_DisblMsk2.DFC_TWCCTrimMaxB1_C DFC_DisblMsk2.DFC_TWCCTrimMinB1_C DFC_DisblMsk2.DFC_TWCDPriCatB1_C DFC_DisblMsk2.DFC_UBRmax_C DFC_DisblMsk2.DFC_UBmax_C DFC_DisblMsk2.DFC_UBmin_C DFC_DisblMsk2.DFC_UBnpl_C /end DEF_CHARACTERISTIC
 /begin OUT_MEASUREMENT DFC_st.DFC_Unused DFC_st.DFC_AltMaxPwr DFC_st.DFC_BrkNpl DFC_st.DFC_Cj930SSp1Mon DFC_st.DFC_Cj930SSp2Mon DFC_st.DFC_Cj930SSp3Mon DFC_st.DFC_IdleChrgActrAMax DFC_st.DFC_IdleChrgActrAMin DFC_st.DFC_IdleChrgActrASig DFC_st.DFC_IdleChrgActrBMax DFC_st.DFC_IdleChrgActrBMin DFC_st.DFC_IdleChrgActrBSig DFC_st.DFC_IdleChrgActrGovDeCold DFC_st.DFC_IdleChrgActrGovDeMax DFC_st.DFC_IdleChrgActrGovDeMin DFC_st.DFC_IdleChrgActrNAMax DFC_st.DFC_IdleChrgActrNAMin DFC_st.DFC_IdleChrgActrNASig DFC_st.DFC_IdleChrgActrNBMax DFC_st.DFC_IdleChrgActrNBMin DFC_st.DFC_IdleChrgActrNBSig DFC_st.DFC_IdleChrgActrOverTmp DFC_st.DFC_MonUMaxSupply1 DFC_st.DFC_MonUMinSupply1 DFC_st.DFC_ClthNplClsd DFC_st.DFC_ClthNplOpn DFC_st.DFC_IgnClPsDevComErr1 DFC_st.DFC_IgnClPsOpenLoad0 DFC_st.DFC_IgnClPsOpenLoad1 DFC_st.DFC_IgnClPsOpenLoad2 DFC_st.DFC_IgnClPsShCirBatt0 DFC_st.DFC_IgnClPsShCirBatt1 DFC_st.DFC_IgnClPsShCirBatt2 DFC_st.DFC_IgnClPsShCirGnd0 DFC_st.DFC_IgnClPsShCirGnd1 DFC_st.DFC_IgnClPsShCirGnd2 DFC_st.DFC_KnDetSens1PortAMax DFC_st.DFC_KnDetSens1PortAMin DFC_st.DFC_KnDetSens1PortBMax DFC_st.DFC_KnDetSens1PortBMin DFC_st.DFC_VehVWhlErr DFC_st.DFC_AirCCmprOL DFC_st.DFC_AirCCmprOvrTemp DFC_st.DFC_AirCCmprSCB DFC_st.DFC_AirCCmprSCG DFC_st.DFC_AltIOLdSRCMin DFC_st.DFC_AltIOOL DFC_st.DFC_AltIOOvrTemp DFC_st.DFC_AltIOSCB DFC_st.DFC_AltIOSCG DFC_st.DFC_DevLibBattUHi DFC_st.DFC_DevLibBattULo DFC_st.DFC_FanDIOOL DFC_st.DFC_FanDIOOvrTemp DFC_st.DFC_FanDIOSCB DFC_st.DFC_FanDIOSCG DFC_st.DFC_FanPWMOL DFC_st.DFC_FanPWMOvrTemp DFC_st.DFC_FanPWMSCB DFC_st.DFC_FanPWMSCG DFC_st.DFC_AirCClntPAnaSRCMax DFC_st.DFC_AirCClntPAnaSRCMin DFC_st.DFC_AirCSwtNpl DFC_st.DFC_AirCSwtSig DFC_st.DFC_AltIOLdSRCMax DFC_st.DFC_BrkSig DFC_st.DFC_ClthEPBNpl DFC_st.DFC_ClthEPBSensErr DFC_st.DFC_ClthErr DFC_st.DFC_ClthSig DFC_st.DFC_MILLmpOL DFC_st.DFC_MILLmpSCB DFC_st.DFC_MILLmpSCG DFC_st.DFC_SRCHighAPP1 DFC_st.DFC_SRCHighAPP2 DFC_st.DFC_SRCLowAPP1 DFC_st.DFC_SRCLowAPP2 DFC_st.DFC_SyncAPP DFC_st.DFC_VehVMax DFC_st.DFC_VehVPlaus DFC_st.DFC_VehVSig DFC_st.DFC_BusDiagBusOffNodeA DFC_st.DFC_ComACSensTO DFC_st.DFC_ComAWD1TO DFC_st.DFC_ComBRK10TO DFC_st.DFC_ComGW11TO DFC_st.DFC_ComLVL1TO DFC_st.DFC_ComPRKA01TO DFC_st.DFC_ComPRKH01TO DFC_st.DFC_ComPRKH1TO DFC_st.DFC_ComTRBCH1TO DFC_st.DFC_ComTRBCH2TO DFC_st.DFC_DK DFC_st.DFC_DKRSA DFC_st.DFC_DKVSmax DFC_st.DFC_DKmax DFC_st.DFC_DKmin DFC_st.DFC_DSSmax DFC_st.DFC_EEPEraseErr DFC_st.DFC_EEPRdErr DFC_st.DFC_EEPWrErr DFC_st.DFC_EV1max DFC_st.DFC_EV1min DFC_st.DFC_EV1sig DFC_st.DFC_EV2max DFC_st.DFC_EV2min DFC_st.DFC_EV2sig DFC_st.DFC_EV3max DFC_st.DFC_EV3min DFC_st.DFC_EV3sig DFC_st.DFC_EpmCaSI1ErrSig DFC_st.DFC_EpmCaSI1NoSig DFC_st.DFC_EpmCaSI1NoSigMax DFC_st.DFC_EpmCaSI1NoSigMin DFC_st.DFC_EpmCaSI1OfsErr DFC_st.DFC_EpmCrSErrSig DFC_st.DFC_EpmCrSNoSig DFC_st.DFC_FRAmax DFC_st.DFC_FRAmin DFC_st.DFC_HEGOS1B1ElecMax DFC_st.DFC_HEGOS1B1ElecMin DFC_st.DFC_HEGOS1B1ElecNpl DFC_st.DFC_HEGOS1B1ElecSig DFC_st.DFC_HEGOS1B1HtgNpl DFC_st.DFC_HEGOS1B1HtrPsMax DFC_st.DFC_HEGOS1B1HtrPsMin DFC_st.DFC_HEGOS1B1HtrPsSig DFC_st.DFC_HEGOS1B1StkMax DFC_st.DFC_HEGOS1B1StkMin DFC_st.DFC_HEGOS2B1RstrcnLean DFC_st.DFC_HEGOS2B1RstrcnRich DFC_st.DFC_IdleChrgActrJamVlvClsd DFC_st.DFC_IdleChrgActrJamVlvOpn DFC_st.DFC_IgnClPsDevOscErr1 DFC_st.DFC_KPEmax DFC_st.DFC_KPEmin DFC_st.DFC_KPEsig DFC_st.DFC_KS1max DFC_st.DFC_KS1min DFC_st.DFC_LLRKHmax DFC_st.DFC_LLRKHmin DFC_st.DFC_LLRKHnpl DFC_st.DFC_LLRmax DFC_st.DFC_LLRmin DFC_st.DFC_LLRnpl DFC_st.DFC_LMmax DFC_st.DFC_LZSRnpl DFC_st.DFC_MD DFC_st.DFC_MD00min DFC_st.DFC_MD00npl DFC_st.DFC_MD01min DFC_st.DFC_MD01npl DFC_st.DFC_MD02min DFC_st.DFC_MD02npl DFC_st.DFC_MD03min DFC_st.DFC_MD03npl DFC_st.DFC_MD04min DFC_st.DFC_MD04npl DFC_st.DFC_MDCyl_0 DFC_st.DFC_MDCyl_1 DFC_st.DFC_MDCyl_2 DFC_st.DFC_MDFC DFC_st.DFC_MDmin DFC_st.DFC_MDnpl DFC_st.DFC_MoCADCNTP DFC_st.DFC_MoCADCTst DFC_st.DFC_MoCComctErrMM DFC_st.DFC_OCWDAActv DFC_st.DFC_OCWDACom DFC_st.DFC_ORAmax DFC_st.DFC_ORAmin DFC_st.DFC_PSR1max DFC_st.DFC_PSRBmax DFC_st.DFC_PSRBmin DFC_st.DFC_PSREmax DFC_st.DFC_PSREmin DFC_st.DFC_PSRPmax DFC_st.DFC_PSRPmin DFC_st.DFC_PSRPsig DFC_st.DFC_PSRmax DFC_st.DFC_SSpMon1 DFC_st.DFC_SSpMon2 DFC_st.DFC_SSpMon3 DFC_st.DFC_SWReset_0 DFC_st.DFC_SWReset_1 DFC_st.DFC_SWReset_2 DFC_st.DFC_TASREmax DFC_st.DFC_TASREmin DFC_st.DFC_TASREnpl DFC_st.DFC_TASRmax DFC_st.DFC_TAmax DFC_st.DFC_TEVEmax DFC_st.DFC_TEVEmin DFC_st.DFC_TEVEsig DFC_st.DFC_TMCSmax DFC_st.DFC_TMCSmin DFC_st.DFC_TMEmax DFC_st.DFC_TMEmin DFC_st.DFC_TMEnpl DFC_st.DFC_TMEsig DFC_st.DFC_TMPmax DFC_st.DFC_TMPmin DFC_st.DFC_TMPnpl DFC_st.DFC_TMmax DFC_st.DFC_TUMmax DFC_st.DFC_TWCCTrimMaxB1 DFC_st.DFC_TWCCTrimMinB1 DFC_st.DFC_TWCDPriCatB1 DFC_st.DFC_UBRmax DFC_st.DFC_UBmax DFC_st.DFC_UBmin DFC_st.DFC_UBnpl DSQ_st.DSQ_ACClntP DSQ_st.DSQ_AirCCmprActr DSQ_st.DSQ_AltIOActr DSQ_st.DSQ_AltIOLoad DSQ_st.DSQ_AltTrqDes DSQ_st.DSQ_BattUSSpThrVlv DSQ_st.DSQ_CEngDsT DSQ_st.DSQ_Clth DSQ_st.DSQ_DSMInhibitAlways DSQ_st.DSQ_EpmReverseRun DSQ_st.DSQ_FanDIO DSQ_st.DSQ_FanPWM DSQ_st.DSQ_IdleChrgActMod DSQ_st.DSQ_VehV DSQ_st.DSQ_stAPP DSQ_st.DSQ_stAPP1 DSQ_st.DSQ_stAPP2 /end OUT_MEASUREMENT
 /begin LOC_MEASUREMENT DFC_stFinal DFC_stMaxFlt DFC_stRun /end LOC_MEASUREMENT
 FUNCTION_VERSION "2.3.1" /end FUNCTION
/begin FUNCTION DFES "2.9.0"
 /begin DEF_CHARACTERISTIC DFES_Cls.DFC_Unused_C DFES_Cls.DFC_AltMaxPwr_C DFES_Cls.DFC_BrkNpl_C DFES_Cls.DFC_Cj930SSp1Mon_C DFES_Cls.DFC_Cj930SSp2Mon_C DFES_Cls.DFC_Cj930SSp3Mon_C DFES_Cls.DFC_IdleChrgActrAMax_C DFES_Cls.DFC_IdleChrgActrAMin_C DFES_Cls.DFC_IdleChrgActrASig_C DFES_Cls.DFC_IdleChrgActrBMax_C DFES_Cls.DFC_IdleChrgActrBMin_C DFES_Cls.DFC_IdleChrgActrBSig_C DFES_Cls.DFC_IdleChrgActrGovDeCold_C DFES_Cls.DFC_IdleChrgActrGovDeMax_C DFES_Cls.DFC_IdleChrgActrGovDeMin_C DFES_Cls.DFC_IdleChrgActrNAMax_C DFES_Cls.DFC_IdleChrgActrNAMin_C DFES_Cls.DFC_IdleChrgActrNASig_C DFES_Cls.DFC_IdleChrgActrNBMax_C DFES_Cls.DFC_IdleChrgActrNBMin_C DFES_Cls.DFC_IdleChrgActrNBSig_C DFES_Cls.DFC_IdleChrgActrOverTmp_C DFES_Cls.DFC_MonUMaxSupply1_C DFES_Cls.DFC_MonUMinSupply1_C DFES_Cls.DFC_ClthNplClsd_C DFES_Cls.DFC_ClthNplOpn_C DFES_Cls.DFC_IgnClPsDevComErr1_C DFES_Cls.DFC_IgnClPsOpenLoad0_C DFES_Cls.DFC_IgnClPsOpenLoad1_C DFES_Cls.DFC_IgnClPsOpenLoad2_C DFES_Cls.DFC_IgnClPsShCirBatt0_C DFES_Cls.DFC_IgnClPsShCirBatt1_C DFES_Cls.DFC_IgnClPsShCirBatt2_C DFES_Cls.DFC_IgnClPsShCirGnd0_C DFES_Cls.DFC_IgnClPsShCirGnd1_C DFES_Cls.DFC_IgnClPsShCirGnd2_C DFES_Cls.DFC_KnDetSens1PortAMax_C DFES_Cls.DFC_KnDetSens1PortAMin_C DFES_Cls.DFC_KnDetSens1PortBMax_C DFES_Cls.DFC_KnDetSens1PortBMin_C DFES_Cls.DFC_VehVWhlErr_C DFES_Cls.DFC_AirCCmprOL_C DFES_Cls.DFC_AirCCmprOvrTemp_C DFES_Cls.DFC_AirCCmprSCB_C DFES_Cls.DFC_AirCCmprSCG_C DFES_Cls.DFC_AltIOLdSRCMin_C DFES_Cls.DFC_AltIOOL_C DFES_Cls.DFC_AltIOOvrTemp_C DFES_Cls.DFC_AltIOSCB_C DFES_Cls.DFC_AltIOSCG_C DFES_Cls.DFC_DevLibBattUHi_C DFES_Cls.DFC_DevLibBattULo_C DFES_Cls.DFC_FanDIOOL_C DFES_Cls.DFC_FanDIOOvrTemp_C DFES_Cls.DFC_FanDIOSCB_C DFES_Cls.DFC_FanDIOSCG_C DFES_Cls.DFC_FanPWMOL_C DFES_Cls.DFC_FanPWMOvrTemp_C DFES_Cls.DFC_FanPWMSCB_C DFES_Cls.DFC_FanPWMSCG_C DFES_Cls.DFC_AirCClntPAnaSRCMax_C DFES_Cls.DFC_AirCClntPAnaSRCMin_C DFES_Cls.DFC_AirCSwtNpl_C DFES_Cls.DFC_AirCSwtSig_C DFES_Cls.DFC_AltIOLdSRCMax_C DFES_Cls.DFC_BrkSig_C DFES_Cls.DFC_ClthEPBNpl_C DFES_Cls.DFC_ClthEPBSensErr_C DFES_Cls.DFC_ClthErr_C DFES_Cls.DFC_ClthSig_C DFES_Cls.DFC_MILLmpOL_C DFES_Cls.DFC_MILLmpSCB_C DFES_Cls.DFC_MILLmpSCG_C DFES_Cls.DFC_SRCHighAPP1_C DFES_Cls.DFC_SRCHighAPP2_C DFES_Cls.DFC_SRCLowAPP1_C DFES_Cls.DFC_SRCLowAPP2_C DFES_Cls.DFC_SyncAPP_C DFES_Cls.DFC_VehVMax_C DFES_Cls.DFC_VehVPlaus_C DFES_Cls.DFC_VehVSig_C DFES_Cls.DFC_BusDiagBusOffNodeA_C DFES_Cls.DFC_ComACSensTO_C DFES_Cls.DFC_ComAWD1TO_C DFES_Cls.DFC_ComBRK10TO_C DFES_Cls.DFC_ComGW11TO_C DFES_Cls.DFC_ComLVL1TO_C DFES_Cls.DFC_ComPRKA01TO_C DFES_Cls.DFC_ComPRKH01TO_C DFES_Cls.DFC_ComPRKH1TO_C DFES_Cls.DFC_ComTRBCH1TO_C DFES_Cls.DFC_ComTRBCH2TO_C DFES_Cls.DFC_DK_C DFES_Cls.DFC_DKRSA_C DFES_Cls.DFC_DKVSmax_C DFES_Cls.DFC_DKmax_C DFES_Cls.DFC_DKmin_C DFES_Cls.DFC_DSSmax_C DFES_Cls.DFC_EEPEraseErr_C DFES_Cls.DFC_EEPRdErr_C DFES_Cls.DFC_EEPWrErr_C DFES_Cls.DFC_EV1max_C DFES_Cls.DFC_EV1min_C DFES_Cls.DFC_EV1sig_C DFES_Cls.DFC_EV2max_C DFES_Cls.DFC_EV2min_C DFES_Cls.DFC_EV2sig_C DFES_Cls.DFC_EV3max_C DFES_Cls.DFC_EV3min_C DFES_Cls.DFC_EV3sig_C DFES_Cls.DFC_EpmCaSI1ErrSig_C DFES_Cls.DFC_EpmCaSI1NoSig_C DFES_Cls.DFC_EpmCaSI1NoSigMax_C DFES_Cls.DFC_EpmCaSI1NoSigMin_C DFES_Cls.DFC_EpmCaSI1OfsErr_C DFES_Cls.DFC_EpmCrSErrSig_C DFES_Cls.DFC_EpmCrSNoSig_C DFES_Cls.DFC_FRAmax_C DFES_Cls.DFC_FRAmin_C DFES_Cls.DFC_HEGOS1B1ElecMax_C DFES_Cls.DFC_HEGOS1B1ElecMin_C DFES_Cls.DFC_HEGOS1B1ElecNpl_C DFES_Cls.DFC_HEGOS1B1ElecSig_C DFES_Cls.DFC_HEGOS1B1HtgNpl_C DFES_Cls.DFC_HEGOS1B1HtrPsMax_C DFES_Cls.DFC_HEGOS1B1HtrPsMin_C DFES_Cls.DFC_HEGOS1B1HtrPsSig_C DFES_Cls.DFC_HEGOS1B1StkMax_C DFES_Cls.DFC_HEGOS1B1StkMin_C DFES_Cls.DFC_HEGOS2B1RstrcnLean_C DFES_Cls.DFC_HEGOS2B1RstrcnRich_C DFES_Cls.DFC_IdleChrgActrJamVlvClsd_C DFES_Cls.DFC_IdleChrgActrJamVlvOpn_C DFES_Cls.DFC_IgnClPsDevOscErr1_C DFES_Cls.DFC_KPEmax_C DFES_Cls.DFC_KPEmin_C DFES_Cls.DFC_KPEsig_C DFES_Cls.DFC_KS1max_C DFES_Cls.DFC_KS1min_C DFES_Cls.DFC_LLRKHmax_C DFES_Cls.DFC_LLRKHmin_C DFES_Cls.DFC_LLRKHnpl_C DFES_Cls.DFC_LLRmax_C DFES_Cls.DFC_LLRmin_C DFES_Cls.DFC_LLRnpl_C DFES_Cls.DFC_LMmax_C DFES_Cls.DFC_LZSRnpl_C DFES_Cls.DFC_MD_C DFES_Cls.DFC_MD00min_C DFES_Cls.DFC_MD00npl_C DFES_Cls.DFC_MD01min_C DFES_Cls.DFC_MD01npl_C DFES_Cls.DFC_MD02min_C DFES_Cls.DFC_MD02npl_C DFES_Cls.DFC_MD03min_C DFES_Cls.DFC_MD03npl_C DFES_Cls.DFC_MD04min_C DFES_Cls.DFC_MD04npl_C DFES_Cls.DFC_MDCyl_0_C DFES_Cls.DFC_MDCyl_1_C DFES_Cls.DFC_MDCyl_2_C DFES_Cls.DFC_MDFC_C DFES_Cls.DFC_MDmin_C DFES_Cls.DFC_MDnpl_C DFES_Cls.DFC_MoCADCNTP_C DFES_Cls.DFC_MoCADCTst_C DFES_Cls.DFC_MoCComctErrMM_C DFES_Cls.DFC_OCWDAActv_C DFES_Cls.DFC_OCWDACom_C DFES_Cls.DFC_ORAmax_C DFES_Cls.DFC_ORAmin_C DFES_Cls.DFC_PSR1max_C DFES_Cls.DFC_PSRBmax_C DFES_Cls.DFC_PSRBmin_C DFES_Cls.DFC_PSREmax_C DFES_Cls.DFC_PSREmin_C DFES_Cls.DFC_PSRPmax_C DFES_Cls.DFC_PSRPmin_C DFES_Cls.DFC_PSRPsig_C DFES_Cls.DFC_PSRmax_C DFES_Cls.DFC_SSpMon1_C DFES_Cls.DFC_SSpMon2_C DFES_Cls.DFC_SSpMon3_C DFES_Cls.DFC_SWReset_0_C DFES_Cls.DFC_SWReset_1_C DFES_Cls.DFC_SWReset_2_C DFES_Cls.DFC_TASREmax_C DFES_Cls.DFC_TASREmin_C DFES_Cls.DFC_TASREnpl_C DFES_Cls.DFC_TASRmax_C DFES_Cls.DFC_TAmax_C DFES_Cls.DFC_TEVEmax_C DFES_Cls.DFC_TEVEmin_C DFES_Cls.DFC_TEVEsig_C DFES_Cls.DFC_TMCSmax_C DFES_Cls.DFC_TMCSmin_C DFES_Cls.DFC_TMEmax_C DFES_Cls.DFC_TMEmin_C DFES_Cls.DFC_TMEnpl_C DFES_Cls.DFC_TMEsig_C DFES_Cls.DFC_TMPmax_C DFES_Cls.DFC_TMPmin_C DFES_Cls.DFC_TMPnpl_C DFES_Cls.DFC_TMmax_C DFES_Cls.DFC_TUMmax_C DFES_Cls.DFC_TWCCTrimMaxB1_C DFES_Cls.DFC_TWCCTrimMinB1_C DFES_Cls.DFC_TWCDPriCatB1_C DFES_Cls.DFC_UBRmax_C DFES_Cls.DFC_UBmax_C DFES_Cls.DFC_UBmin_C DFES_Cls.DFC_UBnpl_C DFES_DbLv.DFC_Unused_C DFES_DbLv.DFC_AltMaxPwr_C DFES_DbLv.DFC_BrkNpl_C DFES_DbLv.DFC_Cj930SSp1Mon_C DFES_DbLv.DFC_Cj930SSp2Mon_C DFES_DbLv.DFC_Cj930SSp3Mon_C DFES_DbLv.DFC_IdleChrgActrAMax_C DFES_DbLv.DFC_IdleChrgActrAMin_C DFES_DbLv.DFC_IdleChrgActrASig_C DFES_DbLv.DFC_IdleChrgActrBMax_C DFES_DbLv.DFC_IdleChrgActrBMin_C DFES_DbLv.DFC_IdleChrgActrBSig_C DFES_DbLv.DFC_IdleChrgActrGovDeCold_C DFES_DbLv.DFC_IdleChrgActrGovDeMax_C DFES_DbLv.DFC_IdleChrgActrGovDeMin_C DFES_DbLv.DFC_IdleChrgActrNAMax_C DFES_DbLv.DFC_IdleChrgActrNAMin_C DFES_DbLv.DFC_IdleChrgActrNASig_C DFES_DbLv.DFC_IdleChrgActrNBMax_C DFES_DbLv.DFC_IdleChrgActrNBMin_C DFES_DbLv.DFC_IdleChrgActrNBSig_C DFES_DbLv.DFC_IdleChrgActrOverTmp_C DFES_DbLv.DFC_MonUMaxSupply1_C DFES_DbLv.DFC_MonUMinSupply1_C DFES_DbLv.DFC_ClthNplClsd_C DFES_DbLv.DFC_ClthNplOpn_C DFES_DbLv.DFC_IgnClPsDevComErr1_C DFES_DbLv.DFC_IgnClPsOpenLoad0_C DFES_DbLv.DFC_IgnClPsOpenLoad1_C DFES_DbLv.DFC_IgnClPsOpenLoad2_C DFES_DbLv.DFC_IgnClPsShCirBatt0_C DFES_DbLv.DFC_IgnClPsShCirBatt1_C DFES_DbLv.DFC_IgnClPsShCirBatt2_C DFES_DbLv.DFC_IgnClPsShCirGnd0_C DFES_DbLv.DFC_IgnClPsShCirGnd1_C DFES_DbLv.DFC_IgnClPsShCirGnd2_C DFES_DbLv.DFC_KnDetSens1PortAMax_C DFES_DbLv.DFC_KnDetSens1PortAMin_C DFES_DbLv.DFC_KnDetSens1PortBMax_C DFES_DbLv.DFC_KnDetSens1PortBMin_C DFES_DbLv.DFC_VehVWhlErr_C DFES_DbLv.DFC_AirCCmprOL_C DFES_DbLv.DFC_AirCCmprOvrTemp_C DFES_DbLv.DFC_AirCCmprSCB_C DFES_DbLv.DFC_AirCCmprSCG_C DFES_DbLv.DFC_AltIOLdSRCMin_C DFES_DbLv.DFC_AltIOOL_C DFES_DbLv.DFC_AltIOOvrTemp_C DFES_DbLv.DFC_AltIOSCB_C DFES_DbLv.DFC_AltIOSCG_C DFES_DbLv.DFC_DevLibBattUHi_C DFES_DbLv.DFC_DevLibBattULo_C DFES_DbLv.DFC_FanDIOOL_C DFES_DbLv.DFC_FanDIOOvrTemp_C DFES_DbLv.DFC_FanDIOSCB_C DFES_DbLv.DFC_FanDIOSCG_C DFES_DbLv.DFC_FanPWMOL_C DFES_DbLv.DFC_FanPWMOvrTemp_C DFES_DbLv.DFC_FanPWMSCB_C DFES_DbLv.DFC_FanPWMSCG_C DFES_DbLv.DFC_AirCClntPAnaSRCMax_C DFES_DbLv.DFC_AirCClntPAnaSRCMin_C /end DEF_CHARACTERISTIC
 /begin LOC_MEASUREMENT DFES_ChkLstDltDemExCond_mp DFES_ctDef DFES_ctDel DFES_ctEntry DFES_ctFrq DFES_ctManuDef DFES_ctManuOk DFES_ctMIL DFES_ctOBD DFES_ctOBDPend DFES_ctOk DFES_ctSrv DFES_EnvBlock DFES_FrzFrVal DFES_idxHash DFES_idxLink DFES_idxPrioQueue DFES_idxSequence DFES_idxVisible DFES_ISOFrstCnfDFC DFES_ISOFrstFailDFC DFES_ISORcntCnfDFC DFES_ISORcntFailDFC DFES_MonEvnt DFES_MonObjt DFES_MonParm DFES_MonPtr DFES_numDFC DFES_numEntryAvl DFES_numEnvSize DFES_numExtdFrzFrmSize DFES_numFrzFrmSize DFES_Order DFES_OutLamps DFES_OutTester DFES_PDTCStore DFES_stChk DFES_stChkFault DFES_stCounters DFES_stCtlSetting DFES_stDTCRecUpdt DFES_stDTCStorage DFES_stEntry DFES_stErrDia DFES_stErrLamp DFES_stFltr DFES_stOutstate DFES_stPrgEvt /end LOC_MEASUREMENT
 FUNCTION_VERSION "2.9.0" /end FUNCTION
/begin COMPU_METHOD DFCDFP_Verb "" TAB_VERB "%2.1" "-" COMPU_TAB_REF DFCDFP_Verb /end COMPU_METHOD
/begin COMPU_VTAB DFCDFP_Verb "" TAB_VERB 299 0 "NoEntry" 1 "DFC_AltMaxPwr" 2 "DFC_BrkNpl" 3 "DFC_Cj930SSp1Mon" 4 "DFC_Cj930SSp2Mon" 5 "DFC_Cj930SSp3Mon" 6 "DFC_IdleChrgActrAMax" 7 "DFC_IdleChrgActrAMin" 8 "DFC_IdleChrgActrASig" 9 "DFC_IdleChrgActrBMax" 10 "DFC_IdleChrgActrBMin" 11 "DFC_IdleChrgActrBSig" 12 "DFC_IdleChrgActrGovDeCold" 13 "DFC_IdleChrgActrGovDeMax" 14 "DFC_IdleChrgActrGovDeMin" 15 "DFC_IdleChrgActrNAMax" 16 "DFC_IdleChrgActrNAMin" 17 "DFC_IdleChrgActrNASig" 18 "DFC_IdleChrgActrNBMax" 19 "DFC_IdleChrgActrNBMin" 20 "DFC_IdleChrgActrNBSig" 21 "DFC_IdleChrgActrOverTmp" 22 "DFC_MonUMaxSupply1" 23 "DFC_MonUMinSupply1" 24 "DFC_ClthNplClsd" 25 "DFC_ClthNplOpn" 26 "DFC_IgnClPsDevComErr1" 27 "DFC_IgnClPsOpenLoad0" 28 "DFC_IgnClPsOpenLoad1" 29 "DFC_IgnClPsOpenLoad2" 30 "DFC_IgnClPsShCirBatt0" 31 "DFC_IgnClPsShCirBatt1" 32 "DFC_IgnClPsShCirBatt2" 33 "DFC_IgnClPsShCirGnd0" 34 "DFC_IgnClPsShCirGnd1" 35 "DFC_IgnClPsShCirGnd2" 36 "DFC_KnDetSens1PortAMax" 37 "DFC_KnDetSens1PortAMin" 38 "DFC_KnDetSens1PortBMax" 39 "DFC_KnDetSens1PortBMin" 40 "DFC_VehVWhlErr" 41 "DFC_AirCCmprOL" 42 "DFC_AirCCmprOvrTemp" 43 "DFC_AirCCmprSCB" 44 "DFC_AirCCmprSCG" 45 "DFC_AltIOLdSRCMin" 46 "DFC_AltIOOL" 47 "DFC_AltIOOvrTemp" 48 "DFC_AltIOSCB" 49 "DFC_AltIOSCG" 50 "DFC_DevLibBattUHi" 51 "DFC_DevLibBattULo" 52 "DFC_FanDIOOL" 53 "DFC_FanDIOOvrTemp" 54 "DFC_FanDIOSCB" 55 "DFC_FanDIOSCG" 56 "DFC_FanPWMOL" 57 "DFC_FanPWMOvrTemp" 58 "DFC_FanPWMSCB" 59 "DFC_FanPWMSCG" 60 "DFC_AirCClntPAnaSRCMax" 61 "DFC_AirCClntPAnaSRCMin" 62 "DFC_AirCSwtNpl" 63 "DFC_AirCSwtSig" 64 "DFC_AltIOLdSRCMax" 65 "DFC_BrkSig" 66 "DFC_ClthEPBNpl" 67 "DFC_ClthEPBSensErr" 68 "DFC_ClthErr" 69 "DFC_ClthSig" 70 "DFC_MILLmpOL" 71 "DFC_MILLmpSCB" 72 "DFC_MILLmpSCG" 73 "DFC_SRCHighAPP1" 74 "DFC_SRCHighAPP2" 75 "DFC_SRCLowAPP1" 76 "DFC_SRCLowAPP2" 77 "DFC_SyncAPP" 78 "DFC_VehVMax" 79 "DFC_VehVPlaus" 80 "DFC_VehVSig" 81 "DFC_BusDiagBusOffNodeA" 82 "DFC_ComACSensTO" 83 "DFC_ComAWD1TO" 84 "DFC_ComBRK10TO" 85 "DFC_ComGW11TO" 86 "DFC_ComLVL1TO" 87 "DFC_ComPRKA01TO" 88 "DFC_ComPRKH01TO" 89 "DFC_ComPRKH1TO" 90 "DFC_ComTRBCH1TO" 91 "DFC_ComTRBCH2TO" 92 "DFC_DK" 93 "DFC_DKRSA" 94 "DFC_DKVSmax" 95 "DFC_DKmax" 96 "DFC_DKmin" 97 "DFC_DSSmax" 98 "DFC_EEPEraseErr" 99 "DFC_EEPRdErr" 100 "DFC_EEPWrErr" 101 "DFC_EV1max" 102 "DFC_EV1min" 103 "DFC_EV1sig" 104 "DFC_EV2max" 105 "DFC_EV2min" 106 "DFC_EV2sig" 107 "DFC_EV3max" 108 "DFC_EV3min" 109 "DFC_EV3sig" 110 "DFC_EpmCaSI1ErrSig" 111 "DFC_EpmCaSI1NoSig" 112 "DFC_EpmCaSI1NoSigMax" 113 "DFC_EpmCaSI1NoSigMin" 114 "DFC_EpmCaSI1OfsErr" 115 "DFC_EpmCrSErrSig" 116 "DFC_EpmCrSNoSig" 117 "DFC_FRAmax" 118 "DFC_FRAmin" 119 "DFC_HEGOS1B1ElecMax" 120 "DFC_HEGOS1B1ElecMin" 121 "DFC_HEGOS1B1ElecNpl" 122 "DFC_HEGOS1B1ElecSig" 123 "DFC_HEGOS1B1HtgNpl" 124 "DFC_HEGOS1B1HtrPsMax" 125 "DFC_HEGOS1B1HtrPsMin" 126 "DFC_HEGOS1B1HtrPsSig" 127 "DFC_HEGOS1B1StkMax" 128 "DFC_HEGOS1B1StkMin" 129 "DFC_HEGOS2B1RstrcnLean" 130 "DFC_HEGOS2B1RstrcnRich" 131 "DFC_IdleChrgActrJamVlvClsd" 132 "DFC_IdleChrgActrJamVlvOpn" 133 "DFC_IgnClPsDevOscErr1" 134 "DFC_KPEmax" 135 "DFC_KPEmin" 136 "DFC_KPEsig" 137 "DFC_KS1max" 138 "DFC_KS1min" 139 "DFC_LLRKHmax" 140 "DFC_LLRKHmin" 141 "DFC_LLRKHnpl" 142 "DFC_LLRmax" 143 "DFC_LLRmin" 144 "DFC_LLRnpl" 145 "DFC_LMmax" 146 "DFC_LZSRnpl" 147 "DFC_MD" 148 "DFC_MD00min" 149 "DFC_MD00npl" 150 "DFC_MD01min" 151 "DFC_MD01npl" 152 "DFC_MD02min" 153 "DFC_MD02npl" 154 "DFC_MD03min" 155 "DFC_MD03npl" 156 "DFC_MD04min" 157 "DFC_MD04npl" 158 "DFC_MDCyl_0" 159 "DFC_MDCyl_1" 160 "DFC_MDCyl_2" 161 "DFC_MDFC" 162 "DFC_MDmin" 163 "DFC_MDnpl" 164 "DFC_MoCADCNTP" 165 "DFC_MoCADCTst" 166 "DFC_MoCComctErrMM" 167 "DFC_OCWDAActv" 168 "DFC_OCWDACom" 169 "DFC_ORAmax" 170 "DFC_ORAmin" 171 "DFC_PSR1max" 172 "DFC_PSRBmax" 173 "DFC_PSRBmin" 174 "DFC_PSREmax" 175 "DFC_PSREmin" 176 "DFC_PSRPmax" 177 "DFC_PSRPmin" 178 "DFC_PSRPsig" 179 "DFC_PSRmax" 180 "DFC_SSpMon1" 181 "DFC_SSpMon2" 182 "DFC_SSpMon3" 183 "DFC_SWReset_0" 184 "DFC_SWReset_1" 185 "DFC_SWReset_2" 186 "DFC_TASREmax" 187 "DFC_TASREmin" 188 "DFC_TASREnpl" 189 "DFC_TASRmax" 190 "DFC_TAmax" 191 "DFC_TEVEmax" 192 "DFC_TEVEmin" 193 "DFC_TEVEsig" 194 "DFC_TMCSmax" 195 "DFC_TMCSmin" 196 "DFC_TMEmax" 197 "DFC_TMEmin" 198 "DFC_TMEnpl" 199 "DFC_TMEsig" 200 "DFC_TMPmax" 201 "DFC_TMPmin" 202 "DFC_TMPnpl" 203 "DFC_TMmax" 204 "DFC_TUMmax" 205 "DFC_TWCCTrimMaxB1" 206 "DFC_TWCCTrimMinB1" 207 "DFC_TWCDPriCatB1" 208 "DFC_UBRmax" 209 "DFC_UBmax" 210 "DFC_UBmin" 211 "DFC_UBnpl" 212 "DFP_AAA" 213 "DFP_BM" 214 "DFP_DK" 215 "DFP_DKVS" 216 "DFP_DSS" 217 "DFP_DVEV" 218 "DFP_DYLSU" 219 "DFP_DZKU0" 220 "DFP_DZKU1" 221 "DFP_DZKU2" 222 "DFP_EGFE" 223 "DFP_ENWS" 224 "DFP_ENWSE" 225 "DFP_EV1" 226 "DFP_EV2" 227 "DFP_EV3" 228 "DFP_FMAS" 229 "DFP_FP1P" 230 "DFP_FP2P" 231 "DFP_FRA" 232 "DFP_FRAU" 233 "DFP_FTDLA" 234 "DFP_HELSU" 235 "DFP_HRE" 236 "DFP_HSH" 237 "DFP_HSHE" 238 "DFP_HSV" 239 "DFP_HSVE" 240 "DFP_HSVSA" 241 "DFP_ICLSU" 242 "DFP_KAT" 243 "DFP_KATF" 244 "DFP_KPE" 245 "DFP_KRNT" 246 "DFP_KROF" 247 "DFP_KRTP" 248 "DFP_KUPPL" 249 "DFP_LASH" 250 "DFP_LLR" 251 "DFP_LLRKH" 252 "DFP_LM" 253 "DFP_LSH" 254 "DFP_LSUKS" 255 "DFP_LSUUN" 256 "DFP_LSV" 257 "DFP_LUES1E" 258 "DFP_LZSR" 259 "DFP_MD" 260 "DFP_N" 261 "DFP_NWKW" 262 "DFP_NWKWE" 263 "DFP_ORA" 264 "DFP_PH" 265 "DFP_PHE" 266 "DFP_PLLSU" 267 "DFP_PS1E" 268 "DFP_PS2E" 269 "DFP_PS3E" 270 "DFP_PSR" 271 "DFP_PSR1" 272 "DFP_PSRB" 273 "DFP_PSRE" 274 "DFP_PSRP" 275 "DFP_PVD" 276 "DFP_RKAT" 277 "DFP_RKAZ" 278 "DFP_STKLSV" 279 "DFP_TA" 280 "DFP_TACS" 281 "DFP_TAR" 282 "DFP_TASR" 283 "DFP_TASRE" 284 "DFP_TES" 285 "DFP_TEVE" 286 "DFP_THM" 287 "DFP_TM" 288 "DFP_TMCS" 289 "DFP_TME" 290 "DFP_TMKI" 291 "DFP_TMP" 292 "DFP_TUM" 293 "DFP_UB" 294 "DFP_UBR" 295 "DFP_ULSU" 296 "DFP_VFZ" 297 "DFP_VFZG" 298 "DFP_ZZZ" DEFAULT_VALUE "---" /end COMPU_VTAB
/begin COMPU_METHOD DFC_OneToOne "" RAT_FUNC "%6.2" "-" COEFFS 0 1 0 0 0 1 /end COMPU_METHOD
/begin COMPU_METHOD DFES_Mon_Verb "" TAB_VERB "%6.3" "-" COMPU_TAB_REF DFES_Mon_Verb /end COMPU_METHOD
/begin COMPU_VTAB DFES_Mon_Verb "" TAB_VERB 33 0 "-----" 4097 "entry_rejected" 4098 "entry_preempted" 4099 "del_mismatch" 8196 "double entry" 8197 "no hash entry" 8198 "ok no tst - inkonsist" 8199 "ok tsted - inkonsist" 8200 "def tsted - inkonsist" 8201 "Counter exceeds" 8202 "MEM missing" 8203 "Hash 2 empty line" 8204 "retry entry" 8205 "Hash link exceeds" 8453 "invalid hash" 8454 "def no tst - inkonsist" 8457 "DEL Counter Serv ex" 8458 "MEM no Hash" 8461 "min hash line" 8709 "missing hash entry" 8713 "DEL Counter Pend ex" 8714 "Deb ok missing" 8717 "MIS MOD hashkey" 8969 "DEL Counter OBD ex" 8970 "Deb def missing" 8973 "insert line 2 hash" 9226 "order queue blocked cooperative" 9478 "numbr PDTC mismatch" 16399 "pot_sus_ffr" 16655 "used_sus_ffr" 32782 "miss diumpr Fid" 32783 "miss dfc DFP" 32769 "invalid DTR limit" /end COMPU_VTAB
/begin COMPU_METHOD DFES_OneToOne "" RAT_FUNC "%6.2" "-" COEFFS 0 1 0 0 0 1 /end COMPU_METHOD
/begin COMPU_METHOD DFES_stCheck_Verb "" TAB_VERB "%6.3" "-" COMPU_TAB_REF DFES_stCheck_Verb /end COMPU_METHOD
/begin COMPU_VTAB DFES_stCheck_Verb "" TAB_VERB 128 0 "OkNoTst" 1 "OkTested" 2 "OkHealed" 3 "OkRstNoTst" 4 "DefectNoTst" 5 "DefectDelay" 6 "Defect" 7 "DefectRstNoTst" 16 "SC_OkNoTst" 17 "SC_OkTested" 18 "SC_OkHealed" 19 "SC_OkRstNoTst" 20 "SC_DefectNoTst" 21 "SC_DefectDelay" 22 "SC_Defect" 23 "SC_DefectRstNoTst" 32 "FC_OkNoTst" 33 "FC_OkTested" 34 "FC_OkHealed" 35 "FC_OkRstNoTst" 36 "FC_DefectNoTst" 37 "FC_DefectDelay" 38 "FC_Defect" 39 "FC_DefectRstNoTst" 48 "FC_SC_OkNoTst" 49 "FC_SC_OkTested" 50 "FC_SC_OkHealed" 51 "FC_SC_OkRstNoTst" 52 "FC_SC_DefectNoTst" 53 "FC_SC_DefectDelay" 54 "FC_SC_Defect" 55 "FC_SC_DefectRstNoTst" 64 "_OkNoTst" 65 "_OkTested" 66 "_OkHealed" 67 "_OkRstNoTst" 68 "_DefectNoTst" 69 "_DefectDelay" 70 "_Defect" 71 "_DefectRstNoTst" 80 "_SC_OkNoTst" 81 "_SC_OkTested" 82 "_SC_OkHealed" 83 "_SC_OkRstNoTst" 84 "_SC_DefectNoTst" 85 "_SC_DefectDelay" 86 "_SC_Defect" 87 "_SC_DefectRstNoTst" 96 "_FC_OkNoTst" 97 "_FC_OkTested" 98 "_FC_OkHealed" 99 "_FC_OkRstNoTst" 100 "_FC_DefectNoTst" 101 "_FC_DefectDelay" 102 "_FC_Defect" 103 "_FC_DefectRstNoTst" 112 "_FC_SC_OkNoTst" 113 "_FC_SC_OkTested" 114 "_FC_SC_OkHealed" 115 "_FC_SC_OkRstNoTst" 116 "_FC_SC_DefectNoTst" 117 "_FC_SC_DefectDelay" 118 "_FC_SC_Defect" 119 "_FC_SC_DefectRstNoTst" 128 "-OkNoTst" 129 "-OkTested" 130 "-OkHealed" 131 "-OkRstNoTst" 132 "-DefectNoTst" 133 "-DefectDelay" 134 "-Defect" 135 "-DefectRstNoTst" 144 "-SC_OkNoTst" 145 "-SC_OkTested" 146 "-SC_OkHealed" 147 "-SC_OkRstNoTst" 148 "-SC_DefectNoTst" 149 "-SC_DefectDelay" 150 "-SC_Defect" 151 "-SC_DefectRstNoTst" 160 "-FC_OkNoTst" 161 "-FC_OkTested" 162 "-FC_OkHealed" 163 "-FC_OkRstNoTst" 164 "-FC_DefectNoTst" 165 "-FC_DefectDelay" 166 "-FC_Defect" 167 "-FC_DefectRstNoTst" 176 "-FC_SC_OkNoTst" 177 "-FC_SC_OkTested" 178 "-FC_SC_OkHealed" 179 "-FC_SC_OkRstNoTst" 180 "-FC_SC_DefectNoTst" 181 "-FC_SC_DefectDelay" 182 "-FC_SC_Defect" 183 "-FC_SC_DefectRstNoTst" 192 "-_OkNoTst" 193 "-_OkTested" 194 "-_OkHealed" 195 "-_OkRstNoTst" 196 "-_DefectNoTst" 197 "-_DefectDelay" 198 "-_Defect" 199 "-_DefectRstNoTst" 208 "-_SC_OkNoTst" 209 "-_SC_OkTested" 210 "-_SC_OkHealed" 211 "-_SC_OkRstNoTst" 212 "-_SC_DefectNoTst" 213 "-_SC_DefectDelay" 214 "-_SC_Defect" 215 "-_SC_DefectRstNoTst" 224 "-_FC_OkNoTst" 225 "-_FC_OkTested" 226 "-_FC_OkHealed" 227 "-_FC_OkRstNoTst" 228 "-_FC_DefectNoTst" 229 "-_FC_DefectDelay" 230 "-_FC_Defect" 231 "-_FC_DefectRstNoTst" 240 "-_FC_SC_OkNoTst" 241 "-_FC_SC_OkTested" 242 "-_FC_SC_OkHealed" 243 "-_FC_SC_OkRstNoTst" 244 "-_FC_SC_DefectNoTst" 245 "-_FC_SC_DefectDelay" 246 "-_FC_SC_Defect" 247 "-_FC_SC_DefectRstNoTst" /end COMPU_VTAB
/begin COMPU_METHOD DFES_stCnt_Verb "" TAB_VERB "%6.3" "-" COMPU_TAB_REF DFES_stCnt_Verb /end COMPU_METHOD
/begin COMPU_VTAB DFES_stCnt_Verb "" TAB_VERB 36 0 "SVS_NONE__MIL_NONE" 1 "SVS_NONE__MIL_HLC_TRG" 2 "SVS_NONE__MIL_HLC_ELAP" 3 "SVS_NONE__MIL_FLC_CNT" 4 "SVS_NONE__MIL_FLC_TIME" 5 "SVS_NONE__MIL_HLC_TIME" 16 "SVS_HLC_TRG__MIL_NONE" 17 "SVS_HLC_TRG__MIL_HLC_TRG" 18 "SVS_HLC_TRG__MIL_HLC_ELAP" 19 "SVS_HLC_TRG__MIL_FLC_CNT" 20 "SVS_HLC_TRG__MIL_FLC_TIME" 21 "SVS_HLC_TRG__MIL_HLC_TIME" 32 "SVS_HLC_ELAP__MIL_NONE" 33 "SVS_HLC_ELAP__MIL_HLC_TRG" 34 "SVS_HLC_ELAP__MIL_HLC_ELAP" 35 "SVS_HLC_ELAP__MIL_FLC_CNT" 36 "SVS_HLC_ELAP__MIL_FLC_TIME" 37 "SVS_HLC_ELAP__MIL_HLC_TIME" 48 "SVS_FLC_CNT__MIL_NONE" 49 "SVS_FLC_CNT__MIL_HLC_TRG" 50 "SVS_FLC_CNT__MIL_HLC_ELAP" 51 "SVS_FLC_CNT__MIL_FLC_CNT" 52 "SVS_FLC_CNT__MIL_FLC_TIME" 53 "SVS_FLC_CNT__MIL_HLC_TIME" 64 "SVS_FLC_TIME__MIL_NONE" 65 "SVS_FLC_TIME__MIL_HLC_TRG" 66 "SVS_FLC_TIME__MIL_HLC_ELAP" 67 "SVS_FLC_TIME__MIL_FLC_CNT" 68 "SVS_FLC_TIME__MIL_FLC_TIME" 69 "SVS_FLC_TIME__MIL_HLC_TIME" 80 "SVS_HLC_TIME__MIL_NONE" 81 "SVS_HLC_TIME__MIL_HLC_TRG" 82 "SVS_HLC_TIME__MIL_HLC_ELAP" 83 "SVS_HLC_TIME__MIL_FLC_CNT" 84 "SVS_HLC_TIME__MIL_FLC_TIME" 85 "SVS_HLC_TIME__MIL_HLC_TIME" /end COMPU_VTAB
/begin COMPU_METHOD DFES_stEntry_Verb "" TAB_VERB "%6.3" "-" COMPU_TAB_REF DFES_stEntry_Verb /end COMPU_METHOD
/begin COMPU_VTAB DFES_stEntry_Verb "" TAB_VERB 240 0 "NoEntry" 1 "Erased" 2 "PrivateTemporary" 3 "SVSOff_FreezeFrameOnly" 4 "SVSOff_DelayActiveDefect" 5 "SVSOff_ServiceNoDefect" 6 "SVSOff_ServiceDefect" 7 "SVSOff_ServiceHistoryDefect" 8 "SVSOff_ServiceHistoryNoDefect" 9 "SVSOff_DelayActiveNoDefect" 10 "SVSOff_PendingDefect" 11 "SVSOff_DebouncedDefect" 12 "SVSOff_HistoryPendingDefect" 13 "SVSOff_HealingNoDefect" 14 "SVSOff_HistoryNoDefect" 16 "DelD_NoEntry" 17 "DelD_Erased" 18 "DelD_PrivateTemporary" 19 "SVSOff_DelD_FreezeFrameOnly" 20 "SVSOff_DelD_DelayActiveDefect" 21 "SVSOff_DelD_ServiceNoDefect" 22 "SVSOff_DelD_ServiceDefect" 23 "SVSOff_DelD_ServiceHistoryDefect" 24 "SVSOff_DelD_ServiceHistoryNoDefect" 25 "SVSOff_DelD_DelayActiveNoDefect" 26 "SVSOff_DelD_PendingDefect" 27 "SVSOff_DelD_DebouncedDefect" 28 "SVSOff_DelD_HistoryPendingDefect" 29 "SVSOff_DelD_HealingNoDefect" 30 "SVSOff_DelD_HistoryNoDefect" 32 "P_NoEntry" 33 "P_Erased" 34 "P_PrivateTemporary" 35 "SVSOff_P_FreezeFrameOnly" 36 "SVSOff_P_DelayActiveDefect" 37 "SVSOff_P_ServiceNoDefect" 38 "SVSOff_P_ServiceDefect" 39 "SVSOff_P_ServiceHistoryDefect" 40 "SVSOff_P_ServiceHistoryNoDefect" 41 "SVSOff_P_DelayActiveNoDefect" 42 "SVSOff_P_PendingDefect" 43 "SVSOff_P_DebouncedDefect" 44 "SVSOff_P_HistoryPendingDefect" 45 "SVSOff_P_HealingNoDefect" 46 "SVSOff_P_HistoryNoDefect" 48 "P_DelD_NoEntry" 49 "P_DelD_Erased" 50 "P_DelD_PrivateTemporary" 51 "SVSOff_P_DelD_FreezeFrameOnly" 52 "SVSOff_P_DelD_DelayActiveDefect" 53 "SVSOff_P_DelD_ServiceNoDefect" 54 "SVSOff_P_DelD_ServiceDefect" 55 "SVSOff_P_DelD_ServiceHistoryDefect" 56 "SVSOff_P_DelD_ServiceHistoryNoDefect" 57 "SVSOff_P_DelD_DelayActiveNoDefect" 58 "SVSOff_P_DelD_PendingDefect" 59 "SVSOff_P_DelD_DebouncedDefect" 60 "SVSOff_P_DelD_HistoryPendingDefect" 61 "SVSOff_P_DelD_HealingNoDefect" 62 "SVSOff_P_DelD_HistoryNoDefect" 64 "PS_NoEntry" 65 "PS_Erased" 66 "PS_PrivateTemporary" 67 "SVSOff_PS_FreezeFrameOnly" 68 "SVSOff_PS_DelayActiveDefect" 69 "SVSOff_PS_ServiceNoDefect" 70 "SVSOff_PS_ServiceDefect" 71 "SVSOff_PS_ServiceHistoryDefect" 72 "SVSOff_PS_ServiceHistoryNoDefect" 73 "SVSOff_PS_DelayActiveNoDefect" 74 "SVSOff_PS_PendingDefect" 75 "SVSOff_PS_DebouncedDefect" 76 "SVSOff_PS_HistoryPendingDefect" 77 "SVSOff_PS_HealingNoDefect" 78 "SVSOff_PS_HistoryNoDefect" 80 "PS_DelD_NoEntry" 81 "PS_DelD_Erased" 82 "PS_DelD_PrivateTemporary" 83 "SVSOff_PS_DelD_FreezeFrameOnly" 84 "SVSOff_PS_DelD_DelayActiveDefect" 85 "SVSOff_PS_DelD_ServiceNoDefect" 86 "SVSOff_PS_DelD_ServiceDefect" 87 "SVSOff_PS_DelD_ServiceHistoryDefect" 88 "SVSOff_PS_DelD_ServiceHistoryNoDefect" 89 "SVSOff_PS_DelD_DelayActiveNoDefect" 90 "SVSOff_PS_DelD_PendingDefect" 91 "SVSOff_PS_DelD_DebouncedDefect" 92 "SVSOff_PS_DelD_HistoryPendingDefect" 93 "SVSOff_PS_DelD_HealingNoDefect" 94 "SVSOff_PS_DelD_HistoryNoDefect" 96 "PS_P_NoEntry" 97 "PS_P_Erased" 98 "PS_P_PrivateTemporary" 99 "SVSOff_PS_P_FreezeFrameOnly" 100 "SVSOff_PS_P_DelayActiveDefect" 101 "SVSOff_PS_P_ServiceNoDefect" 102 "SVSOff_PS_P_ServiceDefect" 103 "SVSOff_PS_P_ServiceHistoryDefect" 104 "SVSOff_PS_P_ServiceHistoryNoDefect" 105 "SVSOff_PS_P_DelayActiveNoDefect" 106 "SVSOff_PS_P_PendingDefect" 107 "SVSOff_PS_P_DebouncedDefect" 108 "SVSOff_PS_P_HistoryPendingDefect" 109 "SVSOff_PS_P_HealingNoDefect" 110 "SVSOff_PS_P_HistoryNoDefect" 112 "PS_P_DelD_NoEntry" 113 "PS_P_DelD_Erased" 114 "PS_P_DelD_PrivateTemporary" 115 "SVSOff_PS_P_DelD_FreezeFrameOnly" 116 "SVSOff_PS_P_DelD_DelayActiveDefect" 117 "SVSOff_PS_P_DelD_ServiceNoDefect" 118 "SVSOff_PS_P_DelD_ServiceDefect" 119 "SVSOff_PS_P_DelD_ServiceHistoryDefect" 120 "SVSOff_PS_P_DelD_ServiceHistoryNoDefect" 121 "SVSOff_PS_P_DelD_DelayActiveNoDefect" 122 "SVSOff_PS_P_DelD_PendingDefect" 123 "SVSOff_PS_P_DelD_DebouncedDefect" 124 "SVSOff_PS_P_DelD_HistoryPendingDefect" 125 "SVSOff_PS_P_DelD_HealingNoDefect" 126 "SVSOff_PS_P_DelD_HistoryNoDefect" 128 "SVSOn_NoEntry" 129 "SVSOn_Erased" 130 "SVSOn_PrivateTemporary" 131 "SVSOn_FreezeFrameOnly" 132 "SVSOn_DelayActiveDefect" 133 "SVSOn_ServiceNoDefect" 134 "SVSOn_ServiceDefect" 135 "SVSOn_ServiceHistoryDefect" 136 "SVSOn_ServiceHistoryNoDefect" 137 "SVSOn_DelayActiveNoDefect" 138 "SVSOn_PendingDefect" 139 "SVSOn_DebouncedDefect" 140 "SVSOn_HistoryPendingDefect" 141 "SVSOn_HealingNoDefect" 142 "SVSOn_HistoryNoDefect" 144 "SVSOn_DelD_NoEntry" 145 "SVSOn_DelD_Erased" 146 "SVSOn_DelD_PrivateTemporary" 147 "SVSOn_DelD_FreezeFrameOnly" 148 "SVSOn_DelD_DelayActiveDefect" 149 "SVSOn_DelD_ServiceNoDefect" 150 "SVSOn_DelD_ServiceDefect" 151 "SVSOn_DelD_ServiceHistoryDefect" 152 "SVSOn_DelD_ServiceHistoryNoDefect" 153 "SVSOn_DelD_DelayActiveNoDefect" 154 "SVSOn_DelD_PendingDefect" 155 "SVSOn_DelD_DebouncedDefect" 156 "SVSOn_DelD_HistoryPendingDefect" 157 "SVSOn_DelD_HealingNoDefect" 158 "SVSOn_DelD_HistoryNoDefect" 160 "SVSOn_P_NoEntry" 161 "SVSOn_P_Erased" 162 "SVSOn_P_PrivateTemporary" 163 "SVSOn_P_FreezeFrameOnly" 164 "SVSOn_P_DelayActiveDefect" 165 "SVSOn_P_ServiceNoDefect" 166 "SVSOn_P_ServiceDefect" 167 "SVSOn_P_ServiceHistoryDefect" 168 "SVSOn_P_ServiceHistoryNoDefect" 169 "SVSOn_P_DelayActiveNoDefect" 170 "SVSOn_P_PendingDefect" 171 "SVSOn_P_DebouncedDefect" 172 "SVSOn_P_HistoryPendingDefect" 173 "SVSOn_P_HealingNoDefect" 174 "SVSOn_P_HistoryNoDefect" 176 "SVSOn_P_DelD_NoEntry" 177 "SVSOn_P_DelD_Erased" 178 "SVSOn_P_DelD_PrivateTemporary" 179 "SVSOn_P_DelD_FreezeFrameOnly" 180 "SVSOn_P_DelD_DelayActiveDefect" 181 "SVSOn_P_DelD_ServiceNoDefect" 182 "SVSOn_P_DelD_ServiceDefect" 183 "SVSOn_P_DelD_ServiceHistoryDefect" 184 "SVSOn_P_DelD_ServiceHistoryNoDefect" 185 "SVSOn_P_DelD_DelayActiveNoDefect" 186 "SVSOn_P_DelD_PendingDefect" 187 "SVSOn_P_DelD_DebouncedDefect" 188 "SVSOn_P_DelD_HistoryPendingDefect" 189 "SVSOn_P_DelD_HealingNoDefect" 190 "SVSOn_P_DelD_HistoryNoDefect" 192 "SVSOn_PS_NoEntry" 193 "SVSOn_PS_Erased" 194 "SVSOn_PS_PrivateTemporary" 195 "SVSOn_PS_FreezeFrameOnly" 196 "SVSOn_PS_DelayActiveDefect" 197 "SVSOn_PS_ServiceNoDefect" 198 "SVSOn_PS_ServiceDefect" 199 "SVSOn_PS_ServiceHistoryDefect" 200 "SVSOn_PS_ServiceHistoryNoDefect" 201 "SVSOn_PS_DelayActiveNoDefect" 202 "SVSOn_PS_PendingDefect" 203 "SVSOn_PS_DebouncedDefect" 204 "SVSOn_PS_HistoryPendingDefect" 205 "SVSOn_PS_HealingNoDefect" 206 "SVSOn_PS_HistoryNoDefect" 208 "SVSOn_PS_DelD_NoEntry" 209 "SVSOn_PS_DelD_Erased" 210 "SVSOn_PS_DelD_PrivateTemporary" 211 "SVSOn_PS_DelD_FreezeFrameOnly" 212 "SVSOn_PS_DelD_DelayActiveDefect" 213 "SVSOn_PS_DelD_ServiceNoDefect" 214 "SVSOn_PS_DelD_ServiceDefect" 215 "SVSOn_PS_DelD_ServiceHistoryDefect" 216 "SVSOn_PS_DelD_ServiceHistoryNoDefect" 217 "SVSOn_PS_DelD_DelayActiveNoDefect" 218 "SVSOn_PS_DelD_PendingDefect" 219 "SVSOn_PS_DelD_DebouncedDefect" 220 "SVSOn_PS_DelD_HistoryPendingDefect" 221 "SVSOn_PS_DelD_HealingNoDefect" 222 "SVSOn_PS_DelD_HistoryNoDefect" 224 "SVSOn_PS_P_NoEntry" 225 "SVSOn_PS_P_Erased" 226 "SVSOn_PS_P_PrivateTemporary" 227 "SVSOn_PS_P_FreezeFrameOnly" 228 "SVSOn_PS_P_DelayActiveDefect" 229 "SVSOn_PS_P_ServiceNoDefect" 230 "SVSOn_PS_P_ServiceDefect" 231 "SVSOn_PS_P_ServiceHistoryDefect" 232 "SVSOn_PS_P_ServiceHistoryNoDefect" 233 "SVSOn_PS_P_DelayActiveNoDefect" 234 "SVSOn_PS_P_PendingDefect" 235 "SVSOn_PS_P_DebouncedDefect" 236 "SVSOn_PS_P_HistoryPendingDefect" 237 "SVSOn_PS_P_HealingNoDefect" 238 "SVSOn_PS_P_HistoryNoDefect" 240 "SVSOn_PS_P_DelD_NoEntry" 241 "SVSOn_PS_P_DelD_Erased" 242 "SVSOn_PS_P_DelD_PrivateTemporary" 243 "SVSOn_PS_P_DelD_FreezeFrameOnly" 244 "SVSOn_PS_P_DelD_DelayActiveDefect" 245 "SVSOn_PS_P_DelD_ServiceNoDefect" 246 "SVSOn_PS_P_DelD_ServiceDefect" 247 "SVSOn_PS_P_DelD_ServiceHistoryDefect" 248 "SVSOn_PS_P_DelD_ServiceHistoryNoDefect" 249 "SVSOn_PS_P_DelD_DelayActiveNoDefect" 250 "SVSOn_PS_P_DelD_PendingDefect" 251 "SVSOn_PS_P_DelD_DebouncedDefect" 252 "SVSOn_PS_P_DelD_HistoryPendingDefect" 253 "SVSOn_PS_P_DelD_HealingNoDefect" 254 "SVSOn_PS_P_DelD_HistoryNoDefect" /end COMPU_VTAB
/begin COMPU_METHOD MgPerHubSec "" RAT_FUNC "%6.3" "mg/(Hub*sec)" COEFFS 0 10 0 0 0 1 /end COMPU_METHOD
/begin COMPU_METHOD mgrad_q1p526Em6_kg_DIV_h "" RAT_FUNC "%8.7" "kg/h" COEFFS 0 65536 0 0 0 0.1 /end COMPU_METHOD
/begin COMPU_METHOD MILLMP_PWRSTG_SY_Compu "" TAB_VERB "%6.3" "" COMPU_TAB_REF MILLMP_PWRSTG_SY_Compu /end COMPU_METHOD
/begin COMPU_VTAB MILLMP_PWRSTG_SY_Compu "" TAB_VERB 2 0 "False" 1 "True" /end COMPU_VTAB
/begin COMPU_METHOD OneToOne "" RAT_FUNC "%6.2" "-" COEFFS 0 1 0 0 0 1 /end COMPU_METHOD
/begin RECORD_LAYOUT Val_Wu8 FNC_VALUES 1 UBYTE COLUMN_DIR DIRECT /end RECORD_LAYOUT
/end MODULE
/end PROJECT
