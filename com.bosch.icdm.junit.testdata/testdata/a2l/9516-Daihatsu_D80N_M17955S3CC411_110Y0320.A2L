ASAP2_VERSION 1 4
/begin PROJECT M17955S3CC411_110Y0320 "M17955S3CC411_110Y0320"
/begin HEADER "" VERSION "M17955S3CC411_110Y0320" PROJECT_NO M17955S3CC411_110Y0320 /end HEADER
/begin MODULE DIM ""
/begin MOD_COMMON "" BYTE_ORDER MSB_LAST ALIGNMENT_BYTE 1 ALIGNMENT_WORD 2 ALIGNMENT_LONG 4 ALIGNMENT_FLOAT32_IEEE 4 /end MOD_COMMON
/begin CHARACTERISTIC CWKRSHIFT "" VALUE 0x80045DE0 KwWU8 10.00 dez 0.00 10.00 FORMAT "%5.2" /end CHARACTERISTIC
/begin CHARACTERISTIC CWME7 "" VALUE 0x80045F28 KwUb 255.0 dez 0.00 255.0 FORMAT "%5.1" /end CHARACTERISTIC
/begin CHARACTERISTIC CWTFA "" VALUE 0x80045EDA KwWU8 255.0 dez 0.00 255.0 FORMAT "%5.1" /end CHARACTERISTIC
/begin CHARACTERISTIC CWTMOTRA "" VALUE 0x80045E98 KwWU8 255.0 dez 0.00 255.0 FORMAT "%5.1" /end CHARACTERISTIC
/begin CHARACTERISTIC CWTPTC "" VALUE 0x80045D86 KwWU8 255.0 dez 0.00 255.0 FORMAT "%5.1" /end CHARACTERISTIC
/begin CHARACTERISTIC DN10BURN "" VALUE 0x80045538 KwWS16 16383.75 nmotd_sw_q0p25 -8192.000 8191.750 FORMAT "%8.3" /end CHARACTERISTIC
/begin CHARACTERISTIC DPITNUM "" VALUE 0x80045B5A KwWU16 65535.00 dez 0.00 65535.00 FORMAT "%8.2" /end CHARACTERISTIC
/begin CHARACTERISTIC DPUAPP "" VALUE 0x80045B5C KwWS16 2559.961 p_q0p039 -1280.000 1279.961 FORMAT "%8.3" /end CHARACTERISTIC
/begin CHARACTERISTIC DSSGRAD "" VALUE 0x80045DD0 KwWU16 1023.984 dgrad_uw_q0p015 0.00 1023.984 FORMAT "%8.3" /end CHARACTERISTIC
/begin CHARACTERISTIC DSSOFS "" VALUE 0x80045DD2 KwWS16 5119.922 p_q0p078 -2560.000 2559.922 FORMAT "%8.3" /end CHARACTERISTIC
/begin CHARACTERISTIC DUKK "" VALUE 0x80045794 KwWS16 3071.953 rel_sw_q0p0468 -1536.000 1535.953 FORMAT "%8.3" /end CHARACTERISTIC
/begin CHARACTERISTIC DWDK "" VALUE 0x80045D87 KwWU8 100.0 relDK_ub_b100 0.00 100.0 FORMAT "%5.1" /end CHARACTERISTIC
/begin CHARACTERISTIC DWDKBAMX "" VALUE 0x80045D88 KwWU16 99.99847 rel_uw_b100 0.00 99.99847 FORMAT "%8.5" /end CHARACTERISTIC
/begin CHARACTERISTIC DWDKLA "" VALUE 0x80045D8A KwWU8 100.0 relDK_ub_b100 0.00 100.0 FORMAT "%5.1" /end CHARACTERISTIC
/begin CHARACTERISTIC DWDKSLN "" CURVE 0x80045D8C KlAxU8SstxU8WU16 100.0000 relDK_uw_b100 0.00 100.0000 FORMAT "%8.4"
 /begin AXIS_DESCR STD_AXIS nmot nmot_ub_q40 6 0.00 10200. FORMAT "%5.0" DEPOSIT ABSOLUTE /end AXIS_DESCR
/end CHARACTERISTIC
/begin CHARACTERISTIC DWEEMX "" VALUE 0x80045A0A KwUb 1530. kw_q6 0.00 1530. FORMAT "%5.0" /end CHARACTERISTIC
/begin CHARACTERISTIC Etc_MaxReqTO_C "" VALUE 0x8004BC70 Val_Wu16 32767.00 OneToOne 0.00 32767.00 FORMAT "%8.2" /end CHARACTERISTIC
/begin CHARACTERISTIC Etks_stDisableDetection_C "" VALUE 0x800400ED Val_Wu8 255.0 OneToOne 0.00 255.0 FORMAT "%5.1" /end CHARACTERISTIC
/begin CHARACTERISTIC FanCtl_facAftRunCorrd_CUR "" CURVE 0x80041F50 Cur_Xs16Ws16 511.9922 Fact1 -256.0000 255.9922 FORMAT "%8.4"
 /begin AXIS_DESCR STD_AXIS GlbDa_tEnv Temp_Cels 4 -3549.940 3003.560 FORMAT "%8.3" DEPOSIT ABSOLUTE /end AXIS_DESCR
/end CHARACTERISTIC
/begin CHARACTERISTIC FanCtl_nThrs_C "" VALUE 0x80041F62 Val_Ws16 32767.50 EngN -16384.00 16383.50 FORMAT "%8.2" /end CHARACTERISTIC
/begin CHARACTERISTIC FanCtl_tClntEngOut_C "" VALUE 0x80041F64 Val_Ws16 6553.500 Temp_Cels -3549.940 3003.560 FORMAT "%8.3" /end CHARACTERISTIC
/begin CHARACTERISTIC FanCtl_tCooltHi_C "" VALUE 0x80041F66 Val_Ws16 6553.500 Temp_Cels -3549.940 3003.560 FORMAT "%8.3" /end CHARACTERISTIC
/begin CHARACTERISTIC FanCtl_tCooltLo_C "" VALUE 0x80041F68 Val_Ws16 6553.500 Temp_Cels -3549.940 3003.560 FORMAT "%8.3" /end CHARACTERISTIC
/begin CHARACTERISTIC FanCtl_tiAftRun_C "" VALUE 0x80041F6A Val_Ws16 65535.00 TimeEngOn -32768.00 32767.00 FORMAT "%8.2" /end CHARACTERISTIC
/begin CHARACTERISTIC FanCtl_tiAftRun_CUR "" CURVE 0x80041F6C Cur_Xs16Ws16 65535.00 TimeEngOn -32768.00 32767.00 FORMAT "%8.2"
 /begin AXIS_DESCR STD_AXIS TS_tClntEngOut Temp_Cels 4 -3549.940 3003.560 FORMAT "%8.3" DEPOSIT ABSOLUTE /end AXIS_DESCR
/end CHARACTERISTIC
/begin CHARACTERISTIC FanCtl_tiDlyOff_C "" VALUE 0x80041F7E Val_Ws16 655.3500 Time_s -327.6800 327.6700 FORMAT "%8.4" /end CHARACTERISTIC
/begin CHARACTERISTIC FanCtl_tiDlyOn_C "" VALUE 0x80041F80 Val_Ws16 655.3500 Time_s -327.6800 327.6700 FORMAT "%8.4" /end CHARACTERISTIC
/begin CHARACTERISTIC FanCtl_tiDlyStrt_C "" VALUE 0x80041F82 Val_Ws16 10485.60 TimeRed -5242.880 5242.720 FORMAT "%8.3" /end CHARACTERISTIC
/begin CHARACTERISTIC Fan_DigOut0.tiBtwTstSCB_C "" VALUE 0x8004BDE8 Kw_Ws16 1000.000 Time_ms 0.00 1000.000 FORMAT "%8.3" /end CHARACTERISTIC
/begin CHARACTERISTIC Fan_DigOut0.tiBtwTstOT_C "" VALUE 0x8004BDEA Kw_Ws16 100.0000 Time_s 0.00 100.0000 FORMAT "%8.4" /end CHARACTERISTIC
/begin CHARACTERISTIC Fan_DigOut0.numTstMax_C "" VALUE 0x8004BDEC Kw_Wu16 65535.00 OneToOne 0.00 65535.00 FORMAT "%8.2" /end CHARACTERISTIC
/begin CHARACTERISTIC Fan_rHysHi_CA "" VAL_BLK 0x8004BDEE ValA_Ws16 799.9878 Prc -400.0000 399.9878 FORMAT "%8.4" NUMBER 1 /end CHARACTERISTIC
/begin CHARACTERISTIC Fan_rHysLo_CA "" VAL_BLK 0x8004BDF0 ValA_Ws16 799.9878 Prc -400.0000 399.9878 FORMAT "%8.4" NUMBER 1 /end CHARACTERISTIC
/begin CHARACTERISTIC Fan_stPsDiaDisblDIO_CA "" VAL_BLK 0x8004BDF2 ValA_Wu16 65535.00 OneToOne 0.00 65535.00 FORMAT "%8.2" NUMBER 1 /end CHARACTERISTIC
/begin CHARACTERISTIC Fan_stPsDisDIO_CA "" VAL_BLK 0x8004BDF4 ValA_Wu16 65535.00 OneToOne 0.00 65535.00 FORMAT "%8.2" NUMBER 1 /end CHARACTERISTIC
/begin CHARACTERISTIC FIMHU "" CURVE 0x80045B22 FklWU8 1.992188 fak_ub_b2 0.00 1.992188 FORMAT "%8.6"
 /begin AXIS_DESCR FIX_AXIS anzwe dez 16 0.00 15.00 FORMAT "%5.2" FIX_AXIS_PAR 0 0 16 /end AXIS_DESCR
/end CHARACTERISTIC
/begin CHARACTERISTIC FIMWU "" CURVE 0x80045B32 FklWU8 1.992188 fak_ub_b2 0.00 1.992188 FORMAT "%8.6"
 /begin AXIS_DESCR FIX_AXIS anzwe dez 16 0.00 15.00 FORMAT "%5.2" FIX_AXIS_PAR 0 0 16 /end AXIS_DESCR
/end CHARACTERISTIC
/begin CHARACTERISTIC FKLAFUGD "" VALUE 0x80045B94 KwWU16 1.000000 fak_q3p0518Em5 0.00 1.000000 FORMAT "%8.6" READ_ONLY /end CHARACTERISTIC
/begin CHARACTERISTIC FKSTT "" CURVE 0x8004553A KlAxU8SstxU8WU16 63.99902 fak_uw_b64 0.00 63.99902 FORMAT "%8.5"
 /begin AXIS_DESCR STD_AXIS tmst temp_ub_q0p75_o48 12 -48.00 143.3 FORMAT "%5.1" DEPOSIT ABSOLUTE /end AXIS_DESCR
/end CHARACTERISTIC
/begin CHARACTERISTIC FMFKRZN "" MAP 0x80045DE2 KfAxU8AyU8SstxU16SstyU16WS16 4096.000 dez 0.00 4096.000 FORMAT "%8.3"
 /begin AXIS_DESCR STD_AXIS stkrfmf dez 5 0.00 255.0000 FORMAT "%8.4" DEPOSIT ABSOLUTE /end AXIS_DESCR
 /begin AXIS_DESCR STD_AXIS zzylkr_int dez 8 0.00 255.0000 FORMAT "%8.4" DEPOSIT ABSOLUTE /end AXIS_DESCR
/end CHARACTERISTIC
/begin CHARACTERISTIC FPVHKMSAB "" CURVE 0x80045B5E KlAxU8SstxU16WU16 104856.0 m_q1p6 0.00 104856.0 FORMAT "%8.1"
 /begin AXIS_DESCR STD_AXIS msabvhk_w m_uw_b6553p5 7 0.00 6553.500 FORMAT "%8.3" DEPOSIT ABSOLUTE /end AXIS_DESCR
/end CHARACTERISTIC
/begin CHARACTERISTIC FPVHKTTA "" CURVE 0x80045B7C KlAxU8SstxU16WU8 5100. fak_q20_hPahPa_mul_h_div_kg 0.00 5100. FORMAT "%5.0"
 /begin AXIS_DESCR STD_AXIS thkmid_w temp_q0p0234_o273 6 -273.1500 1262.827 FORMAT "%8.3" DEPOSIT ABSOLUTE /end AXIS_DESCR
/end CHARACTERISTIC
/begin CHARACTERISTIC FSTTAH "" VALUE 0x80045DDC KwWU8 127.5 vol_q0p5_l 0.00 127.5 FORMAT "%5.1" /end CHARACTERISTIC
/begin CHARACTERISTIC FSTTAL "" VALUE 0x80045DDD KwWU8 127.5 vol_q0p5_l 0.00 127.5 FORMAT "%5.1" /end CHARACTERISTIC
/begin CHARACTERISTIC FSTTPWF "" VALUE 0x80045DDE KwWU8 127.5 vol_q0p5_l 0.00 127.5 FORMAT "%5.1" /end CHARACTERISTIC
/begin CHARACTERISTIC FUKBAE "" VALUE 0x80045796 KwWU16 7.999878 fak_uw_b8 0.00 7.999878 FORMAT "%8.6" /end CHARACTERISTIC
/begin CHARACTERISTIC FUKNSTHO "" CURVE 0x80045798 KlAxU8SstxU8WU8 1.992188 fak_ub_b2 0.00 1.992188 FORMAT "%8.6"
 /begin AXIS_DESCR STD_AXIS fho fak_ub_b4 6 0.00 3.984 FORMAT "%5.3" DEPOSIT ABSOLUTE /end AXIS_DESCR
/end CHARACTERISTIC
/begin CHARACTERISTIC FUKNSTRM "" CURVE 0x800457A6 KlAxU8SstxU8WU16 19.99969 fak_q0p000305 0.00 19.99969 FORMAT "%8.5"
 /begin AXIS_DESCR STD_AXIS tmot temp_ub_q0p75_o48 9 -48.00 143.3 FORMAT "%5.1" DEPOSIT ABSOLUTE /end AXIS_DESCR
/end CHARACTERISTIC
/begin CHARACTERISTIC FUKTINEO "" CURVE 0x800457C2 KlAxU8SstxU16WU16 1.999969 fak_uw_b2 0.00 1.999969 FORMAT "%8.6"
 /begin AXIS_DESCR STD_AXIS vti_w fak_uw_b2 6 0.00 1.999969 FORMAT "%8.6" DEPOSIT ABSOLUTE /end AXIS_DESCR
/end CHARACTERISTIC
/begin CHARACTERISTIC FUKVAE "" VALUE 0x800457DC KwWU16 7.999878 fak_uw_b8 0.00 7.999878 FORMAT "%8.6" /end CHARACTERISTIC
/begin CHARACTERISTIC FVANST "" VALUE 0x800457DE KwWU8 1.992188 fak_ub_b2 0.00 1.992188 FORMAT "%8.6" /end CHARACTERISTIC
/begin CHARACTERISTIC FWEEMRFAM "" CURVE 0x80045A0B GklWUb 1.000000 fak_ub_b2 0.00 1.000000 FORMAT "%8.6"
 /begin AXIS_DESCR COM_AXIS tmot temp_ub_q0p75_o48 8 -48.00 143.3 FORMAT "%5.1" AXIS_PTS_REF STM08FSUB /end AXIS_DESCR
/end CHARACTERISTIC
/begin CHARACTERISTIC FWET "" CURVE 0x80045B42 KlAxU8SstxU8WU8 1.992188 fak_ub_b2 0.00 1.992188 FORMAT "%8.6"
 /begin AXIS_DESCR STD_AXIS tmeswe temp_ub_q0p75_o48 9 -48.00 143.3 FORMAT "%5.1" DEPOSIT ABSOLUTE /end AXIS_DESCR
/end CHARACTERISTIC
/begin CHARACTERISTIC GlbDa_aX_C "" VALUE 0x8004BDFC Val_Ws16 65.53500 Acc -32.76800 32.76700 FORMAT "%8.5" /end CHARACTERISTIC
/begin CHARACTERISTIC GlbDa_lDstLim_C "" VALUE 0x8004BDF8 Val_Ws32 2147473647.00 Length 10000.0000000 2147483647.00 FORMAT "%13.2" /end CHARACTERISTIC
/begin CHARACTERISTIC GlbDa_lWhlCirc_C "" VALUE 0x8004BDFE Val_Ws16 65.53500 Length_fine -32.76800 32.76700 FORMAT "%8.5" /end CHARACTERISTIC
/begin CHARACTERISTIC GlbDa_pEnv_C "" VALUE 0x8004BE00 Val_Ws16 65535.00 Pres_hPa -32768.00 32767.00 FORMAT "%8.2" /end CHARACTERISTIC
/begin CHARACTERISTIC GlbDa_rTrqDfl_C "" VALUE 0x8004BE02 Val_Ws16 655.3500 TransR -327.6800 327.6700 FORMAT "%8.4" /end CHARACTERISTIC
/begin CHARACTERISTIC GlbDa_stVehLimMin_C "" VALUE 0x80041F84 Val_Wu8 255.0 OneToOne 0.00 255.0 FORMAT "%5.1" /end CHARACTERISTIC
/begin CHARACTERISTIC GlbDa_tEnv_C "" VALUE 0x8004BE04 Val_Ws16 6553.500 Temp_Cels -3549.940 3003.560 FORMAT "%8.3" /end CHARACTERISTIC
/begin CHARACTERISTIC GlbDa_tiFltAX_C "" VALUE 0x8004BE08 Val_Ws32 4294.9672940 TimeDelay_s 0.000002000000001 4294.9672960 FORMAT "%12.7" /end CHARACTERISTIC
/begin CHARACTERISTIC GlbDa_tiFltVX_C "" VALUE 0x8004BE0C Val_Ws32 4294.9672940 TimeDelay_s 0.000002000000001 4294.9672960 FORMAT "%12.7" /end CHARACTERISTIC
/begin CHARACTERISTIC GlbDa_tIndAir_C "" VALUE 0x8004BE10 Val_Ws16 6553.500 Temp_Cels -3549.940 3003.560 FORMAT "%8.3" /end CHARACTERISTIC
/begin CHARACTERISTIC GlbDa_trqVehLimMin_C "" VALUE 0x80041F86 Val_Ws16 6553.500 Trq -3276.800 3276.700 FORMAT "%8.3" /end CHARACTERISTIC
/begin CHARACTERISTIC GlbDa_vX_C "" VALUE 0x8004BE12 Val_Ws16 655.3500 Vel -327.6800 327.6700 FORMAT "%8.4" /end CHARACTERISTIC
/begin CHARACTERISTIC GRADWDK "" VALUE 0x80045DA0 KwWU8 39.78 fak_ub_q0p156 0.00 39.78 FORMAT "%5.2" /end CHARACTERISTIC
/begin CHARACTERISTIC HEGOD_mEGStkUs_C "" VALUE 0x80045F4C KwWU16 2912.667 m_q0p0peri4 0.00 2912.667 FORMAT "%8.3" /end CHARACTERISTIC
/begin CHARACTERISTIC HEGOD_stDynSimn_CW "" VALUE 0x80045F38 KwWU8 255.0 dez 0.00 255.0 FORMAT "%5.1" /end CHARACTERISTIC
/begin CHARACTERISTIC HEGOD_stPosnSimn_CW "" VALUE 0x80045F4A KwWU8 255.0 dez 0.00 255.0 FORMAT "%5.1" /end CHARACTERISTIC
/begin CHARACTERISTIC HEGOD_tiDebErrStkHiUs_C "" VALUE 0x80045F4E KwWU8 25.50 t_q0p1 0.00 25.50 FORMAT "%5.2" /end CHARACTERISTIC
/begin CHARACTERISTIC HEGOD_tiDebErrStkLowUs_C "" VALUE 0x80045F4F KwWU8 25.50 t_q0p1 0.00 25.50 FORMAT "%5.2" /end CHARACTERISTIC
/begin CHARACTERISTIC HEGOD_tiDebRstErrStk_C "" VALUE 0x80045F50 KwWU8 25.50 t_q0p1 0.00 25.50 FORMAT "%5.2" /end CHARACTERISTIC
/begin CHARACTERISTIC HEGOD_tiFltSimn_C "" VALUE 0x80045F3A KwWU16 655.34999985 zk10msxs_uw_b655 0.010000152590 655.36000000 FORMAT "%12.8" /end CHARACTERISTIC
/begin CHARACTERISTIC HEGOD_tiFolwLRSimn_C "" VALUE 0x80045F3C KwWU16 655.34999985 zk10msxs_uw_b655 0.010000152590 655.36000000 FORMAT "%12.8" /end CHARACTERISTIC
/begin CHARACTERISTIC HEGOD_tiFolwRLSimn_C "" VALUE 0x80045F3E KwWU16 655.34999985 zk10msxs_uw_b655 0.010000152590 655.36000000 FORMAT "%12.8" /end CHARACTERISTIC
/begin CHARACTERISTIC HEGOD_tiFolwSimn_C "" VALUE 0x80045F40 KwWU16 655.34999985 zk10msxs_uw_b655 0.010000152590 655.36000000 FORMAT "%12.8" /end CHARACTERISTIC
/begin CHARACTERISTIC HEGOD_tiHldLRSimn_C "" VALUE 0x80045F42 KwWU16 655.3500 t_q0p01 0.00 655.3500 FORMAT "%8.4" /end CHARACTERISTIC
/begin CHARACTERISTIC HEGOD_tiHldRLSimn_C "" VALUE 0x80045F44 KwWU16 655.3500 t_q0p01 0.00 655.3500 FORMAT "%8.4" /end CHARACTERISTIC
/begin CHARACTERISTIC HEGOD_tiHldSimn_C "" VALUE 0x80045F46 KwWU16 655.3500 t_q0p01 0.00 655.3500 FORMAT "%8.4" /end CHARACTERISTIC
/begin CHARACTERISTIC HEGOD_tiVltFltSimn_C "" VALUE 0x80045F48 KwWU16 655.34999985 zk10msxs_uw_b655 0.010000152590 655.36000000 FORMAT "%12.8" /end CHARACTERISTIC
/begin CHARACTERISTIC HEGOD_uLeanDsStkUs_C "" VALUE 0x80045F52 KwWU16 319.9951 spg_uw_q0p00488_o1 -1.000000 318.9951 FORMAT "%8.4" /end CHARACTERISTIC
/begin CHARACTERISTIC HEGOD_uRichDsStkUs_C "" VALUE 0x80045F54 KwWU16 319.9951 spg_uw_q0p00488_o1 -1.000000 318.9951 FORMAT "%8.4" /end CHARACTERISTIC
/begin CHARACTERISTIC HEGOD_uS1RichOpRdn_C "" VALUE 0x80045F56 KwWU16 319.9951 spg_uw_q0p00488_o1 -1.000000 318.9951 FORMAT "%8.4" /end CHARACTERISTIC
/begin CHARACTERISTIC HEGO_duErrElecHtrCpl_C "" VALUE 0x80046194 KwWU16 4.995117 spg_q0p00488 0.00 4.995117 FORMAT "%8.6" /end CHARACTERISTIC
/begin CHARACTERISTIC HEGO_duErrElecMinLdPls_C "" VALUE 0x80046188 KwWU16 4.995117 spg_q0p00488 0.00 4.995117 FORMAT "%8.6" /end CHARACTERISTIC
/begin CHARACTERISTIC HEGO_duErrElecSigLdPls_C "" VALUE 0x80046190 KwWU16 4.995117 spg_q0p00488 0.00 4.995117 FORMAT "%8.6" /end CHARACTERISTIC
/begin CHARACTERISTIC HEGO_duHtgMapMax_C "" VALUE 0x80045F62 KwWU16 25.59961 spg_q0p00039 0.00 25.59961 FORMAT "%8.5" /end CHARACTERISTIC
/begin CHARACTERISTIC HEGO_duHtgRmpDwnTSP_C "" VALUE 0x80045F64 KwWU16 255.9961 spgg_q0p0039 0.00 255.9961 FORMAT "%8.4" /end CHARACTERISTIC
/begin CHARACTERISTIC HEGO_duHtgRmpDwn_C "" VALUE 0x80045F66 KwWU16 255.9961 spgg_q0p0039 0.00 255.9961 FORMAT "%8.4" /end CHARACTERISTIC
/begin CHARACTERISTIC HEGO_duHtgRmpUpTSP_C "" VALUE 0x80045F68 KwWU16 255.9961 spgg_q0p0039 0.00 255.9961 FORMAT "%8.4" /end CHARACTERISTIC
/begin CHARACTERISTIC HEGO_duHtgRmpUp_C "" VALUE 0x80045F6A KwWU16 255.9961 spgg_q0p0039 0.00 255.9961 FORMAT "%8.4" /end CHARACTERISTIC
/begin CHARACTERISTIC HEGO_duNomHtgIMaxTSP_C "" VALUE 0x80045F6C KwWS16 25.59961 spg_q0p00039 -12.80000 12.79961 FORMAT "%8.5" /end CHARACTERISTIC
/begin CHARACTERISTIC HEGO_duNomHtgIMax_C "" VALUE 0x80045F6E KwWS16 25.59961 spg_q0p00039 -12.80000 12.79961 FORMAT "%8.5" /end CHARACTERISTIC
/begin CHARACTERISTIC HEGO_duNomHtgIMinTSP_C "" VALUE 0x80045F70 KwWS16 25.59961 spg_q0p00039 -12.80000 12.79961 FORMAT "%8.5" /end CHARACTERISTIC
/begin CHARACTERISTIC HEGO_duNomHtgIMin_C "" VALUE 0x80045F72 KwWS16 25.59961 spg_q0p00039 -12.80000 12.79961 FORMAT "%8.5" /end CHARACTERISTIC
/begin CHARACTERISTIC HEGO_duNomHtgPMaxTSP_C "" VALUE 0x80045F74 KwWS16 25.59961 spg_q0p00039 -12.80000 12.79961 FORMAT "%8.5" /end CHARACTERISTIC
/begin CHARACTERISTIC HEGO_duNomHtgPMax_C "" VALUE 0x80045F76 KwWS16 25.59961 spg_q0p00039 -12.80000 12.79961 FORMAT "%8.5" /end CHARACTERISTIC
/begin CHARACTERISTIC HEGO_duNomHtgPMinTSP_C "" VALUE 0x80045F78 KwWS16 25.59961 spg_q0p00039 -12.80000 12.79961 FORMAT "%8.5" /end CHARACTERISTIC
/begin CHARACTERISTIC HEGO_duNomHtgPMin_C "" VALUE 0x80045F7A KwWS16 25.59961 spg_q0p00039 -12.80000 12.79961 FORMAT "%8.5" /end CHARACTERISTIC
/begin CHARACTERISTIC HEGO_duNomHtgRedErrElecMin_C "" VALUE 0x80045F7C KwWU16 25.59961 spg_q0p00039 0.00 25.59961 FORMAT "%8.5" /end CHARACTERISTIC
/begin CHARACTERISTIC HEGO_facHtgIGnTSP_C "" VALUE 0x80045F7E KwWU16 12.79980 q1p953125Em4_V_DIV_s_Ohm 0.00 12.79980 FORMAT "%8.5" /end CHARACTERISTIC
/begin CHARACTERISTIC HEGO_facHtgIGn_C "" VALUE 0x80045F80 KwWU16 12.79980 q1p953125Em4_V_DIV_s_Ohm 0.00 12.79980 FORMAT "%8.5" /end CHARACTERISTIC
/begin CHARACTERISTIC HEGO_facHtgPGnTSP_CUR "" CURVE 0x80045F82 KlAxU8SstxS16WU16 12.79980 q1p953125Em4_V_DIV_Ohm 0.00 12.79980 FORMAT "%8.5"
 /begin AXIS_DESCR STD_AXIS NO_INPUT_QUANTITY r_uw_q2 11 -65536.00 65534.00 FORMAT "%8.2" DEPOSIT ABSOLUTE /end AXIS_DESCR
/end CHARACTERISTIC
/begin CHARACTERISTIC HEGO_facHtgPGn_CUR "" CURVE 0x80045FB0 KlAxU8SstxS16WU16 12.79980 q1p953125Em4_V_DIV_Ohm 0.00 12.79980 FORMAT "%8.5"
 /begin AXIS_DESCR STD_AXIS NO_INPUT_QUANTITY r_uw_q2 11 -65536.00 65534.00 FORMAT "%8.2" DEPOSIT ABSOLUTE /end AXIS_DESCR
/end CHARACTERISTIC
/begin CHARACTERISTIC HEGO_HtgS1B1_I.pwrHtgSuffMin_C "" VALUE 0x80046044 KwWU8 2.550 fak_q0p01 0.00 2.550 FORMAT "%5.3" /end CHARACTERISTIC
/begin CHARACTERISTIC HEGO_HtgS1B1_I.stHtg_CW "" VALUE 0x80046045 KwWU8 255.0 dez 0.00 255.0 FORMAT "%5.1" /end CHARACTERISTIC
/begin CHARACTERISTIC HEGO_HtgS1B1_I.tEGHtgSuffMin_C "" VALUE 0x80046046 KwWU16 1535.977 temp_q0p0234_o273 -273.1500 1262.827 FORMAT "%8.3" /end CHARACTERISTIC
/begin CHARACTERISTIC HEGO_HtgS1B1_I.tiFltTEGHtg_CUR "" CURVE 0x80046048 KlAxU8SstxU16WU16 6553.4999985 zk100msxs_uw_b6553p6 0.10000152590 6553.6000000 FORMAT "%12.7"
 /begin AXIS_DESCR STD_AXIS NO_INPUT_QUANTITY m_uw_b6553p5 5 0.00 6553.500 FORMAT "%8.3" DEPOSIT ABSOLUTE /end AXIS_DESCR
/end CHARACTERISTIC
/begin CHARACTERISTIC HEGO_HtgS1B1_I.tiHtgSuffDeb_C "" VALUE 0x8004605E KwWU8 25.50 t_q0p1 0.00 25.50 FORMAT "%5.2" /end CHARACTERISTIC
/begin CHARACTERISTIC HEGO_HtgS1B1_I.uDrpHtg_C "" VALUE 0x80046060 KwWU16 25.59961 spg_q0p00039 0.00 25.59961 FORMAT "%8.5" /end CHARACTERISTIC
/begin CHARACTERISTIC HEGO_HtgS1B1_I.uHtgMapCtlTSP_MAP "" MAP 0x80046062 KfAxU8AyU8SstxU16SstyU16WU16 25.59961 spg_q0p00039 0.00 25.59961 FORMAT "%8.5"
 /begin AXIS_DESCR STD_AXIS NO_INPUT_QUANTITY m_uw_b6553p5 7 0.00 6553.500 FORMAT "%8.3" DEPOSIT ABSOLUTE /end AXIS_DESCR
 /begin AXIS_DESCR STD_AXIS HEGO_HtgS1B1_I.tEGFltHtg temp_q0p0234_o273 8 -273.1500 1262.827 FORMAT "%8.3" DEPOSIT ABSOLUTE /end AXIS_DESCR
/end CHARACTERISTIC
/begin CHARACTERISTIC HEGO_HtgS1B1_I.uHtgMapCtl_MAP "" MAP 0x800460F4 KfAxU8AyU8SstxU16SstyU16WU16 25.59961 spg_q0p00039 0.00 25.59961 FORMAT "%8.5"
 /begin AXIS_DESCR STD_AXIS NO_INPUT_QUANTITY m_uw_b6553p5 7 0.00 6553.500 FORMAT "%8.3" DEPOSIT ABSOLUTE /end AXIS_DESCR
 /begin AXIS_DESCR STD_AXIS HEGO_HtgS1B1_I.tEGFltHtg temp_q0p0234_o273 8 -273.1500 1262.827 FORMAT "%8.3" DEPOSIT ABSOLUTE /end AXIS_DESCR
/end CHARACTERISTIC
/begin CHARACTERISTIC HEGO_HtgS1B1_I.uHtgPrt_C "" VALUE 0x80046186 KwWU16 25.59961 spg_q0p00039 0.00 25.59961 FORMAT "%8.5" /end CHARACTERISTIC
/begin CHARACTERISTIC HEGO_numHtrCpl_C "" VALUE 0x80046196 KwWU8 255.0 dez 0.00 255.0 FORMAT "%5.1" /end CHARACTERISTIC
/begin CHARACTERISTIC HEGO_numHtrOff_C "" VALUE 0x80046197 KwWU8 255.0 dez 0.00 255.0 FORMAT "%5.1" /end CHARACTERISTIC
/begin CHARACTERISTIC HEGO_numRiOkOpRdn_C "" VALUE 0x800461A8 KwWU8 255.0 dez 0.00 255.0 FORMAT "%5.1" /end CHARACTERISTIC
/begin CHARACTERISTIC HEGO_OBDHtgS1B1_I.resRiThresDHtg_MAP "" MAP 0x80046210 KfAxU8AyU8SstxU16SstyU16WU16 131070.0 r_uw_q2 0.00 131070.0 FORMAT "%8.1"
 /begin AXIS_DESCR STD_AXIS HEGO_OBDHtgS1B1_I.tEGFlt temp_q0p0234_o273 5 -273.1500 1262.827 FORMAT "%8.3" DEPOSIT ABSOLUTE /end AXIS_DESCR
 /begin AXIS_DESCR STD_AXIS HEGO_OBDHtgS1B1_I.pwrHtgFlt fak_q0p01 5 0.00 2.550000 FORMAT "%8.6" DEPOSIT ABSOLUTE /end AXIS_DESCR
/end CHARACTERISTIC
/begin CHARACTERISTIC HEGO_OpRdnS1B1_I.stDElec_CW "" VALUE 0x800461BC KwWU8 255.0 dez 0.00 255.0 FORMAT "%5.1" /end CHARACTERISTIC
/begin CHARACTERISTIC HEGO_OpRdnS1B1_I.tiDebErrStk_C "" VALUE 0x800461BE KwWU16 6553.500 t_q0p1 0.00 6553.500 FORMAT "%8.3" /end CHARACTERISTIC
/begin CHARACTERISTIC HEGO_OpRdnS1B1_I.tiDebExptOpRdn_CUR "" CURVE 0x800461C0 KlAxU8SstxU16WU16 6553.500 t_q0p1 0.00 6553.500 FORMAT "%8.3"
 /begin AXIS_DESCR STD_AXIS NO_INPUT_QUANTITY temp_q0p0234_om273 4 -273.1500 1262.827 FORMAT "%8.3" DEPOSIT ABSOLUTE /end AXIS_DESCR
/end CHARACTERISTIC
/begin CHARACTERISTIC HEGO_OpRdnS1B1_I.tiDebPrtHtgFin_C "" VALUE 0x800461D2 KwWU16 6553.500 t_q0p1 0.00 6553.500 FORMAT "%8.3" /end CHARACTERISTIC
/begin CHARACTERISTIC HEGO_resErrElecSigRi_C "" VALUE 0x80046198 KwWU16 131070.0 r_uw_q2 0.00 131070.0 FORMAT "%8.1" /end CHARACTERISTIC
/begin CHARACTERISTIC HEGO_resRiDBndMaxTSP_C "" VALUE 0x80045FDE KwWS16 131070.0 r_uw_q2 -65536.00 65534.00 FORMAT "%8.2" /end CHARACTERISTIC
/begin CHARACTERISTIC HEGO_resRiDBndMax_C "" VALUE 0x80045FE0 KwWS16 131070.0 r_uw_q2 -65536.00 65534.00 FORMAT "%8.2" /end CHARACTERISTIC
/begin CHARACTERISTIC HEGO_resRiDBndMinTSP_C "" VALUE 0x80045FE2 KwWS16 131070.0 r_uw_q2 -65536.00 65534.00 FORMAT "%8.2" /end CHARACTERISTIC
/begin CHARACTERISTIC HEGO_resRiDBndMin_C "" VALUE 0x80045FE4 KwWS16 131070.0 r_uw_q2 -65536.00 65534.00 FORMAT "%8.2" /end CHARACTERISTIC
/begin CHARACTERISTIC HEGO_resRiHtgOffTSP_C "" VALUE 0x80045FE6 KwWU16 131070.0 r_uw_q2 0.00 131070.0 FORMAT "%8.1" /end CHARACTERISTIC
/begin CHARACTERISTIC HEGO_resRiHtgOff_C "" VALUE 0x80045FE8 KwWU16 131070.0 r_uw_q2 0.00 131070.0 FORMAT "%8.1" /end CHARACTERISTIC
/begin CHARACTERISTIC HEGO_resRiHtgRedTSP_C "" VALUE 0x80045FEA KwWU16 131070.0 r_uw_q2 0.00 131070.0 FORMAT "%8.1" /end CHARACTERISTIC
/begin CHARACTERISTIC HEGO_resRiHystDHtg_C "" VALUE 0x800461D4 KwWU16 131070.0 r_uw_q2 0.00 131070.0 FORMAT "%8.1" /end CHARACTERISTIC
/begin CHARACTERISTIC HEGO_resRiMaxHtgSuff_C "" VALUE 0x800461D6 KwWU16 131070.0 r_uw_q2 0.00 131070.0 FORMAT "%8.1" /end CHARACTERISTIC
/begin CHARACTERISTIC HEGO_resRiNomTSP_C "" VALUE 0x80045FEC KwWU16 131070.0 r_uw_q2 0.00 131070.0 FORMAT "%8.1" /end CHARACTERISTIC
/begin CHARACTERISTIC HEGO_resRiNom_C "" VALUE 0x80045FEE KwWU16 131070.0 r_uw_q2 0.00 131070.0 FORMAT "%8.1" /end CHARACTERISTIC
/begin CHARACTERISTIC HEGO_resRiOpRdn_C "" VALUE 0x800461AA KwWU16 131070.0 r_uw_q2 0.00 131070.0 FORMAT "%8.1" /end CHARACTERISTIC
/begin CHARACTERISTIC HEGO_resRstErrElecSigRi_C "" VALUE 0x8004619A KwWU16 131070.0 r_uw_q2 0.00 131070.0 FORMAT "%8.1" /end CHARACTERISTIC
/begin CHARACTERISTIC HEGO_rHtgMaxAntiWindUpTSP_C "" VALUE 0x80045FF0 KwWU16 2.559961 fak_q3p906Em5 0.00 2.559961 FORMAT "%8.6" /end CHARACTERISTIC
/begin CHARACTERISTIC HEGO_rHtgMaxAntiWindUp_C "" VALUE 0x80045FF2 KwWU16 2.559961 fak_q3p906Em5 0.00 2.559961 FORMAT "%8.6" /end CHARACTERISTIC
/begin CHARACTERISTIC HEGO_rHtgMinAntiWindUpTSP_C "" VALUE 0x80045FF4 KwWU16 2.559961 fak_q3p906Em5 0.00 2.559961 FORMAT "%8.6" /end CHARACTERISTIC
/begin CHARACTERISTIC HEGO_rHtgMinAntiWindUp_C "" VALUE 0x80045FF6 KwWU16 2.559961 fak_q3p906Em5 0.00 2.559961 FORMAT "%8.6" /end CHARACTERISTIC
/begin CHARACTERISTIC HEGO_stDElec_CW "" VALUE 0x800461B0 KwWU8 255.0 dez 0.00 255.0 FORMAT "%5.1" /end CHARACTERISTIC
/begin CHARACTERISTIC HEGO_stHtgEna_CW "" VALUE 0x80045F58 KwWU8 255.0 dez 0.00 255.0 FORMAT "%5.1" /end CHARACTERISTIC
/begin CHARACTERISTIC HEGO_stS1DHtg_CW "" VALUE 0x80046200 KwWU8 255.0 dez 0.00 255.0 FORMAT "%5.1" /end CHARACTERISTIC
/begin CHARACTERISTIC HEGO_stS1Ps_CW "" VALUE 0x80046261 KwWU8 255.0 dez 0.00 255.0 FORMAT "%5.1" /end CHARACTERISTIC
/begin CHARACTERISTIC HEGO_tEGDHtgMax_C "" VALUE 0x800461D8 KwWU16 1535.977 temp_q0p0234_o273 -273.1500 1262.827 FORMAT "%8.3" /end CHARACTERISTIC
/begin CHARACTERISTIC HEGO_tEGDHtgMin_C "" VALUE 0x800461DA KwWU16 1535.977 temp_q0p0234_o273 -273.1500 1262.827 FORMAT "%8.3" /end CHARACTERISTIC
/begin CHARACTERISTIC HEGO_tEGDHtgShrtTrpMax_C "" VALUE 0x800461DC KwWU16 1535.977 temp_q0p0234_o273 -273.1500 1262.827 FORMAT "%8.3" /end CHARACTERISTIC
/begin CHARACTERISTIC HEGO_tEGDHtgShrtTrpMin_C "" VALUE 0x800461DE KwWU16 1535.977 temp_q0p0234_o273 -273.1500 1262.827 FORMAT "%8.3" /end CHARACTERISTIC
/begin CHARACTERISTIC HEGO_tEGErrElecSigRi_C "" VALUE 0x8004619C KwWU16 1535.977 temp_q0p0234_om273 -273.1500 1262.827 FORMAT "%8.3" /end CHARACTERISTIC
/begin CHARACTERISTIC HEGO_tEGFltMin_C "" VALUE 0x800461E0 KwWU16 1535.977 temp_q0p0234_o273 -273.1500 1262.827 FORMAT "%8.3" /end CHARACTERISTIC
/begin CHARACTERISTIC HEGO_tEGHtgOffStop_C "" VALUE 0x80045F5A KwWU16 1535.977 temp_q0p0234_o273 -273.1500 1262.827 FORMAT "%8.3" /end CHARACTERISTIC
/begin CHARACTERISTIC HEGO_tEGHtgRed_C "" VALUE 0x80045FF8 KwWU16 1535.977 temp_q0p0234_o273 -273.1500 1262.827 FORMAT "%8.3" /end CHARACTERISTIC
/begin CHARACTERISTIC HEGO_tEGMaxHtgEna_C "" VALUE 0x80045FFA KwWU16 1535.977 temp_q0p0234_o273 -273.1500 1262.827 FORMAT "%8.3" /end CHARACTERISTIC
/begin CHARACTERISTIC HEGO_tEngHotHtg_C "" VALUE 0x80045FFC KwWU8 191.3 temp_ub_q0p75_o48 -48.00 143.3 FORMAT "%5.1" /end CHARACTERISTIC
/begin CHARACTERISTIC HEGO_tEngMinHtg_C "" VALUE 0x80045F5C KwWU8 191.3 temp_ub_q0p75_o48 -48.00 143.3 FORMAT "%5.1" /end CHARACTERISTIC
/begin CHARACTERISTIC HEGO_tiDebBattHtgOff_C "" VALUE 0x80045F5D KwWU8 2.550 t_q0p01 0.00 2.550 FORMAT "%5.3" /end CHARACTERISTIC
/begin CHARACTERISTIC HEGO_tiDebDHtgFuncReq_C "" VALUE 0x80046201 KwWU8 25.50 t_q0p1 0.00 25.50 FORMAT "%5.2" /end CHARACTERISTIC
/begin CHARACTERISTIC HEGO_tiDebDHtrPsEna_C "" VALUE 0x8004625C KwWU8 25.50 t_q0p1 0.00 25.50 FORMAT "%5.2" /end CHARACTERISTIC
/begin CHARACTERISTIC HEGO_tiDebDPEHtrCpl_C "" VALUE 0x8004619E KwWU16 655.3500 t_q0p01 0.00 655.3500 FORMAT "%8.4" /end CHARACTERISTIC
/begin CHARACTERISTIC HEGO_tiDebErrElecMax_C "" VALUE 0x800461A0 KwWU8 2.550 t_q0p01 0.00 2.550 FORMAT "%5.3" /end CHARACTERISTIC
/begin CHARACTERISTIC HEGO_tiDebErrElecMinSus_C "" VALUE 0x800461A1 KwWU8 25.50 t_q0p1 0.00 25.50 FORMAT "%5.2" /end CHARACTERISTIC
/begin CHARACTERISTIC HEGO_tiDebErrElecMin_C "" VALUE 0x800461A2 KwWU8 25.50 t_q0p1 0.00 25.50 FORMAT "%5.2" /end CHARACTERISTIC
/begin CHARACTERISTIC HEGO_tiDebErrElecSigSus_C "" VALUE 0x800461A3 KwWU8 25.50 t_q0p1 0.00 25.50 FORMAT "%5.2" /end CHARACTERISTIC
/begin CHARACTERISTIC HEGO_tiDebErrHtgFIDRls_C "" VALUE 0x800461E2 KwWU16 6553.500 t_q0p1 0.00 6553.500 FORMAT "%8.3" /end CHARACTERISTIC
/begin CHARACTERISTIC HEGO_tiDebErrHtg_C "" VALUE 0x800461E4 KwWU8 25.50 t_q0p1 0.00 25.50 FORMAT "%5.2" /end CHARACTERISTIC
/begin CHARACTERISTIC HEGO_tiDebFCOOpnGnd_C "" VALUE 0x8004618B KwWU8 25.50 t_q0p1 0.00 25.50 FORMAT "%5.2" /end CHARACTERISTIC
/begin CHARACTERISTIC HEGO_tiDebFrzRiHtg_C "" VALUE 0x80045FFE KwWU16 655.3500 t_q0p01 0.00 655.3500 FORMAT "%8.4" /end CHARACTERISTIC
/begin CHARACTERISTIC HEGO_tiDebGenDElecS1_C "" VALUE 0x8004618C KwWU8 25.50 t_q0p1 0.00 25.50 FORMAT "%5.2" /end CHARACTERISTIC
/begin CHARACTERISTIC HEGO_tiDebGenDElec_C "" VALUE 0x800461A4 KwWU8 25.50 t_q0p1 0.00 25.50 FORMAT "%5.2" /end CHARACTERISTIC
/begin CHARACTERISTIC HEGO_tiDebHealHtgErr_C "" VALUE 0x800461E5 KwWU8 25.50 t_q0p1 0.00 25.50 FORMAT "%5.2" /end CHARACTERISTIC
/begin CHARACTERISTIC HEGO_tiDebHealHtg_C "" VALUE 0x800461E6 KwWU8 25.50 t_q0p1 0.00 25.50 FORMAT "%5.2" /end CHARACTERISTIC
/begin CHARACTERISTIC HEGO_tiDebHtgMapClsdLopTSP_C "" VALUE 0x80046000 KwWU16 6553.500 t_q0p1 0.00 6553.500 FORMAT "%8.3" /end CHARACTERISTIC
/begin CHARACTERISTIC HEGO_tiDebHtgMapClsdLop_C "" VALUE 0x80046002 KwWU16 6553.500 t_q0p1 0.00 6553.500 FORMAT "%8.3" /end CHARACTERISTIC
/begin CHARACTERISTIC HEGO_tiDebHtgMaxHys_C "" VALUE 0x80046004 KwWU16 6553.500 t_q0p1 0.00 6553.500 FORMAT "%8.3" /end CHARACTERISTIC
/begin CHARACTERISTIC HEGO_tiDebHtgMax_C "" VALUE 0x80046006 KwWU16 6553.500 t_q0p1 0.00 6553.500 FORMAT "%8.3" /end CHARACTERISTIC
/begin CHARACTERISTIC HEGO_tiDebHtrPsCurrLim_C "" VALUE 0x80046008 KwWU8 25.50 t_q0p1 0.00 25.50 FORMAT "%5.2" /end CHARACTERISTIC
/begin CHARACTERISTIC HEGO_tiDebPsErr_C "" VALUE 0x8004625D KwWU8 12.75 t_q0p05 0.00 12.75 FORMAT "%5.2" /end CHARACTERISTIC
/begin CHARACTERISTIC HEGO_tiDebPs_C "" VALUE 0x8004625E KwWU8 0.2550 t_q0p001 0.00 0.2550 FORMAT "%6.4" /end CHARACTERISTIC
/begin CHARACTERISTIC HEGO_tiDebRstErrStkCVB_C "" VALUE 0x800461AC KwWU8 25.50 t_q0p1 0.00 25.50 FORMAT "%5.2" /end CHARACTERISTIC
/begin CHARACTERISTIC HEGO_tiDelLdPlsMin_C "" VALUE 0x8004618A KwWU8 25.40 t_q0p1 0.1000 25.50 FORMAT "%5.2" /end CHARACTERISTIC
/begin CHARACTERISTIC HEGO_tiDelLdPlsSig_C "" VALUE 0x80046192 KwWU8 25.40 t_q0p1 0.1000 25.50 FORMAT "%5.2" /end CHARACTERISTIC
/begin CHARACTERISTIC HEGO_tiEngStopDHtgMin_C "" VALUE 0x80046202 KwWU16 65535.00 t_q1 0.00 65535.00 FORMAT "%8.2" /end CHARACTERISTIC
/begin CHARACTERISTIC HEGO_tiFltPwrHtg_C "" VALUE 0x800461E8 KwWU16 6553.4999985 zk100msxs_uw_b6553p6 0.10000152590 6553.6000000 FORMAT "%12.7" /end CHARACTERISTIC
/begin CHARACTERISTIC HEGO_tiFltRiHtg_C "" VALUE 0x8004600A KwWU16 6553.4999985 zk100msxs_uw_b6553p6 0.10000152590 6553.6000000 FORMAT "%12.7" /end CHARACTERISTIC
/begin CHARACTERISTIC HEGO_tiFltTempEG_CUR "" CURVE 0x800461EA KlAxU8SstxU16WU16 6553.4999985 zk100msxs_uw_b6553p6 0.10000152590 6553.6000000 FORMAT "%12.7"
 /begin AXIS_DESCR STD_AXIS NO_INPUT_QUANTITY m_q0p1 5 0.00 6553.500 FORMAT "%8.3" DEPOSIT ABSOLUTE /end AXIS_DESCR
/end CHARACTERISTIC
/begin CHARACTERISTIC HEGO_tiFrmHtrCpl_C "" VALUE 0x800461A5 KwWU8 2.550 t_q0p01 0.00 2.550 FORMAT "%5.3" /end CHARACTERISTIC
/begin CHARACTERISTIC HEGO_tiHtrPsRst_C "" VALUE 0x80045F5E KwWU8 25.50 t_q0p1 0.00 25.50 FORMAT "%5.2" /end CHARACTERISTIC
/begin CHARACTERISTIC HEGO_tiMaxHtgRedTSP_C "" VALUE 0x8004600C KwWU16 6553.500 t_q0p1 0.00 6553.500 FORMAT "%8.3" /end CHARACTERISTIC
/begin CHARACTERISTIC HEGO_tiMaxHtgRed_C "" VALUE 0x8004600E KwWU16 6553.500 t_q0p1 0.00 6553.500 FORMAT "%8.3" /end CHARACTERISTIC
/begin CHARACTERISTIC HEGO_tIntkAirThrDHtgMin_C "" VALUE 0x80046204 KwWU16 1535.977 temp_q0p0234_o273 -273.1500 1262.827 FORMAT "%8.3" /end CHARACTERISTIC
/begin CHARACTERISTIC HEGO_uBattDHtgMax_C "" VALUE 0x80046206 KwWU16 25.59961 spg_q0p00039 0.00 25.59961 FORMAT "%8.5" /end CHARACTERISTIC
/begin CHARACTERISTIC HEGO_uBattDHtgMin_C "" VALUE 0x80046208 KwWU16 25.59961 spg_q0p00039 0.00 25.59961 FORMAT "%8.5" /end CHARACTERISTIC
/begin CHARACTERISTIC HEGO_uBattHtgOff_C "" VALUE 0x80045F60 KwWU16 25.59961 spg_q0p00039 0.00 25.59961 FORMAT "%8.5" /end CHARACTERISTIC
/begin CHARACTERISTIC HEGO_uBattMaxDHtrPs_C "" VALUE 0x80046262 KwWU16 25.59961 spg_q0p00039 0.00 25.59961 FORMAT "%8.5" /end CHARACTERISTIC
/begin CHARACTERISTIC HEGO_uBattMinDElec_C "" VALUE 0x800461B1 KwWU8 25.50 spg_q0p1 0.00 25.50 FORMAT "%5.2" /end CHARACTERISTIC
/begin CHARACTERISTIC HEGO_uErrElecMax_C "" VALUE 0x800461B2 KwWU16 4.995117 spg_q0p00488 0.00 4.995117 FORMAT "%8.6" /end CHARACTERISTIC
/begin CHARACTERISTIC HEGO_uErrElecMin_C "" VALUE 0x800461A6 KwWU16 4.995117 spg_q0p00488 0.00 4.995117 FORMAT "%8.6" /end CHARACTERISTIC
/begin CHARACTERISTIC HEGO_uErrElecOpnGnd_C "" VALUE 0x8004618E KwWU16 4.995117 spg_q0p00488 0.00 4.995117 FORMAT "%8.6" /end CHARACTERISTIC
/begin CHARACTERISTIC HEGO_uHtgAftPrtTSP_CUR "" CURVE 0x80046010 KlAxU8SstxU16WU16 25.59961 spg_q0p00039 0.00 25.59961 FORMAT "%8.5"
 /begin AXIS_DESCR STD_AXIS NO_INPUT_QUANTITY temp_q0p0234_o273 4 -273.1500 1262.827 FORMAT "%8.3" DEPOSIT ABSOLUTE /end AXIS_DESCR
/end CHARACTERISTIC
/begin CHARACTERISTIC HEGO_uHtgAftPrt_CUR "" CURVE 0x80046022 KlAxU8SstxU16WU16 25.59961 spg_q0p00039 0.00 25.59961 FORMAT "%8.5"
 /begin AXIS_DESCR STD_AXIS NO_INPUT_QUANTITY temp_q0p0234_o273 4 -273.1500 1262.827 FORMAT "%8.3" DEPOSIT ABSOLUTE /end AXIS_DESCR
/end CHARACTERISTIC
/begin CHARACTERISTIC HEGO_uHtgMaxDeb_C "" VALUE 0x80046034 KwWU16 23.64648 spg_q0p00039 1.953125 25.59961 FORMAT "%8.5" /end CHARACTERISTIC
/begin CHARACTERISTIC HEGO_uHtgMaxHtUpTSP_C "" VALUE 0x80046036 KwWU16 25.59961 spg_q0p00039 0.00 25.59961 FORMAT "%8.5" /end CHARACTERISTIC
/begin CHARACTERISTIC HEGO_uHtgMaxHtUp_C "" VALUE 0x80046038 KwWU16 25.59961 spg_q0p00039 0.00 25.59961 FORMAT "%8.5" /end CHARACTERISTIC
/begin CHARACTERISTIC HEGO_uHtgMax_C "" VALUE 0x8004603A KwWU16 23.64648 spg_q0p00039 1.953125 25.59961 FORMAT "%8.5" /end CHARACTERISTIC
/begin CHARACTERISTIC HEGO_uHtgNom_C "" VALUE 0x8004603C KwWU16 23.64648 spg_q0p00039 1.953125 25.59961 FORMAT "%8.5" /end CHARACTERISTIC
/begin CHARACTERISTIC HEGO_uOpRdnLSFXfour_C "" VALUE 0x800461AE KwWU16 4.995117 spg_q0p00488 0.00 4.995117 FORMAT "%8.6" /end CHARACTERISTIC
/begin CHARACTERISTIC HEGO_uPsHi_C "" VALUE 0x8004625F KwWU8 4.980 spg_q0p0195 0.00 4.980 FORMAT "%5.3" /end CHARACTERISTIC
/begin CHARACTERISTIC HEGO_uPsLo_C "" VALUE 0x80046260 KwWU8 4.980 spg_q0p0195 0.00 4.980 FORMAT "%5.3" /end CHARACTERISTIC
/begin CHARACTERISTIC HEGO_uS1LeanOpRdn_C "" VALUE 0x800461B4 KwWU16 4.995117 spg_q0p00488 0.00 4.995117 FORMAT "%8.6" /end CHARACTERISTIC
/begin CHARACTERISTIC HEGO_uS1RichOpRdn_C "" VALUE 0x800461B6 KwWU16 4.995117 spg_q0p00488 0.00 4.995117 FORMAT "%8.6" /end CHARACTERISTIC
/begin CHARACTERISTIC IMLHS "" VALUE 0x80045560 KwWU8 23.21 m_ub_b23p3 0.00 23.21 FORMAT "%5.2" /end CHARACTERISTIC
/begin CHARACTERISTIC KEMLN "" CURVE 0x80045E50 GklWS8 60.00 zw_sb_q0p75 9.750 69.75 FORMAT "%5.2"
 /begin AXIS_DESCR COM_AXIS nmot nmot_ub_q40 13 0.00 10200. FORMAT "%5.0" AXIS_PTS_REF SNMKRA /end AXIS_DESCR
/end CHARACTERISTIC
/begin CHARACTERISTIC KFABAK "" MAP 0x800457DF GkfWU8 0.9961 fak_ub_b1 0.00 0.9961
 /begin AXIS_DESCR COM_AXIS tmot temp_ub_q0p75_o48 9 -48.00 143.3 FORMAT "%5.1" AXIS_PTS_REF STM09ESUB /end AXIS_DESCR
 /begin AXIS_DESCR COM_AXIS nmot nmot_ub_q40 7 0.00 10200. FORMAT "%5.0" AXIS_PTS_REF SNM07ESUB /end AXIS_DESCR
/end CHARACTERISTIC
/begin CHARACTERISTIC KFAVAK "" MAP 0x8004581E GkfWU8 0.9961 fak_ub_b1 0.00 0.9961
 /begin AXIS_DESCR COM_AXIS tmot temp_ub_q0p75_o48 9 -48.00 143.3 FORMAT "%5.1" AXIS_PTS_REF STM09ESUB /end AXIS_DESCR
 /begin AXIS_DESCR COM_AXIS nmot nmot_ub_q40 7 0.00 10200. FORMAT "%5.0" AXIS_PTS_REF SNM07ESUB /end AXIS_DESCR
/end CHARACTERISTIC
/begin CHARACTERISTIC KFBAKL "" MAP 0x8004585E GkfWU16 31.99951 fak_uw_b32 0.00 31.99951 FORMAT "%8.5"
 /begin AXIS_DESCR COM_AXIS tmot temp_ub_q0p75_o48 9 -48.00 143.3 FORMAT "%5.1" AXIS_PTS_REF STM09ESUB /end AXIS_DESCR
 /begin AXIS_DESCR COM_AXIS nmot nmot_ub_q40 7 0.00 10200. FORMAT "%5.0" AXIS_PTS_REF SNM07ESUB /end AXIS_DESCR
/end CHARACTERISTIC
/begin CHARACTERISTIC KFFLLSST "" MAP 0x80045B96 KfAxU8AyU8SstxU8SstyU8WU8 1.992188 fak_ub_b2 0.00 1.992188 FORMAT "%8.6"
 /begin AXIS_DESCR STD_AXIS tans temp_ub_q0p75_o48 6 -48.00 143.3 FORMAT "%5.1" DEPOSIT ABSOLUTE /end AXIS_DESCR
 /begin AXIS_DESCR STD_AXIS fho fak_ub_b4 6 0.00 3.984 FORMAT "%5.3" DEPOSIT ABSOLUTE /end AXIS_DESCR
/end CHARACTERISTIC
/begin CHARACTERISTIC KFHSTT "" MAP 0x80045561 KfAxU8AyU8SstxU8SstyU8WU8 63.75 fak_ub_b64 0.00 63.75 FORMAT "%5.2"
 /begin AXIS_DESCR STD_AXIS tans temp_ub_q0p75_o48 6 -48.00 143.3 FORMAT "%5.1" DEPOSIT ABSOLUTE /end AXIS_DESCR
 /begin AXIS_DESCR STD_AXIS tmst temp_ub_q0p75_o48 3 -48.00 143.3 FORMAT "%5.1" DEPOSIT ABSOLUTE /end AXIS_DESCR
/end CHARACTERISTIC
/begin CHARACTERISTIC KFKSTTWST "" MAP 0x8004557E KfAxU8AyU8SstxU16SstyU16WU16 1.992188 fak_ub_b2 0.00 1.992188 FORMAT "%8.6"
 /begin AXIS_DESCR STD_AXIS tengsq1_w t_q1 4 0.00 65535.00 FORMAT "%8.2" DEPOSIT ABSOLUTE /end AXIS_DESCR
 /begin AXIS_DESCR STD_AXIS tmst temp_ub_q0p75_o48 4 -48.00000 143.2500 FORMAT "%8.4" DEPOSIT ABSOLUTE /end AXIS_DESCR
/end CHARACTERISTIC
/begin CHARACTERISTIC KFMAKR "" MAP 0x80045E5D GkfWS8 33.75 kw_q0p75 0.7500 34.50 FORMAT "%5.2"
 /begin AXIS_DESCR COM_AXIS nmot nmot_ub_q40 13 0.00 10200. FORMAT "%5.0" AXIS_PTS_REF SNMKRA /end AXIS_DESCR
 /begin AXIS_DESCR COM_AXIS rl rel_ub_q0p75 4 0.00 191.3 FORMAT "%5.1" AXIS_PTS_REF SRL04KRUB /end AXIS_DESCR
/end CHARACTERISTIC
/begin CHARACTERISTIC KFSTHO "" MAP 0x800455B2 KfAxU8AyU8SstxU8SstyU8WU8 1.992188 fak_ub_b2 0.00 1.992188 FORMAT "%8.6"
 /begin AXIS_DESCR STD_AXIS tmst temp_ub_q0p75_o48 6 -48.00 143.3 FORMAT "%5.1" DEPOSIT ABSOLUTE /end AXIS_DESCR
 /begin AXIS_DESCR STD_AXIS fho fak_ub_b4 4 0.00 3.984 FORMAT "%5.3" DEPOSIT ABSOLUTE /end AXIS_DESCR
/end CHARACTERISTIC
/begin CHARACTERISTIC KFVAKL "" MAP 0x800458DC GkfWU16 31.99951 fak_uw_b32 0.00 31.99951 FORMAT "%8.5"
 /begin AXIS_DESCR COM_AXIS tmot temp_ub_q0p75_o48 9 -48.00 143.3 FORMAT "%5.1" AXIS_PTS_REF STM09ESUB /end AXIS_DESCR
 /begin AXIS_DESCR COM_AXIS nmot nmot_ub_q40 7 0.00 10200. FORMAT "%5.0" AXIS_PTS_REF SNM07ESUB /end AXIS_DESCR
/end CHARACTERISTIC
/begin CHARACTERISTIC KFWDKMSNVP "" MAP 0x80045BC8 KfAxU8AyU8SstxU16SstyU16WU16 99.99847 rel_uw_b100 0.00 99.99847 FORMAT "%8.5"
 /begin AXIS_DESCR STD_AXIS msndkoos_w m_uw_b6553p5 18 0.00 6553.500 FORMAT "%8.3" DEPOSIT ABSOLUTE /end AXIS_DESCR
 /begin AXIS_DESCR STD_AXIS vpsrvdb_w fak_q3p0518Em5 8 0.00 1.999969 FORMAT "%8.6" DEPOSIT ABSOLUTE /end AXIS_DESCR
/end CHARACTERISTIC
/begin CHARACTERISTIC KFWEE "" MAP 0x80045A13 GkfWUb 1530. zw_ub_q6 0.00 1530. FORMAT "%5.0"
 /begin AXIS_DESCR COM_AXIS nmot_w nmot_uw_q0p25 8 0.00 16383.75 FORMAT "%8.2" AXIS_PTS_REF SNM08GKUW /end AXIS_DESCR
 /begin AXIS_DESCR COM_AXIS rl rel_q0p75 8 0.00 191.3 FORMAT "%5.1" AXIS_PTS_REF SRL08GKUB /end AXIS_DESCR
/end CHARACTERISTIC
/begin CHARACTERISTIC KFWEEST "" MAP 0x80045A53 KfAxUbAyUbSstxUbSstyUbWUb 1530. zw_ub_q6 0.00 1530. FORMAT "%5.0"
 /begin AXIS_DESCR STD_AXIS tmot temp_ub_q0p75_o48 8 -48.00 143.3 FORMAT "%5.1" DEPOSIT ABSOLUTE /end AXIS_DESCR
 /begin AXIS_DESCR STD_AXIS anztibj dez 6 0.00 255.0 FORMAT "%5.1" DEPOSIT ABSOLUTE /end AXIS_DESCR
/end CHARACTERISTIC
/begin CHARACTERISTIC KFWEETM "" MAP 0x80045A93 GkfWSb 1530. zw_sb_q6 -768.0 762.0 FORMAT "%5.1"
 /begin AXIS_DESCR COM_AXIS tmot temp_ub_q0p75_o48 8 -48.00 143.3 FORMAT "%5.1" AXIS_PTS_REF STM08FSUB /end AXIS_DESCR
 /begin AXIS_DESCR COM_AXIS rl rel_q0p75 8 0.00 191.3 FORMAT "%5.1" AXIS_PTS_REF SRL08GKUB /end AXIS_DESCR
/end CHARACTERISTIC
/begin CHARACTERISTIC KFWHSTT "" MAP 0x800455D6 KfAxU8AyU8SstxU8SstyU8WU8 1.992188 fak_ub_b2 0.00 1.992188 FORMAT "%8.6"
 /begin AXIS_DESCR STD_AXIS tans temp_ub_q0p75_o48 6 -48.00 143.3 FORMAT "%5.1" DEPOSIT ABSOLUTE /end AXIS_DESCR
 /begin AXIS_DESCR STD_AXIS anztist dez 8 0.00 255.0 FORMAT "%5.1" DEPOSIT ABSOLUTE /end AXIS_DESCR
/end CHARACTERISTIC
/begin CHARACTERISTIC KFWKSTAB "" MAP 0x80045616 KfAxU8AyU8SstxU16SstyU16WU16 1.992188 fak_ub_b2 0.00 1.992188 FORMAT "%8.6"
 /begin AXIS_DESCR STD_AXIS tengsq1_w t_q1 4 0.00 65535.00 FORMAT "%8.2" DEPOSIT ABSOLUTE /end AXIS_DESCR
 /begin AXIS_DESCR STD_AXIS tmst temp_ub_q0p75_o48 4 -48.00000 143.2500 FORMAT "%8.4" DEPOSIT ABSOLUTE /end AXIS_DESCR
/end CHARACTERISTIC
/begin CHARACTERISTIC KFWKSTN "" MAP 0x8004564A KfAxU8AyU8SstxU8SstyU8WU8 0.9961 fak_ub_b1 0.00 0.9961
 /begin AXIS_DESCR STD_AXIS tmst temp_ub_q0p75_o48 6 -48.00 143.3 FORMAT "%5.1" DEPOSIT ABSOLUTE /end AXIS_DESCR
 /begin AXIS_DESCR STD_AXIS nmot nmot_ub_q40 6 0.00 10200. FORMAT "%5.0" DEPOSIT ABSOLUTE /end AXIS_DESCR
/end CHARACTERISTIC
/begin CHARACTERISTIC KFWKSTT "" MAP 0x8004567C KfAxU8AyU8SstxU8SstyU8WU8 1.992188 fak_ub_b2 0.00 1.992188 FORMAT "%8.6"
 /begin AXIS_DESCR STD_AXIS tmst temp_ub_q0p75_o48 12 -48.00 143.3 FORMAT "%5.1" DEPOSIT ABSOLUTE /end AXIS_DESCR
 /begin AXIS_DESCR STD_AXIS anztist dez 14 0.00 255.0 FORMAT "%5.1" DEPOSIT ABSOLUTE /end AXIS_DESCR
/end CHARACTERISTIC
/begin CHARACTERISTIC KLSIS "" CURVE 0x80045D20 KlAxU8SstxU16WU16 99.99847 rel_uw_b100 0.00 99.99847 FORMAT "%8.5"
 /begin AXIS_DESCR STD_AXIS mdverl_w rel_uw_b100 8 0.00 99.99847 FORMAT "%8.5" DEPOSIT ABSOLUTE /end AXIS_DESCR
/end CHARACTERISTIC
/begin CHARACTERISTIC KLTMOTDIFF "" CURVE 0x80045740 KlAxU8SstxU8WU8 191.3 temp_ub_b191p25 0.00 191.3 FORMAT "%5.1"
 /begin AXIS_DESCR STD_AXIS tmotab temp_ub_q0p75_o48 6 -48.00 143.3 FORMAT "%5.1" DEPOSIT ABSOLUTE /end AXIS_DESCR
/end CHARACTERISTIC
/begin CHARACTERISTIC KLTNSUUK "" CURVE 0x8004595A KlAxU8SstxU8WU16 655.3500 t10msxs_uw_b655p35 0.00 655.3500 FORMAT "%8.4"
 /begin AXIS_DESCR STD_AXIS tmst temp_ub_q0p75_o48 4 -48.00 143.3 FORMAT "%5.1" DEPOSIT ABSOLUTE /end AXIS_DESCR
/end CHARACTERISTIC
/begin CHARACTERISTIC KLVATNST "" CURVE 0x80045968 KlAxU8SstxU16WU8 1.992188 fak_ub_b2 0.00 1.992188 FORMAT "%8.6"
 /begin AXIS_DESCR STD_AXIS tnst_w t10msxs_uw_b655p35 4 0.00 655.3500 FORMAT "%8.4" DEPOSIT ABSOLUTE /end AXIS_DESCR
/end CHARACTERISTIC
/begin CHARACTERISTIC KLZKWEE "" CURVE 0x80045976 KlAxU8SstxU8WU16 655.3500 t_q0p01 0.00 655.3500 FORMAT "%8.4"
 /begin AXIS_DESCR STD_AXIS wdwee kw_q6 2 0.00 1530. FORMAT "%5.0" DEPOSIT ABSOLUTE /end AXIS_DESCR
/end CHARACTERISTIC
/begin CHARACTERISTIC KLZYKSA "" CURVE 0x80045B55 FklWU8 255.0 dez 0.00 255.0 FORMAT "%5.1"
 /begin AXIS_DESCR FIX_AXIS anzzyksa dez 5 0.00 4.000 FORMAT "%5.3" FIX_AXIS_PAR 0 0 5 /end AXIS_DESCR
/end CHARACTERISTIC
/begin CHARACTERISTIC LIMAIRTFA1 "" VALUE 0x80045EDB KwWU8 23.21 m_ub_b23p3 0.00 23.21 FORMAT "%5.2" /end CHARACTERISTIC
/begin CHARACTERISTIC LLSPMSN "" CURVE 0x80045D42 KlAxU8SstxU16WU16 99.99847 rel_uw_b100 0.00 99.99847 FORMAT "%8.5"
 /begin AXIS_DESCR STD_AXIS msnllss_w m_uw_b102p4 16 0.00 102.3984 FORMAT "%8.4" DEPOSIT ABSOLUTE /end AXIS_DESCR
/end CHARACTERISTIC
/begin CHARACTERISTIC MLDTFA "" VALUE 0x80045EDC KwWU8 1020. m_ub_b1020 0.00 1020. FORMAT "%5.0" /end CHARACTERISTIC
/begin CHARACTERISTIC MRFAVW "" CURVE 0x80045AD4 GklWUw 199.9969 rel_uw_b200 0.00 199.9969 FORMAT "%8.4"
 /begin AXIS_DESCR COM_AXIS nmot_w nmot_uw_q0p25 8 0.00 16383.75 FORMAT "%8.2" AXIS_PTS_REF SNM08GKUW /end AXIS_DESCR
/end CHARACTERISTIC
/begin CHARACTERISTIC NDKSF "" VALUE 0x80045E91 KwWU8 10200. nmot_ub_q40 0.00 10200. FORMAT "%5.0" /end CHARACTERISTIC
/begin CHARACTERISTIC NKRFM1 "" VALUE 0x80045E92 KwWU8 10200. nmot_ub_q40 0.00 10200. FORMAT "%5.0" /end CHARACTERISTIC
/begin CHARACTERISTIC NKRFM2 "" VALUE 0x80045E93 KwWU8 10200. nmot_ub_q40 0.00 10200. FORMAT "%5.0" /end CHARACTERISTIC
/begin CHARACTERISTIC NKRFM3 "" VALUE 0x80045E94 KwWU8 10200. nmot_ub_q40 0.00 10200. FORMAT "%5.0" /end CHARACTERISTIC
/begin CHARACTERISTIC NMINPSINI "" VALUE 0x80045DD4 KwWS16 32767.50 EngN -16384.00 16383.50 FORMAT "%8.2" /end CHARACTERISTIC
/begin CHARACTERISTIC OFMSNWDKHF "" VALUE 0x80045D84 KwWS16 6553.500 m_q0p1 -3276.800 3276.700 FORMAT "%8.3" /end CHARACTERISTIC
/begin CHARACTERISTIC QDPSLL "" VALUE 0x80045DA1 KwWU8 1020. m_ub_b1020 0.00 1020. FORMAT "%5.0" /end CHARACTERISTIC
/begin CHARACTERISTIC RKBAUM "" CURVE 0x8004597E GklWS16 1535.953 rel_sw_q0p0468 0.00 1535.953 FORMAT "%8.3"
 /begin AXIS_DESCR COM_AXIS tmot temp_ub_q0p75_o48 9 -48.00 143.3 FORMAT "%5.1" AXIS_PTS_REF STM09ESUB /end AXIS_DESCR
/end CHARACTERISTIC
/begin CHARACTERISTIC RKUKKLU "" VALUE 0x80045990 KwWU16 1535.953 rel_sw_b1536 0.00 1535.953 FORMAT "%8.3" /end CHARACTERISTIC
/begin CHARACTERISTIC RKVAUM "" CURVE 0x80045992 GklWS16 1536.000 rel_sw_q0p0468 -1536.000 0.00 FORMAT "%8.3"
 /begin AXIS_DESCR COM_AXIS tmot temp_ub_q0p75_o48 9 -48.00 143.3 FORMAT "%5.1" AXIS_PTS_REF STM09ESUB /end AXIS_DESCR
/end CHARACTERISTIC
/begin CHARACTERISTIC SENZZYL "" VAL_BLK 0x80045E95 KwbWU8 3.000 dezsub1 1.000 4.000 FORMAT "%5.3" NUMBER 3 /end CHARACTERISTIC
/begin AXIS_PTS SNM07ESUB "" 0x80049EB4 nmot SstAUbSstUb 10200. nmot_ub_q40 7 0.00 10200. FORMAT "%5.0" DEPOSIT ABSOLUTE /end AXIS_PTS
/begin AXIS_PTS SNM08GKUW "" 0x80045AE4 nmot_w SstAUwSstUw 16383.75 nmot_uw_q0p25 8 0.00 16383.75 FORMAT "%8.2" DEPOSIT ABSOLUTE /end AXIS_PTS
/begin AXIS_PTS SNMKRA "" 0x80046282 nmot SstAU8SstU8 10200. nmot_ub_q40 13 0.00 10200. FORMAT "%5.0" DEPOSIT ABSOLUTE /end AXIS_PTS
/begin AXIS_PTS SRL04KRUB "" 0x8004629E rl SstAU8SstU8 191.3 rel_ub_q0p75 4 0.00 191.3 FORMAT "%5.1" DEPOSIT ABSOLUTE /end AXIS_PTS
/begin AXIS_PTS SRL08GKUB "" 0x80045AF6 rl SstAUbSstUb 191.3 rel_q0p75 8 0.00 191.3 FORMAT "%5.1" DEPOSIT ABSOLUTE /end AXIS_PTS
/begin AXIS_PTS STM08FSUB "" 0x80045AFF tmot SstAUbSstUb 191.3 temp_ub_q0p75_o48 8 -48.00 143.3 FORMAT "%5.1" DEPOSIT ABSOLUTE /end AXIS_PTS
/begin AXIS_PTS STM09ESUB "" 0x80049F99 tmot SstAUbSstUb 191.3 temp_ub_q0p75_o48 9 -48.00 143.3 FORMAT "%5.1" DEPOSIT ABSOLUTE /end AXIS_PTS
/begin CHARACTERISTIC TANDT "" CURVE 0x8004574D KlAxU8SstxU8WU8 191.3 temp_ub_b191p25 0.00 191.3 FORMAT "%5.1"
 /begin AXIS_DESCR STD_AXIS tansab temp_ub_q0p75_o48 8 -48.00 143.3 FORMAT "%5.1" DEPOSIT ABSOLUTE /end AXIS_DESCR
/end CHARACTERISTIC
/begin CHARACTERISTIC TANH "" VALUE 0x8004575E KwWU8 191.3 temp_ub_q0p75_o48 -48.00 143.3 FORMAT "%5.1" /end CHARACTERISTIC
/begin CHARACTERISTIC TCTFA1 "" VALUE 0x80045EDD KwWU8 25.40 t_q0p1 0.1000 25.50 FORMAT "%5.2" /end CHARACTERISTIC
/begin CHARACTERISTIC TCUTCW "" VALUE 0x80045E9A KwWU16 6553.4999985 zk100msxs_uw_b6553 0.10000152590 6553.6000000 FORMAT "%12.7" /end CHARACTERISTIC
/begin CHARACTERISTIC TDDK "" VALUE 0x80045DA2 KwWU8 2.550 t_q0p01 0.00 2.550 FORMAT "%5.3" /end CHARACTERISTIC
/begin CHARACTERISTIC TDDSR "" VALUE 0x80045DD6 KwWU8 25.50 t_q0p1 0.00 25.50 FORMAT "%5.2" /end CHARACTERISTIC
/begin CHARACTERISTIC TDELTFA "" VALUE 0x80045EDE KwWU8 25.50 t_q0p1 0.00 25.50 FORMAT "%5.2" /end CHARACTERISTIC
/begin CHARACTERISTIC TDFST "" VALUE 0x80045DDF KwWU8 25.40 t_q0p1 0.1000 25.50 FORMAT "%5.2" /end CHARACTERISTIC
/begin CHARACTERISTIC TDNSUB "" VALUE 0x80045F2A KwUw 6553.500 t100msxs_uw_b6553p5 0.00 6553.500 FORMAT "%8.3" /end CHARACTERISTIC
/begin CHARACTERISTIC TDNSUBR "" VALUE 0x80045F2C KwUw 6553.500 t100msxs_uw_b6553p5 0.00 6553.500 FORMAT "%8.3" /end CHARACTERISTIC
/begin CHARACTERISTIC TDTFA1 "" VALUE 0x80045EDF KwWU8 25.50 t_q0p1 0.00 25.50 FORMAT "%5.2" /end CHARACTERISTIC
/begin CHARACTERISTIC TDTFA1HL "" VALUE 0x80045EE0 KwWU8 25.50 t_q0p1 0.00 25.50 FORMAT "%5.2" /end CHARACTERISTIC
/begin CHARACTERISTIC TDUB "" VALUE 0x80045F2E KwUb 25.30 t100msxs_ub_b25p5 0.2000 25.50 FORMAT "%5.2" /end CHARACTERISTIC
/begin CHARACTERISTIC TDUBEVAB "" VALUE 0x80045F2F KwUb 25.40 t100msxs_ub_b25p5 0.1000 25.50 FORMAT "%5.2" /end CHARACTERISTIC
/begin CHARACTERISTIC TFA1ELI "" CURVE 0x80045EE2 KlAxU8SstxU16WU8 191.3 temp_ub_q0p75_o48 -48.00 143.3 FORMAT "%5.1"
 /begin AXIS_DESCR STD_AXIS wtfa1loc_w spg_uw_q0p00488 20 0.00 4.995117 FORMAT "%8.6" DEPOSIT ABSOLUTE /end AXIS_DESCR
/end CHARACTERISTIC
/begin CHARACTERISTIC TKRF "" VALUE 0x800459A4 KwWU8 25.50 txms_uw_q0p1 0.00 25.50 FORMAT "%5.2" /end CHARACTERISTIC
/begin CHARACTERISTIC TMH "" VALUE 0x8004575F KwWU8 191.3 temp_ub_q0p75_o48 -48.00 143.3 FORMAT "%5.1" /end CHARACTERISTIC
/begin CHARACTERISTIC TMHSG "" VALUE 0x80045760 KwWU8 191.3 temp_ub_q0p75_o48 -48.00 143.3 FORMAT "%5.1" /end CHARACTERISTIC
/begin CHARACTERISTIC TMK "" VALUE 0x80045761 KwWU8 191.3 temp_ub_q0p75_o48 -48.00 143.3 FORMAT "%5.1" /end CHARACTERISTIC
/begin CHARACTERISTIC TMMNEDTFA "" VALUE 0x80045F20 KwWU8 191.3 temp_ub_q0p75_o48 -48.00 143.3 FORMAT "%5.1" /end CHARACTERISTIC
/begin CHARACTERISTIC TMODT "" CURVE 0x80045762 KlAxU8SstxU8WU16 191.2500 temp_ub_b191p25 0.00 191.2500 FORMAT "%8.4"
 /begin AXIS_DESCR STD_AXIS tmotab temp_ub_q0p75_o48 3 -48.00 143.3 FORMAT "%5.1" DEPOSIT ABSOLUTE /end AXIS_DESCR
/end CHARACTERISTIC
/begin CHARACTERISTIC TMOTELI "" CURVE 0x80045E9C KlAxU8SstxU16WU8 191.3 temp_ub_q0p75_o48 -48.00 143.3 FORMAT "%5.1"
 /begin AXIS_DESCR STD_AXIS utcw_w spg_uw_q0p00488 20 0.00 4.995117 FORMAT "%8.6" DEPOSIT ABSOLUTE /end AXIS_DESCR
/end CHARACTERISTIC
/begin CHARACTERISTIC TMSTTFAENA "" VALUE 0x80045F21 KwWU8 191.3 temp_ub_q0p75_o48 -48.00 143.3 FORMAT "%5.1" /end CHARACTERISTIC
/begin CHARACTERISTIC TWSTT "" CURVE 0x8004576C KlAxU8SstxU8WU16 65535.00 t1sxs_uw_q1 0.00 65535.00 FORMAT "%8.2"
 /begin AXIS_DESCR STD_AXIS tmotab temp_ub_q0p75_o48 12 -48.00 143.3 FORMAT "%5.1" DEPOSIT ABSOLUTE /end AXIS_DESCR
/end CHARACTERISTIC
/begin CHARACTERISTIC UADPSRMN "" VALUE 0x80045DD8 KwWU16 4.999924 spg_q7p63em5 0.00 4.999924 FORMAT "%8.6" /end CHARACTERISTIC
/begin CHARACTERISTIC UADPSRMX "" VALUE 0x80045DDA KwWU16 4.999924 spg_q7p63em5 0.00 4.999924 FORMAT "%8.6" /end CHARACTERISTIC
/begin CHARACTERISTIC UBDMN1 "" VALUE 0x80045F30 KwUb 24.02 spg_ubatt 0.00 24.02 FORMAT "%5.2" /end CHARACTERISTIC
/begin CHARACTERISTIC UBDMN2 "" VALUE 0x80045F31 KwUb 24.02 spg_ubatt 0.00 24.02 FORMAT "%5.2" /end CHARACTERISTIC
/begin CHARACTERISTIC UBDMX "" VALUE 0x80045F32 KwUb 24.02 spg_ubatt 0.00 24.02 FORMAT "%5.2" /end CHARACTERISTIC
/begin CHARACTERISTIC UBEVAB "" VALUE 0x80045F33 KwUb 24.02 spg_ubatt 0.00 24.02 FORMAT "%5.2" /end CHARACTERISTIC
/begin CHARACTERISTIC UWDKDO "" VALUE 0x80045DA4 KwWU16 79.99878 spg_uw_q0p001222 0.00 79.99878 FORMAT "%8.5" /end CHARACTERISTIC
/begin CHARACTERISTIC UWDKDU "" VALUE 0x80045DA6 KwWU16 79.99878 spg_uw_q0p001222 0.00 79.99878 FORMAT "%8.5" /end CHARACTERISTIC
/begin CHARACTERISTIC UWDKOFF "" VALUE 0x80045DA8 KwWU16 79.99878 spg_uw_q0p001222 0.00 79.99878 FORMAT "%8.5" /end CHARACTERISTIC
/begin CHARACTERISTIC VFZGTFA "" VALUE 0x80045F22 KwWU8 318.8 vfzg_ub_q1p25 0.00 318.8 FORMAT "%5.1" /end CHARACTERISTIC
/begin CHARACTERISTIC VMDUB "" VALUE 0x80045F34 KwUb 318.8 vfzg_ub_q1p25 0.00 318.8 FORMAT "%5.1" /end CHARACTERISTIC
/begin CHARACTERISTIC WDKBASLN "" CURVE 0x80045DAA KlAxU8SstxU8WU16 100.0000 relDK_uw_b100 0.00 100.0000 FORMAT "%8.4"
 /begin AXIS_DESCR STD_AXIS nmot nmot_ub_q40 6 0.00 10200. FORMAT "%5.0" DEPOSIT ABSOLUTE /end AXIS_DESCR
/end CHARACTERISTIC
/begin CHARACTERISTIC WDKDU "" VALUE 0x80045DBE KwWU8 100.0 relDK_ub_b100 0.00 100.0 FORMAT "%5.1" /end CHARACTERISTIC
/begin CHARACTERISTIC WDKNLN "" CURVE 0x80045DBF KlAxU8SstxU8WU8 100.0 relDK_ub_b100 0.00 100.0 FORMAT "%5.1"
 /begin AXIS_DESCR STD_AXIS nmot nmot_ub_q40 6 0.00 10200. FORMAT "%5.0" DEPOSIT ABSOLUTE /end AXIS_DESCR
/end CHARACTERISTIC
/begin CHARACTERISTIC WEAN "" CURVE 0x80045B08 GklWUb 1530. zw_ub_q6 0.00 1530. FORMAT "%5.0"
 /begin AXIS_DESCR COM_AXIS nmot_w nmot_uw_q0p25 8 0.00 16383.75 FORMAT "%8.2" AXIS_PTS_REF SNM08GKUW /end AXIS_DESCR
/end CHARACTERISTIC
/begin CHARACTERISTIC WEEMRFAN "" CURVE 0x80045B10 GklWUb 1530. zw_ub_q6 0.00 1530. FORMAT "%5.0"
 /begin AXIS_DESCR COM_AXIS nmot_w nmot_uw_q0p25 8 0.00 16383.75 FORMAT "%8.2" AXIS_PTS_REF SNM08GKUW /end AXIS_DESCR
/end CHARACTERISTIC
/begin CHARACTERISTIC WEESTSM "" CURVE 0x80045B18 GklWUb 1530. zw_ub_q6 0.00 1530. FORMAT "%5.0"
 /begin AXIS_DESCR COM_AXIS tmot temp_ub_q0p75_o48 8 -48.00 143.3 FORMAT "%5.1" AXIS_PTS_REF STM08FSUB /end AXIS_DESCR
/end CHARACTERISTIC
/begin CHARACTERISTIC WESSOT "" VALUE 0x80045B20 KwUb 717.2 kw_q2p8125 0.00 717.2 FORMAT "%5.1" /end CHARACTERISTIC
/begin CHARACTERISTIC WFRLI "" CURVE 0x800459A6 KlAxU8SstxU16WU16 6143.906 rel_q0p09375 0.00 6143.906 FORMAT "%8.3"
 /begin AXIS_DESCR STD_AXIS rlp_w rel_uw_q0p0234 10 0.00 1535.977 FORMAT "%8.3" DEPOSIT ABSOLUTE /end AXIS_DESCR
/end CHARACTERISTIC
/begin CHARACTERISTIC WKLLX "" VALUE 0x80045DCC KwWU8 100.0 relDK_ub_b100 0.00 100.0 FORMAT "%5.1" /end CHARACTERISTIC
/begin CHARACTERISTIC WTFA1MN "" VALUE 0x80045F24 KwWU16 4.995117 spg_uw_q0p00488 0.00 4.995117 FORMAT "%8.6" /end CHARACTERISTIC
/begin CHARACTERISTIC WTFA1MX "" VALUE 0x80045F26 KwWU16 4.995117 spg_uw_q0p00488 0.00 4.995117 FORMAT "%8.6" /end CHARACTERISTIC
/begin CHARACTERISTIC ZBAKM "" CURVE 0x800459D0 GklWU8 0.9961 fak_q0p0039 0.00 0.9961
 /begin AXIS_DESCR COM_AXIS tmot temp_ub_q0p75_o48 9 -48.00 143.3 FORMAT "%5.1" AXIS_PTS_REF STM09ESUB /end AXIS_DESCR
/end CHARACTERISTIC
/begin CHARACTERISTIC ZBALM "" CURVE 0x800459D9 GklWU8 0.1245 fak_ub_b0p125 0.00 0.1245 FORMAT "%6.4"
 /begin AXIS_DESCR COM_AXIS tmot temp_ub_q0p75_o48 9 -48.00 143.3 FORMAT "%5.1" AXIS_PTS_REF STM09ESUB /end AXIS_DESCR
/end CHARACTERISTIC
/begin CHARACTERISTIC ZBURNLIM "" VALUE 0x80045792 KwWU8 255.0 dez 0.00 255.0 FORMAT "%5.1" /end CHARACTERISTIC
/begin CHARACTERISTIC ZKUBSQF01 "" VALUE 0x80045F36 KwUw 6553.4999985 zk100msxs_uw_b6553 0.10000152590 6553.6000000 FORMAT "%12.7" /end CHARACTERISTIC
/begin CHARACTERISTIC ZUKBAE "" VALUE 0x800459E2 KwWU16 655.3500 t_q0p01 0.00 655.3500 FORMAT "%8.4" /end CHARACTERISTIC
/begin CHARACTERISTIC ZUKNSTM "" CURVE 0x800459E4 GklWU16 6553.500 t_q0p1 0.00 6553.500 FORMAT "%8.3"
 /begin AXIS_DESCR COM_AXIS tmot temp_ub_q0p75_o48 9 -48.00 143.3 FORMAT "%5.1" AXIS_PTS_REF STM09ESUB /end AXIS_DESCR
/end CHARACTERISTIC
/begin CHARACTERISTIC ZUKVAE "" VALUE 0x800459F6 KwWU16 655.3500 t_q0p01 0.00 655.3500 FORMAT "%8.4" /end CHARACTERISTIC
/begin CHARACTERISTIC ZVAKM "" CURVE 0x800459F8 GklWU8 0.9961 fak_q0p0039 0.00 0.9961
 /begin AXIS_DESCR COM_AXIS tmot temp_ub_q0p75_o48 9 -48.00 143.3 FORMAT "%5.1" AXIS_PTS_REF STM09ESUB /end AXIS_DESCR
/end CHARACTERISTIC
/begin CHARACTERISTIC ZVALM "" CURVE 0x80045A01 GklWU8 0.1245 fak_ub_b0p125 0.00 0.1245 FORMAT "%6.4"
 /begin AXIS_DESCR COM_AXIS tmot temp_ub_q0p75_o48 9 -48.00 143.3 FORMAT "%5.1" AXIS_PTS_REF STM09ESUB /end AXIS_DESCR
/end CHARACTERISTIC
/begin CHARACTERISTIC ZWDK "" VALUE 0x80045DCE KwWU16 6553.4999985 zk100msxs_uw_b655 0.10000152590 6553.6000000 FORMAT "%12.7" /end CHARACTERISTIC
/begin MEASUREMENT abak "" UBYTE fak_ub_b1 1 100 0.00 0.9961 ECU_ADDRESS 0xD0000CF7 /end MEASUREMENT
/begin MEASUREMENT akrcderr_w "" UWORD dez 1 100 0.00 65535.00 FORMAT "%8.2" ECU_ADDRESS 0xD000078E /end MEASUREMENT
/begin MEASUREMENT anztibj "" UBYTE dez 1 100 0.00 255.0 FORMAT "%5.1" ECU_ADDRESS 0xD0000D01 /end MEASUREMENT
/begin MEASUREMENT anztist "" UBYTE dez 1 100 0.00 255.0 FORMAT "%5.1" ECU_ADDRESS 0xD0000CF3 /end MEASUREMENT
/begin MEASUREMENT anzwe "" UBYTE dez 1 100 0.00 255.0 FORMAT "%5.1" ECU_ADDRESS 0xD0000D0C /end MEASUREMENT
/begin MEASUREMENT anzwefim "" UBYTE dez 1 100 0.00 255.0 FORMAT "%5.1" ECU_ADDRESS 0xD0000D0D /end MEASUREMENT
/begin MEASUREMENT anzzyksa "" UBYTE dez 1 100 0.00 255.0 FORMAT "%5.1" ECU_ADDRESS 0xD0000D0E /end MEASUREMENT
/begin MEASUREMENT avak "" UBYTE fak_ub_b1 1 100 0.00 0.9961 ECU_ADDRESS 0xD0000CF8 /end MEASUREMENT
/begin MEASUREMENT avatnst "" UBYTE fak_ub_b2 1 100 0.00 1.992188 FORMAT "%8.6" ECU_ADDRESS 0xD0000CF9 /end MEASUREMENT
/begin MEASUREMENT azylwe "" UBYTE dez 1 100 0.00 255.0 FORMAT "%5.1" ECU_ADDRESS 0xD0000D0F /end MEASUREMENT
/begin MEASUREMENT B_afwe "" UBYTE B_TRUE 1 100 0.00 1.00000000000 BIT_MASK 0x40 FORMAT "%13.11" ECU_ADDRESS 0xD000003E /end MEASUREMENT
/begin MEASUREMENT B_ba "" UBYTE B_TRUE 1 100 0.00 1.00000000000 BIT_MASK 0x8 FORMAT "%13.11" ECU_ADDRESS 0xD000006E /end MEASUREMENT
/begin MEASUREMENT B_bag "" UBYTE B_TRUE 1 100 0.00 1.00000000000 BIT_MASK 0x10 FORMAT "%13.11" ECU_ADDRESS 0xD000008D /end MEASUREMENT
/begin MEASUREMENT B_edks "" UBYTE B_TRUE 1 100 0.00 1.00000000000 BIT_MASK 0x8 FORMAT "%13.11" ECU_ADDRESS 0xD000008E /end MEASUREMENT
/begin MEASUREMENT B_eepesstt "" UBYTE B_TRUE 1 100 0.00 1.00000000000 BIT_MASK 0x1 FORMAT "%13.11" ECU_ADDRESS 0xAFE80187 /end MEASUREMENT
/begin MEASUREMENT B_elhltfa1 "" UBYTE B_TRUE 1 100 0.00 1.00000000000 BIT_MASK 0x4 FORMAT "%13.11" ECU_ADDRESS 0xD0000D2B /end MEASUREMENT
/begin MEASUREMENT B_elmntfa1 "" UBYTE B_TRUE 1 100 0.00 1.00000000000 BIT_MASK 0x10 FORMAT "%13.11" ECU_ADDRESS 0xD0000D2B /end MEASUREMENT
/begin MEASUREMENT B_elmxtfa1 "" UBYTE B_TRUE 1 100 0.00 1.00000000000 BIT_MASK 0x1 FORMAT "%13.11" ECU_ADDRESS 0xD0000D2C /end MEASUREMENT
/begin MEASUREMENT B_elnptfa1 "" UBYTE B_TRUE 1 100 0.00 1.00000000000 BIT_MASK 0x40 FORMAT "%13.11" ECU_ADDRESS 0xD0000D2B /end MEASUREMENT
/begin MEASUREMENT B_enpstfa1 "" UBYTE B_TRUE 1 100 0.00 1.00000000000 BIT_MASK 0x1 FORMAT "%13.11" ECU_ADDRESS 0xAFE8018B /end MEASUREMENT
/begin MEASUREMENT B_env "" UBYTE B_TRUE 1 100 0.00 1.00000000000 BIT_MASK 0x10 FORMAT "%13.11" ECU_ADDRESS 0xD000007E /end MEASUREMENT
/begin MEASUREMENT B_esbnb "" UBYTE B_TRUE 1 100 0.00 1.00000000000 BIT_MASK 0x40 FORMAT "%13.11" ECU_ADDRESS 0xD0000061 /end MEASUREMENT
/begin MEASUREMENT B_esbst "" UBYTE B_TRUE 1 100 0.00 1.00000000000 BIT_MASK 0x4 FORMAT "%13.11" ECU_ADDRESS 0xD0000066 /end MEASUREMENT
/begin MEASUREMENT B_fgdkabgs "" UBYTE B_TRUE 1 100 0.00 1.00000000000 BIT_MASK 0x20 FORMAT "%13.11" ECU_ADDRESS 0xD000006E /end MEASUREMENT
/begin MEASUREMENT B_fwe "" UBYTE B_TRUE 1 100 0.00 1.00000000000 BIT_MASK 0x20 FORMAT "%13.11" ECU_ADDRESS 0xD000003E /end MEASUREMENT
/begin MEASUREMENT B_hrevab "" UBYTE B_TRUE 1 100 0.00 1.00000000000 BIT_MASK 0x1 FORMAT "%13.11" ECU_ADDRESS 0xD0000D35 /end MEASUREMENT
/begin MEASUREMENT B_hst "" UBYTE B_TRUE 1 100 0.00 1.00000000000 BIT_MASK 0x1 FORMAT "%13.11" ECU_ADDRESS 0xAFE80189 /end MEASUREMENT
/begin MEASUREMENT B_hstnl "" UBYTE B_TRUE 1 100 0.00 1.00000000000 BIT_MASK 0x40 FORMAT "%13.11" ECU_ADDRESS 0xD0000060 /end MEASUREMENT
/begin MEASUREMENT B_ll "" UBYTE B_TRUE 1 100 0.00 1.00000000000 BIT_MASK 0x8 FORMAT "%13.11" ECU_ADDRESS 0xD000007E /end MEASUREMENT
/begin MEASUREMENT B_mndk "" UBYTE B_TRUE 1 100 0.00 1.00000000000 BIT_MASK 0x10 FORMAT "%13.11" ECU_ADDRESS 0xD0000076 /end MEASUREMENT
/begin MEASUREMENT B_mrfamx "" UBYTE B_TRUE 1 100 0.00 1.00000000000 BIT_MASK 0x10 FORMAT "%13.11" ECU_ADDRESS 0xD000003E /end MEASUREMENT
/begin MEASUREMENT B_mxdk "" UBYTE B_TRUE 1 100 0.00 1.00000000000 BIT_MASK 0x80 FORMAT "%13.11" ECU_ADDRESS 0xD0000055 /end MEASUREMENT
/begin MEASUREMENT B_pemntfa1 "" UBYTE B_TRUE 1 100 0.00 1.00000000000 BIT_MASK 0x1 FORMAT "%13.11" ECU_ADDRESS 0xD0000D2A /end MEASUREMENT
/begin MEASUREMENT B_pemxtfa1 "" UBYTE B_TRUE 1 100 0.00 1.00000000000 BIT_MASK 0x2 FORMAT "%13.11" ECU_ADDRESS 0xD0000D2A /end MEASUREMENT
/begin MEASUREMENT B_psinical "" UBYTE B_TRUE 1 100 0.00 1.00000000000 BIT_MASK 0x8 FORMAT "%13.11" ECU_ADDRESS 0xD000003F /end MEASUREMENT
/begin MEASUREMENT B_psinirg "" UBYTE B_TRUE 1 100 0.00 1.00000000000 BIT_MASK 0x40 FORMAT "%13.11" ECU_ADDRESS 0xD0000053 /end MEASUREMENT
/begin MEASUREMENT B_psremn "" UBYTE B_TRUE 1 100 0.00 1.00000000000 BIT_MASK 0x4 FORMAT "%13.11" ECU_ADDRESS 0xD000003F /end MEASUREMENT
/begin MEASUREMENT B_psremni "" UBYTE B_TRUE 1 100 0.00 1.00000000000 BIT_MASK 0x2 FORMAT "%13.11" ECU_ADDRESS 0xD000003F /end MEASUREMENT
/begin MEASUREMENT B_psremx "" UBYTE B_TRUE 1 100 0.00 1.00000000000 BIT_MASK 0x1 FORMAT "%13.11" ECU_ADDRESS 0xD000003F /end MEASUREMENT
/begin MEASUREMENT B_psremxi "" UBYTE B_TRUE 1 100 0.00 1.00000000000 BIT_MASK 0x80 FORMAT "%13.11" ECU_ADDRESS 0xD000003E /end MEASUREMENT
/begin MEASUREMENT B_psrmw "" UBYTE B_TRUE 1 100 0.00 1.00000000000 BIT_MASK 0x8 FORMAT "%13.11" ECU_ADDRESS 0xD0000065 /end MEASUREMENT
/begin MEASUREMENT B_psrrg "" UBYTE B_TRUE 1 100 0.00 1.00000000000 BIT_MASK 0x20 FORMAT "%13.11" ECU_ADDRESS 0xD000008B /end MEASUREMENT
/begin MEASUREMENT B_redkl "" UBYTE B_TRUE 1 100 0.00 1.00000000000 BIT_MASK 0x80 FORMAT "%13.11" ECU_ADDRESS 0xD000003D /end MEASUREMENT
/begin MEASUREMENT B_sbbvk "" UBYTE B_TRUE 1 100 0.00 1.00000000000 BIT_MASK 0x40 FORMAT "%13.11" ECU_ADDRESS 0xD000008F /end MEASUREMENT
/begin MEASUREMENT B_tal "" UBYTE B_TRUE 1 100 0.00 1.00000000000 BIT_MASK 0x1 FORMAT "%13.11" ECU_ADDRESS 0xD0000D1C /end MEASUREMENT
/begin MEASUREMENT B_tfaedena "" UBYTE B_TRUE 1 100 0.00 1.00000000000 BIT_MASK 0x40 FORMAT "%13.11" ECU_ADDRESS 0xD0000D2A /end MEASUREMENT
/begin MEASUREMENT B_tmotra "" UBYTE B_TRUE 1 100 0.00 1.00000000000 BIT_MASK 0x80 FORMAT "%13.11" ECU_ADDRESS 0xD0000056 /end MEASUREMENT
/begin MEASUREMENT B_ttbmhv "" UBYTE B_TRUE 1 100 0.00 1.00000000000 BIT_MASK 0x40 FORMAT "%13.11" ECU_ADDRESS 0xD000005A /end MEASUREMENT
/begin MEASUREMENT B_ubg "" UBYTE B_TRUE 1 100 0.00 1.00000000000 BIT_MASK 0x20 FORMAT "%13.11" ECU_ADDRESS 0xD0000056 /end MEASUREMENT
/begin MEASUREMENT B_ubrk "" UBYTE B_TRUE 1 100 0.00 1.00000000000 BIT_MASK 0x4 FORMAT "%13.11" ECU_ADDRESS 0xD0000D35 /end MEASUREMENT
/begin MEASUREMENT B_ubrmax "" UBYTE B_TRUE 1 100 0.00 1.00000000000 BIT_MASK 0x2 FORMAT "%13.11" ECU_ADDRESS 0xD0000D35 /end MEASUREMENT
/begin MEASUREMENT B_uk1 "" UBYTE B_TRUE 1 100 0.00 1.00000000000 BIT_MASK 0x20 FORMAT "%13.11" ECU_ADDRESS 0xD000003D /end MEASUREMENT
/begin MEASUREMENT B_uke "" UBYTE B_TRUE 1 100 0.00 1.00000000000 BIT_MASK 0x8 FORMAT "%13.11" ECU_ADDRESS 0xD000003D /end MEASUREMENT
/begin MEASUREMENT B_ukg "" UBYTE B_TRUE 1 100 0.00 1.00000000000 BIT_MASK 0x2 FORMAT "%13.11" ECU_ADDRESS 0xD0000062 /end MEASUREMENT
/begin MEASUREMENT B_ukk "" UBYTE B_TRUE 1 100 0.00 1.00000000000 BIT_MASK 0x2 FORMAT "%13.11" ECU_ADDRESS 0xD000003E /end MEASUREMENT
/begin MEASUREMENT B_ukns "" UBYTE B_TRUE 1 100 0.00 1.00000000000 BIT_MASK 0x4 FORMAT "%13.11" ECU_ADDRESS 0xD000003D /end MEASUREMENT
/begin MEASUREMENT B_va "" UBYTE B_TRUE 1 100 0.00 1.00000000000 BIT_MASK 0x4 FORMAT "%13.11" ECU_ADDRESS 0xD000007B /end MEASUREMENT
/begin MEASUREMENT B_vaau "" UBYTE B_TRUE 1 100 0.00 1.00000000000 BIT_MASK 0x40 FORMAT "%13.11" ECU_ADDRESS 0xD000003D /end MEASUREMENT
/begin MEASUREMENT B_vag "" UBYTE B_TRUE 1 100 0.00 1.00000000000 BIT_MASK 0x40 FORMAT "%13.11" ECU_ADDRESS 0xD000006B /end MEASUREMENT
/begin MEASUREMENT B_vakl "" UBYTE B_TRUE 1 100 0.00 1.00000000000 BIT_MASK 0x8 FORMAT "%13.11" ECU_ADDRESS 0xD000003E /end MEASUREMENT
/begin MEASUREMENT B_vbmg "" UBYTE B_TRUE 1 100 0.00 1.00000000000 BIT_MASK 0x20 FORMAT "%13.11" ECU_ADDRESS 0xD0000063 /end MEASUREMENT
/begin MEASUREMENT B_wdkhfg "" UBYTE B_TRUE 1 100 0.00 1.00000000000 BIT_MASK 0x80 FORMAT "%13.11" ECU_ADDRESS 0xD0000059 /end MEASUREMENT
/begin MEASUREMENT B_wdkhfu "" UBYTE B_TRUE 1 100 0.00 1.00000000000 BIT_MASK 0x2 FORMAT "%13.11" ECU_ADDRESS 0xD0000081 /end MEASUREMENT
/begin MEASUREMENT B_wf "" UBYTE B_TRUE 1 100 0.00 1.00000000000 BIT_MASK 0x2 FORMAT "%13.11" ECU_ADDRESS 0xD000003D /end MEASUREMENT
/begin MEASUREMENT B_wks "" UBYTE B_TRUE 1 100 0.00 1.00000000000 BIT_MASK 0x2 FORMAT "%13.11" ECU_ADDRESS 0xD000006F /end MEASUREMENT
/begin MEASUREMENT B_wst "" UBYTE B_TRUE 1 100 0.00 1.00000000000 BIT_MASK 0x40 FORMAT "%13.11" ECU_ADDRESS 0xD0000062 /end MEASUREMENT
/begin MEASUREMENT B_wst0 "" UBYTE B_TRUE 1 100 0.00 1.00000000000 BIT_MASK 0x1 FORMAT "%13.11" ECU_ADDRESS 0xAFE80188 /end MEASUREMENT
/begin MEASUREMENT B_wst1 "" UBYTE B_TRUE 1 100 0.00 1.00000000000 BIT_MASK 0x1 FORMAT "%13.11" ECU_ADDRESS 0xD000003D /end MEASUREMENT
/begin MEASUREMENT B_wst2 "" UBYTE B_TRUE 1 100 0.00 1.00000000000 BIT_MASK 0x80 FORMAT "%13.11" ECU_ADDRESS 0xD000003C /end MEASUREMENT
/begin MEASUREMENT Com_ENG1S03Chksum "" UBYTE OneToOne 1 100 0.00 255.0 FORMAT "%5.1" ECU_ADDRESS 0xD0003C2F /end MEASUREMENT
/begin MEASUREMENT danzwefim "" UBYTE dez 1 100 0.00 255.0 FORMAT "%5.1" ECU_ADDRESS 0xD0000D10 /end MEASUREMENT
/begin MEASUREMENT dkrksanf "" UBYTE dez 1 100 0.00 255.0 FORMAT "%5.1" ECU_ADDRESS 0xD0000D21 /end MEASUREMENT
/begin MEASUREMENT drkuke_w "" UWORD rel_uw_q0p0234 1 100 0.00 1535.977 FORMAT "%8.3" ECU_ADDRESS 0xD000071A /end MEASUREMENT
/begin MEASUREMENT dwdkba_w "" SWORD relDK_q0p02441 1 100 -800.0000 799.9756 FORMAT "%8.4" ECU_ADDRESS 0xD0000776 /end MEASUREMENT
/begin MEASUREMENT dwfk_w "" SWORD rel_q0p09375 1 100 -3072.000 3071.906 FORMAT "%8.3" ECU_ADDRESS 0xD000071C /end MEASUREMENT
/begin MEASUREMENT dwfl_w "" SWORD rel_q0p09375 1 100 -3072.000 3071.906 FORMAT "%8.3" ECU_ADDRESS 0xD000071E /end MEASUREMENT
/begin MEASUREMENT dwf_w "" SWORD rel_q0p09375 1 100 -3072.000 3071.906 FORMAT "%8.3" ECU_ADDRESS 0xD000074A /end MEASUREMENT
/begin MEASUREMENT esst_snm08gkuw "" ULONG dez 1 100 0.00 4294967295.00 FORMAT "%13.2" ECU_ADDRESS 0xD0002200 /end MEASUREMENT
/begin MEASUREMENT esst_srl08gkub "" ULONG dez 1 100 0.00 4294967295.00 FORMAT "%13.2" ECU_ADDRESS 0xD0002204 /end MEASUREMENT
/begin MEASUREMENT esst_stm08fsub "" ULONG dez 1 100 0.00 4294967295.00 FORMAT "%13.2" ECU_ADDRESS 0xD0002208 /end MEASUREMENT
/begin MEASUREMENT Etc_ctCurRunTst "" UBYTE OneToOne 1 100 0.00 255.0 FORMAT "%5.1" ECU_ADDRESS 0xD0003C61 /end MEASUREMENT
/begin MEASUREMENT FanCtl_flgXPostDrv_mp "" UBYTE OneToOne 1 100 0.00 1.000 BIT_MASK 0x1 FORMAT "%5.3" ECU_ADDRESS 0xD00053EA /end MEASUREMENT
/begin MEASUREMENT FanCtl_st "" UBYTE OneToOne 1 100 0.00 255.0 FORMAT "%5.1" ECU_ADDRESS 0xD0003C63 /end MEASUREMENT
/begin MEASUREMENT FanCtl_tiAftRunRmn "" SWORD TimeEngOn 1 100 -32768.00 32767.00 FORMAT "%8.2" ECU_ADDRESS 0xAFE806FC /end MEASUREMENT
/begin MEASUREMENT Fans_trqCons "" SWORD Trq 1 100 -3276.800 3276.700 FORMAT "%8.3" ECU_ADDRESS 0xD0003534 /end MEASUREMENT
/begin MEASUREMENT Fans_trqResv "" SWORD Trq 1 100 -3276.800 3276.700 FORMAT "%8.3" ECU_ADDRESS 0xD0003536 /end MEASUREMENT
/begin MEASUREMENT Fan_r "" SWORD Prc 1 100 -400.0000 399.9878 FORMAT "%8.4" ECU_ADDRESS 0xD000352E /end MEASUREMENT
/begin MEASUREMENT Fan_stPs "" UBYTE OneToOne 1 100 0.00 255.0 FORMAT "%5.1" ARRAY_SIZE 1 ECU_ADDRESS 0xD0003C67 /end MEASUREMENT
/begin MEASUREMENT fbakl_w "" SWORD fak_sw_b256 1 100 -256.0000 255.9922 FORMAT "%8.4" ECU_ADDRESS 0xD000074C /end MEASUREMENT
/begin MEASUREMENT fbansi_w "" UWORD fak_q0p000305 1 100 0.00 19.99969 FORMAT "%8.5" ECU_ADDRESS 0xD0000728 /end MEASUREMENT
/begin MEASUREMENT fbavst_w "" SWORD fak_sw_b256 1 100 -256.0000 255.9922 FORMAT "%8.4" ECU_ADDRESS 0xD000072A /end MEASUREMENT
/begin MEASUREMENT fksthaus_w "" UWORD fak_uw_b64 1 100 0.00 63.99902 FORMAT "%8.5" ECU_ADDRESS 0xD0000708 /end MEASUREMENT
/begin MEASUREMENT fksttaus_w "" UWORD fak_uw_b64 1 100 0.00 63.99902 FORMAT "%8.5" ECU_ADDRESS 0xD000070A /end MEASUREMENT
/begin MEASUREMENT fmfkrnew_w "" SWORD dez 1 100 0.00 32767.00 FORMAT "%8.2" ECU_ADDRESS 0xD0000790 /end MEASUREMENT
/begin MEASUREMENT fnstba_w "" UWORD fak_q0p000305 1 100 0.00 19.99969 FORMAT "%8.5" ECU_ADDRESS 0xD000072C /end MEASUREMENT
/begin MEASUREMENT fnstva_w "" UWORD fak_q0p000305 1 100 0.00 19.99969 FORMAT "%8.5" ECU_ADDRESS 0xD000072E /end MEASUREMENT
/begin MEASUREMENT fpvhk_w "" UWORD fak_q16_hPahPa 1 100 0.00 1048560. FORMAT "%8.0" ECU_ADDRESS 0xD0000756 /end MEASUREMENT
/begin MEASUREMENT fst0_w "" UWORD fak_uw_b64 1 100 0.00 63.99902 FORMAT "%8.5" ECU_ADDRESS 0xD000070C /end MEASUREMENT
/begin MEASUREMENT fsta_w "" UWORD fak_uw_b64 1 100 0.00 63.99902 FORMAT "%8.5" ARRAY_SIZE 3 ECU_ADDRESS 0xD0000712 /end MEASUREMENT
/begin MEASUREMENT fstgrund_w "" UWORD fak_uw_b64 1 100 0.00 63.99902 FORMAT "%8.5" ECU_ADDRESS 0xD000070E /end MEASUREMENT
/begin MEASUREMENT fsttval "" UBYTE vol_q0p5_l 1 100 0.00 127.5 FORMAT "%5.1" ECU_ADDRESS 0xAFE8018A /end MEASUREMENT
/begin MEASUREMENT fst_w "" UWORD fak_uw_b64 1 100 0.00 63.99902 FORMAT "%8.5" ECU_ADDRESS 0xD0000718 /end MEASUREMENT
/begin MEASUREMENT ftineo_w "" UWORD fak_uw_b2 1 100 0.00 1.999969 FORMAT "%8.6" ECU_ADDRESS 0xD0000730 /end MEASUREMENT
/begin MEASUREMENT fvakl_w "" SWORD fak_sw_b256 1 100 -256.0000 255.9922 FORMAT "%8.4" ECU_ADDRESS 0xD000074E /end MEASUREMENT
/begin MEASUREMENT fvavst_w "" SWORD fak_sw_b256 1 100 -256.0000 255.9922 FORMAT "%8.4" ECU_ADDRESS 0xD0000732 /end MEASUREMENT
/begin MEASUREMENT fvst_w "" UWORD fak_uw_b64 1 100 0.00 63.99902 FORMAT "%8.5" ECU_ADDRESS 0xD00007BE /end MEASUREMENT
/begin MEASUREMENT fwe "" UBYTE fak_ub_b2 1 100 0.00 1.992188 FORMAT "%8.6" ECU_ADDRESS 0xD0000D14 /end MEASUREMENT
/begin MEASUREMENT fwetm "" UBYTE fak_ub_b2 1 100 0.00 1.992188 FORMAT "%8.6" ECU_ADDRESS 0xD0000D12 /end MEASUREMENT
/begin MEASUREMENT fwkswst_w "" UBYTE fak_ub_b2 1 100 0.00 1.992188 FORMAT "%8.6" ECU_ADDRESS 0xD0000CF4 /end MEASUREMENT
/begin MEASUREMENT GlbDa_aX "" SWORD Acc 1 100 -32.76800 32.76700 FORMAT "%8.5" ECU_ADDRESS 0xD000353E /end MEASUREMENT
/begin MEASUREMENT GlbDa_aXFlt "" SWORD Acc 1 100 -32.76800 32.76700 FORMAT "%8.5" ECU_ADDRESS 0xD0003540 /end MEASUREMENT
/begin MEASUREMENT GlbDa_lTotDst "" SLONG Length 1 100 -2147483648.00 2147483647.00 FORMAT "%13.2" ECU_ADDRESS 0xD0002304 /end MEASUREMENT
/begin MEASUREMENT GlbDa_lTotDstLstStored_mp "" SLONG Length 1 100 -2147483648.00 2147483647.00 FORMAT "%13.2" ECU_ADDRESS 0xD0005254 /end MEASUREMENT
/begin MEASUREMENT GlbDa_lWhlCirc "" SWORD Length_fine 1 100 -32.76800 32.76700 FORMAT "%8.5" ECU_ADDRESS 0xD0003542 /end MEASUREMENT
/begin MEASUREMENT GlbDa_pEnv "" SWORD Pres_hPa 1 100 -32768.00 32767.00 FORMAT "%8.2" ECU_ADDRESS 0xD0003544 /end MEASUREMENT
/begin MEASUREMENT GlbDa_rTrqTot "" SWORD TransR 1 100 -327.6800 327.6700 FORMAT "%8.4" ECU_ADDRESS 0xD0003546 /end MEASUREMENT
/begin MEASUREMENT GlbDa_rTrqTotWoConvRat "" SWORD TransR 1 100 -327.6800 327.6700 FORMAT "%8.4" ECU_ADDRESS 0xD0003548 /end MEASUREMENT
/begin MEASUREMENT GlbDa_stTrqDem "" UWORD OneToOne 1 100 0.00 65535.00 FORMAT "%8.2" ECU_ADDRESS 0xD00035E6 /end MEASUREMENT
/begin MEASUREMENT GlbDa_stVehLimMin "" UBYTE OneToOne 1 100 0.00 255.0 FORMAT "%5.1" ECU_ADDRESS 0xD0003C6C /end MEASUREMENT
/begin MEASUREMENT GlbDa_tEnv "" SWORD Temp_Cels 1 100 -3549.940 3003.560 FORMAT "%8.3" ECU_ADDRESS 0xD000354A /end MEASUREMENT
/begin MEASUREMENT GlbDa_tIndAir "" SWORD Temp_Cels 1 100 -3549.940 3003.560 FORMAT "%8.3" ECU_ADDRESS 0xD000354C /end MEASUREMENT
/begin MEASUREMENT GlbDa_trqCrSVehLimMin "" SWORD Trq 1 100 -3276.800 3276.700 FORMAT "%8.3" ECU_ADDRESS 0xD000354E /end MEASUREMENT
/begin MEASUREMENT GlbDa_trqVehLimMin "" SWORD Trq 1 100 -3276.800 3276.700 FORMAT "%8.3" ECU_ADDRESS 0xD0003550 /end MEASUREMENT
/begin MEASUREMENT GlbDa_vX "" SWORD Vel 1 100 -327.6800 327.6700 FORMAT "%8.4" ECU_ADDRESS 0xD0003552 /end MEASUREMENT
/begin MEASUREMENT GlbDa_vXFlt "" SWORD Vel 1 100 -327.6800 327.6700 FORMAT "%8.4" ECU_ADDRESS 0xD0003554 /end MEASUREMENT
/begin MEASUREMENT HEGOD_bEnaStkLowUs "" UBYTE B_TRUE 1 100 0.00 1.00000000000 BIT_MASK 0x4 FORMAT "%13.11" ECU_ADDRESS 0xD000007D /end MEASUREMENT
/begin MEASUREMENT HEGOD_S1B1Simn_I.bFolwLR "" UBYTE B_TRUE 1 100 0.00 1.00000000000 BIT_MASK 0x1 FORMAT "%13.11" ECU_ADDRESS 0xD000142C /end MEASUREMENT
/begin MEASUREMENT HEGOD_S1B1Simn_I.bFolwRL "" UBYTE B_TRUE 1 100 0.00 1.00000000000 BIT_MASK 0x2 FORMAT "%13.11" ECU_ADDRESS 0xD000142C /end MEASUREMENT
/begin MEASUREMENT HEGOD_S1B1Simn_I.bHldLR "" UBYTE B_TRUE 1 100 0.00 1.00000000000 BIT_MASK 0x4 FORMAT "%13.11" ECU_ADDRESS 0xD000142C /end MEASUREMENT
/begin MEASUREMENT HEGOD_S1B1Simn_I.bHldRL "" UBYTE B_TRUE 1 100 0.00 1.00000000000 BIT_MASK 0x8 FORMAT "%13.11" ECU_ADDRESS 0xD000142C /end MEASUREMENT
/begin MEASUREMENT HEGOD_S1B1Simn_I.bVltgFall "" UBYTE B_TRUE 1 100 0.00 1.00000000000 BIT_MASK 0x20 FORMAT "%13.11" ECU_ADDRESS 0xD000142C /end MEASUREMENT
/begin MEASUREMENT HEGOD_S1B1Simn_I.bVltgRise "" UBYTE B_TRUE 1 100 0.00 1.00000000000 BIT_MASK 0x10 FORMAT "%13.11" ECU_ADDRESS 0xD000142C /end MEASUREMENT
/begin MEASUREMENT HEGOD_S1B1Simn_I.tiHld "" UWORD t_q0p01 1 100 0.00 655.3500 FORMAT "%8.4" ECU_ADDRESS 0xD000142E /end MEASUREMENT
/begin MEASUREMENT HEGOD_S1B1Simn_I.uWiSimn "" UWORD spg_q0p00488 1 100 0.00 4.995117 FORMAT "%8.6" ECU_ADDRESS 0xD0001430 /end MEASUREMENT
/begin MEASUREMENT HEGOD_S1B1Simn_I.uWoSimnFlt "" UWORD spg_q0p00488 1 100 0.00 4.995117 FORMAT "%8.6" ECU_ADDRESS 0xD0001432 /end MEASUREMENT
/begin MEASUREMENT HEGOD_S1B1Simn_I.FolwSimnLT_I.memory "" ULONG spg_q7p451Em8 1 100 0.00 4.99511718750 FORMAT "%13.11" ECU_ADDRESS 0xD0001434 /end MEASUREMENT
/begin MEASUREMENT HEGOD_S1B1Simn_I.VltFltLT_I.memory "" ULONG spg_q7p451Em8 1 100 0.00 4.99511718750 FORMAT "%13.11" ECU_ADDRESS 0xD0001468 /end MEASUREMENT
/begin MEASUREMENT HEGOD_StkUsS1B1_I.bErrStkHiUs "" UBYTE B_TRUE 1 100 0.00 1.00000000000 BIT_MASK 0x1 FORMAT "%13.11" ECU_ADDRESS 0xAFE801CE /end MEASUREMENT
/begin MEASUREMENT HEGOD_StkUsS1B1_I.bErrStkLowUs "" UBYTE B_TRUE 1 100 0.00 1.00000000000 BIT_MASK 0x2 FORMAT "%13.11" ECU_ADDRESS 0xAFE801CE /end MEASUREMENT
/begin MEASUREMENT HEGOD_StkUsS1B1_I.bMsEGStkUs "" UBYTE B_TRUE 1 100 0.00 1.00000000000 BIT_MASK 0x1 FORMAT "%13.11" ECU_ADDRESS 0xD0001478 /end MEASUREMENT
/begin MEASUREMENT HEGOD_StkUsS1B1_I.mEGStkUs "" UWORD m_q0p0peri4 1 100 0.00 2912.667 FORMAT "%8.3" ECU_ADDRESS 0xD000147A /end MEASUREMENT
/begin MEASUREMENT HEGOD_StkUsS1B1_I.DebErrStkHiUsTONV_I.outbit "" UBYTE B_TRUE 1 100 0.00 1.00000000000 BIT_MASK 0x1 FORMAT "%13.11" ECU_ADDRESS 0xD000147C /end MEASUREMENT
/begin MEASUREMENT HEGOD_StkUsS1B1_I.DebErrStkHiUsTONV_I.time "" UBYTE t_q0p1 1 100 0.00 25.50 FORMAT "%5.2" ECU_ADDRESS 0xD000147D /end MEASUREMENT
/begin MEASUREMENT HEGOD_StkUsS1B1_I.DebErrStkLowUsTONV_I.outbit "" UBYTE B_TRUE 1 100 0.00 1.00000000000 BIT_MASK 0x1 FORMAT "%13.11" ECU_ADDRESS 0xD000147E /end MEASUREMENT
/begin MEASUREMENT HEGOD_StkUsS1B1_I.DebErrStkLowUsTONV_I.time "" UBYTE t_q0p1 1 100 0.00 25.50 FORMAT "%5.2" ECU_ADDRESS 0xD000147F /end MEASUREMENT
/begin MEASUREMENT HEGOD_StkUsS1B1_I.ErrStkHiFF_I.status "" UBYTE B_TRUE 1 100 0.00 1.00000000000 BIT_MASK 0x1 FORMAT "%13.11" ECU_ADDRESS 0xD0001482 /end MEASUREMENT
/begin MEASUREMENT HEGOD_StkUsS1B1_I.ErrStkHiSusFF_I.status "" UBYTE B_TRUE 1 100 0.00 1.00000000000 BIT_MASK 0x1 FORMAT "%13.11" ECU_ADDRESS 0xD0001483 /end MEASUREMENT
/begin MEASUREMENT HEGOD_StkUsS1B1_I.ErrStkLowFF_I.status "" UBYTE B_TRUE 1 100 0.00 1.00000000000 BIT_MASK 0x1 FORMAT "%13.11" ECU_ADDRESS 0xD0001484 /end MEASUREMENT
/begin MEASUREMENT HEGOD_StkUsS1B1_I.MsEGStkUsIK_I.memory "" ULONG m_q6p78168Em7_g 1 100 0.00 2912.71111043 FORMAT "%13.8" ECU_ADDRESS 0xD0001488 /end MEASUREMENT
/begin MEASUREMENT HEGOD_StkUsS1B1_I.SignLamCtlEBFF_I.status "" UBYTE B_TRUE 1 100 0.00 1.00000000000 BIT_MASK 0x1 FORMAT "%13.11" ECU_ADDRESS 0xD000148C /end MEASUREMENT
/begin MEASUREMENT HEGOD_StkUsS1B1_I.SignLamCtlEB_I.buffer "" UBYTE B_TRUE 1 100 0.00 1.00000000000 BIT_MASK 0x1 FORMAT "%13.11" ECU_ADDRESS 0xD000148E /end MEASUREMENT
/begin MEASUREMENT HEGOD_StkUsS1B1_I.SignLamCtlEB_I.oldSignal "" UBYTE B_TRUE 1 100 0.00 1.00000000000 BIT_MASK 0x1 FORMAT "%13.11" ECU_ADDRESS 0xD000148F /end MEASUREMENT
/begin MEASUREMENT HEGO_bEnaDElecPhy "" UBYTE B_TRUE 1 100 0.00 1.00000000000 BIT_MASK 0x2 FORMAT "%13.11" ECU_ADDRESS 0xD0000067 /end MEASUREMENT
/begin MEASUREMENT HEGO_bEnaDPs "" UBYTE B_TRUE 1 100 0.00 1.00000000000 BIT_MASK 0x40 FORMAT "%13.11" ECU_ADDRESS 0xD0000089 /end MEASUREMENT
/begin MEASUREMENT HEGO_bS1B1EnaDElec "" UBYTE B_TRUE 1 100 0.00 1.00000000000 BIT_MASK 0x80 FORMAT "%13.11" ECU_ADDRESS 0xD000007C /end MEASUREMENT
/begin MEASUREMENT HEGO_bS1B1EnaDHtg "" UBYTE B_TRUE 1 100 0.00 1.00000000000 BIT_MASK 0x40 FORMAT "%13.11" ECU_ADDRESS 0xD000006F /end MEASUREMENT
/begin MEASUREMENT HEGO_bS1B1ErrElecHtrCpl "" UBYTE B_TRUE 1 100 0.00 1.00000000000 BIT_MASK 0x8 FORMAT "%13.11" ECU_ADDRESS 0xD0000079 /end MEASUREMENT
/begin MEASUREMENT HEGO_bS1B1ErrElecMinWoDeb "" UBYTE B_TRUE 1 100 0.00 1.00000000000 BIT_MASK 0x8 FORMAT "%13.11" ECU_ADDRESS 0xD0000071 /end MEASUREMENT
/begin MEASUREMENT HEGO_bS1B1ErrElecSig "" UBYTE B_TRUE 1 100 0.00 1.00000000000 BIT_MASK 0x40 FORMAT "%13.11" ECU_ADDRESS 0xD0000090 /end MEASUREMENT
/begin MEASUREMENT HEGO_bS1B1ErrElecSigPrev "" UBYTE B_TRUE 1 100 0.00 1.00000000000 BIT_MASK 0x4 FORMAT "%13.11" ECU_ADDRESS 0xD0000062 /end MEASUREMENT
/begin MEASUREMENT HEGO_bS1B1ErrElecSigRi "" UBYTE B_TRUE 1 100 0.00 1.00000000000 BIT_MASK 0x40 FORMAT "%13.11" ECU_ADDRESS 0xD0000083 /end MEASUREMENT
/begin MEASUREMENT HEGO_bS1B1ExptOpRdn "" UBYTE B_TRUE 1 100 0.00 1.00000000000 BIT_MASK 0x4 FORMAT "%13.11" ECU_ADDRESS 0xD0000053 /end MEASUREMENT
/begin MEASUREMENT HEGO_bS1B1HtgCtlTSP "" UBYTE B_TRUE 1 100 0.00 1.00000000000 BIT_MASK 0x1 FORMAT "%13.11" ECU_ADDRESS 0xD000008A /end MEASUREMENT
/begin MEASUREMENT HEGO_bS1B1HtgOn "" UBYTE B_TRUE 1 100 0.00 1.00000000000 BIT_MASK 0x10 FORMAT "%13.11" ECU_ADDRESS 0xD000009D /end MEASUREMENT
/begin MEASUREMENT HEGO_bS1B1HtgPrtFin "" UBYTE B_TRUE 1 100 0.00 1.00000000000 BIT_MASK 0x10 FORMAT "%13.11" ECU_ADDRESS 0xD0000056 /end MEASUREMENT
/begin MEASUREMENT HEGO_bS1B1HtgRiReq "" UBYTE B_TRUE 1 100 0.00 1.00000000000 BIT_MASK 0x40 FORMAT "%13.11" ECU_ADDRESS 0xD0000086 /end MEASUREMENT
/begin MEASUREMENT HEGO_bS1B1HtgSuff "" UBYTE B_TRUE 1 100 0.00 1.00000000000 BIT_MASK 0x1 FORMAT "%13.11" ECU_ADDRESS 0xD000006D /end MEASUREMENT
/begin MEASUREMENT HEGO_bS1B1LdPlsMinReq "" UBYTE B_TRUE 1 100 0.00 1.00000000000 BIT_MASK 0x1 FORMAT "%13.11" ECU_ADDRESS 0xD0000076 /end MEASUREMENT
/begin MEASUREMENT HEGO_bS1B1LdPlsSigCnfReq "" UBYTE B_TRUE 1 100 0.00 1.00000000000 BIT_MASK 0x20 FORMAT "%13.11" ECU_ADDRESS 0xD0000054 /end MEASUREMENT
/begin MEASUREMENT HEGO_bS1B1LdPlsSigReq "" UBYTE B_TRUE 1 100 0.00 1.00000000000 BIT_MASK 0x8 FORMAT "%13.11" ECU_ADDRESS 0xD000006A /end MEASUREMENT
/begin MEASUREMENT HEGO_bS1B1OpRdnRiReq "" UBYTE B_TRUE 1 100 0.00 1.00000000000 BIT_MASK 0x20 FORMAT "%13.11" ECU_ADDRESS 0xD0000064 /end MEASUREMENT
/begin MEASUREMENT HEGO_bS1B1Vld "" UBYTE B_TRUE 1 100 0.00 1.00000000000 BIT_MASK 0x8 FORMAT "%13.11" ECU_ADDRESS 0xD0000073 /end MEASUREMENT
/begin MEASUREMENT HEGO_bS1HtgEna "" UBYTE B_TRUE 1 100 0.00 1.00000000000 BIT_MASK 0x1 FORMAT "%13.11" ECU_ADDRESS 0xD0000089 /end MEASUREMENT
/begin MEASUREMENT HEGO_bS1HtgEnaEngHot "" UBYTE B_TRUE 1 100 0.00 1.00000000000 BIT_MASK 0x10 FORMAT "%13.11" ECU_ADDRESS 0xD000003F /end MEASUREMENT
/begin MEASUREMENT HEGO_bS1HtgEnaER_I.buffer "" UBYTE B_TRUE 1 100 0.00 1.00000000000 BIT_MASK 0x1 FORMAT "%13.11" ECU_ADDRESS 0xD00012FE /end MEASUREMENT
/begin MEASUREMENT HEGO_bS1HtgEnaER_I.oldSignal "" UBYTE B_TRUE 1 100 0.00 1.00000000000 BIT_MASK 0x1 FORMAT "%13.11" ECU_ADDRESS 0xD00012FF /end MEASUREMENT
/begin MEASUREMENT HEGO_bS1HtgRst "" UBYTE B_TRUE 1 100 0.00 1.00000000000 BIT_MASK 0x4 FORMAT "%13.11" ECU_ADDRESS 0xD000008D /end MEASUREMENT
/begin MEASUREMENT HEGO_dresS1B1RiThresMin "" SLONG r_uw_q2 1 100 -131070.000000 131070.000000 FORMAT "%13.6" ECU_ADDRESS 0xAFE80014 /end MEASUREMENT
/begin MEASUREMENT HEGO_HtgCyclS1_I.bStrtHtgCycl "" UBYTE B_TRUE 1 100 0.00 1.00000000000 BIT_MASK 0x1 FORMAT "%13.11" ECU_ADDRESS 0xD00012F0 /end MEASUREMENT
/begin MEASUREMENT HEGO_HtgCyclS1_I.HtgCyclT_I.timeCounter "" UBYTE t_q0p001 1 100 0.00 0.2550 FORMAT "%6.4" ECU_ADDRESS 0xD00012F1 /end MEASUREMENT
/begin MEASUREMENT HEGO_HtgEnaS1_I.bEngStrtFinFF "" UBYTE B_TRUE 1 100 0.00 1.00000000000 BIT_MASK 0x1 FORMAT "%13.11" ECU_ADDRESS 0xD00012F2 /end MEASUREMENT
/begin MEASUREMENT HEGO_HtgEnaS1_I.bHtgEna "" UBYTE B_TRUE 1 100 0.00 1.00000000000 BIT_MASK 0x1 FORMAT "%13.11" ECU_ADDRESS 0xD00012F3 /end MEASUREMENT
/begin MEASUREMENT HEGO_HtgEnaS1_I.bHtgEnaEngHot "" UBYTE B_TRUE 1 100 0.00 1.00000000000 BIT_MASK 0x1 FORMAT "%13.11" ECU_ADDRESS 0xD00012F4 /end MEASUREMENT
/begin MEASUREMENT HEGO_HtgEnaS1_I.bHtgRst "" UBYTE B_TRUE 1 100 0.00 1.00000000000 BIT_MASK 0x1 FORMAT "%13.11" ECU_ADDRESS 0xD00012F5 /end MEASUREMENT
/begin MEASUREMENT HEGO_HtgEnaS1_I.BattHtgOffTONV_I.outbit "" UBYTE B_TRUE 1 100 0.00 1.00000000000 BIT_MASK 0x1 FORMAT "%13.11" ECU_ADDRESS 0xD00012F6 /end MEASUREMENT
/begin MEASUREMENT HEGO_HtgEnaS1_I.BattHtgOffTONV_I.time "" UBYTE t_q0p01 1 100 0.00 2.550 FORMAT "%5.3" ECU_ADDRESS 0xD00012F7 /end MEASUREMENT
/begin MEASUREMENT HEGO_HtgEnaS1_I.HtgRstEF_I.buffer "" UBYTE B_TRUE 1 100 0.00 1.00000000000 BIT_MASK 0x1 FORMAT "%13.11" ECU_ADDRESS 0xD00012F8 /end MEASUREMENT
/begin MEASUREMENT HEGO_HtgEnaS1_I.HtgRstEF_I.oldSignal "" UBYTE B_TRUE 1 100 0.00 1.00000000000 BIT_MASK 0x1 FORMAT "%13.11" ECU_ADDRESS 0xD00012F9 /end MEASUREMENT
/begin MEASUREMENT HEGO_HtgEnaS1_I.HtgRstTE_I.timeCounter "" UBYTE t_q0p1 1 100 0.00 25.50 FORMAT "%5.2" ECU_ADDRESS 0xD00012FA /end MEASUREMENT
/begin MEASUREMENT HEGO_HtgEnaS1_I.HtgRstTOFV_I.outbit "" UBYTE B_TRUE 1 100 0.00 1.00000000000 BIT_MASK 0x1 FORMAT "%13.11" ECU_ADDRESS 0xD00012FC /end MEASUREMENT
/begin MEASUREMENT HEGO_HtgEnaS1_I.HtgRstTOFV_I.time "" UBYTE t_q0p1 1 100 0.00 25.50 FORMAT "%5.2" ECU_ADDRESS 0xD00012FD /end MEASUREMENT
/begin MEASUREMENT HEGO_HtgS1B1_I.B_atmtxOld "" UBYTE B_TRUE 1 100 0.00 1.00000000000 BIT_MASK 0x1 FORMAT "%13.11" ECU_ADDRESS 0xD0001301 /end MEASUREMENT
/begin MEASUREMENT HEGO_HtgS1B1_I.bHtgClsdLopAntiWndUp "" UBYTE B_TRUE 1 100 0.00 1.00000000000 BIT_MASK 0x1 FORMAT "%13.11" ECU_ADDRESS 0xD0001300 /end MEASUREMENT
/begin MEASUREMENT HEGO_HtgS1B1_I.bHtgClsdLopEna "" UBYTE B_TRUE 1 100 0.00 1.00000000000 BIT_MASK 0x2 FORMAT "%13.11" ECU_ADDRESS 0xD0001300 /end MEASUREMENT
/begin MEASUREMENT HEGO_HtgS1B1_I.bHtgClsdLopRiReq "" UBYTE B_TRUE 1 100 0.00 1.00000000000 BIT_MASK 0x2 FORMAT "%13.11" ECU_ADDRESS 0xD0001301 /end MEASUREMENT
/begin MEASUREMENT HEGO_HtgS1B1_I.bHtgMap "" UBYTE B_TRUE 1 100 0.00 1.00000000000 BIT_MASK 0x4 FORMAT "%13.11" ECU_ADDRESS 0xD0001300 /end MEASUREMENT
/begin MEASUREMENT HEGO_HtgS1B1_I.bHtgOffHiTemp "" UBYTE B_TRUE 1 100 0.00 1.00000000000 BIT_MASK 0x8 FORMAT "%13.11" ECU_ADDRESS 0xD0001300 /end MEASUREMENT
/begin MEASUREMENT HEGO_HtgS1B1_I.bHtgOnReq "" UBYTE B_TRUE 1 100 0.00 1.00000000000 BIT_MASK 0x8 FORMAT "%13.11" ECU_ADDRESS 0xD0001302 /end MEASUREMENT
/begin MEASUREMENT HEGO_HtgS1B1_I.bHtgOnReqCurrLim "" UBYTE B_TRUE 1 100 0.00 1.00000000000 BIT_MASK 0x10 FORMAT "%13.11" ECU_ADDRESS 0xD0001302 /end MEASUREMENT
/begin MEASUREMENT HEGO_HtgS1B1_I.bHtgOnReqNoCurrLim "" UBYTE B_TRUE 1 100 0.00 1.00000000000 BIT_MASK 0x20 FORMAT "%13.11" ECU_ADDRESS 0xD0001302 /end MEASUREMENT
/begin MEASUREMENT HEGO_HtgS1B1_I.bHtgOnRls "" UBYTE B_TRUE 1 100 0.00 1.00000000000 BIT_MASK 0x1 FORMAT "%13.11" ECU_ADDRESS 0xD0001302 /end MEASUREMENT
/begin MEASUREMENT HEGO_HtgS1B1_I.bHtgOnTstr "" UBYTE B_TRUE 1 100 0.00 1.00000000000 BIT_MASK 0x2 FORMAT "%13.11" ECU_ADDRESS 0xD0001302 /end MEASUREMENT
/begin MEASUREMENT HEGO_HtgS1B1_I.bHtgPrtFin "" UBYTE B_TRUE 1 100 0.00 1.00000000000 BIT_MASK 0x4 FORMAT "%13.11" ECU_ADDRESS 0xD0001301 /end MEASUREMENT
/begin MEASUREMENT HEGO_HtgS1B1_I.bHtgStrt "" UBYTE B_TRUE 1 100 0.00 1.00000000000 BIT_MASK 0x20 FORMAT "%13.11" ECU_ADDRESS 0xD0001300 /end MEASUREMENT
/begin MEASUREMENT HEGO_HtgS1B1_I.bHtgStrtPwrRed "" UBYTE B_TRUE 1 100 0.00 1.00000000000 BIT_MASK 0x40 FORMAT "%13.11" ECU_ADDRESS 0xD0001300 /end MEASUREMENT
/begin MEASUREMENT HEGO_HtgS1B1_I.bHtgSuff "" UBYTE B_TRUE 1 100 0.00 1.00000000000 BIT_MASK 0x80 FORMAT "%13.11" ECU_ADDRESS 0xD0001300 /end MEASUREMENT
/begin MEASUREMENT HEGO_HtgS1B1_I.bHtgTSP "" UBYTE B_TRUE 1 100 0.00 1.00000000000 BIT_MASK 0x8 FORMAT "%13.11" ECU_ADDRESS 0xD0001301 /end MEASUREMENT
/begin MEASUREMENT HEGO_HtgS1B1_I.bHtrPsCurrLim "" UBYTE B_TRUE 1 100 0.00 1.00000000000 BIT_MASK 0x10 FORMAT "%13.11" ECU_ADDRESS 0xD0001301 /end MEASUREMENT
/begin MEASUREMENT HEGO_HtgS1B1_I.bNewRiAvl "" UBYTE B_TRUE 1 100 0.00 1.00000000000 BIT_MASK 0x10 FORMAT "%13.11" ECU_ADDRESS 0xD0001300 /end MEASUREMENT
/begin MEASUREMENT HEGO_HtgS1B1_I.bRiActAvl "" UBYTE B_TRUE 1 100 0.00 1.00000000000 BIT_MASK 0x4 FORMAT "%13.11" ECU_ADDRESS 0xD0001302 /end MEASUREMENT
/begin MEASUREMENT HEGO_HtgS1B1_I.ctHtgCyclHi "" UBYTE dez 1 100 0.00 255.0 FORMAT "%5.1" ECU_ADDRESS 0xD0001303 /end MEASUREMENT
/begin MEASUREMENT HEGO_HtgS1B1_I.dresRi "" SWORD r_uw_q2 1 100 -65536.00 65534.00 FORMAT "%8.2" ECU_ADDRESS 0xD0001304 /end MEASUREMENT
/begin MEASUREMENT HEGO_HtgS1B1_I.duNomHtgClsdLop "" SWORD spg_q0p00039 1 100 -12.80000 12.79961 FORMAT "%8.5" ECU_ADDRESS 0xD0001306 /end MEASUREMENT
/begin MEASUREMENT HEGO_HtgS1B1_I.duNomHtgI "" SWORD spg_q0p00039 1 100 -12.80000 12.79961 FORMAT "%8.5" ECU_ADDRESS 0xD0001308 /end MEASUREMENT
/begin MEASUREMENT HEGO_HtgS1B1_I.duNomHtgP "" SWORD spg_q0p00039 1 100 -12.80000 12.79961 FORMAT "%8.5" ECU_ADDRESS 0xD000130A /end MEASUREMENT
/begin MEASUREMENT HEGO_HtgS1B1_I.pwrHtg "" UBYTE fak_q0p01 1 100 0.00 2.550 FORMAT "%5.3" ECU_ADDRESS 0xD000130C /end MEASUREMENT
/begin MEASUREMENT HEGO_HtgS1B1_I.rHtg "" UWORD fak_q3p906Em5 1 100 0.00 2.559961 FORMAT "%8.6" ECU_ADDRESS 0xD000130E /end MEASUREMENT
/begin MEASUREMENT HEGO_HtgS1B1_I.resRiAct "" UWORD r_uw_q2 1 100 0.00 131070.0 FORMAT "%8.1" ECU_ADDRESS 0xD0001310 /end MEASUREMENT
/begin MEASUREMENT HEGO_HtgS1B1_I.tEGFltHtg "" UWORD temp_q0p0234_o273 1 100 -273.1500 1262.827 FORMAT "%8.3" ECU_ADDRESS 0xD0001312 /end MEASUREMENT
/begin MEASUREMENT HEGO_HtgS1B1_I.tiHtgOn "" UBYTE t_q0p001 1 100 0.00 0.2550 FORMAT "%6.4" ECU_ADDRESS 0xD0001314 /end MEASUREMENT
/begin MEASUREMENT HEGO_HtgS1B1_I.tiHtgOnHi "" UBYTE t_q0p001 1 100 0.00 0.2550 FORMAT "%6.4" ECU_ADDRESS 0xD0001315 /end MEASUREMENT
/begin MEASUREMENT HEGO_HtgS1B1_I.tiHtgOnLo "" UBYTE t_q0p001 1 100 0.00 0.2540 FORMAT "%6.4" ECU_ADDRESS 0xD0001316 /end MEASUREMENT
/begin MEASUREMENT HEGO_HtgS1B1_I.tiHtgOnOff "" UBYTE t_q0p001 1 100 0.00 0.2550 FORMAT "%6.4" ECU_ADDRESS 0xD0001317 /end MEASUREMENT
/begin MEASUREMENT HEGO_HtgS1B1_I.uBattHtg "" UWORD spg_q0p00039 1 100 0.00 25.59961 FORMAT "%8.5" ECU_ADDRESS 0xD0001318 /end MEASUREMENT
/begin MEASUREMENT HEGO_HtgS1B1_I.uNomHtg "" UWORD spg_q0p00039 1 100 0.00 25.59961 FORMAT "%8.5" ECU_ADDRESS 0xD000131A /end MEASUREMENT
/begin MEASUREMENT HEGO_HtgS1B1_I.uNomHtgAftPrt "" UWORD spg_q0p00039 1 100 0.00 25.59961 FORMAT "%8.5" ECU_ADDRESS 0xD000131C /end MEASUREMENT
/begin MEASUREMENT HEGO_HtgS1B1_I.uNomHtgLim "" UWORD spg_q0p00039 1 100 0.00 25.59961 FORMAT "%8.5" ECU_ADDRESS 0xD000131E /end MEASUREMENT
/begin MEASUREMENT HEGO_HtgS1B1_I.uNomHtgMap "" UWORD spg_q0p00039 1 100 0.00 25.59961 FORMAT "%8.5" ECU_ADDRESS 0xD0001320 /end MEASUREMENT
/begin MEASUREMENT HEGO_HtgS1B1_I.uNomHtgNoLim "" UWORD spg_q0p00039 1 100 0.00 25.59961 FORMAT "%8.5" ECU_ADDRESS 0xD0001322 /end MEASUREMENT
/begin MEASUREMENT HEGO_HtgS1B1_I.uNomHtgOpenLop "" UWORD spg_q0p00039 1 100 0.00 25.59961 FORMAT "%8.5" ECU_ADDRESS 0xD0001324 /end MEASUREMENT
/begin MEASUREMENT HEGO_HtgS1B1_I.uNomHtgStrt "" UWORD spg_q0p00039 1 100 0.00 25.59961 FORMAT "%8.5" ECU_ADDRESS 0xD0001326 /end MEASUREMENT
/begin MEASUREMENT HEGO_HtgS1B1_I.B_atmstERNM_I.oldSignal "" UBYTE B_TRUE 1 100 0.00 1.00000000000 BIT_MASK 0x1 FORMAT "%13.11" ECU_ADDRESS 0xD0001328 /end MEASUREMENT
/begin MEASUREMENT HEGO_HtgS1B1_I.DebFrzRiTOFFV_I.outbit "" UBYTE B_TRUE 1 100 0.00 1.00000000000 BIT_MASK 0x1 FORMAT "%13.11" ECU_ADDRESS 0xD000132A /end MEASUREMENT
/begin MEASUREMENT HEGO_HtgS1B1_I.DebFrzRiTOFFV_I.time "" UWORD t_q0p01 1 100 0.00 655.3500 FORMAT "%8.4" ECU_ADDRESS 0xD000132C /end MEASUREMENT
/begin MEASUREMENT HEGO_HtgS1B1_I.DebHtgMapClsdLopTONV_I.outbit "" UBYTE B_TRUE 1 100 0.00 1.00000000000 BIT_MASK 0x1 FORMAT "%13.11" ECU_ADDRESS 0xD000132E /end MEASUREMENT
/begin MEASUREMENT HEGO_HtgS1B1_I.DebHtgMapClsdLopTONV_I.time "" UWORD t_q0p1 1 100 0.00 6553.500 FORMAT "%8.3" ECU_ADDRESS 0xD0001330 /end MEASUREMENT
/begin MEASUREMENT HEGO_HtgS1B1_I.DebHtgMaxTOFV_I.outbit "" UBYTE B_TRUE 1 100 0.00 1.00000000000 BIT_MASK 0x1 FORMAT "%13.11" ECU_ADDRESS 0xD0001332 /end MEASUREMENT
/begin MEASUREMENT HEGO_HtgS1B1_I.DebHtgMaxTOFV_I.time "" UWORD t_q0p1 1 100 0.00 6553.500 FORMAT "%8.3" ECU_ADDRESS 0xD0001334 /end MEASUREMENT
/begin MEASUREMENT HEGO_HtgS1B1_I.HtgCyclCTR_I.counter "" UBYTE dez 1 100 0.00 255.0 FORMAT "%5.1" ECU_ADDRESS 0xD0001338 /end MEASUREMENT
/begin MEASUREMENT HEGO_HtgS1B1_I.HtgRedTONV_I.outbit "" UBYTE B_TRUE 1 100 0.00 1.00000000000 BIT_MASK 0x1 FORMAT "%13.11" ECU_ADDRESS 0xD000133A /end MEASUREMENT
/begin MEASUREMENT HEGO_HtgS1B1_I.HtgRedTONV_I.time "" UWORD t_q0p1 1 100 0.00 6553.500 FORMAT "%8.3" ECU_ADDRESS 0xD000133C /end MEASUREMENT
/begin MEASUREMENT HEGO_HtgS1B1_I.HtgTR_I.timeCounter "" UBYTE t_q0p001 1 100 0.00 0.2550 FORMAT "%6.4" ECU_ADDRESS 0xD000133E /end MEASUREMENT
/begin MEASUREMENT HEGO_HtgS1B1_I.RiHtgLP_I.memory "" ULONG r_q3p0518Em5 1 100 0.00 131071.999969 FORMAT "%13.6" ECU_ADDRESS 0xD0001344 /end MEASUREMENT
/begin MEASUREMENT HEGO_HtgS1B1_I.bFrzRiEF_I.buffer "" UBYTE B_TRUE 1 100 0.00 1.00000000000 BIT_MASK 0x1 FORMAT "%13.11" ECU_ADDRESS 0xD0001348 /end MEASUREMENT
/begin MEASUREMENT HEGO_HtgS1B1_I.bFrzRiEF_I.oldSignal "" UBYTE B_TRUE 1 100 0.00 1.00000000000 BIT_MASK 0x1 FORMAT "%13.11" ECU_ADDRESS 0xD0001349 /end MEASUREMENT
/begin MEASUREMENT HEGO_HtgS1B1_I.bFrzRiFF_I.status "" UBYTE B_TRUE 1 100 0.00 1.00000000000 BIT_MASK 0x1 FORMAT "%13.11" ECU_ADDRESS 0xD000134A /end MEASUREMENT
/begin MEASUREMENT HEGO_HtgS1B1_I.bHtgClsdLopEnaER_I.buffer "" UBYTE B_TRUE 1 100 0.00 1.00000000000 BIT_MASK 0x1 FORMAT "%13.11" ECU_ADDRESS 0xD000134C /end MEASUREMENT
/begin MEASUREMENT HEGO_HtgS1B1_I.bHtgClsdLopEnaER_I.oldSignal "" UBYTE B_TRUE 1 100 0.00 1.00000000000 BIT_MASK 0x1 FORMAT "%13.11" ECU_ADDRESS 0xD000134D /end MEASUREMENT
/begin MEASUREMENT HEGO_HtgS1B1_I.bHtgRiReqFF_I.status "" UBYTE B_TRUE 1 100 0.00 1.00000000000 BIT_MASK 0x1 FORMAT "%13.11" ECU_ADDRESS 0xD000134E /end MEASUREMENT
/begin MEASUREMENT HEGO_HtgS1B1_I.bHtgStrtERNM_I.oldSignal "" UBYTE B_TRUE 1 100 0.00 1.00000000000 BIT_MASK 0x1 FORMAT "%13.11" ECU_ADDRESS 0xD000134F /end MEASUREMENT
/begin MEASUREMENT HEGO_HtgS1B1_I.bHtgSuffTONVNM_I.time "" UBYTE t_q0p1 1 100 0.00 25.50 FORMAT "%5.2" ECU_ADDRESS 0xD0001350 /end MEASUREMENT
/begin MEASUREMENT HEGO_HtgS1B1_I.tEGHtgLP_I.memory "" ULONG temp_q3p57Em7_om273 1 100 -273.150000000 1262.84999964 FORMAT "%13.8" ECU_ADDRESS 0xD0001358 /end MEASUREMENT
/begin MEASUREMENT HEGO_HtgS1B1_I.uNomHtgStrtAL_I.memory "" SLONG spg_q0p00039 1 100 -838860.800000 838860.799609 FORMAT "%13.6" ECU_ADDRESS 0xD000135C /end MEASUREMENT
/begin MEASUREMENT HEGO_OBDElecS1B1_I.bErrHtrCpl "" UBYTE B_TRUE 1 100 0.00 1.00000000000 BIT_MASK 0x1 FORMAT "%13.11" ECU_ADDRESS 0xD0001363 /end MEASUREMENT
/begin MEASUREMENT HEGO_OBDElecS1B1_I.bErrOpnGnd "" UBYTE B_TRUE 1 100 0.00 1.00000000000 BIT_MASK 0x1 FORMAT "%13.11" ECU_ADDRESS 0xAFE801CC /end MEASUREMENT
/begin MEASUREMENT HEGO_OBDElecS1B1_I.bErrOpnGndDyn "" UBYTE B_TRUE 1 100 0.00 1.00000000000 BIT_MASK 0x1 FORMAT "%13.11" ECU_ADDRESS 0xD0001362 /end MEASUREMENT
/begin MEASUREMENT HEGO_OBDElecS1B1_I.DebErrOpnGndDynTONV_I.outbit "" UBYTE B_TRUE 1 100 0.00 1.00000000000 BIT_MASK 0x1 FORMAT "%13.11" ECU_ADDRESS 0xD0001364 /end MEASUREMENT
/begin MEASUREMENT HEGO_OBDElecS1B1_I.DebErrOpnGndDynTONV_I.time "" UBYTE t_q0p1 1 100 0.00 25.50 FORMAT "%5.2" ECU_ADDRESS 0xD0001365 /end MEASUREMENT
/begin MEASUREMENT HEGO_OBDElecS1B1_I.DebErrOpnGndTONV_I.outbit "" UBYTE B_TRUE 1 100 0.00 1.00000000000 BIT_MASK 0x1 FORMAT "%13.11" ECU_ADDRESS 0xD0001366 /end MEASUREMENT
/begin MEASUREMENT HEGO_OBDElecS1B1_I.DebErrOpnGndTONV_I.time "" UBYTE t_q0p1 1 100 0.00 25.50 FORMAT "%5.2" ECU_ADDRESS 0xD0001367 /end MEASUREMENT
/begin MEASUREMENT HEGO_OBDElecS1B1_I.DebFCOOpnGndTONV_I.outbit "" UBYTE B_TRUE 1 100 0.00 1.00000000000 BIT_MASK 0x1 FORMAT "%13.11" ECU_ADDRESS 0xD0001368 /end MEASUREMENT
/begin MEASUREMENT HEGO_OBDElecS1B1_I.DebFCOOpnGndTONV_I.time "" UBYTE t_q0p1 1 100 0.00 25.50 FORMAT "%5.2" ECU_ADDRESS 0xD0001369 /end MEASUREMENT
/begin MEASUREMENT HEGO_OBDElecS1B1_I.ErrOpnGndFF_I.status "" UBYTE B_TRUE 1 100 0.00 1.00000000000 BIT_MASK 0x1 FORMAT "%13.11" ECU_ADDRESS 0xD000136A /end MEASUREMENT
/begin MEASUREMENT HEGO_OBDElecS1B1_I.HEGO_OBDElecS1_I.bErrElecMinWoDeb "" UBYTE B_TRUE 1 100 0.00 1.00000000000 BIT_MASK 0x1 FORMAT "%13.11" ECU_ADDRESS 0xD000136E /end MEASUREMENT
/begin MEASUREMENT HEGO_OBDElecS1B1_I.HEGO_OBDElecS1_I.bErrElecSig "" UBYTE B_TRUE 1 100 0.00 1.00000000000 BIT_MASK 0x2 FORMAT "%13.11" ECU_ADDRESS 0xD000136C /end MEASUREMENT
/begin MEASUREMENT HEGO_OBDElecS1B1_I.HEGO_OBDElecS1_I.bErrHtrCpl "" UBYTE B_TRUE 1 100 0.00 1.00000000000 BIT_MASK 0x1 FORMAT "%13.11" ECU_ADDRESS 0xD000136F /end MEASUREMENT
/begin MEASUREMENT HEGO_OBDElecS1B1_I.HEGO_OBDElecS1_I.bHtrCplFin "" UBYTE B_TRUE 1 100 0.00 1.00000000000 BIT_MASK 0x8 FORMAT "%13.11" ECU_ADDRESS 0xD000136D /end MEASUREMENT
/begin MEASUREMENT HEGO_OBDElecS1B1_I.HEGO_OBDElecS1_I.bMaxNumHtrCpl "" UBYTE B_TRUE 1 100 0.00 1.00000000000 BIT_MASK 0x1 FORMAT "%13.11" ECU_ADDRESS 0xD000136D /end MEASUREMENT
/begin MEASUREMENT HEGO_OBDElecS1B1_I.HEGO_OBDElecS1_I.bSuffNumHtrOff "" UBYTE B_TRUE 1 100 0.00 1.00000000000 BIT_MASK 0x2 FORMAT "%13.11" ECU_ADDRESS 0xD000136D /end MEASUREMENT
/begin MEASUREMENT HEGO_OBDElecS1B1_I.HEGO_OBDElecS1_I.DebDPEHtrCplTONV_I.outbit "" UBYTE B_TRUE 1 100 0.00 1.00000000000 BIT_MASK 0x1 FORMAT "%13.11" ECU_ADDRESS 0xD0001372 /end MEASUREMENT
/begin MEASUREMENT HEGO_OBDElecS1B1_I.HEGO_OBDElecS1_I.DebDPEHtrCplTONV_I.time "" UWORD t_q0p01 1 100 0.00 655.3500 FORMAT "%8.4" ECU_ADDRESS 0xD0001374 /end MEASUREMENT
/begin MEASUREMENT HEGO_OBDElecS1B1_I.HEGO_OBDElecS1_I.DebErrElecMaxTONV_I.outbit "" UBYTE B_TRUE 1 100 0.00 1.00000000000 BIT_MASK 0x1 FORMAT "%13.11" ECU_ADDRESS 0xD0001376 /end MEASUREMENT
/begin MEASUREMENT HEGO_OBDElecS1B1_I.HEGO_OBDElecS1_I.DebErrElecMaxTONV_I.time "" UBYTE t_q0p01 1 100 0.00 2.550 FORMAT "%5.3" ECU_ADDRESS 0xD0001377 /end MEASUREMENT
/begin MEASUREMENT HEGO_OBDElecS1B1_I.HEGO_OBDElecS1_I.DebErrElecMinTONV_I.outbit "" UBYTE B_TRUE 1 100 0.00 1.00000000000 BIT_MASK 0x1 FORMAT "%13.11" ECU_ADDRESS 0xD000137A /end MEASUREMENT
/begin MEASUREMENT HEGO_OBDElecS1B1_I.HEGO_OBDElecS1_I.DebErrElecMinTONV_I.time "" UBYTE t_q0p1 1 100 0.00 25.50 FORMAT "%5.2" ECU_ADDRESS 0xD000137B /end MEASUREMENT
/begin MEASUREMENT HEGO_OBDElecS1B1_I.HEGO_OBDElecS1_I.DebErrElecSigSusTONV_I.outbit "" UBYTE B_TRUE 1 100 0.00 1.00000000000 BIT_MASK 0x1 FORMAT "%13.11" ECU_ADDRESS 0xD000137C /end MEASUREMENT
/begin MEASUREMENT HEGO_OBDElecS1B1_I.HEGO_OBDElecS1_I.DebErrElecSigSusTONV_I.time "" UBYTE t_q0p1 1 100 0.00 25.50 FORMAT "%5.2" ECU_ADDRESS 0xD000137D /end MEASUREMENT
/begin MEASUREMENT HEGO_OBDElecS1B1_I.HEGO_OBDElecS1_I.DebRstErrElecMinTONV_I.outbit "" UBYTE B_TRUE 1 100 0.00 1.00000000000 BIT_MASK 0x1 FORMAT "%13.11" ECU_ADDRESS 0xD000137E /end MEASUREMENT
/begin MEASUREMENT HEGO_OBDElecS1B1_I.HEGO_OBDElecS1_I.DebRstErrElecMinTONV_I.time "" UBYTE t_q0p1 1 100 0.00 25.50 FORMAT "%5.2" ECU_ADDRESS 0xD000137F /end MEASUREMENT
/begin MEASUREMENT HEGO_OBDElecS1B1_I.HEGO_OBDElecS1_I.EndFrmHtrCplEF_I.oldSignal "" UBYTE B_TRUE 1 100 0.00 1.00000000000 BIT_MASK 0x1 FORMAT "%13.11" ECU_ADDRESS 0xD0001380 /end MEASUREMENT
/begin MEASUREMENT HEGO_OBDElecS1B1_I.HEGO_OBDElecS1_I.ErrElecMinFF_I.status "" UBYTE B_TRUE 1 100 0.00 1.00000000000 BIT_MASK 0x1 FORMAT "%13.11" ECU_ADDRESS 0xD0001381 /end MEASUREMENT
/begin MEASUREMENT HEGO_OBDElecS1B1_I.HEGO_OBDElecS1_I.ErrElecSigRiFF_I.status "" UBYTE B_TRUE 1 100 0.00 1.00000000000 BIT_MASK 0x1 FORMAT "%13.11" ECU_ADDRESS 0xD0001382 /end MEASUREMENT
/begin MEASUREMENT HEGO_OBDElecS1B1_I.HEGO_OBDElecS1_I.FrmHtrCplFF_I.status "" UBYTE B_TRUE 1 100 0.00 1.00000000000 BIT_MASK 0x1 FORMAT "%13.11" ECU_ADDRESS 0xD0001383 /end MEASUREMENT
/begin MEASUREMENT HEGO_OBDElecS1B1_I.HEGO_OBDElecS1_I.FrmHtrCplTOFV_I.outbit "" UBYTE B_TRUE 1 100 0.00 1.00000000000 BIT_MASK 0x1 FORMAT "%13.11" ECU_ADDRESS 0xD0001384 /end MEASUREMENT
/begin MEASUREMENT HEGO_OBDElecS1B1_I.HEGO_OBDElecS1_I.FrmHtrCplTOFV_I.time "" UBYTE t_q0p01 1 100 0.00 2.550 FORMAT "%5.3" ECU_ADDRESS 0xD0001385 /end MEASUREMENT
/begin MEASUREMENT HEGO_OBDElecS1B1_I.HEGO_OBDElecS1_I.HEGO_OBDElecMin_I.bErrMinLdPls "" UBYTE B_TRUE 1 100 0.00 1.00000000000 BIT_MASK 0x1 FORMAT "%13.11" ECU_ADDRESS 0xD0001386 /end MEASUREMENT
/begin MEASUREMENT HEGO_OBDElecS1B1_I.HEGO_OBDElecS1_I.HEGO_OBDElecMin_I.bLdPlsMinReq "" UBYTE B_TRUE 1 100 0.00 1.00000000000 BIT_MASK 0x1 FORMAT "%13.11" ECU_ADDRESS 0xD0001387 /end MEASUREMENT
/begin MEASUREMENT HEGO_OBDElecS1B1_I.HEGO_OBDElecS1_I.HEGO_OBDElecMin_I.sm "" UBYTE OneToOne 1 100 0.00 3.000 FORMAT "%5.3" ECU_ADDRESS 0xD0001388 /end MEASUREMENT
/begin MEASUREMENT HEGO_OBDElecS1B1_I.HEGO_OBDElecS1_I.HEGO_OBDElecSig_I.bErrSigLdPls "" UBYTE B_TRUE 1 100 0.00 1.00000000000 BIT_MASK 0x1 FORMAT "%13.11" ECU_ADDRESS 0xD000138B /end MEASUREMENT
/begin MEASUREMENT HEGO_OBDElecS1B1_I.HEGO_OBDElecS1_I.HEGO_OBDElecSig_I.bErrSigSusLdPls "" UBYTE B_TRUE 1 100 0.00 1.00000000000 BIT_MASK 0x4 FORMAT "%13.11" ECU_ADDRESS 0xD000138A /end MEASUREMENT
/begin MEASUREMENT HEGO_OBDElecS1B1_I.HEGO_OBDElecS1_I.HEGO_OBDElecSig_I.bLdPlsSigCnfExe "" UBYTE B_TRUE 1 100 0.00 1.00000000000 BIT_MASK 0x2 FORMAT "%13.11" ECU_ADDRESS 0xD000138A /end MEASUREMENT
/begin MEASUREMENT HEGO_OBDElecS1B1_I.HEGO_OBDElecS1_I.HEGO_OBDElecSig_I.bLdPlsSigCnfReq "" UBYTE B_TRUE 1 100 0.00 1.00000000000 BIT_MASK 0x1 FORMAT "%13.11" ECU_ADDRESS 0xD000138C /end MEASUREMENT
/begin MEASUREMENT HEGO_OBDElecS1B1_I.HEGO_OBDElecS1_I.HEGO_OBDElecSig_I.bLdPlsSigExe "" UBYTE B_TRUE 1 100 0.00 1.00000000000 BIT_MASK 0x1 FORMAT "%13.11" ECU_ADDRESS 0xD000138A /end MEASUREMENT
/begin MEASUREMENT HEGO_OBDElecS1B1_I.HEGO_OBDElecS1_I.HEGO_OBDElecSig_I.bLdPlsSigReq "" UBYTE B_TRUE 1 100 0.00 1.00000000000 BIT_MASK 0x1 FORMAT "%13.11" ECU_ADDRESS 0xD000138D /end MEASUREMENT
/begin MEASUREMENT HEGO_OBDElecS1B1_I.HEGO_OBDElecS1_I.HEGO_OBDElecSig_I.sm "" UBYTE OneToOne 1 100 0.00 4.000 FORMAT "%5.3" ECU_ADDRESS 0xD000138E /end MEASUREMENT
/begin MEASUREMENT HEGO_OBDElecS1B1_I.HEGO_OBDElecS1_I.HtrCplCTR_I.counter "" UBYTE dez 1 100 0.00 255.0 FORMAT "%5.1" ECU_ADDRESS 0xD0001390 /end MEASUREMENT
/begin MEASUREMENT HEGO_OBDElecS1B1_I.HEGO_OBDElecS1_I.HtrOffCTR_I.counter "" UBYTE dez 1 100 0.00 255.0 FORMAT "%5.1" ECU_ADDRESS 0xD0001391 /end MEASUREMENT
/begin MEASUREMENT HEGO_OBDElecS1B1_I.HEGO_OBDElecS1_I.StrtFrmHtrCplEF_I.buffer "" UBYTE B_TRUE 1 100 0.00 1.00000000000 BIT_MASK 0x1 FORMAT "%13.11" ECU_ADDRESS 0xD0001392 /end MEASUREMENT
/begin MEASUREMENT HEGO_OBDElecS1B1_I.HEGO_OBDElecS1_I.StrtFrmHtrCplEF_I.oldSignal "" UBYTE B_TRUE 1 100 0.00 1.00000000000 BIT_MASK 0x1 FORMAT "%13.11" ECU_ADDRESS 0xD0001393 /end MEASUREMENT
/begin MEASUREMENT HEGO_OBDHtgS1B1_I.bEnaDHtg "" UBYTE B_TRUE 1 100 0.00 1.00000000000 BIT_MASK 0x1 FORMAT "%13.11" ECU_ADDRESS 0xD00013B1 /end MEASUREMENT
/begin MEASUREMENT HEGO_OBDHtgS1B1_I.bEnaDHtgFCMClrEngRun "" UBYTE B_TRUE 1 100 0.00 1.00000000000 BIT_MASK 0x1 FORMAT "%13.11" ECU_ADDRESS 0xD00013B0 /end MEASUREMENT
/begin MEASUREMENT HEGO_OBDHtgS1B1_I.bErrHtg "" UBYTE B_TRUE 1 100 0.00 1.00000000000 BIT_MASK 0x2 FORMAT "%13.11" ECU_ADDRESS 0xD00013B0 /end MEASUREMENT
/begin MEASUREMENT HEGO_OBDHtgS1B1_I.bHtgSuffRi "" UBYTE B_TRUE 1 100 0.00 1.00000000000 BIT_MASK 0x1 FORMAT "%13.11" ECU_ADDRESS 0xD00013B2 /end MEASUREMENT
/begin MEASUREMENT HEGO_OBDHtgS1B1_I.bRiImPlausHi "" UBYTE B_TRUE 1 100 0.00 1.00000000000 BIT_MASK 0x4 FORMAT "%13.11" ECU_ADDRESS 0xD00013B0 /end MEASUREMENT
/begin MEASUREMENT HEGO_OBDHtgS1B1_I.pwrHtgFlt "" UBYTE fak_q0p01 1 100 0.00 2.550 FORMAT "%5.3" ECU_ADDRESS 0xD00013B3 /end MEASUREMENT
/begin MEASUREMENT HEGO_OBDHtgS1B1_I.resRiThresDHtg "" UWORD r_uw_q2 1 100 0.00 131070.0 FORMAT "%8.1" ECU_ADDRESS 0xD00013B4 /end MEASUREMENT
/begin MEASUREMENT HEGO_OBDHtgS1B1_I.tEGFlt "" UWORD temp_q0p0234_o273 1 100 -273.1500 1262.827 FORMAT "%8.3" ECU_ADDRESS 0xD00013B6 /end MEASUREMENT
/begin MEASUREMENT HEGO_OBDHtrPsS1B1_I.bPsOk "" UBYTE B_TRUE 1 100 0.00 1.00000000000 BIT_MASK 0x1 FORMAT "%13.11" ECU_ADDRESS 0xD00013CE /end MEASUREMENT
/begin MEASUREMENT HEGO_OpRdnS1B1_I.bEna "" UBYTE B_TRUE 1 100 0.00 1.00000000000 BIT_MASK 0x1 FORMAT "%13.11" ECU_ADDRESS 0xD0001394 /end MEASUREMENT
/begin MEASUREMENT HEGO_OpRdnS1B1_I.bEnaDElec "" UBYTE B_TRUE 1 100 0.00 1.00000000000 BIT_MASK 0x2 FORMAT "%13.11" ECU_ADDRESS 0xD0001394 /end MEASUREMENT
/begin MEASUREMENT HEGO_OpRdnS1B1_I.bEnaOpRdnHtg "" UBYTE B_TRUE 1 100 0.00 1.00000000000 BIT_MASK 0x4 FORMAT "%13.11" ECU_ADDRESS 0xD0001394 /end MEASUREMENT
/begin MEASUREMENT HEGO_OpRdnS1B1_I.bErrSigPrev "" UBYTE B_TRUE 1 100 0.00 1.00000000000 BIT_MASK 0x8 FORMAT "%13.11" ECU_ADDRESS 0xD0001394 /end MEASUREMENT
/begin MEASUREMENT HEGO_OpRdnS1B1_I.bNewRiAvl "" UBYTE B_TRUE 1 100 0.00 1.00000000000 BIT_MASK 0x40 FORMAT "%13.11" ECU_ADDRESS 0xD0001394 /end MEASUREMENT
/begin MEASUREMENT HEGO_OpRdnS1B1_I.bOpRdnRiReq "" UBYTE B_TRUE 1 100 0.00 1.00000000000 BIT_MASK 0x1 FORMAT "%13.11" ECU_ADDRESS 0xD0001395 /end MEASUREMENT
/begin MEASUREMENT HEGO_OpRdnS1B1_I.bRiOkOpRdn "" UBYTE B_TRUE 1 100 0.00 1.00000000000 BIT_MASK 0x80 FORMAT "%13.11" ECU_ADDRESS 0xD0001394 /end MEASUREMENT
/begin MEASUREMENT HEGO_OpRdnS1B1_I.bSVld "" UBYTE B_TRUE 1 100 0.00 1.00000000000 BIT_MASK 0x20 FORMAT "%13.11" ECU_ADDRESS 0xD0001394 /end MEASUREMENT
/begin MEASUREMENT HEGO_OpRdnS1B1_I.DebErrStkTONV_I.outbit "" UBYTE B_TRUE 1 100 0.00 1.00000000000 BIT_MASK 0x1 FORMAT "%13.11" ECU_ADDRESS 0xD0001396 /end MEASUREMENT
/begin MEASUREMENT HEGO_OpRdnS1B1_I.DebErrStkTONV_I.time "" UWORD t_q0p1 1 100 0.00 6553.500 FORMAT "%8.3" ECU_ADDRESS 0xD0001398 /end MEASUREMENT
/begin MEASUREMENT HEGO_OpRdnS1B1_I.DebExptOpRdnTONV_I.outbit "" UBYTE B_TRUE 1 100 0.00 1.00000000000 BIT_MASK 0x1 FORMAT "%13.11" ECU_ADDRESS 0xD000139A /end MEASUREMENT
/begin MEASUREMENT HEGO_OpRdnS1B1_I.DebExptOpRdnTONV_I.time "" UWORD t_q0p1 1 100 0.00 6553.500 FORMAT "%8.3" ECU_ADDRESS 0xD000139C /end MEASUREMENT
/begin MEASUREMENT HEGO_OpRdnS1B1_I.DebPrtHtgFinTONV_I.outbit "" UBYTE B_TRUE 1 100 0.00 1.00000000000 BIT_MASK 0x1 FORMAT "%13.11" ECU_ADDRESS 0xD000139E /end MEASUREMENT
/begin MEASUREMENT HEGO_OpRdnS1B1_I.DebPrtHtgFinTONV_I.time "" UWORD t_q0p1 1 100 0.00 6553.500 FORMAT "%8.3" ECU_ADDRESS 0xD00013A0 /end MEASUREMENT
/begin MEASUREMENT HEGO_OpRdnS1B1_I.DebRstErrStkCVBTONV_I.time "" UBYTE t_q0p1 1 100 0.00 25.50 FORMAT "%5.2" ECU_ADDRESS 0xD00013A2 /end MEASUREMENT
/begin MEASUREMENT HEGO_OpRdnS1B1_I.DebSVldTONV_I.outbit "" UBYTE B_TRUE 1 100 0.00 1.00000000000 BIT_MASK 0x1 FORMAT "%13.11" ECU_ADDRESS 0xD00013A4 /end MEASUREMENT
/begin MEASUREMENT HEGO_OpRdnS1B1_I.DebSVldTONV_I.time "" UBYTE t_q0p1 1 100 0.00 25.50 FORMAT "%5.2" ECU_ADDRESS 0xD00013A5 /end MEASUREMENT
/begin MEASUREMENT HEGO_OpRdnS1B1_I.SVldFF_I.status "" UBYTE B_TRUE 1 100 0.00 1.00000000000 BIT_MASK 0x1 FORMAT "%13.11" ECU_ADDRESS 0xD00013A6 /end MEASUREMENT
/begin MEASUREMENT HEGO_OpRdnS1B1_I.StkCVBSusFF_I.status "" UBYTE B_TRUE 1 100 0.00 1.00000000000 BIT_MASK 0x1 FORMAT "%13.11" ECU_ADDRESS 0xD00013A7 /end MEASUREMENT
/begin MEASUREMENT HEGO_pwrS1B1Htg "" UBYTE fak_q0p01 1 100 0.00 2.550 FORMAT "%5.3" ECU_ADDRESS 0xD0003C6E /end MEASUREMENT
/begin MEASUREMENT HEGO_resS1B1RiThres "" UWORD r_uw_q2 1 100 0.00 131070.0 FORMAT "%8.1" ECU_ADDRESS 0xD00035EE /end MEASUREMENT
/begin MEASUREMENT HEGO_tS1B1EGFltDHtg "" UWORD temp_q0p0234_o273 1 100 -273.1500 1262.827 FORMAT "%8.3" ECU_ADDRESS 0xD00035F0 /end MEASUREMENT
/begin MEASUREMENT HEGO_uS1B1ExtdMax "" UWORD spg_q0p00488 1 100 0.00 4.995117 FORMAT "%8.6" ECU_ADDRESS 0xAFE80124 /end MEASUREMENT
/begin MEASUREMENT HEGO_uS1B1LdPlsMax "" UWORD spg_q0p00488 1 100 0.00 4.995117 FORMAT "%8.6" ECU_ADDRESS 0xAFE80126 /end MEASUREMENT
/begin MEASUREMENT HEGO_uS1B1LdPlsMin "" UWORD spg_q0p00488 1 100 0.00 4.995117 FORMAT "%8.6" ECU_ADDRESS 0xAFE80128 /end MEASUREMENT
/begin MEASUREMENT HEGO_uS1B1WiDynSim "" UWORD spg_q0p00488 1 100 0.00 4.995117 FORMAT "%8.6" ECU_ADDRESS 0xD00035F6 /end MEASUREMENT
/begin MEASUREMENT IdleChrgActr_rat "" UWORD Prc 1 100 0.00 100.0000 FORMAT "%8.4" ECU_ADDRESS 0xD0003600 /end MEASUREMENT
/begin MEASUREMENT kl_twstt_w "" UWORD t1sxs_uw_q1 1 100 0.00 65535.00 FORMAT "%8.2" ECU_ADDRESS 0xD0000710 /end MEASUREMENT
/begin MEASUREMENT krintka1_w "" UWORD spg_uw_q0p000076 1 100 0.00 4.999924 FORMAT "%8.6" ARRAY_SIZE 8 ECU_ADDRESS 0xD0000792 /end MEASUREMENT
/begin MEASUREMENT kr_monitor "" UBYTE dez 1 100 0.00 7.000 FORMAT "%5.3" ECU_ADDRESS 0xD0000D22 /end MEASUREMENT
/begin MEASUREMENT ksnew "" UBYTE dez 1 100 0.00 4.000 FORMAT "%5.3" ECU_ADDRESS 0xD0000D23 /end MEASUREMENT
/begin MEASUREMENT msndkoos_w "" UWORD m_uw_b6553p5 1 100 0.00 6553.500 FORMAT "%8.3" ECU_ADDRESS 0xD0000760 /end MEASUREMENT
/begin MEASUREMENT msnllss_w "" UWORD m_uw_b102p4 1 100 0.00 102.3984 FORMAT "%8.4" ECU_ADDRESS 0xD0000768 /end MEASUREMENT
/begin MEASUREMENT noupsini "" UBYTE dez 1 100 0.00 255.0 FORMAT "%5.1" ECU_ADDRESS 0xD0000D1B /end MEASUREMENT
/begin MEASUREMENT pabvhk_w "" UWORD p_uw_q0p039 1 100 0.00 2559.961 FORMAT "%8.3" ECU_ADDRESS 0xD0000758 /end MEASUREMENT
/begin MEASUREMENT pabvuk_w "" UWORD p_uw_q0p039 1 100 0.00 2559.961 FORMAT "%8.3" ECU_ADDRESS 0xD000075A /end MEASUREMENT
/begin MEASUREMENT pabvvk_w "" UWORD p_uw_q0p039 1 100 0.00 2559.961 FORMAT "%8.3" ECU_ADDRESS 0xD000075C /end MEASUREMENT
/begin MEASUREMENT psini_w "" UWORD p_q0p039 1 100 0.00 2559.961 FORMAT "%8.3" ECU_ADDRESS 0xD0000788 /end MEASUREMENT
/begin MEASUREMENT psrrff_w "" UWORD p_q0p078 1 100 0.00 5119.922 FORMAT "%8.3" ECU_ADDRESS 0xD000078A /end MEASUREMENT
/begin MEASUREMENT psrr_w "" UWORD p_q0p078 1 100 0.00 5119.922 FORMAT "%8.3" ECU_ADDRESS 0xD000078C /end MEASUREMENT
/begin MEASUREMENT puabg_w "" UWORD p_q0p039 1 100 0.00 2559.961 FORMAT "%8.3" ECU_ADDRESS 0xD000075E /end MEASUREMENT
/begin MEASUREMENT rinsv_w "" UWORD r_uw_q2 1 100 0.00 131070.0 FORMAT "%8.1" ECU_ADDRESS 0xD00007CA /end MEASUREMENT
/begin MEASUREMENT rkg_w "" UWORD rel_uw_b3072 1 100 0.00 3071.953 FORMAT "%8.3" ECU_ADDRESS 0xD00007C0 /end MEASUREMENT
/begin MEASUREMENT rkmeeff_w "" UWORD rel_uw_b3072 1 100 0.00 3071.953 FORMAT "%8.3" ECU_ADDRESS 0xD00007C2 /end MEASUREMENT
/begin MEASUREMENT rkuke_w "" SWORD rel_sw_q0p0468 1 100 -1536.000 1535.953 FORMAT "%8.3" ECU_ADDRESS 0xD0000734 /end MEASUREMENT
/begin MEASUREMENT rkukgp_w "" SWORD rel_sw_q0p0468 1 100 -1536.000 1535.953 FORMAT "%8.3" ECU_ADDRESS 0xD0000736 /end MEASUREMENT
/begin MEASUREMENT rkukg_w "" SWORD rel_sw_q0p0468 1 100 -1536.000 1535.953 FORMAT "%8.3" ECU_ADDRESS 0xD0000750 /end MEASUREMENT
/begin MEASUREMENT rkukkl_w "" SWORD rel_sw_q0p0468 1 100 -1536.000 1535.953 FORMAT "%8.3" ECU_ADDRESS 0xD0000738 /end MEASUREMENT
/begin MEASUREMENT rkukk_w "" SWORD rel_sw_q0p0468 1 100 -1536.000 1535.953 FORMAT "%8.3" ECU_ADDRESS 0xD0000752 /end MEASUREMENT
/begin MEASUREMENT rkukl_w "" SWORD rel_sw_q0p0468 1 100 -1536.000 1535.953 FORMAT "%8.3" ECU_ADDRESS 0xD000073A /end MEASUREMENT
/begin MEASUREMENT rkuk_w "" SWORD rel_sw_q0p0468 1 100 -1536.000 1535.953 FORMAT "%8.3" ECU_ADDRESS 0xD000073C /end MEASUREMENT
/begin MEASUREMENT rkvmeeff_w "" UWORD rel_uw_b3072 1 100 0.00 3071.953 FORMAT "%8.3" ECU_ADDRESS 0xD00007C4 /end MEASUREMENT
/begin MEASUREMENT rk_l "" ULONG rel_uw_b3072 1 100 0.00 201326591.953 FORMAT "%13.3" ECU_ADDRESS 0xD000221C /end MEASUREMENT
/begin MEASUREMENT rk_w "" UWORD rel_uw_b3072 1 100 0.00 3071.953 FORMAT "%8.3" ECU_ADDRESS 0xD00007C6 /end MEASUREMENT
/begin MEASUREMENT rllaso_w "" UWORD rel_uw_q0p0234 1 100 0.00 1535.977 FORMAT "%8.3" ECU_ADDRESS 0xD00007C8 /end MEASUREMENT
/begin MEASUREMENT s1fl2p11 "" UBYTE dez 1 100 0.00 255.0 FORMAT "%5.1" ARRAY_SIZE 2 ECU_ADDRESS 0xD0000D16 /end MEASUREMENT
/begin MEASUREMENT s1fl2p45 "" UBYTE dez 1 100 0.00 255.0 FORMAT "%5.1" ARRAY_SIZE 2 ECU_ADDRESS 0xD0000D18 /end MEASUREMENT
/begin MEASUREMENT sdwfk_w "" SWORD rel_q0p09375 1 100 -3072.000 3071.906 FORMAT "%8.3" ECU_ADDRESS 0xD000073E /end MEASUREMENT
/begin MEASUREMENT sdwfl_w "" SWORD rel_q0p09375 1 100 -3072.000 3071.906 FORMAT "%8.3" ECU_ADDRESS 0xD0000740 /end MEASUREMENT
/begin MEASUREMENT stkrfmf "" UBYTE dez 1 100 0.00 255.0 FORMAT "%5.1" ECU_ADDRESS 0xD0000D24 /end MEASUREMENT
/begin MEASUREMENT tfa1limf "" UBYTE temp_ub_q0p75_o48 1 100 -48.00 143.3 FORMAT "%5.1" ECU_ADDRESS 0xD0000D2D /end MEASUREMENT
/begin MEASUREMENT tfa1lin "" UBYTE temp_ub_q0p75_o48 1 100 -48.00 143.3 FORMAT "%5.1" ECU_ADDRESS 0xD0000D2E /end MEASUREMENT
/begin MEASUREMENT tfa1linf "" UBYTE temp_ub_q0p75_o48 1 100 -48.00 143.3 FORMAT "%5.1" ECU_ADDRESS 0xD0000D2F /end MEASUREMENT
/begin MEASUREMENT tmeswe "" UBYTE temp_ub_q0p75_o48 1 100 -48.00 143.3 FORMAT "%5.1" ECU_ADDRESS 0xD0000D13 /end MEASUREMENT
/begin MEASUREMENT tmotlin "" UBYTE temp_ub_q0p75_o48 1 100 -48.00 143.3 FORMAT "%5.1" ECU_ADDRESS 0xD0000D28 /end MEASUREMENT
/begin MEASUREMENT tmotlinf "" UBYTE temp_ub_q0p75_o48 1 100 -48.00 143.3 FORMAT "%5.1" ECU_ADDRESS 0xD0000D29 /end MEASUREMENT
/begin MEASUREMENT tmotnldiff "" UBYTE temp_ub_b191p25 1 100 0.00 191.3 FORMAT "%5.1" ECU_ADDRESS 0xD0000CF6 /end MEASUREMENT
/begin MEASUREMENT tmotnlmx "" UBYTE temp_ub_q0p75_o48 1 100 -48.00 143.3 FORMAT "%5.1" ECU_ADDRESS 0xAFE80186 /end MEASUREMENT
/begin MEASUREMENT tmottstr_w "" UWORD temp_q0p0234_o273 1 100 -273.1500 1262.827 FORMAT "%8.3" ECU_ADDRESS 0xD00007A6 /end MEASUREMENT
/begin MEASUREMENT tp_u32 "" ULONG undefined 1 100 0.00 4294967295.00 FORMAT "%13.2" ECU_ADDRESS 0xD0002218 /end MEASUREMENT
/begin MEASUREMENT ttdnsubr_w "" UWORD t100msxs_uw_b6553p5 1 100 0.00 6553.500 FORMAT "%8.3" ECU_ADDRESS 0xD00007AE /end MEASUREMENT
/begin MEASUREMENT ttdnsub_w "" UWORD t100msxs_uw_b6553p5 1 100 0.00 6553.500 FORMAT "%8.3" ECU_ADDRESS 0xD00007B0 /end MEASUREMENT
/begin MEASUREMENT ub "" UBYTE spg_ubatt 1 100 0.00 24.02 FORMAT "%5.2" ECU_ADDRESS 0xD0000D36 /end MEASUREMENT
/begin MEASUREMENT ubrsq "" UBYTE spg_q0p1 1 100 0.00 25.50 FORMAT "%5.2" ECU_ADDRESS 0xD0000D37 /end MEASUREMENT
/begin MEASUREMENT ubrsq_w "" UWORD spg_q0p00039 1 100 0.00 25.59961 FORMAT "%8.5" ECU_ADDRESS 0xD00007B2 /end MEASUREMENT
/begin MEASUREMENT ubsq "" UBYTE spg_q0p1 1 100 0.00 25.50 FORMAT "%5.2" ECU_ADDRESS 0xD0000D38 /end MEASUREMENT
/begin MEASUREMENT ubsqf "" UBYTE spg_q0p1 1 100 0.00 25.50 FORMAT "%5.2" ECU_ADDRESS 0xD0000D39 /end MEASUREMENT
/begin MEASUREMENT ubsqf_w "" UWORD spg_q0p00039 1 100 0.00 25.59961 FORMAT "%8.5" ECU_ADDRESS 0xD00007B4 /end MEASUREMENT
/begin MEASUREMENT ubsq_w "" UWORD spg_q0p00039 1 100 0.00 25.59961 FORMAT "%8.5" ECU_ADDRESS 0xD00007B6 /end MEASUREMENT
/begin MEASUREMENT udsm_w "" UWORD spg_q7p63em5 1 100 0.00 4.999924 FORMAT "%8.6" ECU_ADDRESS 0xD0000786 /end MEASUREMENT
/begin MEASUREMENT umsnmsok_w "" UWORD fak_uw_b8 1 100 0.00 7.999878 FORMAT "%8.6" ECU_ADDRESS 0xD0000762 /end MEASUREMENT
/begin MEASUREMENT umsnmsug_w "" UWORD fak_uw_b8 1 100 0.00 7.999878 FORMAT "%8.6" ECU_ADDRESS 0xD0000764 /end MEASUREMENT
/begin MEASUREMENT upsinisu_l "" ULONG spg_q0p00488 1 100 0.00 20971519.9951 FORMAT "%13.4" ECU_ADDRESS 0xD0002210 /end MEASUREMENT
/begin MEASUREMENT utcwf_w "" UWORD spg_uw_q0p00488 1 100 0.00 4.995117 FORMAT "%8.6" ECU_ADDRESS 0xD00007A8 /end MEASUREMENT
/begin MEASUREMENT utcw_w "" UWORD spg_uw_q0p00488 1 100 0.00 4.995117 FORMAT "%8.6" ECU_ADDRESS 0xD00007AA /end MEASUREMENT
/begin MEASUREMENT vkrnew "" UBYTE dez 1 100 0.00 6.000 FORMAT "%5.3" ECU_ADDRESS 0xD0000D25 /end MEASUREMENT
/begin MEASUREMENT vti_w "" UWORD fak_uw_b2 1 100 0.00 1.999969 FORMAT "%8.6" ECU_ADDRESS 0xD0000742 /end MEASUREMENT
/begin MEASUREMENT wdkba "" UBYTE relDK_ub_b100 1 100 0.00 100.0 FORMAT "%5.1" ECU_ADDRESS 0xD0000D1A /end MEASUREMENT
/begin MEASUREMENT wdkba_w "" SWORD relDK_q0p02441 1 100 -800.0000 799.9756 FORMAT "%8.4" ECU_ADDRESS 0xD0000778 /end MEASUREMENT
/begin MEASUREMENT wdkbl_w "" UWORD relDK_uw_b100 1 100 0.00 100.0000 FORMAT "%8.4" ECU_ADDRESS 0xD0000774 /end MEASUREMENT
/begin MEASUREMENT wdkhfu_w "" UWORD rel_uw_b100 1 100 0.00 99.99847 FORMAT "%8.5" ECU_ADDRESS 0xD0000766 /end MEASUREMENT
/begin MEASUREMENT wdkhf_w "" UWORD rel_uw_b100 1 100 0.00 99.99847 FORMAT "%8.5" ECU_ADDRESS 0xD000076A /end MEASUREMENT
/begin MEASUREMENT wdklmn_w "" UWORD relDK_uw_b100 1 100 0.00 100.0000 FORMAT "%8.4" ECU_ADDRESS 0xAFE8011E /end MEASUREMENT
/begin MEASUREMENT wdklmr_w "" UWORD relDK_uw_b100 1 100 0.00 100.0000 FORMAT "%8.4" ECU_ADDRESS 0xAFE80122 /end MEASUREMENT
/begin MEASUREMENT wdklm_w "" UWORD relDK_uw_b100 1 100 0.00 100.0000 FORMAT "%8.4" ECU_ADDRESS 0xAFE80120 /end MEASUREMENT
/begin MEASUREMENT wdkma_w "" UWORD rel_uw_b100 1 100 0.00 99.99847 FORMAT "%8.5" ECU_ADDRESS 0xD000077A /end MEASUREMENT
/begin MEASUREMENT wdkmi_w "" UWORD rel_uw_b100 1 100 0.00 99.99847 FORMAT "%8.5" ECU_ADDRESS 0xD000077C /end MEASUREMENT
/begin MEASUREMENT wdkpm_w "" UWORD rel_uw_b100 1 100 0.00 99.99847 FORMAT "%8.5" ECU_ADDRESS 0xD000077E /end MEASUREMENT
/begin MEASUREMENT wdkraw_w "" UWORD rel_uw_b100 1 100 0.00 99.99847 FORMAT "%8.5" ECU_ADDRESS 0xD0000780 /end MEASUREMENT
/begin MEASUREMENT wdkugd_w "" UWORD rel_uw_b100 1 100 0.00 99.99847 FORMAT "%8.5" ECU_ADDRESS 0xD000076C /end MEASUREMENT
/begin MEASUREMENT wdkugtx_w "" UWORD rel_uw_b100 1 100 0.00 99.99847 FORMAT "%8.5" ECU_ADDRESS 0xD000076E /end MEASUREMENT
/begin MEASUREMENT wdk_w "" UWORD rel_uw_b100 1 100 0.00 99.99847 FORMAT "%8.5" ECU_ADDRESS 0xD0000782 /end MEASUREMENT
/begin MEASUREMENT wdwee "" UBYTE kw_q6 1 100 0.00 1530. FORMAT "%5.0" ECU_ADDRESS 0xD0000CFC /end MEASUREMENT
/begin MEASUREMENT wea "" UBYTE kw_q6 1 100 0.00 1530. FORMAT "%5.0" ECU_ADDRESS 0xD0000D05 /end MEASUREMENT
/begin MEASUREMENT wee "" UBYTE kw_q6 1 100 0.00 1530. FORMAT "%5.0" ECU_ADDRESS 0xD0000D06 /end MEASUREMENT
/begin MEASUREMENT weea "" UBYTE kw_q6 1 100 0.00 1530. FORMAT "%5.0" ARRAY_SIZE 3 ECU_ADDRESS 0xD0000D07 /end MEASUREMENT
/begin MEASUREMENT weemrfa "" UBYTE kw_q6 1 100 0.00 1530. FORMAT "%5.0" ECU_ADDRESS 0xD0000D02 /end MEASUREMENT
/begin MEASUREMENT weemrfabg "" UBYTE kw_q6 1 100 0.00 1530. FORMAT "%5.0" ECU_ADDRESS 0xD0000D03 /end MEASUREMENT
/begin MEASUREMENT weenst "" UBYTE kw_q6 1 100 0.00 1530. FORMAT "%5.0" ECU_ADDRESS 0xD0000D04 /end MEASUREMENT
/begin MEASUREMENT weeotkrf_w "" UWORD kw_q0p0234 1 100 0.00 1535.977 FORMAT "%8.3" ECU_ADDRESS 0xD0000754 /end MEASUREMENT
/begin MEASUREMENT weestsim "" UBYTE kw_q6 1 100 0.00 1530. FORMAT "%5.0" ECU_ADDRESS 0xD0000D0A /end MEASUREMENT
/begin MEASUREMENT wes "" UBYTE kw_q6 1 100 0.00 1530. FORMAT "%5.0" ECU_ADDRESS 0xD0000D0B /end MEASUREMENT
/begin MEASUREMENT wf_w "" SWORD rel_q0p09375 1 100 -3072.000 3071.906 FORMAT "%8.3" ECU_ADDRESS 0xD0000744 /end MEASUREMENT
/begin MEASUREMENT wmfa "" SBYTE zw_sb_q0p75 1 100 -96.00 95.25 FORMAT "%5.2" ECU_ADDRESS 0xD0000D1D /end MEASUREMENT
/begin MEASUREMENT wmfaseg "" SWORD kw_sw_q0p0219 1 100 -720.0000 719.9780 FORMAT "%8.4" ECU_ADDRESS 0xD00007A2 /end MEASUREMENT
/begin MEASUREMENT wmfl "" SBYTE zw_sb_q0p75 1 100 -96.00 95.25 FORMAT "%5.2" ECU_ADDRESS 0xD0000D1E /end MEASUREMENT
/begin MEASUREMENT wmflcd "" SWORD kw_sw_q0p0219 1 100 -720.0000 719.9780 FORMAT "%8.4" ECU_ADDRESS 0xD00007A4 /end MEASUREMENT
/begin MEASUREMENT woe_w "" UWORD kw_q0p0234 1 100 0.00 1535.977 FORMAT "%8.3" ECU_ADDRESS 0xD0000746 /end MEASUREMENT
/begin MEASUREMENT wtfa1loc_w "" UWORD spg_uw_q0p00488 1 100 0.00 319.9951 FORMAT "%8.4" ECU_ADDRESS 0xD00007AC /end MEASUREMENT
/begin MEASUREMENT wubiso_w "" UWORD spg_q0p001 1 100 0.00 65.53500 FORMAT "%8.5" ECU_ADDRESS 0xD00007B8 /end MEASUREMENT
/begin MEASUREMENT zbake "" UBYTE fak_q0p0039 1 100 0.00 0.9961 ECU_ADDRESS 0xD0000CFD /end MEASUREMENT
/begin MEASUREMENT zbale "" UBYTE fak_ub_b0p125 1 100 0.00 0.1245 FORMAT "%6.4" ECU_ADDRESS 0xD0000CFE /end MEASUREMENT
/begin MEASUREMENT zburnsum "" UBYTE dez 1 100 0.00 255.0 FORMAT "%5.1" ECU_ADDRESS 0xD0000CF5 /end MEASUREMENT
/begin MEASUREMENT zkrksdf "" UBYTE dez 1 100 0.00 255.0 FORMAT "%5.1" ECU_ADDRESS 0xD0000D1F /end MEASUREMENT
/begin MEASUREMENT zuknstm_w "" UWORD t_q0p1 1 100 0.00 6553.500 FORMAT "%8.3" ECU_ADDRESS 0xD0000748 /end MEASUREMENT
/begin MEASUREMENT zvake "" UBYTE fak_q0p0039 1 100 0.00 0.9961 ECU_ADDRESS 0xD0000CFF /end MEASUREMENT
/begin MEASUREMENT zvale "" UBYTE fak_ub_b0p125 1 100 0.00 0.1245 FORMAT "%6.4" ECU_ADDRESS 0xD0000D00 /end MEASUREMENT
/begin MEASUREMENT zzylkr "" UBYTE dez 1 100 0.00 255.0 FORMAT "%5.1" ECU_ADDRESS 0xD0000D26 /end MEASUREMENT
/begin MEASUREMENT zzylkr_dia "" UBYTE dez 1 100 0.00 255.0 FORMAT "%5.1" ECU_ADDRESS 0xD0000D20 /end MEASUREMENT
/begin MEASUREMENT zzylkr_int "" UBYTE dez 1 100 0.00 255.0 FORMAT "%5.1" ECU_ADDRESS 0xD0000D27 /end MEASUREMENT
/begin FUNCTION ESSTT "7.4.0"
 /begin DEF_CHARACTERISTIC DN10BURN FKSTT IMLHS KFHSTT KFKSTTWST KFSTHO KFWHSTT KFWKSTAB KFWKSTN KFWKSTT KLTMOTDIFF TANDT TANH TMH TMHSG TMK TMODT TWSTT ZBURNLIM /end DEF_CHARACTERISTIC
 /begin REF_CHARACTERISTIC CWWL /end REF_CHARACTERISTIC
 /begin IN_MEASUREMENT anztib B_eepwf B_nachl B_nmin B_pwf B_stendes B_stendz B_zesync dnmot_w fho imlatm kstaa nmot tans tansab tengslst tengsq1_w tmot tmotab tmst /end IN_MEASUREMENT
 /begin OUT_MEASUREMENT B_hst B_hstnl B_vbmg B_wks B_wst fsta_w fst_w tmotnldiff tmotnlmx /end OUT_MEASUREMENT
 /begin LOC_MEASUREMENT anztist B_eepesstt B_wst0 B_wst1 B_wst2 fksthaus_w fksttaus_w fst0_w fstgrund_w fwkswst_w kl_twstt_w zburnsum /end LOC_MEASUREMENT
 FUNCTION_VERSION "7.4.0" /end FUNCTION
/begin FUNCTION ESS_Axispoints "1.1.0" FUNCTION_VERSION "1.1.0" /end FUNCTION
/begin FUNCTION ESUK "6.3.0"
 /begin DEF_CHARACTERISTIC DUKK FUKBAE FUKNSTHO FUKNSTRM FUKTINEO FUKVAE FVANST KFABAK KFAVAK KFBAKL KFVAKL KLTNSUUK KLVATNST KLZKWEE RKBAUM RKUKKLU RKVAUM TKRF WFRLI ZBAKM ZBALM ZUKBAE ZUKNSTM ZUKVAE ZVAKM ZVALM /end DEF_CHARACTERISTIC
 /begin REF_CHARACTERISTIC SNM07ESUB STM09ESUB WESSOT WNWREO /end REF_CHARACTERISTIC
 /begin IN_MEASUREMENT anzti B_fs B_ll B_nswo2 B_sa B_stend drlp_w esst_snm07esub esst_stm09esub fho nmot rlp_w tef_w tmot tmst tnst_w vwkw wee /end IN_MEASUREMENT
 /begin OUT_MEASUREMENT B_ba B_bag B_ukg B_va B_vag dwf_w fbakl_w fvakl_w rkukg_w rkukk_w weeotkrf_w /end OUT_MEASUREMENT
 /begin LOC_MEASUREMENT abak avak avatnst B_redkl B_uk1 B_uke B_ukk B_ukns B_vaau B_vakl B_wf drkuke_w dwfk_w dwfl_w fbansi_w fbavst_w fnstba_w fnstva_w ftineo_w fvavst_w rkuke_w rkukgp_w rkukkl_w rkukl_w rkuk_w sdwfk_w sdwfl_w vti_w wdwee wf_w woe_w zbake zbale zuknstm_w zvake zvale /end LOC_MEASUREMENT
 FUNCTION_VERSION "6.3.0" /end FUNCTION
/begin FUNCTION ESVW "1.1.0"
 /begin DEF_CHARACTERISTIC DWEEMX FWEEMRFAM KFWEE KFWEEST KFWEETM MRFAVW SNM08GKUW SRL08GKUB STM08FSUB WEAN WEEMRFAN WEESTSM WESSOT /end DEF_CHARACTERISTIC
 /begin IN_MEASUREMENT anztib B_stendes mrfa_w nmot_w rl tmot /end IN_MEASUREMENT
 /begin OUT_MEASUREMENT B_esbnb B_esbst esst_snm08gkuw esst_srl08gkub esst_stm08fsub wea wee weea weestsim wes /end OUT_MEASUREMENT
 /begin LOC_MEASUREMENT anztibj B_mrfamx weemrfa weemrfabg weenst /end LOC_MEASUREMENT
 FUNCTION_VERSION "1.1.0" /end FUNCTION
/begin FUNCTION ESWE "1.6.0" /begin DEF_CHARACTERISTIC FIMHU FIMWU FWET KLZYKSA /end DEF_CHARACTERISTIC /begin IN_MEASUREMENT anzti B_ll B_stendes evz_austot tmot /end IN_MEASUREMENT /begin OUT_MEASUREMENT fwe /end OUT_MEASUREMENT
 /begin LOC_MEASUREMENT anzwe anzwefim anzzyksa azylwe B_afwe B_fwe danzwefim fwetm tmeswe /end LOC_MEASUREMENT
 FUNCTION_VERSION "1.6.0" /end FUNCTION
/begin FUNCTION ETC_Std "1.12.0" /begin DEF_CHARACTERISTIC Etc_MaxReqTO_C /end DEF_CHARACTERISTIC /begin OUT_MEASUREMENT Etc_ctCurRunTst /end OUT_MEASUREMENT FUNCTION_VERSION "1.12.0" /end FUNCTION
/begin FUNCTION EtkS "1.14.0" /begin DEF_CHARACTERISTIC Etks_stDisableDetection_C /end DEF_CHARACTERISTIC FUNCTION_VERSION "1.14.0" /end FUNCTION
/begin FUNCTION ExeCon "1.8.3" FUNCTION_VERSION "1.8.3" /end FUNCTION
/begin FUNCTION EXHPRESMOD "1.0.0" /begin DEF_CHARACTERISTIC DPITNUM DPUAPP FPVHKMSAB FPVHKTTA /end DEF_CHARACTERISTIC /begin IN_MEASUREMENT msabvhk_w pu_w thkmid_w /end IN_MEASUREMENT /begin OUT_MEASUREMENT pabvhk_w pabvuk_w pabvvk_w puabg_w /end OUT_MEASUREMENT /begin LOC_MEASUREMENT fpvhk_w /end LOC_MEASUREMENT FUNCTION_VERSION "1.0.0" /end FUNCTION
/begin FUNCTION Fadc "1.5.0" FUNCTION_VERSION "1.5.0" /end FUNCTION
/begin FUNCTION FanCtl_Spd "19.0.0"
 /begin DEF_CHARACTERISTIC FanCtl_facAftRunCorrd_CUR FanCtl_nThrs_C FanCtl_tClntEngOut_C FanCtl_tCooltHi_C FanCtl_tCooltLo_C FanCtl_tiAftRun_C FanCtl_tiAftRun_CUR FanCtl_tiDlyOff_C FanCtl_tiDlyOn_C FanCtl_tiDlyStrt_C /end DEF_CHARACTERISTIC
 /begin IN_MEASUREMENT ACCtl_stOut CoEng_st CoEng_tiNormalRed Epm_nEng ESC_tiSampling Fan1_r GlbDa_tEnv TS_tClntEngOut /end IN_MEASUREMENT
 /begin OUT_MEASUREMENT FanCtl_st /end OUT_MEASUREMENT
 /begin LOC_MEASUREMENT FanCtl_flgXPostDrv_mp FanCtl_tiAftRunRmn /end LOC_MEASUREMENT
 FUNCTION_VERSION "19.0.0" /end FUNCTION
/begin FUNCTION Fans_Trq "1.13.0" /begin OUT_MEASUREMENT Fans_trqCons Fans_trqResv /end OUT_MEASUREMENT FUNCTION_VERSION "1.13.0" /end FUNCTION
/begin FUNCTION Fan_DD "4.5.0"
 /begin DEF_CHARACTERISTIC Fan_DigOut0.tiBtwTstSCB_C Fan_DigOut0.tiBtwTstOT_C Fan_DigOut0.numTstMax_C Fan_rHysHi_CA Fan_rHysLo_CA Fan_stPsDiaDisblDIO_CA Fan_stPsDisDIO_CA /end DEF_CHARACTERISTIC
 /begin IN_MEASUREMENT BattU_facCor DevLib_stPwrStgEnaCond /end IN_MEASUREMENT
 /begin OUT_MEASUREMENT Fan_r Fan_stPs /end OUT_MEASUREMENT
 FUNCTION_VERSION "4.5.0" /end FUNCTION
/begin FUNCTION FlashHndl "1.11.0" FUNCTION_VERSION "1.11.0" /end FUNCTION
/begin FUNCTION FrmAppl_Std "38.0.0" /begin IN_MEASUREMENT Com_stClntFail Com_tRaw T50_st /end IN_MEASUREMENT /begin OUT_MEASUREMENT Com_ENG1S03Chksum /end OUT_MEASUREMENT FUNCTION_VERSION "38.0.0" /end FUNCTION
/begin FUNCTION FrmSch_Std "1.9.1" FUNCTION_VERSION "1.9.1" /end FUNCTION
/begin FUNCTION Frm_Std "23.0.0" FUNCTION_VERSION "23.0.0" /end FUNCTION
/begin FUNCTION FUEDK "10.2.1" /begin DEF_CHARACTERISTIC FKLAFUGD KFFLLSST KFWDKMSNVP KLSIS LLSPMSN OFMSNWDKHF /end DEF_CHARACTERISTIC /begin REF_CHARACTERISTIC FKVDVP OFMSNDKTN VPSRVDUGD /end REF_CHARACTERISTIC
 /begin IN_MEASUREMENT B_llrein B_msdkhfsg B_vpdkugd dfuelsan_w dkpsrmh_w fho ftpavdn_w ftpavd_w ftpvd_w mdverl_w msdkhfs_w msdkugd_w msdkugtx_w msllss_w msnlls_w ofmsndk_w psrdkugd_w psr_w pvd_w tans ummsnms_w vpsrvdb_w /end IN_MEASUREMENT
 /begin OUT_MEASUREMENT B_fgdkabgs B_wdkhfg B_wdkhfu IdleChrgActr_rat msnllss_w wdkhf_w wdkugd_w wdkugtx_w /end OUT_MEASUREMENT
 /begin LOC_MEASUREMENT msndkoos_w umsnmsok_w umsnmsug_w wdkhfu_w /end LOC_MEASUREMENT
 FUNCTION_VERSION "10.2.1" /end FUNCTION
/begin FUNCTION GConf_Sy "" /end FUNCTION
/begin FUNCTION getErf "" /begin IN_MEASUREMENT sfpArray /end IN_MEASUREMENT /end FUNCTION
/begin FUNCTION GGDKG "10.3.0"
 /begin DEF_CHARACTERISTIC CWTPTC DWDK DWDKBAMX DWDKLA DWDKSLN GRADWDK QDPSLL TDDK UWDKDO UWDKDU UWDKOFF WDKBASLN WDKDU WDKNLN WKLLX ZWDK /end DEF_CHARACTERISTIC
 /begin IN_MEASUREMENT B_pwf B_st ml_w nmot uwdk_w wdkhf_w /end IN_MEASUREMENT
 /begin OUT_MEASUREMENT B_edks B_ll B_mndk B_mxdk dwdkba_w s1fl2p11 s1fl2p45 wdkba wdkba_w wdklmr_w wdkma_w wdkmi_w wdkpm_w wdkraw_w wdk_w /end OUT_MEASUREMENT
 /begin LOC_MEASUREMENT wdkbl_w wdklmn_w wdklm_w /end LOC_MEASUREMENT
 FUNCTION_VERSION "10.3.0" /end FUNCTION
/begin FUNCTION GGDSS "2.4.0" /begin DEF_CHARACTERISTIC DSSGRAD DSSOFS NMINPSINI TDDSR UADPSRMN UADPSRMX /end DEF_CHARACTERISTIC /begin REF_CHARACTERISTIC NPSRSEG /end REF_CHARACTERISTIC /begin IN_MEASUREMENT B_syn2fe Epm_nEng10ms nmot_w udss_w /end IN_MEASUREMENT /begin OUT_MEASUREMENT B_psinirg B_psrmw B_psrrg psini_w psrrff_w psrr_w /end OUT_MEASUREMENT
 /begin LOC_MEASUREMENT B_psinical B_psremn B_psremni B_psremx B_psremxi noupsini udsm_w upsinisu_l /end LOC_MEASUREMENT
 FUNCTION_VERSION "2.4.0" /end FUNCTION
/begin FUNCTION GGFSTT "4.0.0" /begin DEF_CHARACTERISTIC FSTTAH FSTTAL FSTTPWF TDFST /end DEF_CHARACTERISTIC /begin IN_MEASUREMENT B_pwf tfst_w /end IN_MEASUREMENT /begin OUT_MEASUREMENT B_tal fsttval /end OUT_MEASUREMENT FUNCTION_VERSION "4.0.0" /end FUNCTION
/begin FUNCTION GGKR "7.0.0"
 /begin DEF_CHARACTERISTIC CWKRSHIFT FMFKRZN KEMLN KFMAKR NDKSF NKRFM1 NKRFM2 NKRFM3 SENZZYL /end DEF_CHARACTERISTIC
 /begin REF_CHARACTERISTIC Epm_phiTdc1_C KRANH SNMKRA SRL04KRUB /end REF_CHARACTERISTIC
 /begin IN_MEASUREMENT B_krldy B_krndy B_nldg KnDet_ctCyl KnDet_ctIntegRsltInvld KnDet_IntegWinEnd KnDet_stDiaCtl KnDet_stSigEvalCurrCmb nmot rl vkr /end IN_MEASUREMENT
 /begin OUT_MEASUREMENT dkrksanf fmfkrnew_w krintka1_w kr_monitor ksnew stkrfmf vkrnew wmfaseg wmflcd zzylkr zzylkr_int /end OUT_MEASUREMENT
 /begin LOC_MEASUREMENT akrcderr_w wmfa wmfl zkrksdf zzylkr_dia /end LOC_MEASUREMENT
 FUNCTION_VERSION "7.0.0" /end FUNCTION
/begin FUNCTION GGTCW "1.7.0" /begin DEF_CHARACTERISTIC CWTMOTRA TCUTCW TMOTELI /end DEF_CHARACTERISTIC /begin OUT_MEASUREMENT B_tmotra tmotlin tmotlinf tmottstr_w utcwf_w utcw_w /end OUT_MEASUREMENT FUNCTION_VERSION "1.7.0" /end FUNCTION
/begin FUNCTION GGTFA "1.4.1"
 /begin DEF_CHARACTERISTIC CWTFA LIMAIRTFA1 MLDTFA TCTFA1 TDELTFA TDTFA1 TDTFA1HL TFA1ELI TMMNEDTFA TMSTTFAENA VFZGTFA WTFA1MN WTFA1MX /end DEF_CHARACTERISTIC
 /begin IN_MEASUREMENT B_etfa1fcl imlatm ml tmot tmst vfzg /end IN_MEASUREMENT
 /begin OUT_MEASUREMENT B_elhltfa1 B_elmntfa1 B_elmxtfa1 B_elnptfa1 B_enpstfa1 tfa1limf tfa1lin tfa1linf /end OUT_MEASUREMENT
 /begin LOC_MEASUREMENT B_pemntfa1 B_pemxtfa1 B_tfaedena wtfa1loc_w /end LOC_MEASUREMENT
 FUNCTION_VERSION "1.4.1" /end FUNCTION
/begin FUNCTION GGUBHR "1.4.0"
 /begin DEF_CHARACTERISTIC CWME7 TDNSUB TDNSUBR TDUB TDUBEVAB UBDMN1 UBDMN2 UBDMX UBEVAB VMDUB ZKUBSQF01 /end DEF_CHARACTERISTIC
 /begin IN_MEASUREMENT B_hr B_stend vfzg wub_w /end IN_MEASUREMENT
 /begin OUT_MEASUREMENT B_hrevab B_ubg B_ubrk B_ubrmax ub ubrsq ubrsq_w ubsq ubsqf ubsqf_w ubsq_w wubiso_w /end OUT_MEASUREMENT
 /begin LOC_MEASUREMENT tp_u32 ttdnsubr_w ttdnsub_w /end LOC_MEASUREMENT
 FUNCTION_VERSION "1.4.0" /end FUNCTION
/begin FUNCTION GK "4.4.0"
 /begin IN_MEASUREMENT B_stendes fgru fnswl_w fra_w fr_w fst_w fwe lamsbg_w redist rka_w rkte_w rkukg_w rlp_w /end IN_MEASUREMENT
 /begin OUT_MEASUREMENT fvst_w rkg_w rkmeeff_w rkvmeeff_w rk_l rk_w rllaso_w /end OUT_MEASUREMENT
 FUNCTION_VERSION "4.4.0" /end FUNCTION
/begin FUNCTION GlbDa_Axispoints "2.1.0" FUNCTION_VERSION "2.1.0" /end FUNCTION
/begin FUNCTION GlbDa_LSum "2.9.1" /begin DEF_CHARACTERISTIC GlbDa_lDstLim_C /end DEF_CHARACTERISTIC /begin IN_MEASUREMENT CoEng_st VehV_v /end IN_MEASUREMENT /begin OUT_MEASUREMENT GlbDa_lTotDst /end OUT_MEASUREMENT /begin LOC_MEASUREMENT GlbDa_lTotDstLstStored_mp /end LOC_MEASUREMENT FUNCTION_VERSION "2.9.1" /end FUNCTION
/begin FUNCTION GlbDa_SetData "2.11.0"
 /begin DEF_CHARACTERISTIC GlbDa_aX_C GlbDa_lWhlCirc_C GlbDa_pEnv_C GlbDa_rTrqDfl_C GlbDa_tEnv_C GlbDa_tiFltAX_C GlbDa_tiFltVX_C GlbDa_tIndAir_C GlbDa_vX_C /end DEF_CHARACTERISTIC
 /begin IN_MEASUREMENT Air_tCACDs EnvP_p EnvT_t PT_rTrq PT_rTrqWoConvRat VehMot_rTrqDfftl VehV_a VehV_v /end IN_MEASUREMENT
 /begin OUT_MEASUREMENT GlbDa_aX GlbDa_aXFlt GlbDa_lWhlCirc GlbDa_pEnv GlbDa_rTrqTot GlbDa_rTrqTotWoConvRat GlbDa_tEnv GlbDa_tIndAir GlbDa_vX GlbDa_vXFlt /end OUT_MEASUREMENT
 FUNCTION_VERSION "2.11.0" /end FUNCTION
/begin FUNCTION GlbDa_TrqDem "3.0.0" /begin DEF_CHARACTERISTIC GlbDa_stVehLimMin_C GlbDa_trqVehLimMin_C /end DEF_CHARACTERISTIC
 /begin IN_MEASUREMENT CoVeh_trqAcs CoVeh_trqPrpLimErr PT_rTrq PT_stStabIntv PT_stTraIntv PT_trqLos PT_trqTraPrt SpdGov_st VehMot_stLimDfftl VehMot_stPrpAccPed VehMot_stStabIntv VehMot_trqPrtDfftl /end IN_MEASUREMENT
 /begin OUT_MEASUREMENT GlbDa_stTrqDem GlbDa_stVehLimMin GlbDa_trqCrSVehLimMin GlbDa_trqVehLimMin /end OUT_MEASUREMENT
 FUNCTION_VERSION "3.0.0" /end FUNCTION
/begin FUNCTION Gpta "1.13.0" FUNCTION_VERSION "1.13.0" /end FUNCTION
/begin FUNCTION HBr "1.0.0" FUNCTION_VERSION "1.0.0" /end FUNCTION
/begin FUNCTION HEGOD_DynSimn "1.0.1"
 /begin DEF_CHARACTERISTIC HEGOD_stDynSimn_CW HEGOD_tiFltSimn_C HEGOD_tiFolwLRSimn_C HEGOD_tiFolwRLSimn_C HEGOD_tiFolwSimn_C HEGOD_tiHldLRSimn_C HEGOD_tiHldRLSimn_C HEGOD_tiHldSimn_C HEGOD_tiVltFltSimn_C HEGOD_stPosnSimn_CW /end DEF_CHARACTERISTIC
 /begin IN_MEASUREMENT HEGO_uS1B1WoDynSim SyC_stSub /end IN_MEASUREMENT
 /begin OUT_MEASUREMENT HEGO_uS1B1WiDynSim /end OUT_MEASUREMENT
 /begin LOC_MEASUREMENT HEGOD_S1B1Simn_I.bFolwLR HEGOD_S1B1Simn_I.bFolwRL HEGOD_S1B1Simn_I.bHldLR HEGOD_S1B1Simn_I.bHldRL HEGOD_S1B1Simn_I.bVltgFall HEGOD_S1B1Simn_I.bVltgRise HEGOD_S1B1Simn_I.tiHld HEGOD_S1B1Simn_I.uWiSimn HEGOD_S1B1Simn_I.uWoSimnFlt HEGOD_S1B1Simn_I.FolwSimnLT_I.memory HEGOD_S1B1Simn_I.VltFltLT_I.memory /end LOC_MEASUREMENT
 FUNCTION_VERSION "1.0.1" /end FUNCTION
/begin FUNCTION HEGOD_RstrcnDs "1.2.0" FUNCTION_VERSION "1.2.0" /end FUNCTION
/begin FUNCTION HEGOD_StkUs "1.1.1"
 /begin DEF_CHARACTERISTIC HEGOD_mEGStkUs_C HEGOD_tiDebErrStkHiUs_C HEGOD_tiDebErrStkLowUs_C HEGOD_tiDebRstErrStk_C HEGOD_uLeanDsStkUs_C HEGOD_uRichDsStkUs_C HEGOD_uS1RichOpRdn_C /end DEF_CHARACTERISTIC
 /begin REF_CHARACTERISTIC HEGO_uErrElecMax_C USRW /end REF_CHARACTERISTIC
 /begin IN_MEASUREMENT B_cdlsh B_pwf B_stend B_cdlsv B_dtes B_lr B_sgnlr HEGO_bS1B1EnaDElec HEGO_bS1B1Vld HEGO_uS1B1Extd msaovvk_w /end IN_MEASUREMENT
 /begin OUT_MEASUREMENT HEGOD_bEnaStkLowUs /end OUT_MEASUREMENT
 /begin LOC_MEASUREMENT HEGOD_StkUsS1B1_I.bErrStkHiUs HEGOD_StkUsS1B1_I.bErrStkLowUs HEGOD_StkUsS1B1_I.bMsEGStkUs HEGOD_StkUsS1B1_I.mEGStkUs HEGOD_StkUsS1B1_I.DebErrStkHiUsTONV_I.outbit HEGOD_StkUsS1B1_I.DebErrStkHiUsTONV_I.time HEGOD_StkUsS1B1_I.DebErrStkLowUsTONV_I.outbit HEGOD_StkUsS1B1_I.DebErrStkLowUsTONV_I.time HEGOD_StkUsS1B1_I.ErrStkHiFF_I.status HEGOD_StkUsS1B1_I.ErrStkHiSusFF_I.status HEGOD_StkUsS1B1_I.ErrStkLowFF_I.status HEGOD_StkUsS1B1_I.MsEGStkUsIK_I.memory HEGOD_StkUsS1B1_I.SignLamCtlEBFF_I.status HEGOD_StkUsS1B1_I.SignLamCtlEB_I.buffer HEGOD_StkUsS1B1_I.SignLamCtlEB_I.oldSignal /end LOC_MEASUREMENT
 FUNCTION_VERSION "1.1.1" /end FUNCTION
/begin FUNCTION HEGO_H2Cor "1.5.0" FUNCTION_VERSION "1.5.0" /end FUNCTION
/begin FUNCTION HEGO_Htg "3.2.1"
 /begin DEF_CHARACTERISTIC HEGO_stHtgEna_CW HEGO_tEGHtgOffStop_C HEGO_tEngMinHtg_C HEGO_tiDebBattHtgOff_C HEGO_tiHtrPsRst_C HEGO_uBattHtgOff_C HEGO_duHtgMapMax_C HEGO_duHtgRmpDwnTSP_C HEGO_duHtgRmpDwn_C HEGO_duHtgRmpUpTSP_C HEGO_duHtgRmpUp_C HEGO_duNomHtgIMaxTSP_C HEGO_duNomHtgIMax_C HEGO_duNomHtgIMinTSP_C HEGO_duNomHtgIMin_C HEGO_duNomHtgPMaxTSP_C HEGO_duNomHtgPMax_C HEGO_duNomHtgPMinTSP_C HEGO_duNomHtgPMin_C HEGO_duNomHtgRedErrElecMin_C HEGO_facHtgIGnTSP_C HEGO_facHtgIGn_C HEGO_facHtgPGnTSP_CUR HEGO_facHtgPGn_CUR HEGO_resRiDBndMaxTSP_C HEGO_resRiDBndMax_C HEGO_resRiDBndMinTSP_C HEGO_resRiDBndMin_C HEGO_resRiHtgOffTSP_C HEGO_resRiHtgOff_C HEGO_resRiHtgRedTSP_C HEGO_resRiNomTSP_C HEGO_resRiNom_C HEGO_rHtgMaxAntiWindUpTSP_C HEGO_rHtgMaxAntiWindUp_C HEGO_rHtgMinAntiWindUpTSP_C HEGO_rHtgMinAntiWindUp_C HEGO_tEGHtgRed_C HEGO_tEGMaxHtgEna_C HEGO_tEngHotHtg_C HEGO_tiDebFrzRiHtg_C HEGO_tiDebHtgMapClsdLopTSP_C HEGO_tiDebHtgMapClsdLop_C HEGO_tiDebHtgMaxHys_C HEGO_tiDebHtgMax_C HEGO_tiDebHtrPsCurrLim_C HEGO_tiFltRiHtg_C HEGO_tiMaxHtgRedTSP_C HEGO_tiMaxHtgRed_C HEGO_uHtgAftPrtTSP_CUR HEGO_uHtgAftPrt_CUR HEGO_uHtgMaxDeb_C HEGO_uHtgMaxHtUpTSP_C HEGO_uHtgMaxHtUp_C HEGO_uHtgMax_C HEGO_uHtgNom_C HEGO_HtgS1B1_I.pwrHtgSuffMin_C HEGO_HtgS1B1_I.stHtg_CW HEGO_HtgS1B1_I.tEGHtgSuffMin_C HEGO_HtgS1B1_I.tiFltTEGHtg_CUR HEGO_HtgS1B1_I.tiHtgSuffDeb_C HEGO_HtgS1B1_I.uDrpHtg_C HEGO_HtgS1B1_I.uHtgMapCtlTSP_MAP HEGO_HtgS1B1_I.uHtgMapCtl_MAP HEGO_HtgS1B1_I.uHtgPrt_C /end DEF_CHARACTERISTIC
 /begin IN_MEASUREMENT B_stend tmot B_atmst B_atmtpa HEGO_bS1B1ErrElecMinWoDeb HEGO_bS1B1FrzRi HEGO_bS1B1Vld HEGO_bS1B1VldRi HEGO_resS1B1RiNoFlt msabg_w tavso_w ubsq_w /end IN_MEASUREMENT
 /begin OUT_MEASUREMENT HEGO_bS1B1HtgCtlTSP HEGO_bS1B1HtgOn HEGO_bS1B1HtgPrtFin HEGO_bS1B1HtgRiReq HEGO_bS1B1HtgSuff HEGO_bS1HtgEna HEGO_bS1HtgRst HEGO_pwrS1B1Htg /end OUT_MEASUREMENT
 /begin LOC_MEASUREMENT HEGO_bS1HtgEnaEngHot HEGO_bS1HtgEnaER_I.buffer HEGO_bS1HtgEnaER_I.oldSignal HEGO_HtgCyclS1_I.bStrtHtgCycl HEGO_HtgCyclS1_I.HtgCyclT_I.timeCounter HEGO_HtgEnaS1_I.bEngStrtFinFF HEGO_HtgEnaS1_I.bHtgEna HEGO_HtgEnaS1_I.bHtgEnaEngHot HEGO_HtgEnaS1_I.bHtgRst HEGO_HtgEnaS1_I.BattHtgOffTONV_I.outbit HEGO_HtgEnaS1_I.BattHtgOffTONV_I.time HEGO_HtgEnaS1_I.HtgRstEF_I.buffer HEGO_HtgEnaS1_I.HtgRstEF_I.oldSignal HEGO_HtgEnaS1_I.HtgRstTE_I.timeCounter HEGO_HtgEnaS1_I.HtgRstTOFV_I.outbit HEGO_HtgEnaS1_I.HtgRstTOFV_I.time HEGO_HtgS1B1_I.B_atmtxOld HEGO_HtgS1B1_I.bHtgClsdLopAntiWndUp HEGO_HtgS1B1_I.bHtgClsdLopEna HEGO_HtgS1B1_I.bHtgClsdLopRiReq HEGO_HtgS1B1_I.bHtgMap HEGO_HtgS1B1_I.bHtgOffHiTemp HEGO_HtgS1B1_I.bHtgOnReq HEGO_HtgS1B1_I.bHtgOnReqCurrLim HEGO_HtgS1B1_I.bHtgOnReqNoCurrLim HEGO_HtgS1B1_I.bHtgOnRls HEGO_HtgS1B1_I.bHtgOnTstr HEGO_HtgS1B1_I.bHtgPrtFin HEGO_HtgS1B1_I.bHtgStrt HEGO_HtgS1B1_I.bHtgStrtPwrRed HEGO_HtgS1B1_I.bHtgSuff HEGO_HtgS1B1_I.bHtgTSP HEGO_HtgS1B1_I.bHtrPsCurrLim HEGO_HtgS1B1_I.bNewRiAvl HEGO_HtgS1B1_I.bRiActAvl HEGO_HtgS1B1_I.ctHtgCyclHi HEGO_HtgS1B1_I.dresRi HEGO_HtgS1B1_I.duNomHtgClsdLop HEGO_HtgS1B1_I.duNomHtgI HEGO_HtgS1B1_I.duNomHtgP HEGO_HtgS1B1_I.pwrHtg HEGO_HtgS1B1_I.rHtg HEGO_HtgS1B1_I.resRiAct HEGO_HtgS1B1_I.tEGFltHtg HEGO_HtgS1B1_I.tiHtgOn HEGO_HtgS1B1_I.tiHtgOnHi HEGO_HtgS1B1_I.tiHtgOnLo HEGO_HtgS1B1_I.tiHtgOnOff HEGO_HtgS1B1_I.uBattHtg HEGO_HtgS1B1_I.uNomHtg HEGO_HtgS1B1_I.uNomHtgAftPrt HEGO_HtgS1B1_I.uNomHtgLim HEGO_HtgS1B1_I.uNomHtgMap HEGO_HtgS1B1_I.uNomHtgNoLim HEGO_HtgS1B1_I.uNomHtgOpenLop HEGO_HtgS1B1_I.uNomHtgStrt HEGO_HtgS1B1_I.B_atmstERNM_I.oldSignal HEGO_HtgS1B1_I.DebFrzRiTOFFV_I.outbit HEGO_HtgS1B1_I.DebFrzRiTOFFV_I.time HEGO_HtgS1B1_I.DebHtgMapClsdLopTONV_I.outbit HEGO_HtgS1B1_I.DebHtgMapClsdLopTONV_I.time HEGO_HtgS1B1_I.DebHtgMaxTOFV_I.outbit HEGO_HtgS1B1_I.DebHtgMaxTOFV_I.time HEGO_HtgS1B1_I.HtgCyclCTR_I.counter HEGO_HtgS1B1_I.HtgRedTONV_I.outbit HEGO_HtgS1B1_I.HtgRedTONV_I.time HEGO_HtgS1B1_I.HtgTR_I.timeCounter HEGO_HtgS1B1_I.RiHtgLP_I.memory HEGO_HtgS1B1_I.bFrzRiEF_I.buffer HEGO_HtgS1B1_I.bFrzRiEF_I.oldSignal HEGO_HtgS1B1_I.bFrzRiFF_I.status HEGO_HtgS1B1_I.bHtgClsdLopEnaER_I.buffer HEGO_HtgS1B1_I.bHtgClsdLopEnaER_I.oldSignal HEGO_HtgS1B1_I.bHtgRiReqFF_I.status HEGO_HtgS1B1_I.bHtgStrtERNM_I.oldSignal HEGO_HtgS1B1_I.bHtgSuffTONVNM_I.time HEGO_HtgS1B1_I.tEGHtgLP_I.memory HEGO_HtgS1B1_I.uNomHtgStrtAL_I.memory /end LOC_MEASUREMENT
 FUNCTION_VERSION "3.2.1" /end FUNCTION
/begin FUNCTION HEGO_OBDElec "1.13.1"
 /begin DEF_CHARACTERISTIC HEGO_duErrElecMinLdPls_C HEGO_tiDelLdPlsMin_C HEGO_tiDebFCOOpnGnd_C HEGO_tiDebGenDElecS1_C HEGO_uErrElecOpnGnd_C HEGO_duErrElecSigLdPls_C HEGO_tiDelLdPlsSig_C HEGO_duErrElecHtrCpl_C HEGO_numHtrCpl_C HEGO_numHtrOff_C HEGO_resErrElecSigRi_C HEGO_resRstErrElecSigRi_C HEGO_tEGErrElecSigRi_C HEGO_tiDebDPEHtrCpl_C HEGO_tiDebErrElecMax_C HEGO_tiDebErrElecMinSus_C HEGO_tiDebErrElecMin_C HEGO_tiDebErrElecSigSus_C HEGO_tiDebGenDElec_C HEGO_tiFrmHtrCpl_C HEGO_uErrElecMin_C HEGO_numRiOkOpRdn_C HEGO_resRiOpRdn_C HEGO_tiDebRstErrStkCVB_C HEGO_uOpRdnLSFXfour_C HEGO_OpRdnS1B1_I.stDElec_CW HEGO_OpRdnS1B1_I.tiDebErrStk_C HEGO_OpRdnS1B1_I.tiDebExptOpRdn_CUR HEGO_OpRdnS1B1_I.tiDebPrtHtgFin_C HEGO_stDElec_CW HEGO_uBattMinDElec_C HEGO_uErrElecMax_C HEGO_uS1LeanOpRdn_C HEGO_uS1RichOpRdn_C /end DEF_CHARACTERISTIC
 /begin IN_MEASUREMENT B_eev B_pwf B_sa B_atmtpa B_cdlsv B_lr B_nmot B_sgnlr HEGO_bS1B1FrzRi HEGO_bS1B1HtgOn HEGO_bS1B1HtgPrtFin HEGO_bS1B1LdPlsRslt HEGO_bS1B1VldRi HEGO_resS1B1Ri HEGO_resS1B1RiNoFlt HEGO_uS1B1Extd HEGO_uS1B1LdPls HEGO_uS2B1Extd lamsons_w msaovvk_w tavso_w twvso_w ubsq /end IN_MEASUREMENT
 /begin OUT_MEASUREMENT B_sbbvk B_ttbmhv HEGO_bEnaDElecPhy HEGO_bS1B1EnaDElec HEGO_bS1B1ErrElecHtrCpl HEGO_bS1B1ErrElecMinWoDeb HEGO_bS1B1ErrElecSig HEGO_bS1B1ErrElecSigPrev HEGO_bS1B1ErrElecSigRi HEGO_bS1B1ExptOpRdn HEGO_bS1B1LdPlsMinReq HEGO_bS1B1LdPlsSigCnfReq HEGO_bS1B1LdPlsSigReq HEGO_bS1B1OpRdnRiReq HEGO_bS1B1Vld HEGO_uS1B1ExtdMax HEGO_uS1B1LdPlsMax HEGO_uS1B1LdPlsMin /end OUT_MEASUREMENT
 /begin LOC_MEASUREMENT HEGO_OBDElecS1B1_I.bErrHtrCpl HEGO_OBDElecS1B1_I.bErrOpnGnd HEGO_OBDElecS1B1_I.bErrOpnGndDyn HEGO_OBDElecS1B1_I.DebErrOpnGndDynTONV_I.outbit HEGO_OBDElecS1B1_I.DebErrOpnGndDynTONV_I.time HEGO_OBDElecS1B1_I.DebErrOpnGndTONV_I.outbit HEGO_OBDElecS1B1_I.DebErrOpnGndTONV_I.time HEGO_OBDElecS1B1_I.DebFCOOpnGndTONV_I.outbit HEGO_OBDElecS1B1_I.DebFCOOpnGndTONV_I.time HEGO_OBDElecS1B1_I.ErrOpnGndFF_I.status HEGO_OBDElecS1B1_I.HEGO_OBDElecS1_I.bErrElecMinWoDeb HEGO_OBDElecS1B1_I.HEGO_OBDElecS1_I.bErrElecSig HEGO_OBDElecS1B1_I.HEGO_OBDElecS1_I.bErrHtrCpl HEGO_OBDElecS1B1_I.HEGO_OBDElecS1_I.bHtrCplFin HEGO_OBDElecS1B1_I.HEGO_OBDElecS1_I.bMaxNumHtrCpl HEGO_OBDElecS1B1_I.HEGO_OBDElecS1_I.bSuffNumHtrOff HEGO_OBDElecS1B1_I.HEGO_OBDElecS1_I.DebDPEHtrCplTONV_I.outbit HEGO_OBDElecS1B1_I.HEGO_OBDElecS1_I.DebDPEHtrCplTONV_I.time HEGO_OBDElecS1B1_I.HEGO_OBDElecS1_I.DebErrElecMaxTONV_I.outbit HEGO_OBDElecS1B1_I.HEGO_OBDElecS1_I.DebErrElecMaxTONV_I.time HEGO_OBDElecS1B1_I.HEGO_OBDElecS1_I.DebErrElecMinTONV_I.outbit HEGO_OBDElecS1B1_I.HEGO_OBDElecS1_I.DebErrElecMinTONV_I.time HEGO_OBDElecS1B1_I.HEGO_OBDElecS1_I.DebErrElecSigSusTONV_I.outbit HEGO_OBDElecS1B1_I.HEGO_OBDElecS1_I.DebErrElecSigSusTONV_I.time HEGO_OBDElecS1B1_I.HEGO_OBDElecS1_I.DebRstErrElecMinTONV_I.outbit HEGO_OBDElecS1B1_I.HEGO_OBDElecS1_I.DebRstErrElecMinTONV_I.time HEGO_OBDElecS1B1_I.HEGO_OBDElecS1_I.EndFrmHtrCplEF_I.oldSignal HEGO_OBDElecS1B1_I.HEGO_OBDElecS1_I.ErrElecMinFF_I.status HEGO_OBDElecS1B1_I.HEGO_OBDElecS1_I.ErrElecSigRiFF_I.status HEGO_OBDElecS1B1_I.HEGO_OBDElecS1_I.FrmHtrCplFF_I.status HEGO_OBDElecS1B1_I.HEGO_OBDElecS1_I.FrmHtrCplTOFV_I.outbit HEGO_OBDElecS1B1_I.HEGO_OBDElecS1_I.FrmHtrCplTOFV_I.time HEGO_OBDElecS1B1_I.HEGO_OBDElecS1_I.HEGO_OBDElecMin_I.bErrMinLdPls HEGO_OBDElecS1B1_I.HEGO_OBDElecS1_I.HEGO_OBDElecMin_I.bLdPlsMinReq HEGO_OBDElecS1B1_I.HEGO_OBDElecS1_I.HEGO_OBDElecMin_I.sm HEGO_OBDElecS1B1_I.HEGO_OBDElecS1_I.HEGO_OBDElecSig_I.bErrSigLdPls HEGO_OBDElecS1B1_I.HEGO_OBDElecS1_I.HEGO_OBDElecSig_I.bErrSigSusLdPls HEGO_OBDElecS1B1_I.HEGO_OBDElecS1_I.HEGO_OBDElecSig_I.bLdPlsSigCnfExe HEGO_OBDElecS1B1_I.HEGO_OBDElecS1_I.HEGO_OBDElecSig_I.bLdPlsSigCnfReq HEGO_OBDElecS1B1_I.HEGO_OBDElecS1_I.HEGO_OBDElecSig_I.bLdPlsSigExe HEGO_OBDElecS1B1_I.HEGO_OBDElecS1_I.HEGO_OBDElecSig_I.bLdPlsSigReq HEGO_OBDElecS1B1_I.HEGO_OBDElecS1_I.HEGO_OBDElecSig_I.sm HEGO_OBDElecS1B1_I.HEGO_OBDElecS1_I.HtrCplCTR_I.counter HEGO_OBDElecS1B1_I.HEGO_OBDElecS1_I.HtrOffCTR_I.counter HEGO_OBDElecS1B1_I.HEGO_OBDElecS1_I.StrtFrmHtrCplEF_I.buffer HEGO_OBDElecS1B1_I.HEGO_OBDElecS1_I.StrtFrmHtrCplEF_I.oldSignal HEGO_OpRdnS1B1_I.bEna HEGO_OpRdnS1B1_I.bEnaDElec HEGO_OpRdnS1B1_I.bEnaOpRdnHtg HEGO_OpRdnS1B1_I.bErrSigPrev HEGO_OpRdnS1B1_I.bNewRiAvl HEGO_OpRdnS1B1_I.bOpRdnRiReq HEGO_OpRdnS1B1_I.bRiOkOpRdn HEGO_OpRdnS1B1_I.bSVld HEGO_OpRdnS1B1_I.DebErrStkTONV_I.outbit HEGO_OpRdnS1B1_I.DebErrStkTONV_I.time HEGO_OpRdnS1B1_I.DebExptOpRdnTONV_I.outbit HEGO_OpRdnS1B1_I.DebExptOpRdnTONV_I.time HEGO_OpRdnS1B1_I.DebPrtHtgFinTONV_I.outbit HEGO_OpRdnS1B1_I.DebPrtHtgFinTONV_I.time HEGO_OpRdnS1B1_I.DebRstErrStkCVBTONV_I.time HEGO_OpRdnS1B1_I.DebSVldTONV_I.outbit HEGO_OpRdnS1B1_I.DebSVldTONV_I.time HEGO_OpRdnS1B1_I.SVldFF_I.status HEGO_OpRdnS1B1_I.StkCVBSusFF_I.status /end LOC_MEASUREMENT
 FUNCTION_VERSION "1.13.1" /end FUNCTION
/begin FUNCTION HEGO_OBDHtg "1.8.0"
 /begin DEF_CHARACTERISTIC HEGO_resRiHystDHtg_C HEGO_resRiMaxHtgSuff_C HEGO_tEGDHtgMax_C HEGO_tEGDHtgMin_C HEGO_tEGDHtgShrtTrpMax_C HEGO_tEGDHtgShrtTrpMin_C HEGO_tEGFltMin_C HEGO_tiDebErrHtgFIDRls_C HEGO_tiDebErrHtg_C HEGO_tiDebHealHtgErr_C HEGO_tiDebHealHtg_C HEGO_tiFltPwrHtg_C HEGO_tiFltTempEG_CUR HEGO_OBDHtgS1B1_I.resRiThresDHtg_MAP HEGO_stS1DHtg_CW HEGO_tiDebDHtgFuncReq_C HEGO_tiEngStopDHtgMin_C HEGO_tIntkAirThrDHtgMin_C HEGO_uBattDHtgMax_C HEGO_uBattDHtgMin_C /end DEF_CHARACTERISTIC
 /begin IN_MEASUREMENT B_nmot B_sa B_atmst B_cdhsv B_fa B_fahsv B_pwf B_stend HEGO_bS1B1ErrElecSigRi HEGO_bS1B1ExptOpRdn HEGO_bS1B1VldRi HEGO_pwrS1B1Htg HEGO_resS1B1Ri msabg_w tandk_w tavso_w tengsq1z_w tengszlst ubsq_w /end IN_MEASUREMENT
 /begin OUT_MEASUREMENT B_env HEGO_bEnaDPs HEGO_bS1B1EnaDHtg HEGO_dresS1B1RiThresMin HEGO_resS1B1RiThres HEGO_tS1B1EGFltDHtg rinsv_w /end OUT_MEASUREMENT
 /begin LOC_MEASUREMENT HEGO_OBDHtgS1B1_I.bEnaDHtg HEGO_OBDHtgS1B1_I.bEnaDHtgFCMClrEngRun HEGO_OBDHtgS1B1_I.bErrHtg HEGO_OBDHtgS1B1_I.bHtgSuffRi HEGO_OBDHtgS1B1_I.bRiImPlausHi HEGO_OBDHtgS1B1_I.pwrHtgFlt HEGO_OBDHtgS1B1_I.resRiThresDHtg HEGO_OBDHtgS1B1_I.tEGFlt /end LOC_MEASUREMENT
 FUNCTION_VERSION "1.8.0" /end FUNCTION
/begin FUNCTION HEGO_OBDHtrPs "1.6.0"
 /begin DEF_CHARACTERISTIC HEGO_tiDebDHtrPsEna_C HEGO_tiDebPsErr_C HEGO_tiDebPs_C HEGO_uPsHi_C HEGO_uPsLo_C HEGO_stS1Ps_CW HEGO_uBattMaxDHtrPs_C /end DEF_CHARACTERISTIC
 /begin REF_CHARACTERISTIC TVP /end REF_CHARACTERISTIC
 /begin IN_MEASUREMENT B_desee B_atmtpa HEGO_bEnaDPs HEGO_bS1B1HtgOn HEGO_bS1HtgEna ubsq_w /end IN_MEASUREMENT
 /begin LOC_MEASUREMENT HEGO_OBDHtrPsS1B1_I.bPsOk /end LOC_MEASUREMENT
 FUNCTION_VERSION "1.6.0" /end FUNCTION
/begin COMPU_METHOD Acc "" RAT_FUNC "%6.5" "m/s^2" COEFFS 0 1000 0 0 0 1 /end COMPU_METHOD
/begin COMPU_METHOD B_TRUE "" TAB_VERB "%6.3" "" COMPU_TAB_REF B_TRUE /end COMPU_METHOD
/begin COMPU_VTAB B_TRUE "" TAB_VERB 2 0 "----" 1 "TRUE" /end COMPU_VTAB
/begin COMPU_METHOD dez "" RAT_FUNC "%6.2" "" COEFFS 0 1 0 0 0 1 /end COMPU_METHOD
/begin COMPU_METHOD dezsub1 "" RAT_FUNC "%6.2" "-" COEFFS 0 1 -1 0 0 1 /end COMPU_METHOD
/begin COMPU_METHOD dgrad_uw_q0p015 "" RAT_FUNC "%6.4" "hPa/V" COEFFS 0 65536 0 0 0 1024 /end COMPU_METHOD
/begin COMPU_METHOD EngN "" RAT_FUNC "%6.3" "rpm" COEFFS 0 2 0 0 0 1 /end COMPU_METHOD
/begin COMPU_METHOD Fact1 "" RAT_FUNC "%6.4" "-" COEFFS 0 128 0 0 0 1 /end COMPU_METHOD
/begin COMPU_METHOD fak_q0p000305 "" RAT_FUNC "%6.5" "-" COEFFS 0 65536 0 0 0 20 /end COMPU_METHOD
/begin COMPU_METHOD fak_q0p0039 "" RAT_FUNC "%6.4" "-" COEFFS 0 256 0 0 0 1 /end COMPU_METHOD
/begin COMPU_METHOD fak_q0p01 "" RAT_FUNC "%6.4" "" COEFFS 0 100 0 0 0 1 /end COMPU_METHOD
/begin COMPU_METHOD fak_q16_hPahPa "" RAT_FUNC "%6.1" "hPa*hPa" COEFFS 0 1 0 0 0 16 /end COMPU_METHOD
/begin COMPU_METHOD fak_q20_hPahPa_mul_h_div_kg "" RAT_FUNC "%6.1" "hPa*hPa*h/kg" COEFFS 0 1 0 0 0 20 /end COMPU_METHOD
/begin COMPU_METHOD fak_q3p0518Em5 "" RAT_FUNC "%7.6" "" COEFFS 0 32768 0 0 0 1 /end COMPU_METHOD
/begin COMPU_METHOD fak_q3p906Em5 "" RAT_FUNC "%7.6" "-" COEFFS 0 25600 0 0 0 1 /end COMPU_METHOD
/begin COMPU_METHOD fak_sw_b256 "" RAT_FUNC "%6.4" "-" COEFFS 0 65536 0 0 0 512 /end COMPU_METHOD
/begin COMPU_METHOD fak_ub_b0p125 "" RAT_FUNC "%6.5" "-" COEFFS 0 256 0 0 0 0.125 /end COMPU_METHOD
/begin COMPU_METHOD fak_ub_b1 "" RAT_FUNC "%6.4" "-" COEFFS 0 256 0 0 0 1 /end COMPU_METHOD
/begin COMPU_METHOD fak_ub_b2 "" RAT_FUNC "%8.5" "-" COEFFS 0 256 0 0 0 2 /end COMPU_METHOD
/begin COMPU_METHOD fak_ub_b4 "" RAT_FUNC "%6.4" "-" COEFFS 0 256 0 0 0 4 /end COMPU_METHOD
/begin COMPU_METHOD fak_ub_b64 "" RAT_FUNC "%6.3" "-" COEFFS 0 256 0 0 0 64 /end COMPU_METHOD
/begin COMPU_METHOD fak_ub_q0p156 "" RAT_FUNC "%6.3" "%/V" COEFFS 0 255 0 0 0 39.78 /end COMPU_METHOD
/begin COMPU_METHOD fak_uw_b2 "" RAT_FUNC "%7.6" "-" COEFFS 0 65536 0 0 0 2 /end COMPU_METHOD
/begin COMPU_METHOD fak_uw_b32 "" RAT_FUNC "%6.5" "-" COEFFS 0 65536 0 0 0 32 /end COMPU_METHOD
/begin COMPU_METHOD fak_uw_b64 "" RAT_FUNC "%6.5" "-" COEFFS 0 65536 0 0 0 64 /end COMPU_METHOD
/begin COMPU_METHOD fak_uw_b8 "" RAT_FUNC "%6.5" "-" COEFFS 0 65536 0 0 0 8 /end COMPU_METHOD
/begin COMPU_METHOD kw_q0p0234 "" RAT_FUNC "%6.4" "Grad KW" COEFFS 0 32768 0 0 0 768 /end COMPU_METHOD
/begin COMPU_METHOD kw_q0p75 "" RAT_FUNC "%6.3" "Grad KW" COEFFS 0 4 0 0 0 3 /end COMPU_METHOD
/begin COMPU_METHOD kw_q2p8125 "" RAT_FUNC "%6.2" "deg KW" COEFFS 0 1 0 0 0 2.8125 /end COMPU_METHOD
/begin COMPU_METHOD kw_q6 "" RAT_FUNC "%6.2" "Grad KW" COEFFS 0 1 0 0 0 6 /end COMPU_METHOD
/begin COMPU_METHOD kw_sw_q0p0219 "" RAT_FUNC "%6.4" "Grad KW" COEFFS 0 32768 0 0 0 720 /end COMPU_METHOD
/begin COMPU_METHOD Length "" RAT_FUNC "%6.2" "m" COEFFS 0 1 0 0 0 1 /end COMPU_METHOD
/begin COMPU_METHOD Length_fine "" RAT_FUNC "%6.5" "m" COEFFS 0 1000 0 0 0 1 /end COMPU_METHOD
/begin COMPU_METHOD m_q0p0peri4 "" RAT_FUNC "%6.4" "g" COEFFS 0 45 0 0 0 2 /end COMPU_METHOD
/begin COMPU_METHOD m_q0p1 "" RAT_FUNC "%6.3" "kg/h" COEFFS 0 10 0 0 0 1 /end COMPU_METHOD
/begin COMPU_METHOD m_q1p6 "" RAT_FUNC "%6.2" "kg/h" COEFFS 0 1 0 0 0 1.6 /end COMPU_METHOD
/begin COMPU_METHOD m_q6p78168Em7_g "" RAT_FUNC "%9.8" "g" COEFFS 0 1474560 0 0 0 1 /end COMPU_METHOD
/begin COMPU_METHOD m_ub_b1020 "" RAT_FUNC "%6.2" "kg/h" COEFFS 0 1 0 0 0 4 /end COMPU_METHOD
/begin COMPU_METHOD m_ub_b23p3 "" RAT_FUNC "%6.3" "kg" COEFFS 0 2812.5 0 0 0 256 /end COMPU_METHOD
/begin COMPU_METHOD m_uw_b102p4 "" RAT_FUNC "%6.4" "kg/h" COEFFS 0 65536 0 0 0 102.4 /end COMPU_METHOD
/begin COMPU_METHOD m_uw_b6553p5 "" RAT_FUNC "%6.3" "kg/h" COEFFS 0 1 0 0 0 0.1 /end COMPU_METHOD
/begin COMPU_METHOD nmotd_sw_q0p25 "" RAT_FUNC "%6.3" "1/min" COEFFS 0 1 0 0 0 0.25 /end COMPU_METHOD
/begin COMPU_METHOD nmot_ub_q40 "" RAT_FUNC "%6.1" "1/min" COEFFS 0 1 0 0 0 40 /end COMPU_METHOD
/begin COMPU_METHOD nmot_uw_q0p25 "" RAT_FUNC "%6.3" "1/min" COEFFS 0 1 0 0 0 0.25 /end COMPU_METHOD
/begin COMPU_METHOD OneToOne "" RAT_FUNC "%6.2" "-" COEFFS 0 1 0 0 0 1 /end COMPU_METHOD
/begin COMPU_METHOD Prc "" RAT_FUNC "%6.4" "%" COEFFS 0 81.92 0 0 0 1 /end COMPU_METHOD
/begin COMPU_METHOD Pres_hPa "" RAT_FUNC "%6.2" "hPa" COEFFS 0 1 0 0 0 1 /end COMPU_METHOD
/begin COMPU_METHOD p_q0p039 "" RAT_FUNC "%6.4" "hPa" COEFFS 0 256 0 0 0 10 /end COMPU_METHOD
/begin COMPU_METHOD p_q0p078 "" RAT_FUNC "%6.4" "hPa" COEFFS 0 64 0 0 0 5 /end COMPU_METHOD
/begin COMPU_METHOD p_uw_q0p039 "" RAT_FUNC "%6.4" "hPa" COEFFS 0 256 0 0 0 10 /end COMPU_METHOD
/begin COMPU_METHOD q1p953125Em4_V_DIV_Ohm "" RAT_FUNC "%6.5" "V/Ohm" COEFFS 0 5120 0 0 0 1 /end COMPU_METHOD
/begin COMPU_METHOD q1p953125Em4_V_DIV_s_Ohm "" RAT_FUNC "%6.5" "V/(s*Ohm)" COEFFS 0 5120 0 0 0 1 /end COMPU_METHOD
/begin COMPU_METHOD relDK_q0p02441 "" RAT_FUNC "%6.4" "%DK" COEFFS 0 65536 0 0 0 1600 /end COMPU_METHOD
/begin COMPU_METHOD relDK_ub_b100 "" RAT_FUNC "%6.3" "%DK" COEFFS 0 255 0 0 0 100 /end COMPU_METHOD
/begin COMPU_METHOD relDK_uw_b100 "" RAT_FUNC "%6.4" "%DK" COEFFS 0 65535 0 0 0 100 /end COMPU_METHOD
/begin COMPU_METHOD rel_q0p09375 "" RAT_FUNC "%6.3" "%" COEFFS 0 1 0 0 0 0.09375 /end COMPU_METHOD
/begin COMPU_METHOD rel_q0p75 "" RAT_FUNC "%6.3" "%" COEFFS 0 4 0 0 0 3 /end COMPU_METHOD
/begin COMPU_METHOD rel_sw_b1536 "" RAT_FUNC "%6.4" "%" COEFFS 0 65536 0 0 0 3072 /end COMPU_METHOD
/begin COMPU_METHOD rel_sw_q0p0468 "" RAT_FUNC "%6.4" "%" COEFFS 0 65536 0 0 0 3072 /end COMPU_METHOD
/begin COMPU_METHOD rel_ub_q0p75 "" RAT_FUNC "%6.3" "%" COEFFS 0 1 0 0 0 0.75 /end COMPU_METHOD
/begin COMPU_METHOD rel_uw_b100 "" RAT_FUNC "%6.4" "%" COEFFS 0 65536 0 0 0 100 /end COMPU_METHOD
/begin COMPU_METHOD rel_uw_b200 "" RAT_FUNC "%6.4" "%" COEFFS 0 65536 0 0 0 200 /end COMPU_METHOD
/begin COMPU_METHOD rel_uw_b3072 "" RAT_FUNC "%6.4" "%" COEFFS 0 65536 0 0 0 3072 /end COMPU_METHOD
/begin COMPU_METHOD rel_uw_q0p0234 "" RAT_FUNC "%6.4" "%" COEFFS 0 32 0 0 0 0.75 /end COMPU_METHOD
/begin COMPU_METHOD r_q3p0518Em5 "" RAT_FUNC "%7.6" "Ohm" COEFFS 0 32768 0 0 0 1 /end COMPU_METHOD
/begin COMPU_METHOD r_uw_q2 "" RAT_FUNC "%6.2" "Ohm" COEFFS 0 1 0 0 0 2 /end COMPU_METHOD
/begin COMPU_METHOD spgg_q0p0039 "" RAT_FUNC "%6.4" "V/s" COEFFS 0 65536 0 0 0 256 /end COMPU_METHOD
/begin COMPU_METHOD spg_q0p00039 "" RAT_FUNC "%6.5" "V" COEFFS 0 1 0 0 0 0.000390625 /end COMPU_METHOD
/begin COMPU_METHOD spg_q0p001 "" RAT_FUNC "%6.5" "V" COEFFS 0 1000 0 0 0 1 /end COMPU_METHOD
/begin COMPU_METHOD spg_q0p00488 "" RAT_FUNC "%6.4" "V" COEFFS 0 1024 0 0 0 5 /end COMPU_METHOD
/begin COMPU_METHOD spg_q0p0195 "" RAT_FUNC "%6.4" "V" COEFFS 0 256 0 0 0 5 /end COMPU_METHOD
/begin COMPU_METHOD spg_q0p1 "" RAT_FUNC "%6.3" "V" COEFFS 0 1 0 0 0 0.1 /end COMPU_METHOD
/begin COMPU_METHOD spg_q7p451Em8 "" RAT_FUNC "%10.9" "V" COEFFS 0 4294967296 0 0 0 320 /end COMPU_METHOD
/begin COMPU_METHOD spg_q7p63em5 "" RAT_FUNC "%7.6" "V" COEFFS 0 65536 0 0 0 5 /end COMPU_METHOD
/begin COMPU_METHOD spg_ubatt "" RAT_FUNC "%6.3" "V" COEFFS 0 1 0 0 0 0.0942 /end COMPU_METHOD
/begin COMPU_METHOD spg_uw_q0p000076 "" RAT_FUNC "%7.6" "V" COEFFS 0 65536 0 0 0 5 /end COMPU_METHOD
/begin COMPU_METHOD spg_uw_q0p001222 "" RAT_FUNC "%6.4" "V" COEFFS 0 65536 0 0 0 80 /end COMPU_METHOD
/begin COMPU_METHOD spg_uw_q0p00488 "" RAT_FUNC "%6.4" "V" COEFFS 0 1024 0 0 0 5 /end COMPU_METHOD
/begin COMPU_METHOD spg_uw_q0p00488_o1 "" RAT_FUNC "%6.3" "V" COEFFS 0 1024 1024 0 0 5 /end COMPU_METHOD
/begin COMPU_METHOD SY_DCPVOUT_Compu "" TAB_VERB "%6.3" "" COMPU_TAB_REF SY_DCPVOUT_Compu /end COMPU_METHOD
/begin COMPU_VTAB SY_DCPVOUT_Compu "" TAB_VERB 2 0 "Beobachter DTEV nicht aktiv" 1 "Beobachter DTEV aktiv" /end COMPU_VTAB
/begin COMPU_METHOD SY_DCPVPAS_Compu "" TAB_VERB "%6.3" "" COMPU_TAB_REF SY_DCPVPAS_Compu /end COMPU_METHOD
/begin COMPU_VTAB SY_DCPVPAS_Compu "" TAB_VERB 2 0 "False" 1 "True" /end COMPU_VTAB
/begin COMPU_METHOD SY_DCPVSPL_Compu "" TAB_VERB "%6.3" "" COMPU_TAB_REF SY_DCPVSPL_Compu /end COMPU_METHOD
/begin COMPU_VTAB SY_DCPVSPL_Compu "" TAB_VERB 2 0 "False" 1 "True" /end COMPU_VTAB
/begin COMPU_METHOD SY_DCPVTUM_Compu "" TAB_VERB "%6.3" "" COMPU_TAB_REF SY_DCPVTUM_Compu /end COMPU_METHOD
/begin COMPU_VTAB SY_DCPVTUM_Compu "" TAB_VERB 2 0 "False" 1 "True" /end COMPU_VTAB
/begin COMPU_METHOD SY_DCPV_Compu "" TAB_VERB "%6.3" "" COMPU_TAB_REF SY_DCPV_Compu /end COMPU_METHOD
/begin COMPU_VTAB SY_DCPV_Compu "" TAB_VERB 8 1 "01 only %DTEV-based incl. passive check" 11 "11 only tank pressure sensor based" 12 "12 tank pressure sensor based + add on %DTEV" 21 "21 only based on DMTL-pump" 2 "02 %DTEV-based without passive check" 0 "No CPV diagnosis" 16 "CPV-check with DTESP" 22 "CPV-check with DMTL or DTEV-based" /end COMPU_VTAB
/begin COMPU_METHOD SY_DCV_Compu "" TAB_VERB "%6.3" "" COMPU_TAB_REF SY_DCV_Compu /end COMPU_METHOD
/begin COMPU_VTAB SY_DCV_Compu "" TAB_VERB 2 0 "Keine Diagnose Kurbelgehäuseentlüftung vorhanden" 1 "Diagnose Kurbelgehäuseentlüftung vorhanden" /end COMPU_VTAB
/begin COMPU_METHOD SY_DCYLIMB_Compu "" TAB_VERB "%6.3" "" COMPU_TAB_REF SY_DCYLIMB_Compu /end COMPU_METHOD
/begin COMPU_VTAB SY_DCYLIMB_Compu "" TAB_VERB 2 0 "SY_DCYLIMB_NO" 1 "SY_DCYLIMB_YES" /end COMPU_VTAB
/begin COMPU_METHOD SY_DDPKAT_Compu "" TAB_VERB "%6.3" "" COMPU_TAB_REF SY_DDPKAT_Compu /end COMPU_METHOD
/begin COMPU_VTAB SY_DDPKAT_Compu "" TAB_VERB 2 0 "False" 1 "True" /end COMPU_VTAB
/begin COMPU_METHOD SY_DDS2A3_Compu "" TAB_VERB "%6.3" "" COMPU_TAB_REF SY_DDS2A3_Compu /end COMPU_METHOD
/begin COMPU_VTAB SY_DDS2A3_Compu "" TAB_VERB 2 1 "PRES_SENS_ACTV" 0 "PRES_SENS_INACTV" /end COMPU_VTAB
/begin COMPU_METHOD SY_DDTLSFK_Compu "" TAB_VERB "%6.3" "" COMPU_TAB_REF SY_DDTLSFK_Compu /end COMPU_METHOD
/begin COMPU_VTAB SY_DDTLSFK_Compu "" TAB_VERB 2 0 "False" 1 "True" /end COMPU_VTAB
/begin COMPU_METHOD SY_DDTLSHK_Compu "" TAB_VERB "%6.3" "" COMPU_TAB_REF SY_DDTLSHK_Compu /end COMPU_METHOD
/begin COMPU_VTAB SY_DDTLSHK_Compu "" TAB_VERB 2 0 "False" 1 "True" /end COMPU_VTAB
/begin COMPU_METHOD SY_DECOS_Compu "" TAB_VERB "%6.3" "" COMPU_TAB_REF SY_DECOS_Compu /end COMPU_METHOD
/begin COMPU_VTAB SY_DECOS_Compu "" TAB_VERB 2 0 "kein bedarfsgesteuertes Niederdrucksystem" 1 "bedarfsgesteuertes Niederdrucksystem" /end COMPU_VTAB
/begin COMPU_METHOD SY_DEGFE_Compu "" TAB_VERB "%6.3" "" COMPU_TAB_REF SY_DEGFE_Compu /end COMPU_METHOD
/begin COMPU_VTAB SY_DEGFE_Compu "" TAB_VERB 5 0 "DiagWithoutMassFlowAdaption" 1 "DiagWithMassFlowAdaption" 2 "DiagWithMassFlowAdaptionPinPointing MAF" 3 "DiagWithMassFlowAdaptionPinPointing MAP" 4 "DiagWithMassFlowAdaptionPinPointingServiceDia MAP" /end COMPU_VTAB
/begin COMPU_METHOD SY_DESOK_Compu "" TAB_VERB "%6.3" "" COMPU_TAB_REF SY_DESOK_Compu /end COMPU_METHOD
/begin COMPU_VTAB SY_DESOK_Compu "" TAB_VERB 2 0 "shortened EOL-test unavailable" 1 "shortened EOL-test available" /end COMPU_VTAB
/begin COMPU_METHOD SY_DEVAL_Compu "" TAB_VERB "%6.3" "" COMPU_TAB_REF SY_DEVAL_Compu /end COMPU_METHOD
/begin COMPU_VTAB SY_DEVAL_Compu "" TAB_VERB 2 0 "disabled" 1 "enabled" /end COMPU_VTAB
/begin COMPU_METHOD SY_DFKTAV2_Compu "" TAB_VERB "%6.3" "" COMPU_TAB_REF SY_DFKTAV2_Compu /end COMPU_METHOD
/begin COMPU_VTAB SY_DFKTAV2_Compu "" TAB_VERB 2 0 "False" 1 "True" /end COMPU_VTAB
/begin COMPU_METHOD SY_DFKTAV_Compu "" TAB_VERB "%6.3" "" COMPU_TAB_REF SY_DFKTAV_Compu /end COMPU_METHOD
/begin COMPU_VTAB SY_DFKTAV_Compu "" TAB_VERB 2 0 "False" 1 "True" /end COMPU_VTAB
/begin COMPU_METHOD SY_DFKTKA2_Compu "" TAB_VERB "%6.3" "" COMPU_TAB_REF SY_DFKTKA2_Compu /end COMPU_METHOD
/begin COMPU_VTAB SY_DFKTKA2_Compu "" TAB_VERB 2 0 "False" 1 "True" /end COMPU_VTAB
/begin COMPU_METHOD SY_DFKTKA_Compu "" TAB_VERB "%6.3" "" COMPU_TAB_REF SY_DFKTKA_Compu /end COMPU_METHOD
/begin COMPU_VTAB SY_DFKTKA_Compu "" TAB_VERB 2 0 "False" 1 "True" /end COMPU_VTAB
/begin COMPU_METHOD SY_DFKTSA2_Compu "" TAB_VERB "%6.3" "" COMPU_TAB_REF SY_DFKTSA2_Compu /end COMPU_METHOD
/begin COMPU_VTAB SY_DFKTSA2_Compu "" TAB_VERB 2 0 "False" 1 "True" /end COMPU_VTAB
/begin COMPU_METHOD SY_DFKTSA_Compu "" TAB_VERB "%6.3" "" COMPU_TAB_REF SY_DFKTSA_Compu /end COMPU_METHOD
/begin COMPU_VTAB SY_DFKTSA_Compu "" TAB_VERB 2 0 "False" 1 "True" /end COMPU_VTAB
/begin COMPU_METHOD SY_DFKTSP2_Compu "" TAB_VERB "%6.3" "" COMPU_TAB_REF SY_DFKTSP2_Compu /end COMPU_METHOD
/begin COMPU_VTAB SY_DFKTSP2_Compu "" TAB_VERB 2 0 "False" 1 "True" /end COMPU_VTAB
/begin COMPU_METHOD SY_DFKTSP_Compu "" TAB_VERB "%6.3" "" COMPU_TAB_REF SY_DFKTSP_Compu /end COMPU_METHOD
/begin COMPU_VTAB SY_DFKTSP_Compu "" TAB_VERB 2 0 "False" 1 "True" /end COMPU_VTAB
/begin COMPU_METHOD SY_DFP16BT_Compu "" TAB_VERB "%6.3" "" COMPU_TAB_REF SY_DFP16BT_Compu /end COMPU_METHOD
/begin COMPU_VTAB SY_DFP16BT_Compu "" TAB_VERB 2 0 "DFP Size 8 Bit" 1 "DFP Size 16 Bit" /end COMPU_VTAB
/begin COMPU_METHOD SY_DFPMFFR_Compu "" TAB_VERB "%6.3" "" COMPU_TAB_REF SY_DFPMFFR_Compu /end COMPU_METHOD
/begin COMPU_VTAB SY_DFPMFFR_Compu "" TAB_VERB 2 0 "keine Unterstützung FFR Anforderung" 1 "Unterstützung FFR Anforderung" /end COMPU_VTAB
/begin COMPU_METHOD SY_DFRAVUE_Compu "" TAB_VERB "%6.3" "" COMPU_TAB_REF SY_DFRAVUE_Compu /end COMPU_METHOD
/begin COMPU_VTAB SY_DFRAVUE_Compu "" TAB_VERB 2 0 "False" 1 "True" /end COMPU_VTAB
/begin COMPU_METHOD SY_DFRST_Compu "" TAB_VERB "%6.3" "" COMPU_TAB_REF SY_DFRST_Compu /end COMPU_METHOD
/begin COMPU_VTAB SY_DFRST_Compu "" TAB_VERB 2 0 "False" 1 "True" /end COMPU_VTAB
/begin COMPU_METHOD SY_DHDEVOE_Compu "" TAB_VERB "%6.3" "" COMPU_TAB_REF SY_DHDEVOE_Compu /end COMPU_METHOD
/begin COMPU_VTAB SY_DHDEVOE_Compu "" TAB_VERB 2 0 "no_error_reaction" 1 "error_reaction" /end COMPU_VTAB
/begin COMPU_METHOD SY_DHKTAV2_Compu "" TAB_VERB "%6.3" "" COMPU_TAB_REF SY_DHKTAV2_Compu /end COMPU_METHOD
/begin COMPU_VTAB SY_DHKTAV2_Compu "" TAB_VERB 2 0 "False" 1 "True" /end COMPU_VTAB
/begin COMPU_METHOD SY_DHKTAV_Compu "" TAB_VERB "%6.3" "" COMPU_TAB_REF SY_DHKTAV_Compu /end COMPU_METHOD
/begin COMPU_VTAB SY_DHKTAV_Compu "" TAB_VERB 2 0 "False" 1 "True" /end COMPU_VTAB
/begin COMPU_METHOD SY_DHKTKA2_Compu "" TAB_VERB "%6.3" "" COMPU_TAB_REF SY_DHKTKA2_Compu /end COMPU_METHOD
/begin COMPU_VTAB SY_DHKTKA2_Compu "" TAB_VERB 2 0 "False" 1 "True" /end COMPU_VTAB
/begin COMPU_METHOD SY_DHKTKA_Compu "" TAB_VERB "%6.3" "" COMPU_TAB_REF SY_DHKTKA_Compu /end COMPU_METHOD
/begin COMPU_VTAB SY_DHKTKA_Compu "" TAB_VERB 2 0 "False" 1 "True" /end COMPU_VTAB
/begin COMPU_METHOD SY_DHKTSA2_Compu "" TAB_VERB "%6.3" "" COMPU_TAB_REF SY_DHKTSA2_Compu /end COMPU_METHOD
/begin COMPU_VTAB SY_DHKTSA2_Compu "" TAB_VERB 2 0 "False" 1 "True" /end COMPU_VTAB
/begin COMPU_METHOD SY_DHKTSA_Compu "" TAB_VERB "%6.3" "" COMPU_TAB_REF SY_DHKTSA_Compu /end COMPU_METHOD
/begin COMPU_VTAB SY_DHKTSA_Compu "" TAB_VERB 2 0 "False" 1 "True" /end COMPU_VTAB
/begin COMPU_METHOD SY_DHKTSP2_Compu "" TAB_VERB "%6.3" "" COMPU_TAB_REF SY_DHKTSP2_Compu /end COMPU_METHOD
/begin COMPU_VTAB SY_DHKTSP2_Compu "" TAB_VERB 2 0 "False" 1 "True" /end COMPU_VTAB
/begin COMPU_METHOD SY_DHKTSP_Compu "" TAB_VERB "%6.3" "" COMPU_TAB_REF SY_DHKTSP_Compu /end COMPU_METHOD
/begin COMPU_VTAB SY_DHKTSP_Compu "" TAB_VERB 2 0 "False" 1 "True" /end COMPU_VTAB
/begin COMPU_METHOD SY_DHR_Compu "" TAB_VERB "%6.3" "" COMPU_TAB_REF SY_DHR_Compu /end COMPU_METHOD
/begin COMPU_VTAB SY_DHR_Compu "" TAB_VERB 2 0 "no main relay diagnosis" 1 "main relay diagnosis (CY315/320)" /end COMPU_VTAB
/begin COMPU_METHOD SY_DIONDE_Compu "" TAB_VERB "%6.3" "" COMPU_TAB_REF SY_DIONDE_Compu /end COMPU_METHOD
/begin COMPU_VTAB SY_DIONDE_Compu "" TAB_VERB 2 0 "False" 1 "True" /end COMPU_VTAB
/begin COMPU_METHOD SY_DIRST_Compu "" TAB_VERB "%6.3" "" COMPU_TAB_REF SY_DIRST_Compu /end COMPU_METHOD
/begin COMPU_VTAB SY_DIRST_Compu "" TAB_VERB 3 1 "STARTER_SUP" 0 "NO_DIRST" 2 "NO_STARTER_SUP" /end COMPU_VTAB
/begin COMPU_METHOD SY_DISDPLT_Compu "" TAB_VERB "%6.3" "" COMPU_TAB_REF SY_DISDPLT_Compu /end COMPU_METHOD
/begin COMPU_VTAB SY_DISDPLT_Compu "" TAB_VERB 2 0 "No diagnosis deactivation during very first start." 1 "Diagnosis deactivation during very first start." /end COMPU_VTAB
/begin COMPU_METHOD SY_DKADANL_Compu "" TAB_VERB "%6.3" "" COMPU_TAB_REF SY_DKADANL_Compu /end COMPU_METHOD
/begin COMPU_VTAB SY_DKADANL_Compu "" TAB_VERB 2 0 "no adaption during switch off" 1 "adaption during switch off activated" /end COMPU_VTAB
/begin COMPU_METHOD SY_DKATDPL_Compu "" TAB_VERB "%6.3" "" COMPU_TAB_REF SY_DKATDPL_Compu /end COMPU_METHOD
/begin COMPU_VTAB SY_DKATDPL_Compu "" TAB_VERB 2 0 "False" 1 "True" /end COMPU_VTAB
/begin COMPU_METHOD SY_DKATEF_Compu "" TAB_VERB "%6.3" "" COMPU_TAB_REF SY_DKATEF_Compu /end COMPU_METHOD
/begin COMPU_VTAB SY_DKATEF_Compu "" TAB_VERB 2 0 "keine Katdiagnose mittels Eigenfrequenz" 1 "Katdiagnose mittels Eigenfrequenz" /end COMPU_VTAB
/begin COMPU_METHOD SY_DKATGES_Compu "" TAB_VERB "%6.3" "" COMPU_TAB_REF SY_DKATGES_Compu /end COMPU_METHOD
/begin COMPU_VTAB SY_DKATGES_Compu "" TAB_VERB 2 0 "Keine Gesamtkatdiagnose vorhanden" 1 "Gesamtkatdiagnose vorhanden" /end COMPU_VTAB
/begin COMPU_METHOD SY_DKATLRS_Compu "" TAB_VERB "%6.3" "" COMPU_TAB_REF SY_DKATLRS_Compu /end COMPU_METHOD
/begin COMPU_VTAB SY_DKATLRS_Compu "" TAB_VERB 2 0 "keine passive Katalysatordiagnose vorhanden" 1 "passive Katalysatordiagnose vorhanden" /end COMPU_VTAB
/begin COMPU_METHOD SY_DKATNO_Compu "" TAB_VERB "%6.3" "" COMPU_TAB_REF SY_DKATNO_Compu /end COMPU_METHOD
/begin COMPU_VTAB SY_DKATNO_Compu "" TAB_VERB 2 0 "keine Funktion %DKATNO vorhanden" 1 "Funktion %DKATNO vorhanden" /end COMPU_VTAB
/begin COMPU_METHOD SY_DKATQP_Compu "" TAB_VERB "%6.3" "" COMPU_TAB_REF SY_DKATQP_Compu /end COMPU_METHOD
/begin COMPU_VTAB SY_DKATQP_Compu "" TAB_VERB 2 0 "not active" 1 "active" /end COMPU_VTAB
/begin COMPU_METHOD SY_DKATSP_Compu "" TAB_VERB "%6.3" "" COMPU_TAB_REF SY_DKATSP_Compu /end COMPU_METHOD
/begin COMPU_VTAB SY_DKATSP_Compu "" TAB_VERB 2 0 "keine aktive Katalysatordiagnose vorhanden" 1 "aktive Katalysatordiagnose vorhanden" /end COMPU_VTAB
/begin COMPU_METHOD SY_DKATTE_Compu "" TAB_VERB "%6.3" "" COMPU_TAB_REF SY_DKATTE_Compu /end COMPU_METHOD
/begin COMPU_VTAB SY_DKATTE_Compu "" TAB_VERB 2 0 "False" 1 "True" /end COMPU_VTAB
/begin COMPU_METHOD SY_DKATZP_Compu "" TAB_VERB "%6.3" "" COMPU_TAB_REF SY_DKATZP_Compu /end COMPU_METHOD
/begin COMPU_VTAB SY_DKATZP_Compu "" TAB_VERB 2 0 "SY_DKATZP" 1 "SY_DKATZP" /end COMPU_VTAB
/begin COMPU_METHOD SY_DKHZ_Compu "" TAB_VERB "%6.3" "" COMPU_TAB_REF SY_DKHZ_Compu /end COMPU_METHOD
/begin COMPU_VTAB SY_DKHZ_Compu "" TAB_VERB 2 0 "keine Funktion %DKHZ vorhanden" 1 "Funktion %DKHZ vorhanden" /end COMPU_VTAB
/begin COMPU_METHOD SY_DKLRIKL_Compu "" TAB_VERB "%6.3" "" COMPU_TAB_REF SY_DKLRIKL_Compu /end COMPU_METHOD
/begin COMPU_VTAB SY_DKLRIKL_Compu "" TAB_VERB 2 0 "==0" 1 "==1" /end COMPU_VTAB
/begin COMPU_METHOD SY_DKPDF_Compu "" TAB_VERB "%6.3" "" COMPU_TAB_REF SY_DKPDF_Compu /end COMPU_METHOD
/begin COMPU_VTAB SY_DKPDF_Compu "" TAB_VERB 2 0 "0" 1 "1" /end COMPU_VTAB
/begin COMPU_METHOD SY_DKTEVAL_Compu "" TAB_VERB "%6.3" "" COMPU_TAB_REF SY_DKTEVAL_Compu /end COMPU_METHOD
/begin COMPU_VTAB SY_DKTEVAL_Compu "" TAB_VERB 2 0 "False" 1 "True" /end COMPU_VTAB
/begin COMPU_METHOD SY_DKTEWMA_Compu "" TAB_VERB "%6.3" "" COMPU_TAB_REF SY_DKTEWMA_Compu /end COMPU_METHOD
/begin COMPU_VTAB SY_DKTEWMA_Compu "" TAB_VERB 2 0 "FALSE" 1 "TRUE" /end COMPU_VTAB
/begin COMPU_METHOD SY_DKTSPFK_Compu "" TAB_VERB "%6.3" "" COMPU_TAB_REF SY_DKTSPFK_Compu /end COMPU_METHOD
/begin COMPU_VTAB SY_DKTSPFK_Compu "" TAB_VERB 2 0 "SY_DKTSPFK" 1 "SY_DKTSPFK" /end COMPU_VTAB
/begin COMPU_METHOD SY_DKTSPHK_Compu "" TAB_VERB "%6.3" "" COMPU_TAB_REF SY_DKTSPHK_Compu /end COMPU_METHOD
/begin COMPU_VTAB SY_DKTSPHK_Compu "" TAB_VERB 2 0 "SY_DKTSPHK" 1 "SY_DKTSPHK" /end COMPU_VTAB
/begin COMPU_METHOD SY_DKVFTAL_Compu "" TAB_VERB "%6.3" "" COMPU_TAB_REF SY_DKVFTAL_Compu /end COMPU_METHOD
/begin COMPU_VTAB SY_DKVFTAL_Compu "" TAB_VERB 2 0 "fuel mixture fault entries enabled" 1 "calculation of enabling fuel mixture fault entries" /end COMPU_VTAB
/begin COMPU_METHOD SY_DKVSCMB_Compu "" TAB_VERB "%6.3" "" COMPU_TAB_REF SY_DKVSCMB_Compu /end COMPU_METHOD
/begin COMPU_VTAB SY_DKVSCMB_Compu "" TAB_VERB 2 0 "False" 1 "True" /end COMPU_VTAB
/begin COMPU_METHOD SY_DKVSFFC_Compu "" TAB_VERB "%6.3" "" COMPU_TAB_REF SY_DKVSFFC_Compu /end COMPU_METHOD
/begin COMPU_VTAB SY_DKVSFFC_Compu "" TAB_VERB 2 0 "False" 1 "True" /end COMPU_VTAB
/begin COMPU_METHOD SY_DKVSSC_Compu "" TAB_VERB "%6.3" "" COMPU_TAB_REF SY_DKVSSC_Compu /end COMPU_METHOD
/begin COMPU_VTAB SY_DKVSSC_Compu "" TAB_VERB 2 0 "no similar conditions in DKVS" 1 "similar conditions in DKVS" /end COMPU_VTAB
/begin COMPU_METHOD SY_DKZEROP_Compu "" TAB_VERB "%6.3" "" COMPU_TAB_REF SY_DKZEROP_Compu /end COMPU_METHOD
/begin COMPU_VTAB SY_DKZEROP_Compu "" TAB_VERB 2 0 "kein Anfahren des UMA im Betrieb möglich" 1 "Anfahren des UMA im Betrieb möglich" /end COMPU_VTAB
/begin COMPU_METHOD SY_DLBTSZW_Compu "" TAB_VERB "%6.3" "" COMPU_TAB_REF SY_DLBTSZW_Compu /end COMPU_METHOD
/begin COMPU_VTAB SY_DLBTSZW_Compu "" TAB_VERB 2 0 "False" 1 "True" /end COMPU_VTAB
/begin COMPU_METHOD SY_DLDPATC_Compu "" TAB_VERB "%6.3" "" COMPU_TAB_REF SY_DLDPATC_Compu /end COMPU_METHOD
/begin COMPU_VTAB SY_DLDPATC_Compu "" TAB_VERB 2 0 "False" 1 "True" /end COMPU_VTAB
/begin COMPU_METHOD SY_DLDP_Compu "" TAB_VERB "%6.3" "" COMPU_TAB_REF SY_DLDP_Compu /end COMPU_METHOD
/begin COMPU_VTAB SY_DLDP_Compu "" TAB_VERB 2 0 "kein DLDP System" 1 "DLDP System" /end COMPU_VTAB
/begin COMPU_METHOD SY_DLEAKNO_Compu "" TAB_VERB "%6.3" "" COMPU_TAB_REF SY_DLEAKNO_Compu /end COMPU_METHOD
/begin COMPU_VTAB SY_DLEAKNO_Compu "" TAB_VERB 2 0 "no leakage diagn. NOx sensor" 1 "leakage diagn. NOx sensor exists" /end COMPU_VTAB
/begin COMPU_METHOD SY_DLLRNPL_Compu "" TAB_VERB "%6.3" "" COMPU_TAB_REF SY_DLLRNPL_Compu /end COMPU_METHOD
/begin COMPU_VTAB SY_DLLRNPL_Compu "" TAB_VERB 2 0 "False" 1 "True" /end COMPU_VTAB
/begin COMPU_METHOD SY_DLSFV_Compu "" TAB_VERB "%6.3" "" COMPU_TAB_REF SY_DLSFV_Compu /end COMPU_METHOD
/begin COMPU_VTAB SY_DLSFV_Compu "" TAB_VERB 2 0 "keine %DLSFV vorhanden" 1 "%DLSFV vorhanden" /end COMPU_VTAB
/begin COMPU_METHOD SY_DLSHVTO_Compu "" TAB_VERB "%6.3" "" COMPU_TAB_REF SY_DLSHVTO_Compu /end COMPU_METHOD
/begin COMPU_VTAB SY_DLSHVTO_Compu "" TAB_VERB 2 0 "False" 1 "True" /end COMPU_VTAB
/begin COMPU_METHOD SY_DLSHV_Compu "" TAB_VERB "%6.3" "" COMPU_TAB_REF SY_DLSHV_Compu /end COMPU_METHOD
/begin COMPU_VTAB SY_DLSHV_Compu "" TAB_VERB 2 0 "keine Sonde-Vertauschung hinter Kat erkennbar" 1 "Sonde-Vertauschung hinter Kat erkennbar" /end COMPU_VTAB
/begin COMPU_METHOD SY_DLSUV_Compu "" TAB_VERB "%6.3" "" COMPU_TAB_REF SY_DLSUV_Compu /end COMPU_METHOD
/begin COMPU_VTAB SY_DLSUV_Compu "" TAB_VERB 2 0 "keine Lambdasondenvertauscherkennung vor KAT aktiv" 1 "Lambdasondenvertauscherkennung vor KAT aktiv" /end COMPU_VTAB
/begin COMPU_METHOD SY_DLUTVAR_Compu "" TAB_VERB "%6.3" "" COMPU_TAB_REF SY_DLUTVAR_Compu /end COMPU_METHOD
/begin COMPU_VTAB SY_DLUTVAR_Compu "" TAB_VERB 2 0 "dluts computation from constant crankshaft sgts" 1 "dluts computation from consecutive crankshaft sgts" /end COMPU_VTAB
/begin COMPU_METHOD SY_DMDADAP_Compu "" TAB_VERB "%6.3" "" COMPU_TAB_REF SY_DMDADAP_Compu /end COMPU_METHOD
/begin COMPU_VTAB SY_DMDADAP_Compu "" TAB_VERB 3 0 "standard adaptation" 1 "adaptation with %DMDADAP" 2 "adaptation with %DMDSIC" /end COMPU_VTAB
/begin COMPU_METHOD SY_DMDATEH_Compu "" TAB_VERB "%6.3" "" COMPU_TAB_REF SY_DMDATEH_Compu /end COMPU_METHOD
/begin COMPU_VTAB SY_DMDATEH_Compu "" TAB_VERB 2 0 "disabled" 1 "enabled" /end COMPU_VTAB
/begin COMPU_METHOD SY_DMDBTGT_Compu "" TAB_VERB "%6.3" "" COMPU_TAB_REF SY_DMDBTGT_Compu /end COMPU_METHOD
/begin COMPU_VTAB SY_DMDBTGT_Compu "" TAB_VERB 2 0 "NO_DMD_GearTypeSpecificBaseThreshold" 1 "DMD_GearTypeSpecificBaseThreshold" /end COMPU_VTAB
/begin COMPU_METHOD SY_DMDCYLID_Compu "" TAB_VERB "%6.3" "" COMPU_TAB_REF SY_DMDCYLID_Compu /end COMPU_METHOD
/begin COMPU_VTAB SY_DMDCYLID_Compu "" TAB_VERB 2 0 "False" 1 "True" /end COMPU_VTAB
/begin COMPU_METHOD SY_DMDFCER_Compu "" TAB_VERB "%6.3" "" COMPU_TAB_REF SY_DMDFCER_Compu /end COMPU_METHOD
/begin COMPU_VTAB SY_DMDFCER_Compu "" TAB_VERB 2 0 "False" 1 "True" /end COMPU_VTAB
/begin COMPU_METHOD SY_DMDHSC_Compu "" TAB_VERB "%6.3" "" COMPU_TAB_REF SY_DMDHSC_Compu /end COMPU_METHOD
/begin COMPU_VTAB SY_DMDHSC_Compu "" TAB_VERB 4 0 "NO_SC_NO_MW" 1 "NO_SC_DSMb12" 2 "NO_SC_DSMp12" 3 "SC" /end COMPU_VTAB
/begin COMPU_METHOD SY_DMDMODE_Compu "" TAB_VERB "%6.3" "" COMPU_TAB_REF SY_DMDMODE_Compu /end COMPU_METHOD
/begin COMPU_VTAB SY_DMDMODE_Compu "" TAB_VERB 3 0 "reserviert" 1 "DMD-Laufunruhe" 2 "DMD-Ionenstrom" /end COMPU_VTAB
/begin COMPU_METHOD SY_DMDPAT_Compu "" TAB_VERB "%6.3" "" COMPU_TAB_REF SY_DMDPAT_Compu /end COMPU_METHOD
/begin COMPU_VTAB SY_DMDPAT_Compu "" TAB_VERB 3 1 "Activates additional algorithm" 0 "No algorithm is activated" 2 "Activates additional algorithm(plausability check)" /end COMPU_VTAB
/begin COMPU_METHOD SY_DMDSEGV_Compu "" TAB_VERB "%6.3" "" COMPU_TAB_REF SY_DMDSEGV_Compu /end COMPU_METHOD
/begin COMPU_VTAB SY_DMDSEGV_Compu "" TAB_VERB 2 0 "no switch over of misfire segment" 1 "switch over of misfire segment" /end COMPU_VTAB
/begin COMPU_METHOD SY_DMDSTQ_Compu "" RAT_FUNC "%6.2" "" COEFFS 0 1 0 0 0 1 /end COMPU_METHOD
/begin COMPU_METHOD SY_DMDTAL_Compu "" TAB_VERB "%6.3" "" COMPU_TAB_REF SY_DMDTAL_Compu /end COMPU_METHOD
/begin COMPU_VTAB SY_DMDTAL_Compu "" TAB_VERB 2 0 "keine Unterdrückung MIL an bei leerem Tank" 1 "Unterdrückung MIL an bei leerem Tank" /end COMPU_VTAB
/begin COMPU_METHOD SY_DMDVAR_Compu "" TAB_VERB "%6.3" "" COMPU_TAB_REF SY_DMDVAR_Compu /end COMPU_METHOD
/begin COMPU_VTAB SY_DMDVAR_Compu "" TAB_VERB 4 0 "keine Aussetzererkennung" 1 "Aussetzererkennung im Background" 2 "Aussetzererkennung im Synchro" 3 "Aussetzererkennung im Synchro (handcodiert)" /end COMPU_VTAB
/begin COMPU_METHOD SY_DMDZAGVAR_Compu "" TAB_VERB "%6.3" "" COMPU_TAB_REF SY_DMDZAGVAR_Compu /end COMPU_METHOD
/begin COMPU_VTAB SY_DMDZAGVAR_Compu "" TAB_VERB 2 1 "DMDZAG1" 2 "DMDZAG4" /end COMPU_VTAB
/begin COMPU_METHOD SY_DMDZAG_Compu "" TAB_VERB "%6.3" "" COMPU_TAB_REF SY_DMDZAG_Compu /end COMPU_METHOD
/begin COMPU_VTAB SY_DMDZAG_Compu "" TAB_VERB 3 0 "Misfire generation with DMDZAG not available" 1 "Misfire generation with DMDZAG available, case 1" 2 "Misfire generation with DMDZAG available, case 2" /end COMPU_VTAB
/begin COMPU_METHOD SY_DMDZMS_Compu "" TAB_VERB "%6.3" "" COMPU_TAB_REF SY_DMDZMS_Compu /end COMPU_METHOD
/begin COMPU_VTAB SY_DMDZMS_Compu "" TAB_VERB 2 0 "False" 1 "True" /end COMPU_VTAB
/begin COMPU_METHOD SY_DMKATS_Compu "" TAB_VERB "%6.3" "" COMPU_TAB_REF SY_DMKATS_Compu /end COMPU_METHOD
/begin COMPU_VTAB SY_DMKATS_Compu "" TAB_VERB 2 0 "not active" 1 "active" /end COMPU_VTAB
/begin COMPU_METHOD SY_DMREXKL_Compu "" TAB_VERB "%6.3" "" COMPU_TAB_REF SY_DMREXKL_Compu /end COMPU_METHOD
/begin COMPU_VTAB SY_DMREXKL_Compu "" TAB_VERB 3 0 "no_excl_t_reserve" 1 "basic" 2 "standard" /end COMPU_VTAB
/begin COMPU_METHOD SY_DMTLAF_Compu "" TAB_VERB "%6.3" "" COMPU_TAB_REF SY_DMTLAF_Compu /end COMPU_METHOD
/begin COMPU_VTAB SY_DMTLAF_Compu "" TAB_VERB 2 0 "diagnosis DMTL air filter doesn't exist" 1 "diagnosis DMTL ai filter exists" /end COMPU_VTAB
/begin COMPU_METHOD SY_DMTL_Compu "" TAB_VERB "%6.3" "" COMPU_TAB_REF SY_DMTL_Compu /end COMPU_METHOD
/begin COMPU_VTAB SY_DMTL_Compu "" TAB_VERB 2 0 "DMTL nicht vorhanden" 1 "DMTL vorhanden" /end COMPU_VTAB
/begin COMPU_METHOD SY_DNSTAT_Compu "" RAT_FUNC "%6.2" "" COEFFS 0 1 0 0 0 1 /end COMPU_METHOD
/begin COMPU_METHOD SY_DNWKW_Compu "" TAB_VERB "%6.3" "" COMPU_TAB_REF SY_DNWKW_Compu /end COMPU_METHOD
/begin COMPU_VTAB SY_DNWKW_Compu "" TAB_VERB 2 0 "keine Diagnose NW-KW Zuordnung" 1 "Diagnose NW-KW Zuordnung aktiv" /end COMPU_VTAB
/begin COMPU_METHOD SY_DNWVPSA_Compu "" TAB_VERB "%6.3" "" COMPU_TAB_REF SY_DNWVPSA_Compu /end COMPU_METHOD
/begin COMPU_VTAB SY_DNWVPSA_Compu "" TAB_VERB 2 0 "false" 1 "True" /end COMPU_VTAB
/begin COMPU_METHOD SY_DNWVPSE_Compu "" TAB_VERB "%6.3" "" COMPU_TAB_REF SY_DNWVPSE_Compu /end COMPU_METHOD
/begin COMPU_VTAB SY_DNWVPSE_Compu "" TAB_VERB 2 1 "True" 0 "False" /end COMPU_VTAB
/begin COMPU_METHOD SY_DOPZW_Compu "" TAB_VERB "%6.3" "" COMPU_TAB_REF SY_DOPZW_Compu /end COMPU_METHOD
/begin COMPU_VTAB SY_DOPZW_Compu "" TAB_VERB 2 0 "keine doppelte Zündausgabe aktiv" 1 "doppelte Zündausgabe aktiv" /end COMPU_VTAB
/begin COMPU_METHOD SY_DPCS_Compu "" TAB_VERB "%6.3" "" COMPU_TAB_REF SY_DPCS_Compu /end COMPU_METHOD
/begin COMPU_VTAB SY_DPCS_Compu "" TAB_VERB 10 21 "DMTL" 46 "DTESK" 51 "DTESK, EONV (open gas cap, 1mm, 0.5mm)" 52 "DTESK, EONV (open gas cap, 0.5mm)" 0 "no leak test" 42 "DMTL with DMTL as pressure sensor" 11 "EONV stand alone" 36 "DLDP" 41 "DMTL with TEV-Check, DTEVP" 30 "NVLD" /end COMPU_VTAB
/begin COMPU_METHOD SY_DPLTCWL_Compu "" TAB_VERB "%6.3" "" COMPU_TAB_REF SY_DPLTCWL_Compu /end COMPU_METHOD
/begin COMPU_VTAB SY_DPLTCWL_Compu "" TAB_VERB 3 2 "SY_DPLTCWL_2" 1 "SY_DPLTCWL_1" 0 "SY_DPLTCWL_0" /end COMPU_VTAB
/begin COMPU_METHOD SY_DSBKV_Compu "" TAB_VERB "%6.3" "" COMPU_TAB_REF SY_DSBKV_Compu /end COMPU_METHOD
/begin COMPU_VTAB SY_DSBKV_Compu "" TAB_VERB 2 0 "absolute pressure" 1 "difference pressure" /end COMPU_VTAB
/begin COMPU_METHOD SY_DSKNO_Compu "" TAB_VERB "%6.3" "" COMPU_TAB_REF SY_DSKNO_Compu /end COMPU_METHOD
/begin COMPU_VTAB SY_DSKNO_Compu "" TAB_VERB 2 0 "Keine Funktion %DSKNO vorhanden" 1 "Funktion %DSKNO vorhanden" /end COMPU_VTAB
/begin COMPU_METHOD SY_DSKVND_Compu "" TAB_VERB "%6.3" "" COMPU_TAB_REF SY_DSKVND_Compu /end COMPU_METHOD
/begin COMPU_VTAB SY_DSKVND_Compu "" TAB_VERB 2 0 "kein Kraftstoffniederdrucksensor vorhanden" 1 "Kraftstoffniederdrucksensor vorhanden" /end COMPU_VTAB
/begin COMPU_METHOD SY_DSLSLS_Compu "" TAB_VERB "%6.3" "" COMPU_TAB_REF SY_DSLSLS_Compu /end COMPU_METHOD
/begin COMPU_VTAB SY_DSLSLS_Compu "" TAB_VERB 2 0 "DSLSLS_NO" 1 "DSLSLS_POSSIBLE" /end COMPU_VTAB
/begin COMPU_METHOD SY_DSLSPS_Compu "" TAB_VERB "%6.3" "" COMPU_TAB_REF SY_DSLSPS_Compu /end COMPU_METHOD
/begin COMPU_VTAB SY_DSLSPS_Compu "" TAB_VERB 2 0 "DSLSPS_NO" 1 "DSLSPS_POSSIBLE" /end COMPU_VTAB
/begin COMPU_METHOD SY_DSLSZP_Compu "" TAB_VERB "%6.3" "" COMPU_TAB_REF SY_DSLSZP_Compu /end COMPU_METHOD
/begin COMPU_VTAB SY_DSLSZP_Compu "" TAB_VERB 2 0 "False" 1 "True" /end COMPU_VTAB
/begin COMPU_METHOD SY_DSLS_Compu "" TAB_VERB "%6.3" "" COMPU_TAB_REF SY_DSLS_Compu /end COMPU_METHOD
/begin COMPU_VTAB SY_DSLS_Compu "" TAB_VERB 5 0 "keine Sekundärluftdiagnose" 1 "Sekundärluftdiagnose basierend auf Lambdasonde" 2 "Sekundärluftdiagose mittels eines separaten SL_HFM" 3 "Sekundärluftdiagnose basierend auf Sensorik zur FE" 4 "Sekundärluftdiagnose mit Drucksensor" /end COMPU_VTAB
/begin COMPU_METHOD SY_DSM_Compu "" TAB_VERB "%6.3" "" COMPU_TAB_REF SY_DSM_Compu /end COMPU_METHOD
/begin COMPU_VTAB SY_DSM_Compu "" TAB_VERB 2 0 "kein DSM vorhanden" 1 "DSM vorhanden" /end COMPU_VTAB
/begin COMPU_METHOD SY_DSNDK_Compu "" TAB_VERB "%6.3" "" COMPU_TAB_REF SY_DSNDK_Compu /end COMPU_METHOD
/begin COMPU_VTAB SY_DSNDK_Compu "" TAB_VERB 2 0 "no pressure sensor downstream throttle valve insta" 1 "pressure sensor downstream throttle valve installe" /end COMPU_VTAB
/begin COMPU_METHOD SY_DSPACE_Compu "" TAB_VERB "%6.3" "" COMPU_TAB_REF SY_DSPACE_Compu /end COMPU_METHOD
/begin COMPU_VTAB SY_DSPACE_Compu "" TAB_VERB 2 0 "False" 1 "True" /end COMPU_VTAB
/begin COMPU_METHOD SY_DSS2_Compu "" TAB_VERB "%6.3" "" COMPU_TAB_REF SY_DSS2_Compu /end COMPU_METHOD
/begin COMPU_VTAB SY_DSS2_Compu "" TAB_VERB 2 0 "kein zweiter Drucksensor im Saugrohr verbaut" 1 "zweiter Drucksensor im Saugrohr verbaut" /end COMPU_VTAB
/begin COMPU_METHOD SY_DSS_Compu "" TAB_VERB "%6.3" "" COMPU_TAB_REF SY_DSS_Compu /end COMPU_METHOD
/begin COMPU_VTAB SY_DSS_Compu "" TAB_VERB 2 0 "kein Drucksensor im Saugrohr verbaut" 1 "Drucksensor im Saugrohr verbaut" /end COMPU_VTAB
/begin COMPU_METHOD SY_DSU_Compu "" TAB_VERB "%6.3" "" COMPU_TAB_REF SY_DSU_Compu /end COMPU_METHOD
/begin COMPU_VTAB SY_DSU_Compu "" TAB_VERB 2 0 "kein Umgebungsdrucksensor verbaut" 1 "Umgebungsdrucksensor verbaut" /end COMPU_VTAB
/begin COMPU_METHOD SY_DSV2V_Compu "" TAB_VERB "%6.3" "" COMPU_TAB_REF SY_DSV2V_Compu /end COMPU_METHOD
/begin COMPU_VTAB SY_DSV2V_Compu "" TAB_VERB 2 0 "kein Drucksensor vor zweitem Verdichter vorhanden" 1 "Drucksensor vor zweitem Verdichter vorhanden" /end COMPU_VTAB
/begin COMPU_METHOD SY_DSVDK2_Compu "" TAB_VERB "%6.3" "" COMPU_TAB_REF SY_DSVDK2_Compu /end COMPU_METHOD
/begin COMPU_VTAB SY_DSVDK2_Compu "" TAB_VERB 2 0 "kein zweiter Drucksensor vor Drosselklappe verbaut" 1 "zweiter Drucksensor vor Drosselklappe verbaut" /end COMPU_VTAB
/begin COMPU_METHOD SY_DSVDK_Compu "" TAB_VERB "%6.3" "" COMPU_TAB_REF SY_DSVDK_Compu /end COMPU_METHOD
/begin COMPU_VTAB SY_DSVDK_Compu "" TAB_VERB 2 1 "TRUE" 0 "FALSE" /end COMPU_VTAB
/begin COMPU_METHOD SY_DSVV2_Compu "" TAB_VERB "%6.3" "" COMPU_TAB_REF SY_DSVV2_Compu /end COMPU_METHOD
/begin COMPU_VTAB SY_DSVV2_Compu "" TAB_VERB 2 0 "kein 2. Drucksensor vor Verdichter vorhanden" 1 "2. Drucksensor vor Verdichter vorhanden" /end COMPU_VTAB
/begin COMPU_METHOD SY_DSVV_Compu "" TAB_VERB "%6.3" "" COMPU_TAB_REF SY_DSVV_Compu /end COMPU_METHOD
/begin COMPU_VTAB SY_DSVV_Compu "" TAB_VERB 2 0 "kein Drucksensor vor Verdichter vorhanden" 1 "Drucksensor vor Verdichter vorhanden" /end COMPU_VTAB
/begin COMPU_METHOD SY_DTCWCS_Compu "" TAB_VERB "%6.3" "" COMPU_TAB_REF SY_DTCWCS_Compu /end COMPU_METHOD
/begin COMPU_VTAB SY_DTCWCS_Compu "" TAB_VERB 3 2 "TABST_COUNT" 0 "DISABL" 1 "NO_TABST_COUNT" /end COMPU_VTAB
/begin COMPU_METHOD SY_DTCWHSC_Compu "" TAB_VERB "%6.3" "" COMPU_TAB_REF SY_DTCWHSC_Compu /end COMPU_METHOD
/begin COMPU_VTAB SY_DTCWHSC_Compu "" TAB_VERB 2 0 "SY_DTCWHSC" 1 "SY_DTCWHSC" /end COMPU_VTAB
/begin COMPU_METHOD SY_DTDW_Compu "" TAB_VERB "%6.3" "" COMPU_TAB_REF SY_DTDW_Compu /end COMPU_METHOD
/begin COMPU_VTAB SY_DTDW_Compu "" TAB_VERB 2 0 "False" 1 "True" /end COMPU_VTAB
/begin COMPU_METHOD SY_DTHM_Compu "" TAB_VERB "%6.3" "" COMPU_TAB_REF SY_DTHM_Compu /end COMPU_METHOD
/begin COMPU_VTAB SY_DTHM_Compu "" TAB_VERB 2 0 "False" 1 "True" /end COMPU_VTAB
/begin COMPU_METHOD SY_DUZND_Compu "" TAB_VERB "%6.3" "" COMPU_TAB_REF SY_DUZND_Compu /end COMPU_METHOD
/begin COMPU_VTAB SY_DUZND_Compu "" TAB_VERB 2 0 "keine Spannungsdiagnose der Zündspulen" 1 "Spannungsdiagnose der Zündspulen" /end COMPU_VTAB
/begin COMPU_METHOD SY_DVEADA_Compu "" TAB_VERB "%6.3" "" COMPU_TAB_REF SY_DVEADA_Compu /end COMPU_METHOD
/begin COMPU_VTAB SY_DVEADA_Compu "" TAB_VERB 2 0 "kein Sperren der Einspritzung durch DVE Adaptio er" 1 "Sperren der Einspritzung durch DVE Adaptio erlaubt" /end COMPU_VTAB
/begin COMPU_METHOD SY_DVEAIF_Compu "" TAB_VERB "%6.3" "" COMPU_TAB_REF SY_DVEAIF_Compu /end COMPU_METHOD
/begin COMPU_VTAB SY_DVEAIF_Compu "" TAB_VERB 4 0 "No anti icing functionality" 1 "Higher tolerance before starting" 2 "High tolerance before start and AI at ignition on" 3 "High tolerance before start and AI during drive" /end COMPU_VTAB
/begin COMPU_METHOD t100msxs_ub_b25p5 "" RAT_FUNC "%6.3" "s" COEFFS 0 1 0 0 0 0.1 /end COMPU_METHOD
/begin COMPU_METHOD t100msxs_uw_b6553p5 "" RAT_FUNC "%6.3" "s" COEFFS 0 1 0 0 0 0.1 /end COMPU_METHOD
/begin COMPU_METHOD t10msxs_uw_b655p35 "" RAT_FUNC "%6.4" "s" COEFFS 0 1 0 0 0 0.01 /end COMPU_METHOD
/begin COMPU_METHOD t1sxs_uw_q1 "" RAT_FUNC "%6.2" "s" COEFFS 0 1 0 0 0 1 /end COMPU_METHOD
/begin COMPU_METHOD Temp_Cels "" RAT_FUNC "%6.1" "deg C" COEFFS 0 10 2731.4 0 0 1 /end COMPU_METHOD
/begin COMPU_METHOD temp_q0p0234_o273 "" RAT_FUNC "%6.1" "Grad C" COEFFS 0 1 273.15 0 0 0.0234375 /end COMPU_METHOD
/begin COMPU_METHOD temp_q0p0234_om273 "" RAT_FUNC "%6.1" "Grad C" COEFFS 0 640 174816 0 0 15 /end COMPU_METHOD
/begin COMPU_METHOD temp_q3p57Em7_om273 "" RAT_FUNC "%6.1" "Grad C" COEFFS 0 8388608 2291348275.2 0 0 3 /end COMPU_METHOD
/begin COMPU_METHOD temp_ub_b191p25 "" RAT_FUNC "%6.3" "Grad C" COEFFS 0 1 0 0 0 0.75 /end COMPU_METHOD
/begin COMPU_METHOD temp_ub_q0p75_o48 "" RAT_FUNC "%6.2" "Grad C" COEFFS 0 1 48 0 0 0.75 /end COMPU_METHOD
/begin COMPU_METHOD TimeDelay_s "" RAT_FUNC "%12.4" "s" COEFFS 0 0 1 0 0.00023283064365387 0 /end COMPU_METHOD
/begin COMPU_METHOD TimeEngOn "" RAT_FUNC "%6.2" "s" COEFFS 0 1 0 0 0 1 /end COMPU_METHOD
/begin COMPU_METHOD TimeRed "" RAT_FUNC "%6.3" "s" COEFFS 0 6.25 0 0 0 1 /end COMPU_METHOD
/begin COMPU_METHOD Time_ms "" RAT_FUNC "%6.1" "ms" COEFFS 0 0.1 0 0 0 1 /end COMPU_METHOD
/begin COMPU_METHOD Time_s "" RAT_FUNC "%6.4" "s" COEFFS 0 100 0 0 0 1 /end COMPU_METHOD
/begin COMPU_METHOD TransR "" RAT_FUNC "%6.4" "-" COEFFS 0 100 0 0 0 1 /end COMPU_METHOD
/begin COMPU_METHOD Trq "" RAT_FUNC "%6.3" "Nm" COEFFS 0 10 0 0 0 1 /end COMPU_METHOD
/begin COMPU_METHOD txms_uw_q0p1 "" RAT_FUNC "%6.3" "ms" COEFFS 0 10 0 0 0 1 /end COMPU_METHOD
/begin COMPU_METHOD t_q0p001 "" RAT_FUNC "%6.5" "s" COEFFS 0 1000 0 0 0 1 /end COMPU_METHOD
/begin COMPU_METHOD t_q0p01 "" RAT_FUNC "%6.4" "" COEFFS 0 100 0 0 0 1 /end COMPU_METHOD
/begin COMPU_METHOD t_q0p05 "" RAT_FUNC "%6.4" "s" COEFFS 0 100 0 0 0 5 /end COMPU_METHOD
/begin COMPU_METHOD t_q0p1 "" RAT_FUNC "%6.3" "s" COEFFS 0 10 0 0 0 1 /end COMPU_METHOD
/begin COMPU_METHOD t_q1 "" RAT_FUNC "%6.2" "s" COEFFS 0 1 0 0 0 1 /end COMPU_METHOD
/begin COMPU_METHOD undefined "" RAT_FUNC "%6.2" "" COEFFS 0 1 0 0 0 1 /end COMPU_METHOD
/begin COMPU_METHOD Vel "" RAT_FUNC "%6.4" "km/h" COEFFS 0 100 0 0 0 1 /end COMPU_METHOD
/begin COMPU_METHOD vfzg_ub_q1p25 "" RAT_FUNC "%6.2" "km/h" COEFFS 0 1 0 0 0 1.25 /end COMPU_METHOD
/begin COMPU_METHOD vol_q0p5_l "" RAT_FUNC "%6.3" "L" COEFFS 0 1 0 0 0 0.5 /end COMPU_METHOD
/begin COMPU_METHOD zk100msxs_uw_b655 "" RAT_FUNC "%6.1" "s" COEFFS 0 0 65536 0 10 0 /end COMPU_METHOD
/begin COMPU_METHOD zk100msxs_uw_b6553 "" RAT_FUNC "%6.1" "s" COEFFS 0 0 65536 0 10 0 /end COMPU_METHOD
/begin COMPU_METHOD zk100msxs_uw_b6553p6 "" RAT_FUNC "%6.1" "s" COEFFS 0 0 65536 0 10 0 /end COMPU_METHOD
/begin COMPU_METHOD zk10msxs_uw_b655 "" RAT_FUNC "%6.2" "s" COEFFS 0 0 65536 0 100 0 /end COMPU_METHOD
/begin COMPU_METHOD zw_sb_q0p75 "" RAT_FUNC "%6.3" "Grad KW" COEFFS 0 255 0 0 0 191.25 /end COMPU_METHOD
/begin COMPU_METHOD zw_sb_q6 "" RAT_FUNC "%6.2" "Grad KW" COEFFS 0 1 0 0 0 6 /end COMPU_METHOD
/begin COMPU_METHOD zw_ub_q6 "" RAT_FUNC "%6.2" "Grad KW" COEFFS 0 255 0 0 0 1530 /end COMPU_METHOD
/begin RECORD_LAYOUT Cur_Xs16Ws16 NO_AXIS_PTS_X 1 SWORD AXIS_PTS_X 2 SWORD INDEX_INCR DIRECT FNC_VALUES 3 SWORD COLUMN_DIR DIRECT /end RECORD_LAYOUT
/begin RECORD_LAYOUT FklWU8 FNC_VALUES 1 UBYTE COLUMN_DIR DIRECT /end RECORD_LAYOUT
/begin RECORD_LAYOUT GkfWS8 FNC_VALUES 1 SBYTE COLUMN_DIR DIRECT /end RECORD_LAYOUT
/begin RECORD_LAYOUT GkfWSb FNC_VALUES 1 SBYTE COLUMN_DIR DIRECT /end RECORD_LAYOUT
/begin RECORD_LAYOUT GkfWU16 FNC_VALUES 1 UWORD COLUMN_DIR DIRECT /end RECORD_LAYOUT
/begin RECORD_LAYOUT GkfWU8 FNC_VALUES 1 UBYTE COLUMN_DIR DIRECT /end RECORD_LAYOUT
/begin RECORD_LAYOUT GkfWUb FNC_VALUES 1 UBYTE COLUMN_DIR DIRECT /end RECORD_LAYOUT
/begin RECORD_LAYOUT GklWS16 FNC_VALUES 1 SWORD COLUMN_DIR DIRECT /end RECORD_LAYOUT
/begin RECORD_LAYOUT GklWS8 FNC_VALUES 1 SBYTE COLUMN_DIR DIRECT /end RECORD_LAYOUT
/begin RECORD_LAYOUT GklWU16 FNC_VALUES 1 UWORD COLUMN_DIR DIRECT /end RECORD_LAYOUT
/begin RECORD_LAYOUT GklWU8 FNC_VALUES 1 UBYTE COLUMN_DIR DIRECT /end RECORD_LAYOUT
/begin RECORD_LAYOUT GklWUb FNC_VALUES 1 UBYTE COLUMN_DIR DIRECT /end RECORD_LAYOUT
/begin RECORD_LAYOUT GklWUw FNC_VALUES 1 UWORD COLUMN_DIR DIRECT /end RECORD_LAYOUT
/begin RECORD_LAYOUT KfAxU8AyU8SstxU16SstyU16WS16 NO_AXIS_PTS_X 1 UWORD NO_AXIS_PTS_Y 2 UWORD AXIS_PTS_X 3 UWORD INDEX_INCR DIRECT AXIS_PTS_Y 4 UWORD INDEX_INCR DIRECT FNC_VALUES 5 SWORD COLUMN_DIR DIRECT /end RECORD_LAYOUT
/begin RECORD_LAYOUT KfAxU8AyU8SstxU16SstyU16WU16 NO_AXIS_PTS_X 1 UWORD NO_AXIS_PTS_Y 2 UWORD AXIS_PTS_X 3 UWORD INDEX_INCR DIRECT AXIS_PTS_Y 4 UWORD INDEX_INCR DIRECT FNC_VALUES 5 UWORD COLUMN_DIR DIRECT /end RECORD_LAYOUT
/begin RECORD_LAYOUT KfAxU8AyU8SstxU8SstyU8WU8 NO_AXIS_PTS_X 1 UBYTE NO_AXIS_PTS_Y 2 UBYTE AXIS_PTS_X 3 UBYTE INDEX_INCR DIRECT AXIS_PTS_Y 4 UBYTE INDEX_INCR DIRECT FNC_VALUES 5 UBYTE COLUMN_DIR DIRECT /end RECORD_LAYOUT
/begin RECORD_LAYOUT KfAxUbAyUbSstxUbSstyUbWUb NO_AXIS_PTS_X 1 UBYTE NO_AXIS_PTS_Y 2 UBYTE AXIS_PTS_X 3 UBYTE INDEX_INCR DIRECT AXIS_PTS_Y 4 UBYTE INDEX_INCR DIRECT FNC_VALUES 5 UBYTE COLUMN_DIR DIRECT /end RECORD_LAYOUT
/begin RECORD_LAYOUT KlAxU8SstxS16WU16 NO_AXIS_PTS_X 1 UWORD AXIS_PTS_X 2 SWORD INDEX_INCR DIRECT FNC_VALUES 3 UWORD COLUMN_DIR DIRECT /end RECORD_LAYOUT
/begin RECORD_LAYOUT KlAxU8SstxU16WU16 NO_AXIS_PTS_X 1 UWORD AXIS_PTS_X 2 UWORD INDEX_INCR DIRECT FNC_VALUES 3 UWORD COLUMN_DIR DIRECT /end RECORD_LAYOUT
/begin RECORD_LAYOUT KlAxU8SstxU16WU8 NO_AXIS_PTS_X 1 UWORD AXIS_PTS_X 2 UWORD INDEX_INCR DIRECT FNC_VALUES 3 UBYTE COLUMN_DIR DIRECT /end RECORD_LAYOUT
/begin RECORD_LAYOUT KlAxU8SstxU8WU16 NO_AXIS_PTS_X 1 UBYTE AXIS_PTS_X 2 UBYTE INDEX_INCR DIRECT FNC_VALUES 3 UWORD COLUMN_DIR DIRECT /end RECORD_LAYOUT
/begin RECORD_LAYOUT KlAxU8SstxU8WU8 NO_AXIS_PTS_X 1 UBYTE AXIS_PTS_X 2 UBYTE INDEX_INCR DIRECT FNC_VALUES 3 UBYTE COLUMN_DIR DIRECT /end RECORD_LAYOUT
/begin RECORD_LAYOUT KwbWU8 FNC_VALUES 1 UBYTE COLUMN_DIR DIRECT /end RECORD_LAYOUT
/begin RECORD_LAYOUT KwUb FNC_VALUES 1 UBYTE COLUMN_DIR DIRECT /end RECORD_LAYOUT
/begin RECORD_LAYOUT KwUw FNC_VALUES 1 UWORD COLUMN_DIR DIRECT /end RECORD_LAYOUT
/begin RECORD_LAYOUT KwWS16 FNC_VALUES 1 SWORD COLUMN_DIR DIRECT /end RECORD_LAYOUT
/begin RECORD_LAYOUT KwWU16 FNC_VALUES 1 UWORD COLUMN_DIR DIRECT /end RECORD_LAYOUT
/begin RECORD_LAYOUT KwWU8 FNC_VALUES 1 UBYTE COLUMN_DIR DIRECT /end RECORD_LAYOUT
/begin RECORD_LAYOUT Kw_Ws16 FNC_VALUES 1 SWORD COLUMN_DIR DIRECT /end RECORD_LAYOUT
/begin RECORD_LAYOUT Kw_Wu16 FNC_VALUES 1 UWORD COLUMN_DIR DIRECT /end RECORD_LAYOUT
/begin RECORD_LAYOUT SstAU8SstU8 NO_AXIS_PTS_X 1 UBYTE AXIS_PTS_X 2 UBYTE INDEX_INCR DIRECT /end RECORD_LAYOUT
/begin RECORD_LAYOUT SstAUbSstUb NO_AXIS_PTS_X 1 UBYTE AXIS_PTS_X 2 UBYTE INDEX_INCR DIRECT /end RECORD_LAYOUT
/begin RECORD_LAYOUT SstAUwSstUw NO_AXIS_PTS_X 1 UWORD AXIS_PTS_X 2 UWORD INDEX_INCR DIRECT /end RECORD_LAYOUT
/begin RECORD_LAYOUT ValA_Ws16 FNC_VALUES 1 SWORD COLUMN_DIR DIRECT /end RECORD_LAYOUT
/begin RECORD_LAYOUT ValA_Wu16 FNC_VALUES 1 UWORD COLUMN_DIR DIRECT /end RECORD_LAYOUT
/begin RECORD_LAYOUT Val_Ws16 FNC_VALUES 1 SWORD COLUMN_DIR DIRECT /end RECORD_LAYOUT
/begin RECORD_LAYOUT Val_Ws32 FNC_VALUES 1 SLONG COLUMN_DIR DIRECT /end RECORD_LAYOUT
/begin RECORD_LAYOUT Val_Wu16 FNC_VALUES 1 UWORD COLUMN_DIR DIRECT /end RECORD_LAYOUT
/begin RECORD_LAYOUT Val_Wu8 FNC_VALUES 1 UBYTE COLUMN_DIR DIRECT /end RECORD_LAYOUT
/end MODULE
/end PROJECT
