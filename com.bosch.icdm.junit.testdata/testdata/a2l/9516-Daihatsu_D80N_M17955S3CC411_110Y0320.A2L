ASAP2_VERSION 1 4
/begin PROJECT M17955S3CC411_110Y0320 "M17955S3CC411_110Y0320"
/begin HEADER "" VERSION "M17955S3CC411_110Y0320" PROJECT_NO M17955S3CC411_110Y0320 /end HEADER
/begin MODULE DIM ""
/begin MOD_COMMON "" BYTE_ORDER MSB_LAST ALIGNMENT_BYTE 1 ALIGNMENT_WORD 2 ALIGNMENT_LONG 4 ALIGNMENT_FLOAT32_IEEE 4 /end MOD_COMMON
/begin CHARACTERISTIC CWPSTEVE "" VALUE 0x80045040 KwWU8 255.0 dez 0.00 255.0 FORMAT "%5.1" /end CHARACTERISTIC
/begin CHARACTERISTIC CWRKAKAP "" VALUE 0x80045112 KwWU8 255.0 dez 0.00 255.0 FORMAT "%5.1" /end CHARACTERISTIC
/begin CHARACTERISTIC DSDLUTSIMN "" VALUE 0x80045116 KwWS16 298.0187 lu_MEx -149.0116 149.0071 FORMAT "%8.4" /end CHARACTERISTIC
/begin CHARACTERISTIC DSDLUTSIMX "" VALUE 0x80045118 KwWS16 298.0187 lu_MEx -149.0116 149.0071 FORMAT "%8.4" /end CHARACTERISTIC
/begin CHARACTERISTIC DSMAUX_dtWUCMin_C "" VALUE 0x80040D40 Val_Ws16 6553.500 TempDiff_Kelv -3276.800 3276.700 FORMAT "%8.3" /end CHARACTERISTIC
/begin CHARACTERISTIC DSMAUX_tWUCMin_C "" VALUE 0x80040D42 Val_Ws16 6553.500 Temp_Cels -3549.940 3003.560 FORMAT "%8.3" /end CHARACTERISTIC
/begin CHARACTERISTIC DSMAUX_xClearMode_C "" VALUE 0x80040D44 Val_Wu16 211. DFC_Verb 0.00 211. FORMAT "%2.0" /end CHARACTERISTIC
/begin CHARACTERISTIC DSMAUX_xClearTrg_C "" VALUE 0x80040D46 Val_Wu8 255.0 DFC_OneToOne 0.00 255.0 FORMAT "%5.1" /end CHARACTERISTIC
/begin CHARACTERISTIC DSMDur_valEvntQntDist_C "" VALUE 0x80040D48 Val_Wu16 65535.00 DFES_OneToOne 0.00 65535.00 FORMAT "%8.2" /end CHARACTERISTIC
/begin CHARACTERISTIC DSMDur_valEvntQntTi_C "" VALUE 0x80040D4A Val_Wu16 65535.00 DFES_OneToOne 0.00 65535.00 FORMAT "%8.2" /end CHARACTERISTIC
/begin CHARACTERISTIC DSMDur_xEnaGlb_CA "" VAL_BLK 0x80040D4C ValA_Wu16 65535.00 DFES_OneToOne 0.00 65535.00 FORMAT "%8.2" NUMBER 1 /end CHARACTERISTIC
/begin CHARACTERISTIC DSMDur_xRstGlb_CA "" VAL_BLK 0x80040D4E ValA_Wu8 255.0 DFES_OneToOne 0.00 255.0 FORMAT "%5.1" NUMBER 1 /end CHARACTERISTIC
/begin CHARACTERISTIC DSMDur_xSelEvntGlb_CA "" VAL_BLK 0x80040D4F ValA_Wu8 8.00000000000 DSMDur_EvntSel_Verb 0.00 8.00000000000 FORMAT "%13.11" NUMBER 1 /end CHARACTERISTIC
/begin CHARACTERISTIC DSMRdy_Grp.FlSys_CA "" VAL_BLK 0x8004157E ValA_Wu16 211. DFC_Verb 0.00 211. FORMAT "%2.0" NUMBER 15 /end CHARACTERISTIC
/begin CHARACTERISTIC DSMRdy_Grp.Cat_CA "" VAL_BLK 0x8004159E ValA_Wu16 211. DFC_Verb 0.00 211. FORMAT "%2.0" NUMBER 15 /end CHARACTERISTIC
/begin CHARACTERISTIC DSMRdy_Grp.HtCat_CA "" VAL_BLK 0x800415BC ValA_Wu16 211. DFC_Verb 0.00 211. FORMAT "%2.0" NUMBER 15 /end CHARACTERISTIC
/begin CHARACTERISTIC DSMRdy_Grp.EvpSys_CA "" VAL_BLK 0x800415DA ValA_Wu16 211. DFC_Verb 0.00 211. FORMAT "%2.0" NUMBER 15 /end CHARACTERISTIC
/begin CHARACTERISTIC DSMRdy_Grp.SecAirSys_CA "" VAL_BLK 0x800415F8 ValA_Wu16 211. DFC_Verb 0.00 211. FORMAT "%2.0" NUMBER 15 /end CHARACTERISTIC
/begin CHARACTERISTIC DSMRdy_Grp.O2Sens_CA "" VAL_BLK 0x80041618 ValA_Wu16 211. DFC_Verb 0.00 211. FORMAT "%2.0" NUMBER 15 /end CHARACTERISTIC
/begin CHARACTERISTIC DSMRdy_Grp.O2SensHt_CA "" VAL_BLK 0x80041636 ValA_Wu16 211. DFC_Verb 0.00 211. FORMAT "%2.0" NUMBER 15 /end CHARACTERISTIC
/begin CHARACTERISTIC DSMRdy_Grp.EGR_CA "" VAL_BLK 0x80041654 ValA_Wu16 211. DFC_Verb 0.00 211. FORMAT "%2.0" NUMBER 15 /end CHARACTERISTIC
/begin CHARACTERISTIC DSMRdy_X.PID1ForceLowMsk_C "" VALUE 0x80040D50 Val_Wu32 4294967295.00 DSMRdy_OneToOne 0.00 4294967295.00 FORMAT "%13.2" /end CHARACTERISTIC
/begin CHARACTERISTIC DSMRdy_X.PID1ForceHighMsk_C "" VALUE 0x80040D54 Val_Wu32 4294967295.00 DSMRdy_OneToOne 0.00 4294967295.00 FORMAT "%13.2" /end CHARACTERISTIC
/begin CHARACTERISTIC DSMRdy_X.PID41ForceLowMsk_C "" VALUE 0x80040D58 Val_Wu32 4294967295.00 DSMRdy_OneToOne 0.00 4294967295.00 FORMAT "%13.2" /end CHARACTERISTIC
/begin CHARACTERISTIC DSMRdy_X.PID41ForceHighMsk_C "" VALUE 0x80040D5C Val_Wu32 4294967295.00 DSMRdy_OneToOne 0.00 4294967295.00 FORMAT "%13.2" /end CHARACTERISTIC
/begin CHARACTERISTIC DTR_numCANOBDId_CA "" VAL_BLK 0x80040D60 ValA_Wu8 255.0 DFC_OneToOne 0.00 255.0 FORMAT "%5.1" NUMBER 16 /end CHARACTERISTIC
/begin CHARACTERISTIC DTR_numCANTstId_CA "" VAL_BLK 0x80040D70 ValA_Wu8 255.0 DFC_OneToOne 0.00 255.0 FORMAT "%5.1" NUMBER 16 /end CHARACTERISTIC
/begin CHARACTERISTIC DTR_xAsgnCANRslt_CA "" VAL_BLK 0x80040D80 ValA_Wu8 255. DTR_Verb 0.00 255. FORMAT "%2.0" NUMBER 16 /end CHARACTERISTIC
/begin CHARACTERISTIC EEPRdErr_Datalost_CW "" VALUE 0x8004BC72 Val_Wu8 255.0 default 0.00 255.0 FORMAT "%5.1" /end CHARACTERISTIC
/begin CHARACTERISTIC EEPRdErr_Redundant_CW "" VALUE 0x8004BC73 Val_Wu8 255.0 default 0.00 255.0 FORMAT "%5.1" /end CHARACTERISTIC
/begin CHARACTERISTIC Eep_ClrWrCounter_CW "" VALUE 0x8004BC74 Val_Wu8 255.0 default 0.00 255.0 FORMAT "%5.1" /end CHARACTERISTIC
/begin CHARACTERISTIC Eep_EnFirstFactoryMark_CW "" VALUE 0x8004BC75 Val_Wu8 255.0 default 0.00 255.0 FORMAT "%5.1" /end CHARACTERISTIC
/begin CHARACTERISTIC Eep_EnFirstInit_CW "" VALUE 0x8004BC76 Val_Wu8 255.0 default 0.00 255.0 FORMAT "%5.1" /end CHARACTERISTIC
/begin CHARACTERISTIC Eep_EnvRamClr_CW "" VALUE 0x8004BC77 Val_Wu8 255.0 default 0.00 255.0 FORMAT "%5.1" /end CHARACTERISTIC
/begin CHARACTERISTIC EpmBCr_facPlaus_C "" VALUE 0x8004BC7E Val_Wu8 15.94 EPM_FAC_PLAUS 0.00 15.94 FORMAT "%5.2" /end CHARACTERISTIC
/begin CHARACTERISTIC EpmBCr_phiTimeoutInt_C "" VALUE 0x8004BC78 Val_Ws16 360.0000 AngleCrS 0.00 360.0000 FORMAT "%8.4" /end CHARACTERISTIC
/begin CHARACTERISTIC EpmBCr_phiZero2Sync_CA "" VAL_BLK 0x8004BC80 ValA_Ws16 719.9780 AngleCrS 0.00 719.9780 FORMAT "%8.4" NUMBER 2 /end CHARACTERISTIC
/begin CHARACTERISTIC EpmBCr_swtEnable_C "" VALUE 0x8004BC7A Val_Wu8 2.000 OneToOne 0.00 2.000 FORMAT "%5.3" /end CHARACTERISTIC
/begin CHARACTERISTIC EpmBCr_tEna_C "" VALUE 0x8004BC7C Val_Ws16 6500.000 Temp_Cels -3500.040 2999.960 FORMAT "%8.3" /end CHARACTERISTIC
/begin CHARACTERISTIC EpmCaS_dSegSeries_CA "" VAL_BLK 0x8004BCA4 ValA_Wu8 255.0 OneToOne 0.00 255.0 FORMAT "%5.1" NUMBER 10 /end CHARACTERISTIC
/begin CHARACTERISTIC EpmCaS_facAdapFil_C "" VALUE 0x8004BC84 Val_Ws32 1.00000000000 EpmCaS_Fac_Adap 0.00 1.00000000000 FORMAT "%13.11" /end CHARACTERISTIC
/begin CHARACTERISTIC EpmCaS_facPlausHigh_GCUR "" CURVE 0x8004BCAE CurG_Ws16 65.53500 EpmCaS_Fac_Plaus -32.76800 32.76700 FORMAT "%8.5"
 /begin AXIS_DESCR COM_AXIS Epm_nEng EngN 3 -16384.00 16383.50 FORMAT "%8.2" AXIS_PTS_REF EpmCaS_facPlaus_DST /end AXIS_DESCR
/end CHARACTERISTIC
/begin CHARACTERISTIC EpmCaS_facPlausLow_GCUR "" CURVE 0x8004BCB4 CurG_Ws16 65.53500 EpmCaS_Fac_Plaus -32.76800 32.76700 FORMAT "%8.5"
 /begin AXIS_DESCR COM_AXIS Epm_nEng EngN 3 -16384.00 16383.50 FORMAT "%8.2" AXIS_PTS_REF EpmCaS_facPlaus_DST /end AXIS_DESCR
/end CHARACTERISTIC
/begin AXIS_PTS EpmCaS_facPlaus_DST "" 0x8004BCBA Epm_nEng Axis_Xs16 32767.50 EngN 3 -16384.00 16383.50 FORMAT "%8.2" DEPOSIT ABSOLUTE /end AXIS_PTS
/begin CHARACTERISTIC EpmCaS_numErrSigDef_C "" VALUE 0x8004BC90 Val_Wu16 96.00000 CrSRev2CrSInc 4.000000 100.0000 FORMAT "%8.4" /end CHARACTERISTIC
/begin CHARACTERISTIC EpmCaS_numErrSigOk_C "" VALUE 0x8004BC92 Val_Wu16 96.00000 CrSRev2CrSInc 4.000000 100.0000 FORMAT "%8.4" /end CHARACTERISTIC
/begin CHARACTERISTIC EpmCaS_numNoSigDef_C "" VALUE 0x8004BC94 Val_Wu16 96.00000 CrSRev2CrSInc 4.000000 100.0000 FORMAT "%8.4" /end CHARACTERISTIC
/begin CHARACTERISTIC EpmCaS_numOfsErr_C "" VALUE 0x8004BC98 Val_Wu8 255.0 OneToOne 0.00 255.0 FORMAT "%5.1" /end CHARACTERISTIC
/begin CHARACTERISTIC EpmCaS_numSegSerLst_C "" VALUE 0x8004BCC2 Val_Wu8 255.0 OneToOne 0.00 255.0 FORMAT "%5.1" /end CHARACTERISTIC
/begin CHARACTERISTIC EpmCaS_phiDiffAdapMax_C "" VALUE 0x8004BC88 Val_Ws16 5.998535 AngleCrS 0.00 5.998535 FORMAT "%8.6" /end CHARACTERISTIC
/begin CHARACTERISTIC EpmCaS_phiDiffLim_C "" VALUE 0x8004BC8A Val_Ws16 50.00977 AngleCrS 0.00 50.00977 FORMAT "%8.5" /end CHARACTERISTIC
/begin CHARACTERISTIC EpmCaS_phiLoLimIn_C "" VALUE 0x8004BCC4 Val_Ws16 1439.978 AngleCrS -720.0000 719.9780 FORMAT "%8.4" /end CHARACTERISTIC
/begin CHARACTERISTIC EpmCaS_phiNCor_CUR "" CURVE 0x8004BCC6 Cur_Xs16Ws16 1439.978 AngleCrS -720.0000 719.9780 FORMAT "%8.4"
 /begin AXIS_DESCR STD_AXIS Epm_nEng EngN 6 -16384.00 16383.50 FORMAT "%8.2" DEPOSIT ABSOLUTE /end AXIS_DESCR
/end CHARACTERISTIC
/begin CHARACTERISTIC EpmCaS_phiOfsMax_C "" VALUE 0x8004BC9A Val_Ws16 1439.978 AngleCrS -720.0000 719.9780 FORMAT "%8.4" /end CHARACTERISTIC
/begin CHARACTERISTIC EpmCaS_phiOfsMin_C "" VALUE 0x8004BC9C Val_Ws16 1439.978 AngleCrS -720.0000 719.9780 FORMAT "%8.4" /end CHARACTERISTIC
/begin CHARACTERISTIC EpmCaS_phiSegLenTol_CA "" VAL_BLK 0x8004BCE0 ValA_Ws16 1439.978 AngleCrS -720.0000 719.9780 FORMAT "%8.4" NUMBER 10 /end CHARACTERISTIC
/begin CHARACTERISTIC EpmCaS_phiSegLen_CA "" VAL_BLK 0x8004BCF4 ValA_Ws16 719.9780 AngleCrS 0.00 719.9780 FORMAT "%8.4" NUMBER 10 /end CHARACTERISTIC
/begin CHARACTERISTIC EpmCaS_phiSegOfs_CA "" VAL_BLK 0x8004BD08 ValA_Ws16 719.9780 AngleCrS 0.00 719.9780 FORMAT "%8.4" NUMBER 1 /end CHARACTERISTIC
/begin AXIS_PTS EpmCaS_phiTempCor05_DST "" 0x8004BD0A EngDa_tEng Axis_Xs16 6553.500 Temp_Cels 3 -3549.940 3003.560 FORMAT "%8.3" DEPOSIT ABSOLUTE /end AXIS_PTS
/begin CHARACTERISTIC EpmCaS_phiTempCorI1_GCUR "" CURVE 0x8004BD12 CurG_Ws16 1439.978 AngleCrS -720.0000 719.9780 FORMAT "%8.4"
 /begin AXIS_DESCR COM_AXIS EngDa_tEng Temp_Cels 3 -3549.940 3003.560 FORMAT "%8.3" AXIS_PTS_REF EpmCaS_phiTempCor05_DST /end AXIS_DESCR
/end CHARACTERISTIC
/begin CHARACTERISTIC EpmCaS_phiUpLimIn_C "" VALUE 0x8004BD18 Val_Ws16 1439.978 AngleCrS -720.0000 719.9780 FORMAT "%8.4" /end CHARACTERISTIC
/begin CHARACTERISTIC EpmCaS_stActEdge_C "" VALUE 0x8004BD1A Val_Wu8 255.0 OneToOne 0.00 255.0 FORMAT "%5.1" /end CHARACTERISTIC
/begin CHARACTERISTIC EpmCaS_stMinSyncCaSAg_C "" VALUE 0x8004BD1B Val_Wu8 20.00 OneToOne 10.00 30.00 FORMAT "%5.2" /end CHARACTERISTIC
/begin CHARACTERISTIC EpmCaS_stOfsDiagMode_C "" VALUE 0x8004BC9E Val_Wu8 3.000 OneToOne 0.00 3.000 FORMAT "%5.3" /end CHARACTERISTIC
/begin CHARACTERISTIC EpmCaS_swtAdapStgy_C "" VALUE 0x8004BC8C Val_Wu8 1.000 OneToOne 0.00 1.000 FORMAT "%5.3" /end CHARACTERISTIC
/begin CHARACTERISTIC EpmCaS_swtMeasCaS_C "" VALUE 0x8004BC96 Val_Wu8 51.00 OneToOne 0.00 51.00 FORMAT "%5.2" /end CHARACTERISTIC
/begin CHARACTERISTIC EpmCaS_swtSeg_C "" VALUE 0x8004BD1C Val_Wu8 255.0 OneToOne 0.00 255.0 FORMAT "%5.1" /end CHARACTERISTIC
/begin CHARACTERISTIC EpmCaS_tiGlitchFilter_C "" VALUE 0x8004BD20 Val_Ws32 4294967295.00 OneToOne_us -2147483648.00 2147483647.00 FORMAT "%13.2" /end CHARACTERISTIC
/begin CHARACTERISTIC EpmCaS_tiOfsPT1_C "" VALUE 0x8004BCA0 Val_Wu16 4294901.7590 TimeDelay_ms 65.537000015 4294967.2960 FORMAT "%12.4" /end CHARACTERISTIC
/begin CHARACTERISTIC EpmCaS_tiTimeout_C "" VALUE 0x8004BD24 Val_Ws32 42949672950.0 Time_ms -21474836480.0 21474836470.0 FORMAT "%13.1" /end CHARACTERISTIC
/begin CHARACTERISTIC EpmCrS_dnEngMax_C "" VALUE 0x8004BD28 Val_Ws16 32767.00 EngNGrd -16383.50 16383.50 FORMAT "%8.2" /end CHARACTERISTIC
/begin CHARACTERISTIC EpmCrS_facGapCrit1_C "" VALUE 0x8004BD40 Val_Wu8 15.94 EPM_FAC_PLAUS 0.00 15.94 FORMAT "%5.2" /end CHARACTERISTIC
/begin CHARACTERISTIC EpmCrS_facGapCrit2_C "" VALUE 0x8004BD41 Val_Wu8 15.94 EPM_FAC_PLAUS 0.00 15.94 FORMAT "%5.2" /end CHARACTERISTIC
/begin CHARACTERISTIC EpmCrS_facGapPlausHigh_CA "" VAL_BLK 0x8004BD42 ValA_Wu8 15.94 EPM_FAC_PLAUS 0.00 15.94 FORMAT "%5.2" NUMBER 4 /end CHARACTERISTIC
/begin CHARACTERISTIC EpmCrS_facIncPlausHigh_CA "" VAL_BLK 0x8004BD46 ValA_Wu8 15.94 EPM_FAC_PLAUS 0.00 15.94 FORMAT "%5.2" NUMBER 4 /end CHARACTERISTIC
/begin CHARACTERISTIC EpmCrS_facIncPlausLow_CA "" VAL_BLK 0x8004BD4A ValA_Wu8 15.94 EPM_FAC_PLAUS 0.00 15.94 FORMAT "%5.2" NUMBER 4 /end CHARACTERISTIC
/begin CHARACTERISTIC EpmCrS_nDiagOff_C "" VALUE 0x8004BD2A Val_Ws16 8000.000 EngN 0.00 8000.000 FORMAT "%8.3" /end CHARACTERISTIC
/begin CHARACTERISTIC EpmCrS_nDiagOn_C "" VALUE 0x8004BD2C Val_Ws16 8000.000 EngN 0.00 8000.000 FORMAT "%8.3" /end CHARACTERISTIC
/begin CHARACTERISTIC EpmCrS_nMaxInc_C "" VALUE 0x8004BD4E Val_Ws16 9980.000 EngN 20.00000 10000.00 FORMAT "%8.2" /end CHARACTERISTIC
/begin CHARACTERISTIC EpmCrS_nMinInc_C "" VALUE 0x8004BD50 Val_Ws16 9980.000 EngN 20.00000 10000.00 FORMAT "%8.2" /end CHARACTERISTIC
/begin CHARACTERISTIC EpmCrS_nThreshRange_CA "" VAL_BLK 0x8004BD54 ValA_Ws32 16384.198623855635 EngN2tiIncPer 20.000031000049649 16404.198654855685 FORMAT "%19.13" NUMBER 4 /end CHARACTERISTIC
/begin CHARACTERISTIC EpmCrS_nTiIncPerAvrg_CA "" VAL_BLK 0x8004BD64 ValA_Ws16 16363.00 EngN 20.00000 16383.00 FORMAT "%8.2" NUMBER 4 /end CHARACTERISTIC
/begin CHARACTERISTIC EpmCrS_numErrSigIncDef_C "" VALUE 0x8004BD2E Val_Ws16 32767.00 OneToOne 0.00 32767.00 FORMAT "%8.2" /end CHARACTERISTIC
/begin CHARACTERISTIC EpmCrS_numErrSigIncOK_C "" VALUE 0x8004BD30 Val_Ws16 32767.00 OneToOne 0.00 32767.00 FORMAT "%8.2" /end CHARACTERISTIC
/begin CHARACTERISTIC EpmCrS_numErrSigMaxDef_C "" VALUE 0x8004BD32 Val_Ws16 32767.00 OneToOne 0.00 32767.00 FORMAT "%8.2" /end CHARACTERISTIC
/begin CHARACTERISTIC EpmCrS_numErrSigMinOK_C "" VALUE 0x8004BD34 Val_Ws16 32767.00 OneToOne 0.00 32767.00 FORMAT "%8.2" /end CHARACTERISTIC
/begin CHARACTERISTIC EpmCrS_numIgnInc_C "" VALUE 0x8004BD6C Val_Wu8 252.0 OneToOne 3.000 255.0 FORMAT "%5.1" /end CHARACTERISTIC
/begin CHARACTERISTIC EpmCrS_numNoSigDef_C "" VALUE 0x8004BD36 Val_Ws16 32767.00 OneToOne 0.00 32767.00 FORMAT "%8.2" /end CHARACTERISTIC
/begin CHARACTERISTIC EpmCrS_numTiIncPerAvrg_CA "" VAL_BLK 0x8004BD6D ValA_Wu8 50.00 OneToOne 0.00 50.00 FORMAT "%5.2" NUMBER 4 /end CHARACTERISTIC
/begin CHARACTERISTIC EpmCrS_stDiagT50Reset_C "" VALUE 0x8004BD38 Val_Wu8 1.000 OneToOne 0.00 1.000 FORMAT "%5.3" /end CHARACTERISTIC
/begin CHARACTERISTIC EpmCrS_stTTMeasure_C "" VALUE 0x8004BD88 Val_Wu8 255.0 OneToOne 0.00 255.0 FORMAT "%5.1" /end CHARACTERISTIC
/begin CHARACTERISTIC EpmCrS_swtEnableDiag_C "" VALUE 0x8004BD39 Val_Wu8 255.0 OneToOne 0.00 255.0 FORMAT "%5.1" /end CHARACTERISTIC
/begin CHARACTERISTIC EpmCrS_tiGlitchFilter_CA "" VAL_BLK 0x8004BD74 ValA_Ws32 100000.000000 OneToOne_us 0.00 100000.000000 FORMAT "%13.6" NUMBER 4 /end CHARACTERISTIC
/begin CHARACTERISTIC EpmCrS_tiIgnSig_C "" VALUE 0x8004BD84 Val_Ws32 100000.000000 OneToOne_ms 0.00 100000.000000 FORMAT "%13.6" /end CHARACTERISTIC
/begin CHARACTERISTIC EpmCrS_VehV_v_Max_C "" VALUE 0x8004BD3A Val_Ws16 655.3500 Vel -327.6800 327.6700 FORMAT "%8.4" /end CHARACTERISTIC
/begin CHARACTERISTIC EpmCrS_VehV_v_Min_C "" VALUE 0x8004BD3C Val_Ws16 655.3500 Vel -327.6800 327.6700 FORMAT "%8.4" /end CHARACTERISTIC
/begin CHARACTERISTIC EpmRRS_EnaIgnInj_CW "" VALUE 0x8004BD8A Val_Wu8 3.000 OneToOne 0.00 3.000 FORMAT "%5.3" /end CHARACTERISTIC
/begin CHARACTERISTIC EpmRRS_nEngMax_C "" VALUE 0x8004BD8C Val_Ws16 1000.000 EngN 0.00 1000.000 FORMAT "%8.3" /end CHARACTERISTIC
/begin CHARACTERISTIC EpmRRS_phiMax_C "" VALUE 0x8004BD8E Val_Ws16 360.0000 AngleCrS 0.00 360.0000 FORMAT "%8.4" /end CHARACTERISTIC
/begin CHARACTERISTIC EpmRRS_phiUndef_C "" VALUE 0x8004BD90 Val_Ws16 90.00000 AngleCrS 0.00 90.00000 FORMAT "%8.5" /end CHARACTERISTIC
/begin CHARACTERISTIC EpmRRS_tiMaxToothTime_C "" VALUE 0x8004BD92 Val_Wu8 970.0 t_q10_ms 30.00 1000. FORMAT "%5.0" /end CHARACTERISTIC
/begin CHARACTERISTIC EpmRRS_tiTemp_CUR "" CURVE 0x8004BD94 Cur_Xs16Ws16 32767.00 OneToOne_us 0.00 32767.00 FORMAT "%8.2"
 /begin AXIS_DESCR STD_AXIS EngDa_tEng Temp_Cels 3 -3549.940 3003.560 FORMAT "%8.3" DEPOSIT ABSOLUTE /end AXIS_DESCR
/end CHARACTERISTIC
/begin CHARACTERISTIC EpmRRS_vVehMax_C "" VALUE 0x8004BDA2 Val_Ws16 250.0000 vel_q0p01 0.00 250.0000 FORMAT "%8.4" /end CHARACTERISTIC
/begin CHARACTERISTIC EpmSeq_nMaxStrtInt_C "" VALUE 0x8004BDA4 Val_Ws16 10000.00 EngN 0.00 10000.00 FORMAT "%8.2" /end CHARACTERISTIC
/begin CHARACTERISTIC EpmSeq_phiDelayMax_CA "" VAL_BLK 0x8004BDA6 ValA_Ws16 180.0000 AngleCrS 0.00 180.0000 FORMAT "%8.4" NUMBER 2 /end CHARACTERISTIC
/begin CHARACTERISTIC EpmSeq_phiIntBCr_CA "" VAL_BLK 0x8004BDAA ValA_Ws16 719.9780 AngleCrS 0.00 719.9780 FORMAT "%8.4" NUMBER 2 /end CHARACTERISTIC
/begin CHARACTERISTIC EpmSeq_phiInt_CA "" VAL_BLK 0x8004BDAE ValA_Ws16 719.9780 AngleCrS 0.00 719.9780 FORMAT "%8.4" NUMBER 2 /end CHARACTERISTIC
/begin CHARACTERISTIC EpmSeq_phiStrtInt_CA "" VAL_BLK 0x8004BDB2 ValA_Ws16 719.9780 AngleCrS 0.00 719.9780 FORMAT "%8.4" NUMBER 2 /end CHARACTERISTIC
/begin CHARACTERISTIC EpmSeq_swtInt_C "" VALUE 0x8004BDB6 Val_Wu8 15.00 OneToOne 0.00 15.00 FORMAT "%5.2" /end CHARACTERISTIC
/begin CHARACTERISTIC EpmSyn_dCaSSegMsk_C "" VALUE 0x8004BDB8 Val_Wu8 255.0 OneToOne 0.00 255.0 FORMAT "%5.1" /end CHARACTERISTIC
/begin CHARACTERISTIC EpmSyn_phiIncCor_CUR "" CURVE 0x8004BDBA Cur_Xs16Ws16 39.99023 AngleCrS -19.99512 19.99512 FORMAT "%8.5"
 /begin AXIS_DESCR STD_AXIS Epm_nEng EngN 4 -16384.00 16383.50 FORMAT "%8.2" DEPOSIT ABSOLUTE /end AXIS_DESCR
/end CHARACTERISTIC
/begin CHARACTERISTIC Epm_nALESyncMax_C "" VALUE 0x8004BDD4 Val_Ws16 10000.00 EngN 0.00 10000.00 FORMAT "%8.2" /end CHARACTERISTIC
/begin CHARACTERISTIC Epm_nNoSyncVerify_C "" VALUE 0x8004BDD6 Val_Ws16 10000.00 EngN 0.00 10000.00 FORMAT "%8.2" /end CHARACTERISTIC
/begin CHARACTERISTIC Epm_numFireSeg_C "" VAL_BLK 0x8004BDCC ValA_Wu8 2.000 OneToOne 1.000 3.000 FORMAT "%5.3" NUMBER 3 /end CHARACTERISTIC
/begin CHARACTERISTIC Epm_numReSync_C "" VALUE 0x8004BDD8 Val_Wu8 100.0 OneToOne 0.00 100.0 FORMAT "%5.1" /end CHARACTERISTIC
/begin CHARACTERISTIC Epm_phiGap2Zero_C "" VALUE 0x8004BDD0 Val_Ws16 359.9780 AngleCrS 0.00 359.9780 FORMAT "%8.4" /end CHARACTERISTIC
/begin CHARACTERISTIC Epm_phiTdc1_C "" VALUE 0x8004BDD2 Val_Ws16 719.9780 AngleCrS 0.00 719.9780 FORMAT "%8.4" /end CHARACTERISTIC
/begin CHARACTERISTIC Epm_swtBlkInjCaSSync_C "" VALUE 0x8004BDD9 Val_Wu8 1.000 OneToOne 0.00 1.000 FORMAT "%5.3" /end CHARACTERISTIC
/begin CHARACTERISTIC Epm_swtOpModeStgy_C "" VALUE 0x8004BDDA Val_Wu8 15.00 OneToOne 0.00 15.00 FORMAT "%5.2" /end CHARACTERISTIC
/begin CHARACTERISTIC Epm_tiLockReSync_C "" VALUE 0x8004BDDC Val_Ws16 5000.000 Time_ms 0.00 5000.000 FORMAT "%8.3" /end CHARACTERISTIC
/begin CHARACTERISTIC Epm_tiSpd2Zero_C "" VALUE 0x8004BDDE Val_Wu16 3000.000 Time_ms 0.00 3000.000 FORMAT "%8.3" /end CHARACTERISTIC
/begin CHARACTERISTIC Epm_tiSpdGrdAvgFlt_C "" VALUE 0x8004BDE0 Val_Ws32 998.99238550 TimeDelay_ms 1.0000000689 999.99238556 FORMAT "%12.7" /end CHARACTERISTIC
/begin CHARACTERISTIC Epm_tiSpdGrdFlt_C "" VALUE 0x8004BDE4 Val_Ws32 998.99238550 TimeDelay_ms 1.0000000689 999.99238556 FORMAT "%12.7" /end CHARACTERISTIC
/begin CHARACTERISTIC ESC_nMaxEngReStrt_C "" VALUE 0x8004BC6C Val_Ws16 10000.00 EngN 0.00 10000.00 FORMAT "%8.2" /end CHARACTERISTIC
/begin CHARACTERISTIC ESC_stS1FrstSched_C "" VALUE 0x8004BC6E Val_Wu8 3.00000000000 ESC_stS1FrstSched_t 0.00 3.00000000000 FORMAT "%13.11" /end CHARACTERISTIC
/begin CHARACTERISTIC FNSSM "" CURVE 0x800451B4 GklWU8 3.984 fak_ub_b4 0.00 3.984 FORMAT "%5.3"
 /begin AXIS_DESCR COM_AXIS tmst temp_ub_q0p75_o48 12 -48.00 143.3 FORMAT "%5.1" AXIS_PTS_REF STS12ESUB /end AXIS_DESCR
/end CHARACTERISTIC
/begin CHARACTERISTIC FRKAP "" VALUE 0x80045113 KwWU8 1.992188 fak_ub_b2 0.00 1.992188 FORMAT "%8.6" /end CHARACTERISTIC
/begin CHARACTERISTIC FWSTAB "" CURVE 0x800451C0 GklWU8 1.992188 fak_ub_b2 0.00 1.992188 FORMAT "%8.6"
 /begin AXIS_DESCR COM_AXIS kstaa fak_ub_b2 6 0.00 1.992188 FORMAT "%8.6" AXIS_PTS_REF SKS06ESUB /end AXIS_DESCR
/end CHARACTERISTIC
/begin CHARACTERISTIC FZANSSA1 "" CURVE 0x800451C6 GklWU8 0.249023438 fak_ub_b0p25 0.00 0.249023438 FORMAT "%11.9"
 /begin AXIS_DESCR COM_AXIS tans temp_ub_q0p75_o48 6 -48.00 143.3 FORMAT "%5.1" AXIS_PTS_REF STA06ESUB /end AXIS_DESCR
/end CHARACTERISTIC
/begin CHARACTERISTIC FZANSSA2 "" CURVE 0x800451CC GklWU8 0.249023438 fak_ub_b0p25 0.00 0.249023438 FORMAT "%11.9"
 /begin AXIS_DESCR COM_AXIS tans temp_ub_q0p75_o48 6 -48.00 143.3 FORMAT "%5.1" AXIS_PTS_REF STA06ESUB /end AXIS_DESCR
/end CHARACTERISTIC
/begin CHARACTERISTIC FZANSSM1 "" CURVE 0x800451D2 GklWU8 0.249023438 fak_ub_b0p25 0.00 0.249023438 FORMAT "%11.9"
 /begin AXIS_DESCR COM_AXIS tmst temp_ub_q0p75_o48 12 -48.00 143.3 FORMAT "%5.1" AXIS_PTS_REF STS12ESUB /end AXIS_DESCR
/end CHARACTERISTIC
/begin CHARACTERISTIC FZANSSM2 "" CURVE 0x800451DE GklWU8 0.249023438 fak_ub_b0p25 0.00 0.249023438 FORMAT "%11.9"
 /begin AXIS_DESCR COM_AXIS tmst temp_ub_q0p75_o48 12 -48.00 143.3 FORMAT "%5.1" AXIS_PTS_REF STS12ESUB /end AXIS_DESCR
/end CHARACTERISTIC
/begin CHARACTERISTIC FZANSSM3 "" CURVE 0x800451EA GklWU8 0.249023438 fak_ub_b0p25 0.00 0.249023438 FORMAT "%11.9"
 /begin AXIS_DESCR COM_AXIS tmst temp_ub_q0p75_o48 12 -48.00 143.3 FORMAT "%5.1" AXIS_PTS_REF STS12ESUB /end AXIS_DESCR
/end CHARACTERISTIC
/begin CHARACTERISTIC KFFNSAMX "" MAP 0x8004511A KfAxU8AyU8SstxU8SstyU16WU16 1.999969 fak_uw_b2 0.00 1.999969 FORMAT "%8.6"
 /begin AXIS_DESCR STD_AXIS tmotnsad temp_ub_q0p75_o48 6 -48.00 143.3 FORMAT "%5.1" DEPOSIT ABSOLUTE /end AXIS_DESCR
 /begin AXIS_DESCR STD_AXIS lamsbg_w fak_uw_b16 3 0.00 15.99976 FORMAT "%8.5" DEPOSIT ABSOLUTE /end AXIS_DESCR
/end CHARACTERISTIC
/begin CHARACTERISTIC KFFNSHO "" MAP 0x800451F6 KfAxU8AyU8SstxU8SstyU8WU8 1.992188 fak_ub_b2 0.00 1.992188 FORMAT "%8.6"
 /begin AXIS_DESCR STD_AXIS tmst temp_ub_q0p75_o48 6 -48.00 143.3 FORMAT "%5.1" DEPOSIT ABSOLUTE /end AXIS_DESCR
 /begin AXIS_DESCR STD_AXIS fho fak_ub_b4 4 0.00 3.984 FORMAT "%5.3" DEPOSIT ABSOLUTE /end AXIS_DESCR
/end CHARACTERISTIC
/begin CHARACTERISTIC KFFWL "" MAP 0x8004521A GkfWU8 1.992188 fak_ub_b2 0.00 1.992188 FORMAT "%8.6"
 /begin AXIS_DESCR COM_AXIS tmot temp_ub_q0p75_o48 12 -48.00 143.3 FORMAT "%5.1" AXIS_PTS_REF STM12ESUB /end AXIS_DESCR
 /begin AXIS_DESCR COM_AXIS tmst temp_ub_q0p75_o48 12 -48.00 143.3 FORMAT "%5.1" AXIS_PTS_REF STS12ESUB /end AXIS_DESCR
/end CHARACTERISTIC
/begin CHARACTERISTIC KFFWLRL "" MAP 0x800452AA GkfWU8 1.992188 fak_ub_b2 0.00 1.992188 FORMAT "%8.6"
 /begin AXIS_DESCR COM_AXIS tmst temp_ub_q0p75_o48 8 -48.00 143.3 FORMAT "%5.1" AXIS_PTS_REF STS08ESUB /end AXIS_DESCR
 /begin AXIS_DESCR COM_AXIS rlp rel_ub_q0p75 6 0.00 191.3 FORMAT "%5.1" AXIS_PTS_REF SRP06ESUB /end AXIS_DESCR
/end CHARACTERISTIC
/begin CHARACTERISTIC KFKNSTWST "" MAP 0x800452DA KfAxU8AyU8SstxU8SstyU16WU8 1.992188 fak_ub_b2 0.00 1.992188 FORMAT "%8.6"
 /begin AXIS_DESCR STD_AXIS tmst temp_ub_q0p75_o48 4 -48.00 143.3 FORMAT "%5.1" DEPOSIT ABSOLUTE /end AXIS_DESCR
 /begin AXIS_DESCR STD_AXIS tengsq1_w dez 4 0.00 65535.00 FORMAT "%8.2" DEPOSIT ABSOLUTE /end AXIS_DESCR
/end CHARACTERISTIC
/begin CHARACTERISTIC KFLRST "" MAP 0x80045436 GkfWU16 327.67499992 zk5msxs_uw_b327p68 0.0050000762951 327.68000000 FORMAT "%12.8"
 /begin AXIS_DESCR COM_AXIS nmot_w nmot_uw_q0p25 7 0.00 16383.75 FORMAT "%8.2" AXIS_PTS_REF SNM07LSUW /end AXIS_DESCR
 /begin AXIS_DESCR COM_AXIS rlinterp_w rel_uw_q0p0234 8 0.00 1535.977 FORMAT "%8.3" AXIS_PTS_REF SRL08LSUW /end AXIS_DESCR
/end CHARACTERISTIC
/begin CHARACTERISTIC KFLRSZ "" MAP 0x800454A6 GkfWU16 327.66999985 zk10msxs_uw_b655p36 0.010000152590 327.68000000 FORMAT "%12.8"
 /begin AXIS_DESCR COM_AXIS nmot_w nmot_uw_q0p25 7 0.00 16383.75 FORMAT "%8.2" AXIS_PTS_REF SNM07LSUW /end AXIS_DESCR
 /begin AXIS_DESCR COM_AXIS rlinterp_w rel_uw_q0p0234 8 0.00 1535.977 FORMAT "%8.3" AXIS_PTS_REF SRL08LSUW /end AXIS_DESCR
/end CHARACTERISTIC
/begin CHARACTERISTIC KFNSA "" MAP 0x800452F8 KfAxU8AyU8SstxU8SstyU8WU8 1.992188 fak_ub_b2 0.00 1.992188 FORMAT "%8.6"
 /begin AXIS_DESCR STD_AXIS tans temp_ub_q0p75_o48 6 -48.00 143.3 FORMAT "%5.1" DEPOSIT ABSOLUTE /end AXIS_DESCR
 /begin AXIS_DESCR STD_AXIS tmot temp_ub_q0p75_o48 3 -48.00 143.3 FORMAT "%5.1" DEPOSIT ABSOLUTE /end AXIS_DESCR
/end CHARACTERISTIC
/begin CHARACTERISTIC KFNSWRL "" MAP 0x80045315 GkfWU8 1.992188 fak_ub_b2 0.00 1.992188 FORMAT "%8.6"
 /begin AXIS_DESCR COM_AXIS tmst temp_ub_q0p75_o48 8 -48.00 143.3 FORMAT "%5.1" AXIS_PTS_REF STS08ESUB /end AXIS_DESCR
 /begin AXIS_DESCR COM_AXIS rlp rel_ub_q0p75 6 0.00 191.3 FORMAT "%5.1" AXIS_PTS_REF SRP06ESUB /end AXIS_DESCR
/end CHARACTERISTIC
/begin CHARACTERISTIC KFSDLUSDMR "" MAP 0x80045044 KfAxU8AyU8SstxU8SstyU16WU8 25.77 lu_MEx_div_8 0.00 25.77 FORMAT "%5.2"
 /begin AXIS_DESCR STD_AXIS tmsdluts temp_ub_q0p75_o48 6 -48.00 143.3 FORMAT "%5.1" DEPOSIT ABSOLUTE /end AXIS_DESCR
 /begin AXIS_DESCR STD_AXIS dmrmx_w rel_uw_b100 4 0.00 99.99847 FORMAT "%8.5" DEPOSIT ABSOLUTE /end AXIS_DESCR
/end CHARACTERISTIC
/begin CHARACTERISTIC KFSDLUSOL "" MAP 0x8004506C KfAxU8AyU8SstxU8SstyU16WU8 25.77 lu_MEx_div_8 0.00 25.77 FORMAT "%5.2"
 /begin AXIS_DESCR STD_AXIS tmsdluts temp_ub_q0p75_o48 6 -48.00 143.3 FORMAT "%5.1" DEPOSIT ABSOLUTE /end AXIS_DESCR
 /begin AXIS_DESCR STD_AXIS anztib_w dez 12 0.00 65535.00 FORMAT "%8.2" DEPOSIT ABSOLUTE /end AXIS_DESCR
/end CHARACTERISTIC
/begin CHARACTERISTIC KFSDLUSRRI "" MAP 0x800450D4 KfAxU8AyU8SstxU8SstyU16WU8 25.77 lu_MEx_div_8 0.00 25.77 FORMAT "%5.2"
 /begin AXIS_DESCR STD_AXIS tmsdluts temp_ub_q0p75_o48 6 -48.00 143.3 FORMAT "%5.1" DEPOSIT ABSOLUTE /end AXIS_DESCR
 /begin AXIS_DESCR STD_AXIS rri_w rel_uw_b100 4 0.00 99.99847 FORMAT "%8.5" DEPOSIT ABSOLUTE /end AXIS_DESCR
/end CHARACTERISTIC
/begin CHARACTERISTIC KFWSTAARL "" MAP 0x80045345 GkfWU8 3.984 fak_ub_b4 0.00 3.984 FORMAT "%5.3"
 /begin AXIS_DESCR COM_AXIS kstaa fak_ub_b2 6 0.00 1.992188 FORMAT "%8.6" AXIS_PTS_REF SKS06ESUB /end AXIS_DESCR
 /begin AXIS_DESCR COM_AXIS rlp rel_ub_q0p75 6 0.00 191.3 FORMAT "%5.1" AXIS_PTS_REF SRP06ESUB /end AXIS_DESCR
/end CHARACTERISTIC
/begin CHARACTERISTIC KFWWLML "" MAP 0x80045369 GkfWU8 1.992188 fak_ub_b2 0.00 1.992188 FORMAT "%8.6"
 /begin AXIS_DESCR COM_AXIS imlatm_w m_uw_b23p3 6 0.00 23.30133 FORMAT "%8.5" AXIS_PTS_REF SIM06ESUW /end AXIS_DESCR
 /begin AXIS_DESCR COM_AXIS tmst temp_ub_q0p75_o48 8 -48.00 143.3 FORMAT "%5.1" AXIS_PTS_REF STS08ESUB /end AXIS_DESCR
/end CHARACTERISTIC
/begin CHARACTERISTIC KFWWNS "" MAP 0x8004539A KfAxU8AyU8SstxU8SstyU16WU8 1.992188 fak_ub_b2 0.00 1.992188 FORMAT "%8.6"
 /begin AXIS_DESCR STD_AXIS tmst temp_ub_q0p75_o48 8 -48.00 143.3 FORMAT "%5.1" DEPOSIT ABSOLUTE /end AXIS_DESCR
 /begin AXIS_DESCR STD_AXIS tengsq1_w dez 8 0.00 65535.00 FORMAT "%8.2" DEPOSIT ABSOLUTE /end AXIS_DESCR
/end CHARACTERISTIC
/begin CHARACTERISTIC KLFNSAMX "" CURVE 0x8004514C KlAxU8SstxU8WU16 1.999969 fak_uw_b2 0.00 1.999969 FORMAT "%8.6"
 /begin AXIS_DESCR STD_AXIS tmot temp_ub_q0p75_o48 6 -48.00 143.3 FORMAT "%5.1" DEPOSIT ABSOLUTE /end AXIS_DESCR
/end CHARACTERISTIC
/begin CHARACTERISTIC KLFNSKH "" CURVE 0x800453F4 KlAxU8SstxU8WU8 3.984 fak_ub_b4 0.00 3.984 FORMAT "%5.3"
 /begin AXIS_DESCR STD_AXIS tmst temp_ub_q0p75_o48 4 -48.00 143.3 FORMAT "%5.1" DEPOSIT ABSOLUTE /end AXIS_DESCR
/end CHARACTERISTIC
/begin CHARACTERISTIC KLFWLN "" CURVE 0x800453FD KlAxU8SstxU8WU8 1.992188 fak_ub_b2 0.00 1.992188 FORMAT "%8.6"
 /begin AXIS_DESCR STD_AXIS nmot nmot_ub_q40 6 0.00 10200. FORMAT "%5.0" DEPOSIT ABSOLUTE /end AXIS_DESCR
/end CHARACTERISTIC
/begin CHARACTERISTIC KLLUTS "" CURVE 0x800450FC KlAxU8SstxS16WU16 3.999939 fak_uw_b4 0.00 3.999939 FORMAT "%8.6"
 /begin AXIS_DESCR STD_AXIS luts_w lu_MEx 4 -149.0116 149.0071 FORMAT "%8.4" DEPOSIT ABSOLUTE /end AXIS_DESCR
/end CHARACTERISTIC
/begin CHARACTERISTIC KLNSADI "" CURVE 0x80045160 KlAxU8SstxS16WS16 1.999969 fak_sw_b1 -1.000000 0.9999695 FORMAT "%8.6"
 /begin AXIS_DESCR STD_AXIS dsdlutsi_w lu_MEx 6 -149.0116 149.0071 FORMAT "%8.4" DEPOSIT ABSOLUTE /end AXIS_DESCR
/end CHARACTERISTIC
/begin CHARACTERISTIC KLNSADP "" CURVE 0x8004517A KlAxU8SstxS16WU16 1.999969 fak_uw_b2 0.00 1.999969 FORMAT "%8.6"
 /begin AXIS_DESCR STD_AXIS dsdluts_w lu_MEx 6 -149.0116 149.0071 FORMAT "%8.4" DEPOSIT ABSOLUTE /end AXIS_DESCR
/end CHARACTERISTIC
/begin CHARACTERISTIC KLZANSFHO "" CURVE 0x8004540A KlAxU8SstxU8WU8 3.984 fak_ub_b4 0.00 3.984 FORMAT "%5.3"
 /begin AXIS_DESCR STD_AXIS fho fak_ub_b4 8 0.00 3.984 FORMAT "%5.3" DEPOSIT ABSOLUTE /end AXIS_DESCR
/end CHARACTERISTIC
/begin CHARACTERISTIC KLZKNSADI "" CURVE 0x80045194 KlAxU8SstxS16WU16 0.9999847 fak_uw_b1 0.00 0.9999847 FORMAT "%9.7"
 /begin AXIS_DESCR STD_AXIS dsdluts_w lu_MEx 6 -149.0116 149.0071 FORMAT "%8.4" DEPOSIT ABSOLUTE /end AXIS_DESCR
/end CHARACTERISTIC
/begin CHARACTERISTIC RKAKAP "" VALUE 0x80045114 KwWS8 23.91 rel_q0p09375 -12.00 11.91 FORMAT "%5.2" /end CHARACTERISTIC
/begin CHARACTERISTIC SF_LM "" VAL_BLK 0x8004503A KwbWU16 86. dfp_verbal 0.00 86. FORMAT "%2.0" READ_ONLY NUMBER 3 /end CHARACTERISTIC
/begin AXIS_PTS SIM06ESUW "" 0x80049E60 imlatm_w SstAUwSstUw 23.30133 m_uw_b23p3 6 0.00 23.30133 FORMAT "%8.5" DEPOSIT ABSOLUTE /end AXIS_PTS
/begin AXIS_PTS SKS06ESUB "" 0x80049E6E kstaa SstAUbSstUb 1.992188 fak_ub_b2 6 0.00 1.992188 FORMAT "%8.6" DEPOSIT ABSOLUTE /end AXIS_PTS
/begin AXIS_PTS SNM07LSUW "" 0x80045516 nmot_w SstAU8SstU16 16383.75 nmot_uw_q0p25 7 0.00 16383.75 FORMAT "%8.2" DEPOSIT ABSOLUTE /end AXIS_PTS
/begin AXIS_PTS SRL08LSUW "" 0x80045526 rlinterp_w SstAU8SstU16 1535.977 rel_uw_q0p0234 8 0.00 1535.977 FORMAT "%8.3" DEPOSIT ABSOLUTE /end AXIS_PTS
/begin AXIS_PTS SRP06ESUB "" 0x80049F67 rlp SstAUbSstUb 191.3 rel_ub_q0p75 6 0.00 191.3 FORMAT "%5.1" DEPOSIT ABSOLUTE /end AXIS_PTS
/begin AXIS_PTS STA06ESUB "" 0x80049F7D tans SstAUbSstUb 191.3 temp_ub_q0p75_o48 6 -48.00 143.3 FORMAT "%5.1" DEPOSIT ABSOLUTE /end AXIS_PTS
/begin AXIS_PTS STM12ESUB "" 0x80049FAE tmot SstAUbSstUb 191.3 temp_ub_q0p75_o48 12 -48.00 143.3 FORMAT "%5.1" DEPOSIT ABSOLUTE /end AXIS_PTS
/begin AXIS_PTS STS08ESUB "" 0x80049FC2 tmst SstAUbSstUb 191.3 temp_ub_q0p75_o48 8 -48.00 143.3 FORMAT "%5.1" DEPOSIT ABSOLUTE /end AXIS_PTS
/begin AXIS_PTS STS12ESUB "" 0x80049FCB tmst SstAUbSstUb 191.3 temp_ub_q0p75_o48 12 -48.00 143.3 FORMAT "%5.1" DEPOSIT ABSOLUTE /end AXIS_PTS
/begin CHARACTERISTIC SZANSSM1 "" CURVE 0x8004541B GklWU8 1.000000 fak_ub_b2 0.00 1.000000 FORMAT "%8.6"
 /begin AXIS_DESCR COM_AXIS tmst temp_ub_q0p75_o48 12 -48.00 143.3 FORMAT "%5.1" AXIS_PTS_REF STS12ESUB /end AXIS_DESCR
/end CHARACTERISTIC
/begin CHARACTERISTIC SZANSSM2 "" CURVE 0x80045427 GklWU8 1.000000 fak_ub_b2 0.00 1.000000 FORMAT "%8.6"
 /begin AXIS_DESCR COM_AXIS tmst temp_ub_q0p75_o48 12 -48.00 143.3 FORMAT "%5.1" AXIS_PTS_REF STS12ESUB /end AXIS_DESCR
/end CHARACTERISTIC
/begin CHARACTERISTIC TKIHKMRED "" VALUE 0x80045042 KwWU16 1535.977 temp_q0p0234_o273 -273.1500 1262.827 FORMAT "%8.3" /end CHARACTERISTIC
/begin CHARACTERISTIC TMWUC "" VALUE 0x80045041 KwWU8 191.3 temp_ub_q0p75_o48 -48.00 143.3 FORMAT "%5.1" /end CHARACTERISTIC
/begin CHARACTERISTIC TNSADHMX "" VALUE 0x800451AE KwWU16 6553.500 t100msxs_uw_b6553p5 0.00 6553.500 FORMAT "%8.3" /end CHARACTERISTIC
/begin CHARACTERISTIC TNSEMX "" VALUE 0x800451B0 KwWU16 6553.500 t100msxs_uw_b6553p5 0.00 6553.500 FORMAT "%8.3" /end CHARACTERISTIC
/begin CHARACTERISTIC ZDGZA1 "" VALUE 0x80045433 KwWU8 255.0 dez 0.00 255.0 FORMAT "%5.1" /end CHARACTERISTIC
/begin CHARACTERISTIC ZDGZA2 "" VALUE 0x80045434 KwWU8 255.0 dez 0.00 255.0 FORMAT "%5.1" /end CHARACTERISTIC
/begin CHARACTERISTIC ZDGZA3 "" VALUE 0x80045435 KwWU8 255.0 dez 0.00 255.0 FORMAT "%5.1" /end CHARACTERISTIC
/begin CHARACTERISTIC ZKASDLUTS "" VALUE 0x8004510E KwWU16 0.9999847 fak_uw_b1 0.00 0.9999847 FORMAT "%9.7" /end CHARACTERISTIC
/begin CHARACTERISTIC ZKFNSADOFF "" VALUE 0x800451B2 KwWU16 6553.4999985 zk100msxs_uw_b6553 0.10000152590 6553.6000000 FORMAT "%12.7" /end CHARACTERISTIC
/begin CHARACTERISTIC ZKMSDLUTS "" VALUE 0x80045110 KwWU16 0.9999847 fak_uw_b1 0.00 0.9999847 FORMAT "%9.7" /end CHARACTERISTIC
/begin CHARACTERISTIC ZNGFIL "" VALUE 0x80045B90 KwSl 4294967.2669 TimeDelay_ms 0.029121650999 4294967.2960 FORMAT "%12.4" /end CHARACTERISTIC
/begin MEASUREMENT bbdcy "" UBYTE dez 1 100 0.00 255.0 FORMAT "%5.1" ECU_ADDRESS 0xD0000F3B /end MEASUREMENT
/begin MEASUREMENT bbwuc "" UBYTE dez 1 100 0.00 255.0 FORMAT "%5.1" ECU_ADDRESS 0xD0000F3C /end MEASUREMENT
/begin MEASUREMENT bmlosctr_w "" UWORD dez 1 100 0.00 65535.00 FORMAT "%8.2" ECU_ADDRESS 0xAFE8011C /end MEASUREMENT
/begin MEASUREMENT B_bm "" UBYTE B_TRUE 1 100 0.00 1.00000000000 BIT_MASK 0x1 FORMAT "%13.11" ECU_ADDRESS 0xD0000078 /end MEASUREMENT
/begin MEASUREMENT B_dcy "" UBYTE B_TRUE 1 100 0.00 1.00000000000 BIT_MASK 0x80 FORMAT "%13.11" ECU_ADDRESS 0xD0000088 /end MEASUREMENT
/begin MEASUREMENT B_dopzue "" UBYTE B_TRUE 1 100 0.00 1.00000000000 BIT_MASK 0x1 FORMAT "%13.11" ECU_ADDRESS 0xD0000098 /end MEASUREMENT
/begin MEASUREMENT B_eepwf "" UBYTE B_TRUE 1 100 0.00 1.00000000000 BIT_MASK 0x80 FORMAT "%13.11" ECU_ADDRESS 0xD0000053 /end MEASUREMENT
/begin MEASUREMENT B_ehfs "" UBYTE B_TRUE 1 100 0.00 1.00000000000 BIT_MASK 0x1 FORMAT "%13.11" ECU_ADDRESS 0xD000009A /end MEASUREMENT
/begin MEASUREMENT B_engrest "" UBYTE B_TRUE 1 100 0.00 1.00000000000 BIT_MASK 0x80 FORMAT "%13.11" ECU_ADDRESS 0xD0000073 /end MEASUREMENT
/begin MEASUREMENT B_engrestp "" UBYTE B_TRUE 1 100 0.00 1.00000000000 BIT_MASK 0x4 FORMAT "%13.11" ECU_ADDRESS 0xD0000098 /end MEASUREMENT
/begin MEASUREMENT B_engrests "" UBYTE B_TRUE 1 100 0.00 1.00000000000 BIT_MASK 0x4 FORMAT "%13.11" ECU_ADDRESS 0xD0000079 /end MEASUREMENT
/begin MEASUREMENT B_fbm "" UBYTE B_TRUE 1 100 0.00 1.00000000000 BIT_MASK 0x8 FORMAT "%13.11" ECU_ADDRESS 0xD000005D /end MEASUREMENT
/begin MEASUREMENT B_fhfs "" UBYTE B_TRUE 1 100 0.00 1.00000000000 BIT_MASK 0x1 FORMAT "%13.11" ECU_ADDRESS 0xD0000092 /end MEASUREMENT
/begin MEASUREMENT B_fnsoff "" UBYTE B_TRUE 1 100 0.00 1.00000000000 BIT_MASK 0x1 FORMAT "%13.11" ECU_ADDRESS 0xD0000088 /end MEASUREMENT
/begin MEASUREMENT B_fsynst "" UBYTE B_TRUE 1 100 0.00 1.00000000000 BIT_MASK 0x10 FORMAT "%13.11" ECU_ADDRESS 0xD000003C /end MEASUREMENT
/begin MEASUREMENT B_fwloff "" UBYTE B_TRUE 1 100 0.00 1.00000000000 BIT_MASK 0x80 FORMAT "%13.11" ECU_ADDRESS 0xD0000077 /end MEASUREMENT
/begin MEASUREMENT B_mil "" UBYTE B_TRUE 1 100 0.00 1.00000000000 BIT_MASK 0x4 FORMAT "%13.11" ECU_ADDRESS 0xD0000071 /end MEASUREMENT
/begin MEASUREMENT B_milblk "" UBYTE B_TRUE 1 100 0.00 1.00000000000 BIT_MASK 0x8 FORMAT "%13.11" ECU_ADDRESS 0xD000007D /end MEASUREMENT
/begin MEASUREMENT B_milst "" UBYTE B_TRUE 1 100 0.00 1.00000000000 BIT_MASK 0x2 FORMAT "%13.11" ECU_ADDRESS 0xD000009B /end MEASUREMENT
/begin MEASUREMENT B_motstop "" UBYTE B_TRUE 1 100 0.00 1.00000000000 BIT_MASK 0x80 FORMAT "%13.11" ECU_ADDRESS 0xD0000087 /end MEASUREMENT
/begin MEASUREMENT B_ngasok "" UBYTE B_TRUE 1 100 0.00 1.00000000000 BIT_MASK 0x80 FORMAT "%13.11" ECU_ADDRESS 0xD000009C /end MEASUREMENT
/begin MEASUREMENT B_nldg "" UBYTE B_TRUE 1 100 0.00 1.00000000000 BIT_MASK 0x2 FORMAT "%13.11" ECU_ADDRESS 0xD000005A /end MEASUREMENT
/begin MEASUREMENT B_nlph "" UBYTE B_TRUE 1 100 0.00 1.00000000000 BIT_MASK 0x80 FORMAT "%13.11" ECU_ADDRESS 0xD0000093 /end MEASUREMENT
/begin MEASUREMENT B_nlphwe "" UBYTE B_TRUE 1 100 0.00 1.00000000000 BIT_MASK 0x4 FORMAT "%13.11" ECU_ADDRESS 0xD0000073 /end MEASUREMENT
/begin MEASUREMENT B_nmin "" UBYTE B_TRUE 1 100 0.00 1.00000000000 BIT_MASK 0x20 FORMAT "%13.11" ECU_ADDRESS 0xD0000078 /end MEASUREMENT
/begin MEASUREMENT B_nmot "" UBYTE B_TRUE 1 100 0.00 1.00000000000 BIT_MASK 0x8 FORMAT "%13.11" ECU_ADDRESS 0xD000007B /end MEASUREMENT
/begin MEASUREMENT B_nwkv "" UBYTE B_TRUE 1 100 0.00 1.00000000000 BIT_MASK 0x2 FORMAT "%13.11" ECU_ADDRESS 0xD0000087 /end MEASUREMENT
/begin MEASUREMENT B_optpherk "" UBYTE B_TRUE 1 100 0.00 1.00000000000 BIT_MASK 0x8 FORMAT "%13.11" ECU_ADDRESS 0xD0000077 /end MEASUREMENT
/begin MEASUREMENT B_phsinvst "" UBYTE B_TRUE 1 100 0.00 1.00000000000 BIT_MASK 0x2 FORMAT "%13.11" ECU_ADDRESS 0xD0000099 /end MEASUREMENT
/begin MEASUREMENT B_phsnl "" UBYTE B_TRUE 1 100 0.00 1.00000000000 BIT_MASK 0x2 FORMAT "%13.11" ECU_ADDRESS 0xD000006B /end MEASUREMENT
/begin MEASUREMENT B_pwf "" UBYTE B_TRUE 1 100 0.00 1.00000000000 BIT_MASK 0x1 FORMAT "%13.11" ECU_ADDRESS 0xD000006E /end MEASUREMENT
/begin MEASUREMENT B_stainjen "" UBYTE B_TRUE 1 100 0.00 1.00000000000 BIT_MASK 0x4 FORMAT "%13.11" ECU_ADDRESS 0xD000005E /end MEASUREMENT
/begin MEASUREMENT B_statas "" UBYTE B_TRUE 1 100 0.00 1.00000000000 BIT_MASK 0x8 FORMAT "%13.11" ECU_ADDRESS 0xD0000075 /end MEASUREMENT
/begin MEASUREMENT B_stprel "" UBYTE B_TRUE 1 100 0.00 1.00000000000 BIT_MASK 0x8 FORMAT "%13.11" ECU_ADDRESS 0xD000009B /end MEASUREMENT
/begin MEASUREMENT B_stprep "" UBYTE B_TRUE 1 100 0.00 1.00000000000 BIT_MASK 0x20 FORMAT "%13.11" ECU_ADDRESS 0xD0000082 /end MEASUREMENT
/begin MEASUREMENT B_sttrigg "" UBYTE B_TRUE 1 100 0.00 1.00000000000 BIT_MASK 0x1 FORMAT "%13.11" ECU_ADDRESS 0xD000003C /end MEASUREMENT
/begin MEASUREMENT B_synnot "" UBYTE B_TRUE 1 100 0.00 1.00000000000 BIT_MASK 0x40 FORMAT "%13.11" ECU_ADDRESS 0xD0000077 /end MEASUREMENT
/begin MEASUREMENT B_synph "" UBYTE B_TRUE 1 100 0.00 1.00000000000 BIT_MASK 0x4 FORMAT "%13.11" ECU_ADDRESS 0xD0000096 /end MEASUREMENT
/begin MEASUREMENT B_umsync "" UBYTE B_TRUE 1 100 0.00 1.00000000000 BIT_MASK 0x40 FORMAT "%13.11" ECU_ADDRESS 0xD000007C /end MEASUREMENT
/begin MEASUREMENT B_wuc "" UBYTE B_TRUE 1 100 0.00 1.00000000000 BIT_MASK 0x10 FORMAT "%13.11" ECU_ADDRESS 0xD0000084 /end MEASUREMENT
/begin MEASUREMENT B_zprel "" UBYTE B_TRUE 1 100 0.00 1.00000000000 BIT_MASK 0x2 FORMAT "%13.11" ECU_ADDRESS 0xD000007E /end MEASUREMENT
/begin MEASUREMENT CoETS_trqInrLim "" SWORD md_q0p1 1 100 -3276.800 3276.700 FORMAT "%8.3" ECU_ADDRESS 0xD000348E /end MEASUREMENT
/begin MEASUREMENT CoETS_trqInrLimSet "" SWORD md_q0p1 1 100 -3276.800 3276.700 FORMAT "%8.3" ECU_ADDRESS 0xD0003490 /end MEASUREMENT
/begin MEASUREMENT CoETS_trqUnFltLtd "" SWORD md_q0p1 1 100 -3276.800 3276.700 FORMAT "%8.3" ECU_ADDRESS 0xD0003492 /end MEASUREMENT
/begin MEASUREMENT Com_stClntFail "" UBYTE OneToOne 1 100 0.00 255.0 FORMAT "%5.1" ECU_ADDRESS 0xD0003C31 /end MEASUREMENT
/begin MEASUREMENT Com_tRaw "" SWORD temp_q0p01 1 100 -327.6800 327.6700 FORMAT "%8.4" ECU_ADDRESS 0xD00034B6 /end MEASUREMENT
/begin MEASUREMENT dcycnt "" UWORD dez 1 100 0.00 65535.00 FORMAT "%8.2" ECU_ADDRESS 0xAFE8014E /end MEASUREMENT
/begin MEASUREMENT dnmot_w "" SWORD nmot_sw_q0p25 1 100 -8192.000 8191.750 FORMAT "%8.3" ECU_ADDRESS 0xD00006C0 /end MEASUREMENT
/begin MEASUREMENT dsdliold_w "" SWORD lu_MEx 1 100 -149.0116 149.0071 FORMAT "%8.4" ECU_ADDRESS 0xD00006E4 /end MEASUREMENT
/begin MEASUREMENT dsdlutsi_w "" SWORD lu_MEx 1 100 -149.0116 149.0071 FORMAT "%8.4" ECU_ADDRESS 0xD00006E6 /end MEASUREMENT
/begin MEASUREMENT dsdluts_w "" SWORD lu_MEx 1 100 -149.0116 149.0071 FORMAT "%8.4" ECU_ADDRESS 0xD00006DE /end MEASUREMENT
/begin MEASUREMENT DSMAUX_ctWUC "" UBYTE OneToOne 1 100 0.00 255.0 FORMAT "%5.1" ECU_ADDRESS 0xAFE80258 /end MEASUREMENT
/begin MEASUREMENT DSMAUX_DTRG.DTRG_Time200ms "" UBYTE DFC_OneToOne 1 100 0.00 255.0 FORMAT "%5.1" ECU_ADDRESS 0xD0003DE7 /end MEASUREMENT
/begin MEASUREMENT DSMAUX_DTRG.DTRG_SimilarCondHLC "" UBYTE DFC_OneToOne 1 100 0.00 255.0 FORMAT "%5.1" ECU_ADDRESS 0xD0003DE8 /end MEASUREMENT
/begin MEASUREMENT DSMAUX_DTRG.DTRG_WarmUpCycle "" UBYTE DFC_OneToOne 1 100 0.00 255.0 FORMAT "%5.1" ECU_ADDRESS 0xD0003DE9 /end MEASUREMENT
/begin MEASUREMENT DSMAUX_DTRG.DTRG_DrivingCycleFLC "" UBYTE DFC_OneToOne 1 100 0.00 255.0 FORMAT "%5.1" ECU_ADDRESS 0xD0003DEA /end MEASUREMENT
/begin MEASUREMENT DSMAUX_DTRG.DTRG_AlwaysTrue "" UBYTE DFC_OneToOne 1 100 0.00 255.0 FORMAT "%5.1" ECU_ADDRESS 0xD0003DEB /end MEASUREMENT
/begin MEASUREMENT DSMAUX_DTRG.DTRG_DrivingCycleHLC "" UBYTE DFC_OneToOne 1 100 0.00 255.0 FORMAT "%5.1" ECU_ADDRESS 0xD0003DEC /end MEASUREMENT
/begin MEASUREMENT DSMAUX_DTRG.bbsp2_17 "" UBYTE DFC_OneToOne 1 100 0.00 255.0 FORMAT "%5.1" ECU_ADDRESS 0xD0003DED /end MEASUREMENT
/begin MEASUREMENT DSMAUX_DTRG.bbsp1_17 "" UBYTE DFC_OneToOne 1 100 0.00 255.0 FORMAT "%5.1" ECU_ADDRESS 0xD0003DEE /end MEASUREMENT
/begin MEASUREMENT DSMAUX_DTRG.DTRG_NoTrigger "" UBYTE DFC_OneToOne 1 100 0.00 255.0 FORMAT "%5.1" ECU_ADDRESS 0xD0003DEF /end MEASUREMENT
/begin MEASUREMENT DSMAUX_stStrtEnd "" UBYTE OneToOne 1 100 0.00 1.000 BIT_MASK 0x20 FORMAT "%5.3" ECU_ADDRESS 0xD0000089 /end MEASUREMENT
/begin MEASUREMENT DSMAUX_tClntStrt "" SWORD Temp_Cels 1 100 -3549.940 3003.560 FORMAT "%8.3" ECU_ADDRESS 0xD0003776 /end MEASUREMENT
/begin MEASUREMENT DSMDur_ctGlb "" ULONG DFES_OneToOne 1 100 0.00 4294967295.00 FORMAT "%13.2" ARRAY_SIZE 1 ECU_ADDRESS 0xAFE80244 /end MEASUREMENT
/begin MEASUREMENT DSMDur_ctPID21h "" ULONG DSMDUR_10m_Counter 1 100 0.00 42949672.9500 FORMAT "%13.4" ECU_ADDRESS 0xAFE8024C /end MEASUREMENT
/begin MEASUREMENT DSMDur_ctPID31h "" ULONG DSMDUR_10m_Counter 1 100 0.00 42949672.9500 FORMAT "%13.4" ECU_ADDRESS 0xAFE80250 /end MEASUREMENT
/begin MEASUREMENT DSMDur_stGlb "" UBYTE DSMDur_StDispl_Verb 1 100 0.00 2.00000000000 FORMAT "%13.11" ARRAY_SIZE 1 ECU_ADDRESS 0xAFE80248 /end MEASUREMENT
/begin MEASUREMENT DSMDur_stPID21h "" UBYTE DSMDur_StDispl_Verb 1 100 0.00 2.00000000000 FORMAT "%13.11" ECU_ADDRESS 0xAFE80254 /end MEASUREMENT
/begin MEASUREMENT DSMRdy_stGrpRdy "" UWORD DSMRdy_OneToOne 1 100 0.00 65535.00 FORMAT "%8.2" ECU_ADDRESS 0xAFE80240 /end MEASUREMENT
/begin MEASUREMENT DSMRdy_stGrpRdyDFES "" UWORD DSMRdy_OneToOne 1 100 0.00 65535.00 FORMAT "%8.2" ECU_ADDRESS 0xD0003772 /end MEASUREMENT
/begin MEASUREMENT DSMRdy_stGrpRdyScan "" UWORD DSMRdy_OneToOne 1 100 0.00 65535.00 FORMAT "%8.2" ECU_ADDRESS 0xD0003770 /end MEASUREMENT
/begin MEASUREMENT DSMRdy_stGrpSup "" UWORD DSMRdy_OneToOne 1 100 0.00 65535.00 FORMAT "%8.2" ECU_ADDRESS 0xD0003774 /end MEASUREMENT
/begin MEASUREMENT DSMRdy_xPId1 "" ULONG DSMRdy_OneToOne 1 100 0.00 4294967295.00 FORMAT "%13.2" ECU_ADDRESS 0xD0002984 /end MEASUREMENT
/begin MEASUREMENT DSM_bStFuncTst_mp "" UBYTE OneToOne 1 100 0.00 255.0 FORMAT "%5.1" ECU_ADDRESS 0xD00053C6 /end MEASUREMENT
/begin MEASUREMENT DSM_DisblMode_mp "" UWORD OneToOne 1 100 0.00 65535.00 FORMAT "%8.2" ECU_ADDRESS 0xD00052F4 /end MEASUREMENT
/begin MEASUREMENT DSM_ECUId_mp "" UBYTE OneToOne 1 100 0.00 255.0 FORMAT "%5.1" ECU_ADDRESS 0xD00053C7 /end MEASUREMENT
/begin MEASUREMENT DSM_lDst_mp "" SLONG Length 1 100 -2147483648.00 2147483647.00 FORMAT "%13.2" ECU_ADDRESS 0xD0005180 /end MEASUREMENT
/begin MEASUREMENT DSM_nEng_mp "" SWORD EngN 1 100 -16384.00 16383.50 FORMAT "%8.2" ECU_ADDRESS 0xD00052F6 /end MEASUREMENT
/begin MEASUREMENT DSM_pEnv_mp "" SWORD Pres_hPa 1 100 -32768.00 32767.00 FORMAT "%8.2" ECU_ADDRESS 0xD00052F8 /end MEASUREMENT
/begin MEASUREMENT DSM_rAPP_mp "" SWORD Prc 1 100 -400.0000 399.9878 FORMAT "%8.4" ECU_ADDRESS 0xD00052FA /end MEASUREMENT
/begin MEASUREMENT DSM_stPostDrive "" UBYTE OneToOne 1 100 0.00 255.0 FORMAT "%5.1" ECU_ADDRESS 0xD0003DE4 /end MEASUREMENT
/begin MEASUREMENT DSM_stReInit "" UBYTE OneToOne 1 100 0.00 255.0 FORMAT "%5.1" ECU_ADDRESS 0xD0003DE3 /end MEASUREMENT
/begin MEASUREMENT DSM_stStrEnd_mp "" UBYTE OneToOne 1 100 0.00 255.0 FORMAT "%5.1" ECU_ADDRESS 0xD00053C8 /end MEASUREMENT
/begin MEASUREMENT DSM_stWiggle_mp "" UBYTE OneToOne 1 100 0.00 255.0 FORMAT "%5.1" ECU_ADDRESS 0xD00053C9 /end MEASUREMENT
/begin MEASUREMENT DSM_tEngDS_mp "" SWORD Temp_Cels 1 100 -3549.940 3003.560 FORMAT "%8.3" ECU_ADDRESS 0xD00052FC /end MEASUREMENT
/begin MEASUREMENT DSM_tEnv_mp "" SWORD Temp_Cels 1 100 -3549.940 3003.560 FORMAT "%8.3" ECU_ADDRESS 0xD00052FE /end MEASUREMENT
/begin MEASUREMENT DSM_vVeh_mp "" SWORD Vel 1 100 -327.6800 327.6700 FORMAT "%8.4" ECU_ADDRESS 0xD0005300 /end MEASUREMENT
/begin MEASUREMENT DTR_valLoLim.DTR_IdleChrgActrGovDeMax "" UWORD DFC_OneToOne 1 100 0.00 65535.00 FORMAT "%8.2" ECU_ADDRESS 0xAFE80220 /end MEASUREMENT
/begin MEASUREMENT DTR_valLoLim.DTR_IdleChrgActrGovDeMin "" UWORD DFC_OneToOne 1 100 0.00 65535.00 FORMAT "%8.2" ECU_ADDRESS 0xAFE80222 /end MEASUREMENT
/begin MEASUREMENT DTR_valLoLim.DTR_OBDMID_01_TID_01 "" UWORD DFC_OneToOne 1 100 0.00 65535.00 FORMAT "%8.2" ECU_ADDRESS 0xAFE80224 /end MEASUREMENT
/begin MEASUREMENT DTR_valLoLim.DTR_OBDMID_01_TID_02 "" UWORD DFC_OneToOne 1 100 0.00 65535.00 FORMAT "%8.2" ECU_ADDRESS 0xAFE80226 /end MEASUREMENT
/begin MEASUREMENT DTR_valLoLim.DTR_OBDMID_02_TID_01 "" UWORD DFC_OneToOne 1 100 0.00 65535.00 FORMAT "%8.2" ECU_ADDRESS 0xAFE80228 /end MEASUREMENT
/begin MEASUREMENT DTR_valLoLim.DTR_OBDMID_02_TID_02 "" UWORD DFC_OneToOne 1 100 0.00 65535.00 FORMAT "%8.2" ECU_ADDRESS 0xAFE8022A /end MEASUREMENT
/begin MEASUREMENT DTR_valLoLim.DTR_OBDMID_02_TID_OSCLO "" UWORD DFC_OneToOne 1 100 0.00 65535.00 FORMAT "%8.2" ECU_ADDRESS 0xAFE8022C /end MEASUREMENT
/begin MEASUREMENT DTR_valLoLim.DTR_OBDMID_02_TID_OSCUP "" UWORD DFC_OneToOne 1 100 0.00 65535.00 FORMAT "%8.2" ECU_ADDRESS 0xAFE8022E /end MEASUREMENT
/begin MEASUREMENT DTR_valLoLim.DTR_OBDMID_21_TID_AV "" UWORD DFC_OneToOne 1 100 0.00 65535.00 FORMAT "%8.2" ECU_ADDRESS 0xAFE80230 /end MEASUREMENT
/begin MEASUREMENT DTR_valLoLim.DTR_OBDMID_41_TID_HTR "" UWORD DFC_OneToOne 1 100 0.00 65535.00 FORMAT "%8.2" ECU_ADDRESS 0xAFE80232 /end MEASUREMENT
/begin MEASUREMENT DTR_valLoLim.DTR_OBDMID_a2_TID_0b_0 "" UWORD DFC_OneToOne 1 100 0.00 65535.00 FORMAT "%8.2" ECU_ADDRESS 0xAFE80234 /end MEASUREMENT
/begin MEASUREMENT DTR_valLoLim.DTR_OBDMID_a2_TID_0b_1 "" UWORD DFC_OneToOne 1 100 0.00 65535.00 FORMAT "%8.2" ECU_ADDRESS 0xAFE80236 /end MEASUREMENT
/begin MEASUREMENT DTR_valLoLim.DTR_OBDMID_a2_TID_0b_2 "" UWORD DFC_OneToOne 1 100 0.00 65535.00 FORMAT "%8.2" ECU_ADDRESS 0xAFE80238 /end MEASUREMENT
/begin MEASUREMENT DTR_valLoLim.DTR_OBDMID_a2_TID_0c_0 "" UWORD DFC_OneToOne 1 100 0.00 65535.00 FORMAT "%8.2" ECU_ADDRESS 0xAFE8023A /end MEASUREMENT
/begin MEASUREMENT DTR_valLoLim.DTR_OBDMID_a2_TID_0c_1 "" UWORD DFC_OneToOne 1 100 0.00 65535.00 FORMAT "%8.2" ECU_ADDRESS 0xAFE8023C /end MEASUREMENT
/begin MEASUREMENT DTR_valLoLim.DTR_OBDMID_a2_TID_0c_2 "" UWORD DFC_OneToOne 1 100 0.00 65535.00 FORMAT "%8.2" ECU_ADDRESS 0xAFE8023E /end MEASUREMENT
/begin MEASUREMENT DTR_valTst.DTR_IdleChrgActrGovDeMax "" UWORD DFC_OneToOne 1 100 0.00 65535.00 FORMAT "%8.2" ECU_ADDRESS 0xAFE801E0 /end MEASUREMENT
/begin MEASUREMENT DTR_valTst.DTR_IdleChrgActrGovDeMin "" UWORD DFC_OneToOne 1 100 0.00 65535.00 FORMAT "%8.2" ECU_ADDRESS 0xAFE801E2 /end MEASUREMENT
/begin MEASUREMENT DTR_valTst.DTR_OBDMID_01_TID_01 "" UWORD DFC_OneToOne 1 100 0.00 65535.00 FORMAT "%8.2" ECU_ADDRESS 0xAFE801E4 /end MEASUREMENT
/begin MEASUREMENT DTR_valTst.DTR_OBDMID_01_TID_02 "" UWORD DFC_OneToOne 1 100 0.00 65535.00 FORMAT "%8.2" ECU_ADDRESS 0xAFE801E6 /end MEASUREMENT
/begin MEASUREMENT DTR_valTst.DTR_OBDMID_02_TID_01 "" UWORD DFC_OneToOne 1 100 0.00 65535.00 FORMAT "%8.2" ECU_ADDRESS 0xAFE801E8 /end MEASUREMENT
/begin MEASUREMENT DTR_valTst.DTR_OBDMID_02_TID_02 "" UWORD DFC_OneToOne 1 100 0.00 65535.00 FORMAT "%8.2" ECU_ADDRESS 0xAFE801EA /end MEASUREMENT
/begin MEASUREMENT DTR_valTst.DTR_OBDMID_02_TID_OSCLO "" UWORD DFC_OneToOne 1 100 0.00 65535.00 FORMAT "%8.2" ECU_ADDRESS 0xAFE801EC /end MEASUREMENT
/begin MEASUREMENT DTR_valTst.DTR_OBDMID_02_TID_OSCUP "" UWORD DFC_OneToOne 1 100 0.00 65535.00 FORMAT "%8.2" ECU_ADDRESS 0xAFE801EE /end MEASUREMENT
/begin MEASUREMENT DTR_valTst.DTR_OBDMID_21_TID_AV "" UWORD DFC_OneToOne 1 100 0.00 65535.00 FORMAT "%8.2" ECU_ADDRESS 0xAFE801F0 /end MEASUREMENT
/begin MEASUREMENT DTR_valTst.DTR_OBDMID_41_TID_HTR "" UWORD DFC_OneToOne 1 100 0.00 65535.00 FORMAT "%8.2" ECU_ADDRESS 0xAFE801F2 /end MEASUREMENT
/begin MEASUREMENT DTR_valTst.DTR_OBDMID_a2_TID_0b_0 "" UWORD DFC_OneToOne 1 100 0.00 65535.00 FORMAT "%8.2" ECU_ADDRESS 0xAFE801F4 /end MEASUREMENT
/begin MEASUREMENT DTR_valTst.DTR_OBDMID_a2_TID_0b_1 "" UWORD DFC_OneToOne 1 100 0.00 65535.00 FORMAT "%8.2" ECU_ADDRESS 0xAFE801F6 /end MEASUREMENT
/begin MEASUREMENT DTR_valTst.DTR_OBDMID_a2_TID_0b_2 "" UWORD DFC_OneToOne 1 100 0.00 65535.00 FORMAT "%8.2" ECU_ADDRESS 0xAFE801F8 /end MEASUREMENT
/begin MEASUREMENT DTR_valTst.DTR_OBDMID_a2_TID_0c_0 "" UWORD DFC_OneToOne 1 100 0.00 65535.00 FORMAT "%8.2" ECU_ADDRESS 0xAFE801FA /end MEASUREMENT
/begin MEASUREMENT DTR_valTst.DTR_OBDMID_a2_TID_0c_1 "" UWORD DFC_OneToOne 1 100 0.00 65535.00 FORMAT "%8.2" ECU_ADDRESS 0xAFE801FC /end MEASUREMENT
/begin MEASUREMENT DTR_valTst.DTR_OBDMID_a2_TID_0c_2 "" UWORD DFC_OneToOne 1 100 0.00 65535.00 FORMAT "%8.2" ECU_ADDRESS 0xAFE801FE /end MEASUREMENT
/begin MEASUREMENT DTR_valUpLim.DTR_IdleChrgActrGovDeMax "" UWORD DFC_OneToOne 1 100 0.00 65535.00 FORMAT "%8.2" ECU_ADDRESS 0xAFE80200 /end MEASUREMENT
/begin MEASUREMENT DTR_valUpLim.DTR_IdleChrgActrGovDeMin "" UWORD DFC_OneToOne 1 100 0.00 65535.00 FORMAT "%8.2" ECU_ADDRESS 0xAFE80202 /end MEASUREMENT
/begin MEASUREMENT DTR_valUpLim.DTR_OBDMID_01_TID_01 "" UWORD DFC_OneToOne 1 100 0.00 65535.00 FORMAT "%8.2" ECU_ADDRESS 0xAFE80204 /end MEASUREMENT
/begin MEASUREMENT DTR_valUpLim.DTR_OBDMID_01_TID_02 "" UWORD DFC_OneToOne 1 100 0.00 65535.00 FORMAT "%8.2" ECU_ADDRESS 0xAFE80206 /end MEASUREMENT
/begin MEASUREMENT DTR_valUpLim.DTR_OBDMID_02_TID_01 "" UWORD DFC_OneToOne 1 100 0.00 65535.00 FORMAT "%8.2" ECU_ADDRESS 0xAFE80208 /end MEASUREMENT
/begin MEASUREMENT DTR_valUpLim.DTR_OBDMID_02_TID_02 "" UWORD DFC_OneToOne 1 100 0.00 65535.00 FORMAT "%8.2" ECU_ADDRESS 0xAFE8020A /end MEASUREMENT
/begin MEASUREMENT DTR_valUpLim.DTR_OBDMID_02_TID_OSCLO "" UWORD DFC_OneToOne 1 100 0.00 65535.00 FORMAT "%8.2" ECU_ADDRESS 0xAFE8020C /end MEASUREMENT
/begin MEASUREMENT DTR_valUpLim.DTR_OBDMID_02_TID_OSCUP "" UWORD DFC_OneToOne 1 100 0.00 65535.00 FORMAT "%8.2" ECU_ADDRESS 0xAFE8020E /end MEASUREMENT
/begin MEASUREMENT DTR_valUpLim.DTR_OBDMID_21_TID_AV "" UWORD DFC_OneToOne 1 100 0.00 65535.00 FORMAT "%8.2" ECU_ADDRESS 0xAFE80210 /end MEASUREMENT
/begin MEASUREMENT DTR_valUpLim.DTR_OBDMID_41_TID_HTR "" UWORD DFC_OneToOne 1 100 0.00 65535.00 FORMAT "%8.2" ECU_ADDRESS 0xAFE80212 /end MEASUREMENT
/begin MEASUREMENT DTR_valUpLim.DTR_OBDMID_a2_TID_0b_0 "" UWORD DFC_OneToOne 1 100 0.00 65535.00 FORMAT "%8.2" ECU_ADDRESS 0xAFE80214 /end MEASUREMENT
/begin MEASUREMENT DTR_valUpLim.DTR_OBDMID_a2_TID_0b_1 "" UWORD DFC_OneToOne 1 100 0.00 65535.00 FORMAT "%8.2" ECU_ADDRESS 0xAFE80216 /end MEASUREMENT
/begin MEASUREMENT DTR_valUpLim.DTR_OBDMID_a2_TID_0b_2 "" UWORD DFC_OneToOne 1 100 0.00 65535.00 FORMAT "%8.2" ECU_ADDRESS 0xAFE80218 /end MEASUREMENT
/begin MEASUREMENT DTR_valUpLim.DTR_OBDMID_a2_TID_0c_0 "" UWORD DFC_OneToOne 1 100 0.00 65535.00 FORMAT "%8.2" ECU_ADDRESS 0xAFE8021A /end MEASUREMENT
/begin MEASUREMENT DTR_valUpLim.DTR_OBDMID_a2_TID_0c_1 "" UWORD DFC_OneToOne 1 100 0.00 65535.00 FORMAT "%8.2" ECU_ADDRESS 0xAFE8021C /end MEASUREMENT
/begin MEASUREMENT DTR_valUpLim.DTR_OBDMID_a2_TID_0c_2 "" UWORD DFC_OneToOne 1 100 0.00 65535.00 FORMAT "%8.2" ECU_ADDRESS 0xAFE8021E /end MEASUREMENT
/begin MEASUREMENT Eeebd_numSectChg "" UWORD OneToOne 1 100 0.00 65535.00 FORMAT "%8.2" ECU_ADDRESS 0xAFE80750 /end MEASUREMENT
/begin MEASUREMENT Eeebd_stEee "" UBYTE Eeebd_EeeStates_Verb 1 100 0.00 3.00000000000 FORMAT "%13.11" ECU_ADDRESS 0xD0003DCD /end MEASUREMENT
/begin MEASUREMENT Eep_ctAbsCallWrFkt "" UWORD OneToOne 1 100 0.00 65535.00 FORMAT "%8.2" ECU_ADDRESS 0xAFE801D4 /end MEASUREMENT
/begin MEASUREMENT Eep_ctCallWrFkt "" UWORD OneToOne 1 100 0.00 65535.00 FORMAT "%8.2" ECU_ADDRESS 0xAFE8074E /end MEASUREMENT
/begin MEASUREMENT Eep_ctMaxCallWrFkt "" UWORD OneToOne 1 100 0.00 65535.00 FORMAT "%8.2" ECU_ADDRESS 0xAFE801D2 /end MEASUREMENT
/begin MEASUREMENT Eep_EnvRamHist "" UBYTE OneToOne 1 100 0.00 255.0 FORMAT "%5.1" ECU_ADDRESS 0xD0003DC6 /end MEASUREMENT
/begin MEASUREMENT Eep_EnvRamInvld "" UBYTE OneToOne 1 100 0.00 255.0 FORMAT "%5.1" ECU_ADDRESS 0xD0003DC5 /end MEASUREMENT
/begin MEASUREMENT Eep_numBlkCtr "" ULONG OneToOne 1 100 0.00 4294967295.00 FORMAT "%13.2" ARRAY_SIZE 15 ECU_ADDRESS 0xAFE806B4 /end MEASUREMENT
/begin MEASUREMENT Eep_numEnvRamLength "" UWORD OneToOne 1 100 0.00 65535.00 FORMAT "%8.2" ECU_ADDRESS 0xD0003760 /end MEASUREMENT
/begin MEASUREMENT Eep_stBlk "" UWORD OneToOne 1 100 0.00 65535.00 FORMAT "%8.2" ARRAY_SIZE 14 ECU_ADDRESS 0xD0001C78 /end MEASUREMENT
/begin MEASUREMENT Eep_stBlockFail "" UBYTE OneToOne 1 100 0.00 255.0 FORMAT "%5.1" ECU_ADDRESS 0xAFE806F6 /end MEASUREMENT
/begin MEASUREMENT Eep_stMain "" UBYTE Eep_MainStates_Verb 1 100 0.00 12.0000000000 FORMAT "%13.10" ECU_ADDRESS 0xD0003DB8 /end MEASUREMENT
/begin MEASUREMENT Eep_stPostDrv "" UBYTE Eep_PostDrvState_Verb 1 100 0.00 4.00000000000 FORMAT "%13.11" ECU_ADDRESS 0xD0003DBD /end MEASUREMENT
/begin MEASUREMENT Eep_xIniTimeus "" ULONG OneToOne 1 100 0.00 4294967295.00 FORMAT "%13.2" ECU_ADDRESS 0xD0002750 /end MEASUREMENT
/begin MEASUREMENT EpmBCr_ctCaSRev "" UBYTE OneToOne 1 100 0.00 255.0 FORMAT "%5.1" ECU_ADDRESS 0xD0003B2D /end MEASUREMENT
/begin MEASUREMENT EpmBCr_ctEdgeRefTabIdx "" UBYTE OneToOne 1 100 0.00 255.0 FORMAT "%5.1" ARRAY_SIZE 1 ECU_ADDRESS 0xD0003B32 /end MEASUREMENT
/begin MEASUREMENT EpmBCr_ctEdge_mp "" UBYTE OneToOne 1 100 0.00 255.0 FORMAT "%5.1" ECU_ADDRESS 0xD00053CA /end MEASUREMENT
/begin MEASUREMENT EpmBCr_nEng "" SWORD EngN 1 100 -16384.00 16383.50 FORMAT "%8.2" ECU_ADDRESS 0xD000328A /end MEASUREMENT
/begin MEASUREMENT EpmBCr_numEdgeID_mpA "" UBYTE OneToOne 1 100 0.00 255.0 FORMAT "%5.1" ARRAY_SIZE 2 ECU_ADDRESS 0xD00053CB /end MEASUREMENT
/begin MEASUREMENT EpmBCr_numSyncPos_mp "" UBYTE OneToOne 1 100 0.00 255.0 FORMAT "%5.1" ECU_ADDRESS 0xD00053CD /end MEASUREMENT
/begin MEASUREMENT EpmBCr_phiCurrCaSEdge "" SWORD AngleCrS 1 100 -720.0000 719.9780 FORMAT "%8.4" ARRAY_SIZE 1 ECU_ADDRESS 0xD0003286 /end MEASUREMENT
/begin MEASUREMENT EpmBCr_phiLastCaSEdge "" SWORD AngleCrS 1 100 -720.0000 719.9780 FORMAT "%8.4" ARRAY_SIZE 1 ECU_ADDRESS 0xD0003288 /end MEASUREMENT
/begin MEASUREMENT EpmBCr_phiNxtCaSEdge "" SWORD AngleCrS 1 100 -720.0000 719.9780 FORMAT "%8.4" ECU_ADDRESS 0xD000328C /end MEASUREMENT
/begin MEASUREMENT EpmBCr_phiPos "" SWORD AngleCrS 1 100 -720.0000 719.9780 FORMAT "%8.4" ECU_ADDRESS 0xD000328E /end MEASUREMENT
/begin MEASUREMENT EpmBCr_phiSeg2Seg "" SWORD AngleCrS 1 100 -720.0000 719.9780 FORMAT "%8.4" ECU_ADDRESS 0xD0003284 /end MEASUREMENT
/begin MEASUREMENT EpmBCr_phiSync2Curr_mp "" SWORD AngleCrS 1 100 -720.0000 719.9780 FORMAT "%8.4" ECU_ADDRESS 0xD0005302 /end MEASUREMENT
/begin MEASUREMENT EpmBCr_stIntrCo "" UBYTE EpmBCr_stIntrCo_State_t 1 100 0.00 3.00000000000 FORMAT "%13.11" ECU_ADDRESS 0xD0003B2B /end MEASUREMENT
/begin MEASUREMENT EpmBCr_stPlaus "" UBYTE EpmBCr_stPlaus_State 1 100 0.00 3.00000000000 FORMAT "%13.11" ARRAY_SIZE 1 ECU_ADDRESS 0xD0003B31 /end MEASUREMENT
/begin MEASUREMENT EpmBCr_stPlausRet_mp "" UBYTE OneToOne 1 100 0.00 255.0 FORMAT "%5.1" ECU_ADDRESS 0xD00053CE /end MEASUREMENT
/begin MEASUREMENT EpmBCr_stPos "" UBYTE EpmBCr_stPos_State 1 100 0.00 1.00000000000 FORMAT "%13.11" ECU_ADDRESS 0xD0003B33 /end MEASUREMENT
/begin MEASUREMENT EpmBCr_stTmrModeStarted "" UBYTE OneToOne 1 100 0.00 255.0 FORMAT "%5.1" ECU_ADDRESS 0xD0003B2C /end MEASUREMENT
/begin MEASUREMENT EpmBCr_tiIncPer "" SLONG OneToOne_us 1 100 -2147483648.00 2147483647.00 FORMAT "%13.2" ECU_ADDRESS 0xD0001D00 /end MEASUREMENT
/begin MEASUREMENT EpmBCr_tiSeg "" SLONG OneToOne_us 1 100 -2147483648.00 2147483647.00 FORMAT "%13.2" ECU_ADDRESS 0xD0001CFC /end MEASUREMENT
/begin MEASUREMENT EpmCaS_bActivatePatmat "" UBYTE OneToOne 1 100 0.00 255.0 FORMAT "%5.1" ARRAY_SIZE 1 ECU_ADDRESS 0xD0003B34 /end MEASUREMENT
/begin MEASUREMENT EpmCaS_ctEdgeEquid "" SBYTE OneToOne 1 100 -128.0 127.0 FORMAT "%5.1" ARRAY_SIZE 1 ECU_ADDRESS 0xD0003BE5 /end MEASUREMENT
/begin MEASUREMENT EpmCaS_ctEdgeLst "" SWORD OneToOne 1 100 -32768.00 32767.00 FORMAT "%8.2" ARRAY_SIZE 1 ECU_ADDRESS 0xD0003290 /end MEASUREMENT
/begin MEASUREMENT EpmCaS_ctErrSig "" UWORD CrSRev2CrSInc 1 100 0.00 1820.417 FORMAT "%8.3" ARRAY_SIZE 1 ECU_ADDRESS 0xD0003292 /end MEASUREMENT
/begin MEASUREMENT EpmCaS_ctNoSig "" UWORD CrSRev2CrSInc 1 100 0.00 1820.417 FORMAT "%8.3" ARRAY_SIZE 1 ECU_ADDRESS 0xD0003294 /end MEASUREMENT
/begin MEASUREMENT EpmCaS_ctOfsErr_mp "" UBYTE OneToOne 1 100 0.00 255.0 FORMAT "%5.1" ARRAY_SIZE 1 ECU_ADDRESS 0xD00053D0 /end MEASUREMENT
/begin MEASUREMENT EpmCaS_ctRevNoSig "" UWORD RevCnt 1 100 0.00 4095.938 FORMAT "%8.3" ARRAY_SIZE 1 ECU_ADDRESS 0xD0003296 /end MEASUREMENT
/begin MEASUREMENT EpmCaS_ctRevSig "" UWORD RevCnt 1 100 0.00 4095.938 FORMAT "%8.3" ARRAY_SIZE 1 ECU_ADDRESS 0xD0003298 /end MEASUREMENT
/begin MEASUREMENT EpmCaS_ctSigOk "" UWORD CrSRev2CrSInc 1 100 0.00 1820.417 FORMAT "%8.3" ARRAY_SIZE 1 ECU_ADDRESS 0xD000329A /end MEASUREMENT
/begin MEASUREMENT EpmCaS_nCaS_mp "" SWORD EngNCaS 1 100 -8192.000 8191.750 FORMAT "%8.3" ECU_ADDRESS 0xD0005338 /end MEASUREMENT
/begin MEASUREMENT EpmCaS_nEng "" SWORD EngN 1 100 -16384.00 16383.50 FORMAT "%8.2" ECU_ADDRESS 0xD00034EC /end MEASUREMENT
/begin MEASUREMENT EpmCaS_numBufEntry_mp "" UBYTE OneToOne 1 100 0.00 255.0 FORMAT "%5.1" ARRAY_SIZE 1 ECU_ADDRESS 0xD00053D1 /end MEASUREMENT
/begin MEASUREMENT EpmCaS_numCurrEdge "" UWORD OneToOne 1 100 0.00 65535.00 FORMAT "%8.2" ARRAY_SIZE 1 ECU_ADDRESS 0xD000329C /end MEASUREMENT
/begin MEASUREMENT EpmCaS_numRawValue_mp "" SBYTE OneToOne 1 100 -128.0 127.0 FORMAT "%5.1" ECU_ADDRESS 0xD00053CF /end MEASUREMENT
/begin MEASUREMENT EpmCaS_numSegTeeth_mp "" UBYTE OneToOne 1 100 0.00 255.0 FORMAT "%5.1" ECU_ADDRESS 0xD00053D2 /end MEASUREMENT
/begin MEASUREMENT EpmCaS_numValidTeeth_mp "" UBYTE OneToOne 1 100 0.00 255.0 FORMAT "%5.1" ARRAY_SIZE 1 ECU_ADDRESS 0xD00053D3 /end MEASUREMENT
/begin MEASUREMENT EpmCaS_omega_mp "" SWORD AngleCrS 1 100 -720.0000 719.9780 FORMAT "%8.4" ARRAY_SIZE 1 ECU_ADDRESS 0xD000533A /end MEASUREMENT
/begin MEASUREMENT EpmCaS_phiAdapLimFil_mp "" SWORD AngleCrS 1 100 -720.0000 719.9780 FORMAT "%8.4" ARRAY_SIZE 1 ECU_ADDRESS 0xD0005304 /end MEASUREMENT
/begin MEASUREMENT EpmCaS_phiAdapRefPosI1_mp "" SWORD AngleCrS 1 100 -720.0000 719.9780 FORMAT "%8.4" ARRAY_SIZE 10 ECU_ADDRESS 0xD0005306 /end MEASUREMENT
/begin MEASUREMENT EpmCaS_phiAdap_mp "" SWORD AngleCrS 1 100 -720.0000 719.9780 FORMAT "%8.4" ARRAY_SIZE 1 ECU_ADDRESS 0xD000531A /end MEASUREMENT
/begin MEASUREMENT EpmCaS_phiCaSOfsAvg "" SLONG AngleCrS 1 100 -47185920.0000 47185919.9780 FORMAT "%13.4" ARRAY_SIZE 1 ECU_ADDRESS 0xD0002070 /end MEASUREMENT
/begin MEASUREMENT EpmCaS_phiCor "" SWORD AngleCrS 1 100 -720.0000 719.9780 FORMAT "%8.4" ARRAY_SIZE 1 ECU_ADDRESS 0xD00034EE /end MEASUREMENT
/begin MEASUREMENT EpmCaS_phiDiffCal2Adap "" SWORD AngleCrS 1 100 -720.0000 719.9780 FORMAT "%8.4" ARRAY_SIZE 10 ECU_ADDRESS 0xD0003362 /end MEASUREMENT
/begin MEASUREMENT EpmCaS_phiDiffLim "" SWORD AngleCrS 1 100 -720.0000 719.9780 FORMAT "%8.4" ARRAY_SIZE 1 ECU_ADDRESS 0xD00034F0 /end MEASUREMENT
/begin MEASUREMENT EpmCaS_phiEdge "" SWORD AngleCrS 1 100 -720.0000 719.9780 FORMAT "%8.4" ARRAY_SIZE 1 ECU_ADDRESS 0xD00034F2 /end MEASUREMENT
/begin MEASUREMENT EpmCaS_phiMissedSeg_mp "" SWORD AngleCrS 1 100 -720.0000 719.9780 FORMAT "%8.4" ARRAY_SIZE 1 ECU_ADDRESS 0xD0005330 /end MEASUREMENT
/begin MEASUREMENT EpmCaS_phiOfsCorr "" SWORD AngleCrS 1 100 -720.0000 719.9780 FORMAT "%8.4" ARRAY_SIZE 1 ECU_ADDRESS 0xD00034F4 /end MEASUREMENT
/begin MEASUREMENT EpmCaS_phiOfsTolc_mp "" SWORD AngleCrS 1 100 -720.0000 719.9780 FORMAT "%8.4" ECU_ADDRESS 0xD0005332 /end MEASUREMENT
/begin MEASUREMENT EpmCaS_phiRawValue_mp "" SWORD AngleCrS 1 100 -720.0000 719.9780 FORMAT "%8.4" ARRAY_SIZE 10 ECU_ADDRESS 0xD000531C /end MEASUREMENT
/begin MEASUREMENT EpmCaS_phiRefPos "" SWORD AngleCrS 1 100 -720.0000 719.9780 FORMAT "%8.4" ARRAY_SIZE 10 ECU_ADDRESS 0xD00033AC /end MEASUREMENT
/begin MEASUREMENT EpmCaS_phiSegLenTolc_mp "" SWORD AngleCrS 1 100 -720.0000 719.9780 FORMAT "%8.4" ECU_ADDRESS 0xD0005334 /end MEASUREMENT
/begin MEASUREMENT EpmCaS_phiSpeedSegLen_mp "" SWORD AngleCrS 1 100 -720.0000 719.9780 FORMAT "%8.4" ECU_ADDRESS 0xD0005336 /end MEASUREMENT
/begin MEASUREMENT EpmCaS_phiTempCor "" SWORD AngleCrS 1 100 -720.0000 719.9780 FORMAT "%8.4" ARRAY_SIZE 1 ECU_ADDRESS 0xD00034F6 /end MEASUREMENT
/begin MEASUREMENT EpmCaS_stAdap "" UBYTE EpmCaS_stAdap_State 1 100 0.00 4.00000000000 FORMAT "%13.11" ARRAY_SIZE 1 ECU_ADDRESS 0xAFE801B2 /end MEASUREMENT
/begin MEASUREMENT EpmCaS_stAdapErr "" UBYTE OneToOne 1 100 0.00 255.0 FORMAT "%5.1" ARRAY_SIZE 1 ECU_ADDRESS 0xD0003B90 /end MEASUREMENT
/begin MEASUREMENT EpmCaS_stDiag "" UBYTE EpmCaS_stDiag_t 1 100 0.00 3.00000000000 FORMAT "%13.11" ARRAY_SIZE 1 ECU_ADDRESS 0xD0003B92 /end MEASUREMENT
/begin MEASUREMENT EpmCaS_stDiagErr "" UBYTE EpmCaS_stDiagErr_t 1 100 0.00 3.00000000000 FORMAT "%13.11" ARRAY_SIZE 1 ECU_ADDRESS 0xD0003B93 /end MEASUREMENT
/begin MEASUREMENT EpmCaS_stNEng "" UBYTE OneToOne 1 100 0.00 255.0 FORMAT "%5.1" ECU_ADDRESS 0xD0003C4D /end MEASUREMENT
/begin MEASUREMENT EpmCaS_stOfs "" UBYTE EpmCas_stOfs_State 1 100 0.00 1.00000000000 FORMAT "%13.11" ARRAY_SIZE 1 ECU_ADDRESS 0xD0003B96 /end MEASUREMENT
/begin MEASUREMENT EpmCaS_stOfsErr "" UBYTE EpmCaS_stOfsErr_Val 1 100 0.00 5.00000000000 FORMAT "%13.11" ARRAY_SIZE 1 ECU_ADDRESS 0xD0003B95 /end MEASUREMENT
/begin MEASUREMENT EpmCaS_stphiDiffLim "" UBYTE EpmCaS_stphiDiffLim_t 1 100 0.00 8.00000000000 FORMAT "%13.11" ARRAY_SIZE 1 ECU_ADDRESS 0xD0003C4E /end MEASUREMENT
/begin MEASUREMENT EpmCaS_stPosValid "" UBYTE OneToOne 1 100 0.00 255.0 FORMAT "%5.1" ARRAY_SIZE 1 ECU_ADDRESS 0xD0003B36 /end MEASUREMENT
/begin MEASUREMENT EpmCaS_stSegFault "" UBYTE OneToOne 1 100 0.00 255.0 FORMAT "%5.1" ARRAY_SIZE 1 ECU_ADDRESS 0xD0003B35 /end MEASUREMENT
/begin MEASUREMENT EpmCaS_tiEdge "" SLONG Per_Dur 1 100 -2147483648.00 2147483647.00 FORMAT "%13.2" ARRAY_SIZE 1 ECU_ADDRESS 0xD00022F0 /end MEASUREMENT
/begin MEASUREMENT EpmCrS_bDisturb "" UBYTE OneToOne 1 100 0.00 255.0 FORMAT "%5.1" ECU_ADDRESS 0xD0003B37 /end MEASUREMENT
/begin MEASUREMENT EpmCrS_ctCaSRev_mp "" SWORD OneToOne 1 100 -32768.00 32767.00 FORMAT "%8.2" ECU_ADDRESS 0xD000533C /end MEASUREMENT
/begin MEASUREMENT EpmCrS_ctErrSig "" SWORD OneToOne 1 100 -32768.00 32767.00 FORMAT "%8.2" ECU_ADDRESS 0xD00032A0 /end MEASUREMENT
/begin MEASUREMENT EpmCrS_ctErrSigSyncIni "" SWORD OneToOne 1 100 -32768.00 32767.00 FORMAT "%8.2" ECU_ADDRESS 0xD00032A2 /end MEASUREMENT
/begin MEASUREMENT EpmCrS_ctInc "" UBYTE OneToOne 1 100 0.00 255.0 FORMAT "%5.1" ECU_ADDRESS 0xD0003C4F /end MEASUREMENT
/begin MEASUREMENT EpmCrS_ctRange "" UBYTE OneToOne 1 100 0.00 255.0 FORMAT "%5.1" ECU_ADDRESS 0xD0003B3E /end MEASUREMENT
/begin MEASUREMENT EpmCrS_ctRev "" UWORD OneToOne 1 100 0.00 65535.00 FORMAT "%8.2" ECU_ADDRESS 0xD00032A4 /end MEASUREMENT
/begin MEASUREMENT EpmCrS_ctRev100msLim_mp "" SBYTE OneToOne 1 100 -128.0 127.0 FORMAT "%5.1" ECU_ADDRESS 0xD00053D4 /end MEASUREMENT
/begin MEASUREMENT EpmCrS_ctRevCnt "" UWORD RevCnt 1 100 0.00 4095.938 FORMAT "%8.3" ECU_ADDRESS 0xD00032B0 /end MEASUREMENT
/begin MEASUREMENT EpmCrS_ctRevIni "" SWORD OneToOne 1 100 -32768.00 32767.00 FORMAT "%8.2" ECU_ADDRESS 0xD00034F8 /end MEASUREMENT
/begin MEASUREMENT EpmCrS_ctRevStrt "" SWORD OneToOne 1 100 -32768.00 32767.00 FORMAT "%8.2" ECU_ADDRESS 0xD00034FA /end MEASUREMENT
/begin MEASUREMENT EpmCrS_ctRevStrtExtd "" SLONG OneToOne 1 100 -2147483648.00 2147483647.00 FORMAT "%13.2" ECU_ADDRESS 0xD00022F4 /end MEASUREMENT
/begin MEASUREMENT EpmCrS_ctRevWaitDiag "" SWORD OneToOne 1 100 -32768.00 32767.00 FORMAT "%8.2" ECU_ADDRESS 0xD00032A6 /end MEASUREMENT
/begin MEASUREMENT EpmCrS_dnEngFltSyncIni "" SWORD EngNGrd 1 100 -16384.00 16383.50 FORMAT "%8.2" ECU_ADDRESS 0xD00032AA /end MEASUREMENT
/begin MEASUREMENT EpmCrS_numNewInc_mp "" UBYTE OneToOne 1 100 0.00 255.0 FORMAT "%5.1" ECU_ADDRESS 0xD00053D5 /end MEASUREMENT
/begin MEASUREMENT EpmCrS_numSeg "" UBYTE OneToOne 1 100 0.00 255.0 FORMAT "%5.1" ECU_ADDRESS 0xD0003C50 /end MEASUREMENT
/begin MEASUREMENT EpmCrS_numTiIncPerAvrg_mp "" ULONG OneToOne 1 100 0.00 4294967295.00 FORMAT "%13.2" ECU_ADDRESS 0xD0005184 /end MEASUREMENT
/begin MEASUREMENT EpmCrS_phiIgnInc "" SWORD AngleCrS 1 100 -720.0000 719.9780 FORMAT "%8.4" ECU_ADDRESS 0xD00032AE /end MEASUREMENT
/begin MEASUREMENT EpmCrS_phiIntSeg "" SWORD AngleCrS 1 100 -720.0000 719.9780 FORMAT "%8.4" ECU_ADDRESS 0xD00034FC /end MEASUREMENT
/begin MEASUREMENT EpmCrS_phiSeg "" SWORD AngleCrS 1 100 -720.0000 719.9780 FORMAT "%8.4" ECU_ADDRESS 0xD00034FE /end MEASUREMENT
/begin MEASUREMENT EpmCrS_stDiag "" UBYTE EpmCrS_Diag_State 1 100 0.00 1.00000000000 FORMAT "%13.11" ECU_ADDRESS 0xD0003C51 /end MEASUREMENT
/begin MEASUREMENT EpmCrS_stDiagErrSig "" UBYTE EpmCrS_DiagResult_State 1 100 0.00 4.00000000000 FORMAT "%13.11" ECU_ADDRESS 0xD0003B3C /end MEASUREMENT
/begin MEASUREMENT EpmCrS_stDiagNoSig "" UBYTE EpmCrS_DiagResult_State 1 100 0.00 4.00000000000 FORMAT "%13.11" ECU_ADDRESS 0xD0003B3D /end MEASUREMENT
/begin MEASUREMENT EpmCrS_stSigDiagSrc "" UWORD OneToOne 1 100 0.00 65535.00 FORMAT "%8.2" ECU_ADDRESS 0xD00032AC /end MEASUREMENT
/begin MEASUREMENT EpmCrS_stSigMode "" UBYTE EpmHCrS_stSigMode_State_t 1 100 0.00 11.0000000000 FORMAT "%13.10" ECU_ADDRESS 0xD0003C52 /end MEASUREMENT
/begin MEASUREMENT EpmCrS_tiIncPer "" SLONG GptaClc6_ti_COMPU 1 100 -858993459.200 858993458.800 FORMAT "%13.3" ECU_ADDRESS 0xD00022F8 /end MEASUREMENT
/begin MEASUREMENT EpmCrS_tiInc_mp "" SLONG Time_ns_to_us 1 100 -2147483.64800 2147483.64700 FORMAT "%13.5" ARRAY_SIZE 15 ECU_ADDRESS 0xD0005188 /end MEASUREMENT
/begin MEASUREMENT EpmCrS_tiSeg "" SLONG Per_Dur 1 100 -2147483648.00 2147483647.00 FORMAT "%13.2" ECU_ADDRESS 0xD00022FC /end MEASUREMENT
/begin MEASUREMENT EpmCrS_tiSegCurr "" SLONG Per_Dur 1 100 -2147483648.00 2147483647.00 FORMAT "%13.2" ECU_ADDRESS 0xD0002300 /end MEASUREMENT
/begin MEASUREMENT EpmHCaS_numMaxTryPrepBuf "" SLONG OneToOne 1 100 -2147483648.00 2147483647.00 FORMAT "%13.2" ECU_ADDRESS 0xD0001D04 /end MEASUREMENT
/begin MEASUREMENT EpmHCrS_ctResyncUpperLvl_mp "" UBYTE OneToOne 1 100 0.00 255.0 FORMAT "%5.1" ECU_ADDRESS 0xD00053D6 /end MEASUREMENT
/begin MEASUREMENT EpmHCrS_stSigErr "" UWORD OneToOne 1 100 0.00 65535.00 FORMAT "%8.2" ECU_ADDRESS 0xD00033CE /end MEASUREMENT
/begin MEASUREMENT EpmHCrS_stSigMode "" UBYTE EpmHCrS_stSigMode_State_t 1 100 0.00 11.0000000000 FORMAT "%13.10" ECU_ADDRESS 0xD0003BB8 /end MEASUREMENT
/begin MEASUREMENT EpmHInt_tiInt4DelMeas "" ULONG OneToOne_us 1 100 0.00 4294967295.00 FORMAT "%13.2" ECU_ADDRESS 0xD0001D08 /end MEASUREMENT
/begin MEASUREMENT EpmRRS_actIncAr_mp "" UWORD OneToOne 1 100 0.00 65535.00 FORMAT "%8.2" ARRAY_SIZE 16 ECU_ADDRESS 0xD000533E /end MEASUREMENT
/begin MEASUREMENT EpmRRS_actIncBuf_mp "" UWORD OneToOne 1 100 0.00 65535.00 FORMAT "%8.2" ECU_ADDRESS 0xD000535E /end MEASUREMENT
/begin MEASUREMENT EpmRRS_actIncOrig_mp "" UWORD OneToOne 1 100 0.00 65535.00 FORMAT "%8.2" ECU_ADDRESS 0xD0005360 /end MEASUREMENT
/begin MEASUREMENT EpmRRS_actInc_mp "" UWORD OneToOne 1 100 0.00 65535.00 FORMAT "%8.2" ECU_ADDRESS 0xD0005362 /end MEASUREMENT
/begin MEASUREMENT EpmRRS_bEngSwOff "" UBYTE OneToOne 1 100 0.00 255.0 FORMAT "%5.1" ECU_ADDRESS 0xD0003C53 /end MEASUREMENT
/begin MEASUREMENT EpmRRS_ctGapInBuffer_mp "" UBYTE OneToOne 1 100 0.00 255.0 FORMAT "%5.1" ECU_ADDRESS 0xD00053D7 /end MEASUREMENT
/begin MEASUREMENT EpmRRS_ctNewTeethOrig_mp "" UBYTE OneToOne 1 100 0.00 255.0 FORMAT "%5.1" ARRAY_SIZE 2 ECU_ADDRESS 0xD00053D8 /end MEASUREMENT
/begin MEASUREMENT EpmRRS_ctNewTeeth_mp "" UBYTE OneToOne 1 100 0.00 255.0 FORMAT "%5.1" ECU_ADDRESS 0xD00053DA /end MEASUREMENT
/begin MEASUREMENT EpmRRS_ctToothTimeout_mp "" UWORD OneToOne 1 100 0.00 65535.00 FORMAT "%8.2" ECU_ADDRESS 0xD0005364 /end MEASUREMENT
/begin MEASUREMENT EpmRRS_GapDetected_mp "" UBYTE OneToOne 1 100 0.00 255.0 FORMAT "%5.1" ECU_ADDRESS 0xD00053DB /end MEASUREMENT
/begin MEASUREMENT EpmRRS_idxWrAct_mp "" SWORD OneToOne 1 100 -32768.00 32767.00 FORMAT "%8.2" ECU_ADDRESS 0xD0005366 /end MEASUREMENT
/begin MEASUREMENT EpmRRS_incGapTest_mp "" SWORD OneToOne 1 100 -32768.00 32767.00 FORMAT "%8.2" ECU_ADDRESS 0xD0005368 /end MEASUREMENT
/begin MEASUREMENT EpmRRS_incSynOffs_mp "" SWORD OneToOne 1 100 -32768.00 32767.00 FORMAT "%8.2" ECU_ADDRESS 0xD000536A /end MEASUREMENT
/begin MEASUREMENT EpmRRS_maxToothCondAr_mp "" UWORD OneToOne 1 100 0.00 65535.00 FORMAT "%8.2" ARRAY_SIZE 16 ECU_ADDRESS 0xD000536C /end MEASUREMENT
/begin MEASUREMENT EpmRRS_phiEngRR "" SWORD AngleCrS 1 100 -720.0000 719.9780 FORMAT "%8.4" ECU_ADDRESS 0xD00032B4 /end MEASUREMENT
/begin MEASUREMENT EpmRRS_phiEngStop_mp "" SWORD AngleCrS 1 100 -720.0000 719.9780 FORMAT "%8.4" ECU_ADDRESS 0xD000538C /end MEASUREMENT
/begin MEASUREMENT EpmRRS_phiGapPos "" SWORD AngleCrS 1 100 -720.0000 719.9780 FORMAT "%8.4" ARRAY_SIZE 2 ECU_ADDRESS 0xD00032B6 /end MEASUREMENT
/begin MEASUREMENT EpmRRS_phiRelTDC_mp "" SWORD AngleCrS 1 100 -720.0000 719.9780 FORMAT "%8.4" ECU_ADDRESS 0xD000538E /end MEASUREMENT
/begin MEASUREMENT EpmRRS_stAgDetect "" UBYTE EpmRRS_stAgDetect_t 1 100 0.00 2.00000000000 FORMAT "%13.11" ECU_ADDRESS 0xD0003B40 /end MEASUREMENT
/begin MEASUREMENT EpmRRS_stEnable "" UBYTE OneToOne 1 100 0.00 255.0 FORMAT "%5.1" ECU_ADDRESS 0xD0003B41 /end MEASUREMENT
/begin MEASUREMENT EpmRRS_stEngStop "" UBYTE OneToOne 1 100 0.00 255.0 FORMAT "%5.1" ECU_ADDRESS 0xD0003B42 /end MEASUREMENT
/begin MEASUREMENT EpmRRS_stEngStopAg_mp "" UBYTE EpmRRS_stEngStopAg_t 1 100 0.00 2.00000000000 FORMAT "%13.11" ECU_ADDRESS 0xD00053DC /end MEASUREMENT
/begin MEASUREMENT EpmRRS_stGetBufNumPer_mp "" UBYTE OneToOne 1 100 0.00 255.0 FORMAT "%5.1" ECU_ADDRESS 0xD00053DD /end MEASUREMENT
/begin MEASUREMENT EpmRRS_stReason_mp "" UBYTE OneToOne 1 100 0.00 255.0 FORMAT "%5.1" ECU_ADDRESS 0xD00053DE /end MEASUREMENT
/begin MEASUREMENT EpmRRS_stRotDir_mp "" UBYTE OneToOne 1 100 0.00 255.0 FORMAT "%5.1" ECU_ADDRESS 0xD00053DF /end MEASUREMENT
/begin MEASUREMENT EpmRRS_stToothPerBuf_mp "" UBYTE OneToOne 1 100 0.00 255.0 FORMAT "%5.1" ECU_ADDRESS 0xD00053E0 /end MEASUREMENT
/begin MEASUREMENT EpmRRS_tiToothPerOrg_mp "" SLONG OneToOne_us 1 100 -2147483648.00 2147483647.00 FORMAT "%13.2" ARRAY_SIZE 16 ECU_ADDRESS 0xD00051C4 /end MEASUREMENT
/begin MEASUREMENT EpmRRS_tiToothPer_mp "" SLONG OneToOne_us 1 100 -2147483648.00 2147483647.00 FORMAT "%13.2" ARRAY_SIZE 16 ECU_ADDRESS 0xD0005204 /end MEASUREMENT
/begin MEASUREMENT EpmSeq_numIncDiffInt "" SWORD OneToOne 1 100 -32768.00 32767.00 FORMAT "%8.2" ARRAY_SIZE 2 ECU_ADDRESS 0xD0003500 /end MEASUREMENT
/begin MEASUREMENT EpmSeq_numInt "" UBYTE EpmSeq_numInt_Compu 1 100 0.00 16.0000000000 FORMAT "%13.10" ECU_ADDRESS 0xD0003C54 /end MEASUREMENT
/begin MEASUREMENT EpmSeq_numIntTyp "" UBYTE OneToOne 1 100 0.00 255.0 FORMAT "%5.1" ECU_ADDRESS 0xD0003C55 /end MEASUREMENT
/begin MEASUREMENT EpmSeq_phiNxtInt "" SWORD AngleCrS 1 100 0.00 719.9780 FORMAT "%8.4" ECU_ADDRESS 0xD00033D0 /end MEASUREMENT
/begin MEASUREMENT EpmSeq_stInt "" UBYTE EpmSeq_stInt_Compu 1 100 0.00 8.00000000000 FORMAT "%13.11" ECU_ADDRESS 0xD0003BBB /end MEASUREMENT
/begin MEASUREMENT EpmSrv_stCnvAgT2Ag_mp "" UBYTE EpmSrv_stCnvAgT2Ag_t 1 100 0.00 255.000000000 FORMAT "%13.9" ECU_ADDRESS 0xD00053E1 /end MEASUREMENT
/begin MEASUREMENT EpmSyn_CaSData "" UBYTE OneToOne 1 100 0.00 255.0 FORMAT "%5.1" ARRAY_SIZE 24 ECU_ADDRESS 0xD00033DE /end MEASUREMENT
/begin MEASUREMENT EpmSyn_ctLstEdge_mp "" SWORD OneToOne 1 100 -32768.00 32767.00 FORMAT "%8.2" ECU_ADDRESS 0xD0005390 /end MEASUREMENT
/begin MEASUREMENT EpmSyn_ctSigTabLstEntr_mp "" SBYTE OneToOne 1 100 -128.0 127.0 FORMAT "%5.1" ECU_ADDRESS 0xD00053E2 /end MEASUREMENT
/begin MEASUREMENT EpmSyn_GetAngleCnt_mp "" SWORD AngleCrS 1 100 -720.0000 719.9780 FORMAT "%8.4" ECU_ADDRESS 0xD0005392 /end MEASUREMENT
/begin MEASUREMENT EpmSyn_numCaSSync "" UBYTE OneToOne 1 100 0.00 255.0 FORMAT "%5.1" ECU_ADDRESS 0xD0003B43 /end MEASUREMENT
/begin MEASUREMENT EpmSyn_numIntTyp "" ULONG OneToOne 1 100 0.00 4294967295.00 FORMAT "%13.2" ECU_ADDRESS 0xD0002334 /end MEASUREMENT
/begin MEASUREMENT EpmSyn_numMatches_mp "" UBYTE OneToOne 1 100 0.00 255.0 FORMAT "%5.1" ECU_ADDRESS 0xD00053E3 /end MEASUREMENT
/begin MEASUREMENT EpmSyn_numMatchPos_mp "" UBYTE OneToOne 1 100 0.00 255.0 FORMAT "%5.1" ECU_ADDRESS 0xD00053E4 /end MEASUREMENT
/begin MEASUREMENT EpmSyn_numNewEdges_mp "" UBYTE OneToOne 1 100 0.00 255.0 FORMAT "%5.1" ECU_ADDRESS 0xD00053E5 /end MEASUREMENT
/begin MEASUREMENT EpmSyn_numSegInSigTab_mp "" UBYTE OneToOne 1 100 0.00 255.0 FORMAT "%5.1" ECU_ADDRESS 0xD00053E6 /end MEASUREMENT
/begin MEASUREMENT EpmSyn_phiAgClk_mp "" SWORD AngleCrS 1 100 -720.0000 719.9780 FORMAT "%8.4" ECU_ADDRESS 0xD0005394 /end MEASUREMENT
/begin MEASUREMENT EpmSyn_phiCaSPos "" SWORD AngleCrS 1 100 -720.0000 719.9780 FORMAT "%8.4" ARRAY_SIZE 1 ECU_ADDRESS 0xD00032BC /end MEASUREMENT
/begin MEASUREMENT EpmSyn_phiCaSPosCorrAdap "" SWORD AngleCrS 1 100 -720.0000 719.9780 FORMAT "%8.4" ARRAY_SIZE 1 ECU_ADDRESS 0xD00032BA /end MEASUREMENT
/begin MEASUREMENT EpmSyn_phiDiff "" SWORD AngleCrS 1 100 -720.0000 719.9780 FORMAT "%8.4" ECU_ADDRESS 0xD0003504 /end MEASUREMENT
/begin MEASUREMENT EpmSyn_phiIncCor_mp "" SWORD AngleCrS 1 100 -720.0000 719.9780 FORMAT "%8.4" ECU_ADDRESS 0xD0005396 /end MEASUREMENT
/begin MEASUREMENT EpmSyn_phiInt "" SWORD AngleCrS 1 100 -720.0000 719.9780 FORMAT "%8.4" ECU_ADDRESS 0xD0003506 /end MEASUREMENT
/begin MEASUREMENT EpmSyn_phiOffs "" SWORD AngleCrS 1 100 -720.0000 719.9780 FORMAT "%8.4" ECU_ADDRESS 0xD00033FA /end MEASUREMENT
/begin MEASUREMENT EpmSyn_phiOffsCor "" SWORD AngleCrS 1 100 -720.0000 719.9780 FORMAT "%8.4" ECU_ADDRESS 0xD00033FC /end MEASUREMENT
/begin MEASUREMENT EpmSyn_stCasEval "" UBYTE EpmSyn_stCaSEvalComp 1 100 0.00 4.00000000000 FORMAT "%13.11" ECU_ADDRESS 0xD0003BD7 /end MEASUREMENT
/begin MEASUREMENT EpmSyn_stCaSPos "" UBYTE EpmSyn_stCaSPosComp 1 100 0.00 20.0000000000 FORMAT "%13.10" ARRAY_SIZE 1 ECU_ADDRESS 0xD0003BC1 /end MEASUREMENT
/begin MEASUREMENT EpmSyn_stCrSPos "" UBYTE EpmSyn_stCrSPos_State_t 1 100 0.00 3.00000000000 FORMAT "%13.11" ECU_ADDRESS 0xD0003C56 /end MEASUREMENT
/begin MEASUREMENT EpmSyn_stCrSPosErr "" UWORD OneToOne 1 100 0.00 65535.00 FORMAT "%8.2" ECU_ADDRESS 0xD00033FE /end MEASUREMENT
/begin MEASUREMENT EpmSyn_stGapPos "" UBYTE OneToOne 1 100 0.00 255.0 FORMAT "%5.1" ECU_ADDRESS 0xD0003BD8 /end MEASUREMENT
/begin MEASUREMENT EpmSyn_stPreSeg_mp "" UBYTE OneToOne 1 100 0.00 255.0 FORMAT "%5.1" ECU_ADDRESS 0xD00053E7 /end MEASUREMENT
/begin MEASUREMENT EpmSyn_stRR "" UBYTE EpmSyn_stRRComp 1 100 0.00 1.00000000000 FORMAT "%13.11" ARRAY_SIZE 1 ECU_ADDRESS 0xD0003C57 /end MEASUREMENT
/begin MEASUREMENT Epm_ctCyl "" UBYTE OneToOne 1 100 0.00 255.0 FORMAT "%5.1" ECU_ADDRESS 0xD0003C58 /end MEASUREMENT
/begin MEASUREMENT Epm_ctReSync "" UBYTE OneToOne 1 100 0.00 255.0 FORMAT "%5.1" ECU_ADDRESS 0xD0003B46 /end MEASUREMENT
/begin MEASUREMENT Epm_ctTDCPhys_mp "" UBYTE OneToOne 1 100 0.00 255.0 FORMAT "%5.1" ECU_ADDRESS 0xD00053E8 /end MEASUREMENT
/begin MEASUREMENT Epm_dnEng "" SWORD EngNGrd 1 100 -16384.00 16383.50 FORMAT "%8.2" ECU_ADDRESS 0xD0003508 /end MEASUREMENT
/begin MEASUREMENT Epm_dnEngAvg "" SWORD EngNGrd 1 100 -16384.00 16383.50 FORMAT "%8.2" ECU_ADDRESS 0xD000350A /end MEASUREMENT
/begin MEASUREMENT Epm_dnEngAvgFlt "" SWORD EngNGrd 1 100 -16384.00 16383.50 FORMAT "%8.2" ECU_ADDRESS 0xD000350C /end MEASUREMENT
/begin MEASUREMENT Epm_dnEngFlt "" SWORD EngNGrd 1 100 -16384.00 16383.50 FORMAT "%8.2" ECU_ADDRESS 0xD000350E /end MEASUREMENT
/begin MEASUREMENT Epm_nEng "" SWORD EngN 1 100 -16384.00 16383.50 FORMAT "%8.2" ECU_ADDRESS 0xD0003512 /end MEASUREMENT
/begin MEASUREMENT Epm_nEng10ms "" SWORD EngN 1 100 -16384.00 16383.50 FORMAT "%8.2" ECU_ADDRESS 0xD0003510 /end MEASUREMENT
/begin MEASUREMENT Epm_nEngCurr "" SWORD EngN 1 100 -16384.00 16383.50 FORMAT "%8.2" ECU_ADDRESS 0xD0003514 /end MEASUREMENT
/begin MEASUREMENT Epm_nEngDiff "" SWORD EngN 1 100 -16384.00 16383.50 FORMAT "%8.2" ECU_ADDRESS 0xD0003516 /end MEASUREMENT
/begin MEASUREMENT Epm_nEngDiffAvg "" SWORD EngN 1 100 -16384.00 16383.50 FORMAT "%8.2" ECU_ADDRESS 0xD0003518 /end MEASUREMENT
/begin MEASUREMENT Epm_nEngInc10ms "" SWORD EngN 1 100 -16384.00 16383.50 FORMAT "%8.2" ECU_ADDRESS 0xD000351A /end MEASUREMENT
/begin MEASUREMENT Epm_nEngLRes "" UBYTE EngN_LRes 1 100 0.00 10200. FORMAT "%5.0" ECU_ADDRESS 0xD0003C59 /end MEASUREMENT
/begin MEASUREMENT Epm_nEngOldS0_mp "" SWORD EngN 1 100 -16384.00 16383.50 FORMAT "%8.2" ECU_ADDRESS 0xD000539C /end MEASUREMENT
/begin MEASUREMENT Epm_nEngOldS1_mp "" SWORD EngN 1 100 -16384.00 16383.50 FORMAT "%8.2" ECU_ADDRESS 0xD000539E /end MEASUREMENT
/begin MEASUREMENT Epm_nEngRaw "" SWORD EngN 1 100 -16384.00 16383.50 FORMAT "%8.2" ECU_ADDRESS 0xD000351C /end MEASUREMENT
/begin MEASUREMENT Epm_nEngTooth10ms "" SWORD EngN 1 100 -16384.00 16383.50 FORMAT "%8.2" ECU_ADDRESS 0xD000351E /end MEASUREMENT
/begin MEASUREMENT Epm_nEngVerify "" SWORD EngN 1 100 -16384.00 16383.50 FORMAT "%8.2" ECU_ADDRESS 0xD00032BE /end MEASUREMENT
/begin MEASUREMENT Epm_numConfCaS "" UWORD OneToOne 1 100 0.00 65535.00 FORMAT "%8.2" ECU_ADDRESS 0xD0004C9C /end MEASUREMENT
/begin MEASUREMENT Epm_numConfCrS "" ULONG OneToOne 1 100 0.00 4294967295.00 FORMAT "%13.2" ECU_ADDRESS 0xD0004BF0 /end MEASUREMENT
/begin MEASUREMENT Epm_numCyl "" UBYTE OneToOne 1 100 0.00 255.0 FORMAT "%5.1" ECU_ADDRESS 0xD0003C5A /end MEASUREMENT
/begin MEASUREMENT Epm_numValidTeeth_mp "" SWORD OneToOne 1 100 -32768.00 32767.00 FORMAT "%8.2" ECU_ADDRESS 0xD000539A /end MEASUREMENT
/begin MEASUREMENT Epm_numVersion "" UWORD OneToOne 1 100 0.00 65535.00 FORMAT "%8.2" ECU_ADDRESS 0xD0004C9A /end MEASUREMENT
/begin MEASUREMENT Epm_phiDiffTDC "" SWORD AngleCrS 1 100 -720.0000 719.9780 FORMAT "%8.4" ECU_ADDRESS 0xD0003520 /end MEASUREMENT
/begin MEASUREMENT Epm_phiHCrsGetCurrPos "" SWORD AngleCrS 1 100 -720.0000 719.9780 FORMAT "%8.4" ECU_ADDRESS 0xD00032C0 /end MEASUREMENT
/begin MEASUREMENT Epm_phiIntDelay_mp "" SWORD AngleCrS 1 100 -720.0000 719.9780 FORMAT "%8.4" ECU_ADDRESS 0xD0005398 /end MEASUREMENT
/begin MEASUREMENT Epm_stCmbTestReq "" UBYTE Epm_stCmbTestReq_State_t 1 100 0.00 10.0000000000 FORMAT "%13.10" ECU_ADDRESS 0xD0003C5B /end MEASUREMENT
/begin MEASUREMENT Epm_stOpMode "" UBYTE Epm_stOpMode_State_t 1 100 1.00000000000 60.0000000000 FORMAT "%13.10" ECU_ADDRESS 0xD0003C5C /end MEASUREMENT
/begin MEASUREMENT Epm_stReSyncReason_mp "" UBYTE Epm_stReSyncReason_State_t 1 100 0.00 7.00000000000 FORMAT "%13.11" ECU_ADDRESS 0xD00053E9 /end MEASUREMENT
/begin MEASUREMENT Epm_stSpd "" UBYTE Epm_stSpd_t 1 100 0.00 4.00000000000 FORMAT "%13.11" ECU_ADDRESS 0xD0003C5D /end MEASUREMENT
/begin MEASUREMENT Epm_stSync "" UBYTE Epm_stSync_State_t 1 100 0.00 30.0000000000 FORMAT "%13.10" ECU_ADDRESS 0xD0003C5E /end MEASUREMENT
/begin MEASUREMENT Epm_stSyncRestore "" UBYTE Epm_stOpMode_State_t 1 100 1.00000000000 60.0000000000 FORMAT "%13.10" ECU_ADDRESS 0xD0003B44 /end MEASUREMENT
/begin MEASUREMENT Epm_stTestInj "" UBYTE OneToOne 1 100 0.00 255.0 FORMAT "%5.1" ECU_ADDRESS 0xD0003B45 /end MEASUREMENT
/begin MEASUREMENT Epm_tiSegNTEETH_mp "" SLONG OneToOne_us 1 100 -2147483648.00 2147483647.00 FORMAT "%13.2" ECU_ADDRESS 0xD0005244 /end MEASUREMENT
/begin MEASUREMENT Epm_tiSegONETOOTH_mp "" SLONG OneToOne_us 1 100 -2147483648.00 2147483647.00 FORMAT "%13.2" ECU_ADDRESS 0xD0005248 /end MEASUREMENT
/begin MEASUREMENT Epm_tiSegPARTSEG_mp "" SLONG OneToOne_us 1 100 -2147483648.00 2147483647.00 FORMAT "%13.2" ECU_ADDRESS 0xD000524C /end MEASUREMENT
/begin MEASUREMENT Epm_tiSegRaw_mp "" SLONG OneToOne_us 1 100 -2147483648.00 2147483647.00 FORMAT "%13.2" ECU_ADDRESS 0xD0005250 /end MEASUREMENT
/begin MEASUREMENT Epm_tiSpd2Zero "" UWORD Time_ms 1 100 0.00 655350.0 FORMAT "%8.1" ECU_ADDRESS 0xD00032C2 /end MEASUREMENT
/begin MEASUREMENT ESC_stErr "" UBYTE OneToOne 1 100 0.00 255.0 FORMAT "%5.1" ECU_ADDRESS 0xD0003BDA /end MEASUREMENT
/begin MEASUREMENT ESC_tiSampling "" SLONG Per_Dur 1 100 -2147483648.00 2147483647.00 FORMAT "%13.2" ECU_ADDRESS 0xD00021CC /end MEASUREMENT
/begin MEASUREMENT fgru "" UBYTE fak_ub_b2 1 100 0.00 1.992188 FORMAT "%8.6" ECU_ADDRESS 0xD0000CDA /end MEASUREMENT
/begin MEASUREMENT fgrung "" UBYTE fak_ub_b2 1 100 0.00 1.992188 FORMAT "%8.6" ECU_ADDRESS 0xD0000CDB /end MEASUREMENT
/begin MEASUREMENT fktns_w "" UWORD fak_uw_b16 1 100 0.00 15.99976 FORMAT "%8.5" ECU_ADDRESS 0xD00006F6 /end MEASUREMENT
/begin MEASUREMENT flimit_w "" UWORD fak_uw_b2 1 100 0.00 1.999969 FORMAT "%8.6" ECU_ADDRESS 0xD00006E8 /end MEASUREMENT
/begin MEASUREMENT flimuebw_w "" UWORD fak_uw_b2 1 100 0.00 1.999969 FORMAT "%8.6" ECU_ADDRESS 0xD00006EA /end MEASUREMENT
/begin MEASUREMENT fnsadi_w "" SWORD fak_sw_b1 1 100 -1.000000 0.9999695 FORMAT "%8.6" ECU_ADDRESS 0xD00006EC /end MEASUREMENT
/begin MEASUREMENT fnsadlim_w "" UWORD fak_uw_b2 1 100 0.00 1.999969 FORMAT "%8.6" ECU_ADDRESS 0xD00006EE /end MEASUREMENT
/begin MEASUREMENT fnsadp_w "" UWORD fak_uw_b2 1 100 0.00 1.999969 FORMAT "%8.6" ECU_ADDRESS 0xD00006F0 /end MEASUREMENT
/begin MEASUREMENT fnsad_w "" UWORD fak_uw_b2 1 100 0.00 1.999969 FORMAT "%8.6" ECU_ADDRESS 0xD00006F2 /end MEASUREMENT
/begin MEASUREMENT fnswkstaa "" UBYTE fak_ub_b4 1 100 0.00 3.984 FORMAT "%5.3" ECU_ADDRESS 0xD0000CE6 /end MEASUREMENT
/begin MEASUREMENT fnswlst_w "" UWORD fak_uw_b16 1 100 0.00 15.99976 FORMAT "%8.5" ECU_ADDRESS 0xD00006F8 /end MEASUREMENT
/begin MEASUREMENT fnswl_w "" UWORD fak_uw_b16 1 100 0.00 15.99976 FORMAT "%8.5" ECU_ADDRESS 0xD00006FA /end MEASUREMENT
/begin MEASUREMENT fns_w "" UWORD fak_uw_b16 1 100 0.00 15.99976 FORMAT "%8.5" ECU_ADDRESS 0xD00006FC /end MEASUREMENT
/begin MEASUREMENT fwl "" UBYTE fak_ub_b2 1 100 0.00 1.992188 FORMAT "%8.6" ECU_ADDRESS 0xD0000CF2 /end MEASUREMENT
/begin MEASUREMENT fwlrl "" UBYTE fak_ub_b2 1 100 0.00 1.992188 FORMAT "%8.6" ECU_ADDRESS 0xD0000CE7 /end MEASUREMENT
/begin MEASUREMENT fwnsnaus_w "" UWORD fak_uw_b16 1 100 0.00 15.99976 FORMAT "%8.5" ECU_ADDRESS 0xD00006F4 /end MEASUREMENT
/begin MEASUREMENT gkfkffwl "" UBYTE fak_ub_b2 1 100 0.00 1.992188 FORMAT "%8.6" ECU_ADDRESS 0xD0000CE8 /end MEASUREMENT
/begin MEASUREMENT gkfkfwwlml "" UBYTE fak_ub_b2 1 100 0.00 1.992188 FORMAT "%8.6" ECU_ADDRESS 0xD0000CE9 /end MEASUREMENT
/begin MEASUREMENT gklfzansh1 "" UBYTE fak_ub_b0p25 1 100 0.00 0.249023438 FORMAT "%11.9" ECU_ADDRESS 0xD0000CEA /end MEASUREMENT
/begin MEASUREMENT gklfzansh2 "" UBYTE fak_ub_b0p25 1 100 0.00 0.249023438 FORMAT "%11.9" ECU_ADDRESS 0xD0000CEB /end MEASUREMENT
/begin MEASUREMENT gklfzansh3 "" UBYTE fak_ub_b0p25 1 100 0.00 0.249023438 FORMAT "%11.9" ECU_ADDRESS 0xD0000CEC /end MEASUREMENT
/begin MEASUREMENT gklszansh1 "" UBYTE fak_ub_b2 1 100 0.00 1.000000 FORMAT "%8.6" ECU_ADDRESS 0xD0000CED /end MEASUREMENT
/begin MEASUREMENT gklszansh2 "" UBYTE fak_ub_b2 1 100 0.00 1.000000 FORMAT "%8.6" ECU_ADDRESS 0xD0000CEE /end MEASUREMENT
/begin MEASUREMENT HLSDem_bNMaxPrio "" UBYTE B_TRUE 1 100 0.00 1.00000000000 BIT_MASK 0x1 FORMAT "%13.11" ECU_ADDRESS 0xD0000095 /end MEASUREMENT
/begin MEASUREMENT HLSDem_nMaxDspl "" SWORD EngN 1 100 -16384.00 16383.50 FORMAT "%8.2" ECU_ADDRESS 0xD0003558 /end MEASUREMENT
/begin MEASUREMENT HLSDem_nMaxEngWoHalt "" SWORD EngN 1 100 -16384.00 16383.50 FORMAT "%8.2" ECU_ADDRESS 0xD000355A /end MEASUREMENT
/begin MEASUREMENT HLSDem_nMinWoTraIntv "" SWORD nmot_sw_q0p5 1 100 -16384.00 16383.50 FORMAT "%8.2" ECU_ADDRESS 0xD000355C /end MEASUREMENT
/begin MEASUREMENT HLSDem_stNMaxWarnDspl "" UBYTE OneToOne 1 100 0.00 255.0 FORMAT "%5.1" ECU_ADDRESS 0xD0003C72 /end MEASUREMENT
/begin MEASUREMENT kfkfwwns "" UBYTE fak_ub_b2 1 100 0.00 1.992188 FORMAT "%8.6" ECU_ADDRESS 0xD0000CEF /end MEASUREMENT
/begin MEASUREMENT lutsnorm_w "" SWORD lu_MEx 1 100 -149.0116 149.0071 FORMAT "%8.4" ECU_ADDRESS 0xD00006DC /end MEASUREMENT
/begin MEASUREMENT ngas_w "" SWORD nmotg_sw_q0p39 1 100 -12800.16 12799.77 FORMAT "%8.2" ECU_ADDRESS 0xD00006C2 /end MEASUREMENT
/begin MEASUREMENT ngfil "" SBYTE nmotg_sb_q100 1 100 -12800. 12700. FORMAT "%5.0" ECU_ADDRESS 0xD0000CCC /end MEASUREMENT
/begin MEASUREMENT ngfil2 "" SBYTE nmotg_sb_q100 1 100 -12800. 12700. FORMAT "%5.0" ECU_ADDRESS 0xD0000CCD /end MEASUREMENT
/begin MEASUREMENT ngfil2_w "" SWORD nmotg_sw_q0p39 1 100 -12800.16 12799.77 FORMAT "%8.2" ECU_ADDRESS 0xD00006C4 /end MEASUREMENT
/begin MEASUREMENT ngfil_w "" SWORD nmotg_sw_q0p39 1 100 -12800.16 12799.77 FORMAT "%8.2" ECU_ADDRESS 0xD00006C6 /end MEASUREMENT
/begin MEASUREMENT nmot "" UBYTE nmot_ub_q40 1 100 0.00 10000. FORMAT "%5.0" ECU_ADDRESS 0xD0000CCE /end MEASUREMENT
/begin MEASUREMENT nmotbi_w "" UWORD nmot_uw_q0p25 1 100 0.00 16383.75 FORMAT "%8.2" ECU_ADDRESS 0xD00006C8 /end MEASUREMENT
/begin MEASUREMENT nmotll "" UBYTE nmot_ub_q10 1 100 0.00 2550. FORMAT "%5.0" ECU_ADDRESS 0xD0000CCF /end MEASUREMENT
/begin MEASUREMENT nmotst "" UBYTE nmot_ub_q10 1 100 0.00 2550. FORMAT "%5.0" ECU_ADDRESS 0xD0000CD0 /end MEASUREMENT
/begin MEASUREMENT nmotst1t_w "" UWORD nmot_uw_q0p25 1 100 0.00 10000.00 FORMAT "%8.2" ECU_ADDRESS 0xD00006CA /end MEASUREMENT
/begin MEASUREMENT nmotz "" UBYTE nmot_q10 1 100 0.00 2550. FORMAT "%5.0" ECU_ADDRESS 0xD0000CD1 /end MEASUREMENT
/begin MEASUREMENT nmot_w "" UWORD nmot_uw_q0p25 1 100 0.00 10000.00 FORMAT "%8.2" ECU_ADDRESS 0xD00006CC /end MEASUREMENT
/begin MEASUREMENT nsactr "" UBYTE fak_ub_b2 1 100 0.00 1.992188 FORMAT "%8.6" ECU_ADDRESS 0xD0000CF0 /end MEASUREMENT
/begin MEASUREMENT nsactrho "" UBYTE fak_ub_b2 1 100 0.00 1.992188 FORMAT "%8.6" ECU_ADDRESS 0xD0000CF1 /end MEASUREMENT
/begin MEASUREMENT NST_ABR_0.B_fnsb1 "" UBYTE B_TRUE 1 100 0.00 1.00000000000 BIT_MASK 0x1 FORMAT "%13.11" ECU_ADDRESS 0xD000129A /end MEASUREMENT
/begin MEASUREMENT NST_ABR_0.B_fnsb2 "" UBYTE B_TRUE 1 100 0.00 1.00000000000 BIT_MASK 0x2 FORMAT "%13.11" ECU_ADDRESS 0xD000129A /end MEASUREMENT
/begin MEASUREMENT NST_ABR_0.B_fnsb3 "" UBYTE B_TRUE 1 100 0.00 1.00000000000 BIT_MASK 0x4 FORMAT "%13.11" ECU_ADDRESS 0xD000129A /end MEASUREMENT
/begin MEASUREMENT NST_ABR_0.abr1_count "" UWORD dez 1 100 0.00 255.0000 FORMAT "%8.4" ECU_ADDRESS 0xD0001298 /end MEASUREMENT
/begin MEASUREMENT phidelmx_w "" UWORD kw_q0p1 1 100 0.00 6553.500 FORMAT "%8.3" ARRAY_SIZE 2 ECU_ADDRESS 0xD00006CE /end MEASUREMENT
/begin MEASUREMENT phiOffsOld "" SWORD AngleCrS 1 100 -720.0000 719.9780 FORMAT "%8.4" ECU_ADDRESS 0xD00006BE /end MEASUREMENT
/begin MEASUREMENT PthSet_trqInrSet "" SWORD Trq 1 100 -3276.800 3276.700 FORMAT "%8.3" ECU_ADDRESS 0xD000357A /end MEASUREMENT
/begin MEASUREMENT rkakapb "" SBYTE rel_q0p09375 1 100 -12.00 11.91 FORMAT "%5.2" ECU_ADDRESS 0xD0000CDC /end MEASUREMENT
/begin MEASUREMENT rlinterp_w "" UWORD rel_uw_q0p0234 1 100 0.00 1535.977 FORMAT "%8.3" ECU_ADDRESS 0xD00006FE /end MEASUREMENT
/begin MEASUREMENT s1fl3p0c "" UBYTE dez 1 100 0.00 255.0 FORMAT "%5.1" ARRAY_SIZE 3 ECU_ADDRESS 0xD0000CD2 /end MEASUREMENT
/begin MEASUREMENT sdlutsol_w "" SWORD lu_MEx 1 100 -149.0116 149.0071 FORMAT "%8.4" ECU_ADDRESS 0xD00006E0 /end MEASUREMENT
/begin MEASUREMENT sdluts_w "" SWORD lu_MEx 1 100 -149.0116 149.0071 FORMAT "%8.4" ECU_ADDRESS 0xD00006E2 /end MEASUREMENT
/begin MEASUREMENT stSyncOld "" UBYTE dez 1 100 0.00 255.0 FORMAT "%5.1" ECU_ADDRESS 0xD0000CCB /end MEASUREMENT
/begin MEASUREMENT synstate "" UBYTE dez 1 100 0.00 255.0 FORMAT "%5.1" ECU_ADDRESS 0xD0000CD5 /end MEASUREMENT
/begin MEASUREMENT tistrtdly "" UBYTE t10msxs_ub_q0p01 1 100 0.00 2.550 FORMAT "%5.3" ECU_ADDRESS 0xD0000CC9 /end MEASUREMENT
/begin MEASUREMENT tlrsl_w "" UWORD t_q0p01 1 100 0.01000000 655.3500 FORMAT "%8.4" ECU_ADDRESS 0xD0000700 /end MEASUREMENT
/begin MEASUREMENT tlrs_w "" UWORD zk5msxs_uw_b327p68 1 100 0.0050000762951 327.68000000 FORMAT "%12.8" ECU_ADDRESS 0xD0000702 /end MEASUREMENT
/begin MEASUREMENT tmotnsad "" UBYTE temp_ub_q0p75_o48 1 100 -48.00 143.3 FORMAT "%5.1" ECU_ADDRESS 0xD0000CDD /end MEASUREMENT
/begin MEASUREMENT tmsdluts "" UBYTE temp_ub_q0p75_o48 1 100 -48.00 143.3 FORMAT "%5.1" ECU_ADDRESS 0xD0000CD9 /end MEASUREMENT
/begin MEASUREMENT tnwie_l "" ULONG t_q1p024_ms 1 100 0.00 4398046510.08 FORMAT "%13.2" ECU_ADDRESS 0xD0002064 /end MEASUREMENT
/begin MEASUREMENT top_w "" UWORD t6minxmin_q6 1 100 0.00 393210.0 FORMAT "%8.1" ECU_ADDRESS 0xAFE8011A /end MEASUREMENT
/begin MEASUREMENT tseg_l "" ULONG t_q0p0001_ms 1 100 0.00 429496.729500 FORMAT "%13.6" ECU_ADDRESS 0xD0002068 /end MEASUREMENT
/begin MEASUREMENT uzkw_w "" UWORD dez 1 100 0.00 65535.00 FORMAT "%8.2" ECU_ADDRESS 0xD00006D2 /end MEASUREMENT
/begin MEASUREMENT wnwadmne_w "" SWORD kw_q0p0078 1 100 -256.0000 255.9922 FORMAT "%8.4" ECU_ADDRESS 0xD00006D4 /end MEASUREMENT
/begin MEASUREMENT wnwadmxe_w "" SWORD kw_q0p0078 1 100 -256.0000 255.9922 FORMAT "%8.4" ECU_ADDRESS 0xD00006D6 /end MEASUREMENT
/begin MEASUREMENT wnwkwe_w "" UWORD kw_q0p1 1 100 0.00 6553.500 FORMAT "%8.3" ECU_ADDRESS 0xD00006D8 /end MEASUREMENT
/begin MEASUREMENT wuccnt "" UBYTE dez 1 100 0.00 255.0 FORMAT "%5.1" ECU_ADDRESS 0xD0000F3D /end MEASUREMENT
/begin MEASUREMENT zlrsl_w "" UWORD t_q0p01 1 100 0.01000000 655.3500 FORMAT "%8.4" ECU_ADDRESS 0xD0000704 /end MEASUREMENT
/begin MEASUREMENT zlrs_w "" UWORD zk10msxs_uw_b655p36 1 100 0.010000152590 655.36000000 FORMAT "%12.8" ECU_ADDRESS 0xD0000706 /end MEASUREMENT
/begin MEASUREMENT zphfl "" SBYTE dez 1 100 -128.0 127.0 FORMAT "%5.1" ECU_ADDRESS 0xD0000CD6 /end MEASUREMENT
/begin MEASUREMENT zrph_l "" ULONG dez 1 100 0.00 4294967295.00 FORMAT "%13.2" ECU_ADDRESS 0xD000206C /end MEASUREMENT
/begin MEASUREMENT zzkwas_w "" UWORD dez 1 100 0.00 65535.00 FORMAT "%8.2" ECU_ADDRESS 0xD00006DA /end MEASUREMENT
/begin MEASUREMENT zzyl "" UBYTE dez 1 100 0.00 11.00 FORMAT "%5.2" ECU_ADDRESS 0xD0000CD7 /end MEASUREMENT
/begin MEASUREMENT zzylbi "" UBYTE dez 1 100 0.00 11.00 FORMAT "%5.2" ECU_ADDRESS 0xD0000CD8 /end MEASUREMENT
/begin FUNCTION DSELHFS "1.3.0" /begin DEF_CHARACTERISTIC SF_LM /end DEF_CHARACTERISTIC /begin IN_MEASUREMENT B_dknolu B_i_ska_fr B_psrgg /end IN_MEASUREMENT /begin OUT_MEASUREMENT B_ehfs B_fhfs B_statas /end OUT_MEASUREMENT FUNCTION_VERSION "1.3.0" /end FUNCTION
/begin FUNCTION DSMAux "2.9.0"
 /begin DEF_CHARACTERISTIC DSMAUX_dtWUCMin_C DSMAUX_tWUCMin_C DSMAUX_xClearMode_C DSMAUX_xClearTrg_C /end DEF_CHARACTERISTIC
 /begin OUT_MEASUREMENT DSMAUX_DTRG.DTRG_Time200ms DSMAUX_DTRG.DTRG_SimilarCondHLC DSMAUX_DTRG.DTRG_WarmUpCycle DSMAUX_DTRG.DTRG_DrivingCycleFLC DSMAUX_DTRG.DTRG_AlwaysTrue DSMAUX_DTRG.DTRG_DrivingCycleHLC DSMAUX_DTRG.bbsp2_17 DSMAUX_DTRG.bbsp1_17 DSMAUX_DTRG.DTRG_NoTrigger /end OUT_MEASUREMENT
 /begin LOC_MEASUREMENT DSMAUX_ctWUC DSMAUX_stStrtEnd DSMAUX_tClntStrt DSM_stPostDrive DSM_stReInit /end LOC_MEASUREMENT
 FUNCTION_VERSION "2.9.0" /end FUNCTION
/begin FUNCTION DSMDur "2.2.0"
 /begin DEF_CHARACTERISTIC DSMDur_valEvntQntDist_C DSMDur_valEvntQntTi_C DSMDur_xEnaGlb_CA DSMDur_xRstGlb_CA DSMDur_xSelEvntGlb_CA /end DEF_CHARACTERISTIC
 /begin OUT_MEASUREMENT DSMDur_ctGlb DSMDur_stGlb /end OUT_MEASUREMENT
 /begin LOC_MEASUREMENT DSMDur_ctPID21h DSMDur_ctPID31h DSMDur_stPID21h /end LOC_MEASUREMENT
 FUNCTION_VERSION "2.2.0" /end FUNCTION
/begin FUNCTION DSMRdy "2.5.0"
 /begin DEF_CHARACTERISTIC DSMRdy_Grp.FlSys_CA DSMRdy_Grp.Cat_CA DSMRdy_Grp.HtCat_CA DSMRdy_Grp.EvpSys_CA DSMRdy_Grp.SecAirSys_CA DSMRdy_Grp.O2Sens_CA DSMRdy_Grp.O2SensHt_CA DSMRdy_Grp.EGR_CA DSMRdy_X.PID1ForceLowMsk_C DSMRdy_X.PID1ForceHighMsk_C DSMRdy_X.PID41ForceLowMsk_C DSMRdy_X.PID41ForceHighMsk_C /end DEF_CHARACTERISTIC
 /begin LOC_MEASUREMENT DSMRdy_stGrpRdy DSMRdy_stGrpRdyDFES DSMRdy_stGrpRdyScan DSMRdy_stGrpSup DSMRdy_xPId1 /end LOC_MEASUREMENT
 FUNCTION_VERSION "2.5.0" /end FUNCTION
/begin FUNCTION DSM_Conf "2.10.1"
 /begin IN_MEASUREMENT APP_r BasSvr_bFuncTstReq CEngDsT_t CoEng_st EnvP_p EnvT_t Epm_nEng GlbDa_lTotDst VehV_v /end IN_MEASUREMENT
 /begin LOC_MEASUREMENT DSM_bStFuncTst_mp DSM_DisblMode_mp DSM_ECUId_mp DSM_lDst_mp DSM_nEng_mp DSM_pEnv_mp DSM_rAPP_mp DSM_stStrEnd_mp DSM_stWiggle_mp DSM_tEngDS_mp DSM_tEnv_mp DSM_vVeh_mp /end LOC_MEASUREMENT
 FUNCTION_VERSION "2.10.1" /end FUNCTION
/begin FUNCTION DSM_DTRCompu "1.6.0" FUNCTION_VERSION "1.6.0" /end FUNCTION
/begin FUNCTION DSQ "2.0.0" FUNCTION_VERSION "2.0.0" /end FUNCTION
/begin FUNCTION DTEVE "1.3.0" /begin DEF_CHARACTERISTIC CWPSTEVE /end DEF_CHARACTERISTIC /begin REF_CHARACTERISTIC TVP /end REF_CHARACTERISTIC /begin IN_MEASUREMENT B_desee tateout_w /end IN_MEASUREMENT FUNCTION_VERSION "1.3.0" /end FUNCTION
/begin FUNCTION DTOP "1.1.0" /begin OUT_MEASUREMENT top_w /end OUT_MEASUREMENT FUNCTION_VERSION "1.1.0" /end FUNCTION
/begin FUNCTION DTR "2.1.0" /begin DEF_CHARACTERISTIC DTR_numCANOBDId_CA DTR_numCANTstId_CA DTR_xAsgnCANRslt_CA /end DEF_CHARACTERISTIC
 /begin OUT_MEASUREMENT DTR_valLoLim.DTR_IdleChrgActrGovDeMax DTR_valLoLim.DTR_IdleChrgActrGovDeMin DTR_valLoLim.DTR_OBDMID_01_TID_01 DTR_valLoLim.DTR_OBDMID_01_TID_02 DTR_valLoLim.DTR_OBDMID_02_TID_01 DTR_valLoLim.DTR_OBDMID_02_TID_02 DTR_valLoLim.DTR_OBDMID_02_TID_OSCLO DTR_valLoLim.DTR_OBDMID_02_TID_OSCUP DTR_valLoLim.DTR_OBDMID_21_TID_AV DTR_valLoLim.DTR_OBDMID_41_TID_HTR DTR_valLoLim.DTR_OBDMID_a2_TID_0b_0 DTR_valLoLim.DTR_OBDMID_a2_TID_0b_1 DTR_valLoLim.DTR_OBDMID_a2_TID_0b_2 DTR_valLoLim.DTR_OBDMID_a2_TID_0c_0 DTR_valLoLim.DTR_OBDMID_a2_TID_0c_1 DTR_valLoLim.DTR_OBDMID_a2_TID_0c_2 DTR_valTst.DTR_IdleChrgActrGovDeMax DTR_valTst.DTR_IdleChrgActrGovDeMin DTR_valTst.DTR_OBDMID_01_TID_01 DTR_valTst.DTR_OBDMID_01_TID_02 DTR_valTst.DTR_OBDMID_02_TID_01 DTR_valTst.DTR_OBDMID_02_TID_02 DTR_valTst.DTR_OBDMID_02_TID_OSCLO DTR_valTst.DTR_OBDMID_02_TID_OSCUP DTR_valTst.DTR_OBDMID_21_TID_AV DTR_valTst.DTR_OBDMID_41_TID_HTR DTR_valTst.DTR_OBDMID_a2_TID_0b_0 DTR_valTst.DTR_OBDMID_a2_TID_0b_1 DTR_valTst.DTR_OBDMID_a2_TID_0b_2 DTR_valTst.DTR_OBDMID_a2_TID_0c_0 DTR_valTst.DTR_OBDMID_a2_TID_0c_1 DTR_valTst.DTR_OBDMID_a2_TID_0c_2 DTR_valUpLim.DTR_IdleChrgActrGovDeMax DTR_valUpLim.DTR_IdleChrgActrGovDeMin DTR_valUpLim.DTR_OBDMID_01_TID_01 DTR_valUpLim.DTR_OBDMID_01_TID_02 DTR_valUpLim.DTR_OBDMID_02_TID_01 DTR_valUpLim.DTR_OBDMID_02_TID_02 DTR_valUpLim.DTR_OBDMID_02_TID_OSCLO DTR_valUpLim.DTR_OBDMID_02_TID_OSCUP DTR_valUpLim.DTR_OBDMID_21_TID_AV DTR_valUpLim.DTR_OBDMID_41_TID_HTR DTR_valUpLim.DTR_OBDMID_a2_TID_0b_0 DTR_valUpLim.DTR_OBDMID_a2_TID_0b_1 DTR_valUpLim.DTR_OBDMID_a2_TID_0b_2 DTR_valUpLim.DTR_OBDMID_a2_TID_0c_0 DTR_valUpLim.DTR_OBDMID_a2_TID_0c_1 DTR_valUpLim.DTR_OBDMID_a2_TID_0c_2 /end OUT_MEASUREMENT
 FUNCTION_VERSION "2.1.0" /end FUNCTION
/begin FUNCTION DTRG2MED "1.0.0" /begin DEF_CHARACTERISTIC TMWUC /end DEF_CHARACTERISTIC /begin OUT_MEASUREMENT bbdcy bbwuc B_dcy B_wuc dcycnt wuccnt /end OUT_MEASUREMENT FUNCTION_VERSION "1.0.0" /end FUNCTION
/begin FUNCTION ECTEXTCV "99.0.0" /begin DEF_CHARACTERISTIC TKIHKMRED /end DEF_CHARACTERISTIC /begin IN_MEASUREMENT tkihkm_w /end IN_MEASUREMENT FUNCTION_VERSION "99.0.0" /end FUNCTION
/begin FUNCTION Eec "1.11.0" FUNCTION_VERSION "1.11.0" /end FUNCTION
/begin FUNCTION Eeebd "1.15.0" /begin OUT_MEASUREMENT Eeebd_numSectChg Eeebd_stEee /end OUT_MEASUREMENT FUNCTION_VERSION "1.15.0" /end FUNCTION
/begin FUNCTION Eeepdd "1.15.0" FUNCTION_VERSION "1.15.0" /end FUNCTION
/begin FUNCTION EEP2MED "1.1.0_1" /begin OUT_MEASUREMENT B_eepwf B_pwf /end OUT_MEASUREMENT FUNCTION_VERSION "1.1.0_1" /end FUNCTION
/begin FUNCTION EepCust_CpDs_AvsNPD "" /begin REF_CHARACTERISTIC BasSvrAppl_EepAltAdap_C /end REF_CHARACTERISTIC /end FUNCTION
/begin FUNCTION EepCust_CpDs_Diag "" /end FUNCTION
/begin FUNCTION EepHal "1.15.0"
 /begin DEF_CHARACTERISTIC EEPRdErr_Datalost_CW EEPRdErr_Redundant_CW Eep_ClrWrCounter_CW Eep_EnFirstFactoryMark_CW Eep_EnFirstInit_CW Eep_EnvRamClr_CW /end DEF_CHARACTERISTIC
 /begin OUT_MEASUREMENT Eep_ctAbsCallWrFkt Eep_ctCallWrFkt Eep_ctMaxCallWrFkt Eep_EnvRamHist Eep_EnvRamInvld Eep_numBlkCtr Eep_numEnvRamLength Eep_stBlk Eep_stBlockFail Eep_stMain Eep_stPostDrv Eep_xIniTimeus /end OUT_MEASUREMENT
 FUNCTION_VERSION "1.15.0" /end FUNCTION
/begin FUNCTION Eesbd "1.14.0" FUNCTION_VERSION "1.14.0" /end FUNCTION
/begin FUNCTION Eespdd "1.15.0" FUNCTION_VERSION "1.15.0" /end FUNCTION
/begin FUNCTION EngDem2ETS "2.0.0" /begin REF_CHARACTERISTIC MDNORM /end REF_CHARACTERISTIC /begin IN_MEASUREMENT B_mdein B_nmax dmllr_w mifil_w misol_w nsber_w /end IN_MEASUREMENT
 /begin OUT_MEASUREMENT CoETS_trqInrLim CoETS_trqInrLimSet CoETS_trqUnFltLtd HLSDem_bNMaxPrio HLSDem_nMaxDspl HLSDem_nMaxEngWoHalt HLSDem_nMinWoTraIntv HLSDem_stNMaxWarnDspl PthSet_trqInrSet /end OUT_MEASUREMENT
 FUNCTION_VERSION "2.0.0" /end FUNCTION
/begin FUNCTION EngECU_Co "11.0.0" /begin IN_MEASUREMENT CEngDsT_tRaw /end IN_MEASUREMENT /begin OUT_MEASUREMENT Com_stClntFail Com_tRaw /end OUT_MEASUREMENT FUNCTION_VERSION "11.0.0" /end FUNCTION
/begin FUNCTION ENGSTART "1.11.1" /begin IN_MEASUREMENT B_stendmd Epm_stSpd Epm_stSync Strt_stStaActv /end IN_MEASUREMENT
 /begin OUT_MEASUREMENT B_engrest B_engrestp B_engrests B_stainjen B_stprep tistrtdly /end OUT_MEASUREMENT
 /begin LOC_MEASUREMENT B_fsynst B_sttrigg /end LOC_MEASUREMENT
 FUNCTION_VERSION "1.11.1" /end FUNCTION
/begin FUNCTION EpmBCr_IntrCo "1.25.0" /begin DEF_CHARACTERISTIC EpmBCr_phiTimeoutInt_C EpmBCr_swtEnable_C EpmBCr_tEna_C /end DEF_CHARACTERISTIC /begin REF_CHARACTERISTIC EpmCrS_dnEngMax_C EpmCrS_nDiagOff_C /end REF_CHARACTERISTIC
 /begin IN_MEASUREMENT EngDa_tEng EpmBCr_phiNxtCaSEdge EpmBCr_stPos EpmCaS_nEng EpmCrS_stDiagErrSig EpmCrS_stDiagNoSig EpmSeq_phiNxtInt EpmSyn_phiInt Epm_dnEngFlt Epm_nEng Epm_stOpMode T15_st /end IN_MEASUREMENT
 /begin OUT_MEASUREMENT EpmBCr_stIntrCo EpmBCr_stTmrModeStarted /end OUT_MEASUREMENT
 FUNCTION_VERSION "1.25.0" /end FUNCTION
/begin FUNCTION EpmBCr_Plaus "2.24.1" /begin DEF_CHARACTERISTIC EpmBCr_facPlaus_C /end DEF_CHARACTERISTIC /begin REF_CHARACTERISTIC EpmBCr_phiZero2Sync_CA /end REF_CHARACTERISTIC /begin OUT_MEASUREMENT EpmBCr_phiSeg2Seg EpmBCr_tiSeg /end OUT_MEASUREMENT
 /begin LOC_MEASUREMENT EpmBCr_ctCaSRev EpmBCr_ctEdge_mp EpmBCr_numEdgeID_mpA EpmBCr_numSyncPos_mp EpmBCr_phiSync2Curr_mp EpmBCr_stPlaus EpmBCr_stPlausRet_mp /end LOC_MEASUREMENT
 FUNCTION_VERSION "2.24.1" /end FUNCTION
/begin FUNCTION EpmBCr_Pos "1.26.0" /begin DEF_CHARACTERISTIC EpmBCr_phiZero2Sync_CA /end DEF_CHARACTERISTIC /begin IN_MEASUREMENT EpmBCr_phiSeg2Seg EpmBCr_tiSeg /end IN_MEASUREMENT
 /begin OUT_MEASUREMENT EpmBCr_nEng EpmBCr_phiNxtCaSEdge EpmBCr_phiPos EpmBCr_stPos /end OUT_MEASUREMENT
 /begin LOC_MEASUREMENT EpmBCr_ctEdgeRefTabIdx EpmBCr_phiCurrCaSEdge EpmBCr_phiLastCaSEdge EpmBCr_tiIncPer /end LOC_MEASUREMENT
 FUNCTION_VERSION "1.26.0" /end FUNCTION
/begin FUNCTION EpmCaS_Adap "1.25.1"
 /begin DEF_CHARACTERISTIC EpmCaS_facAdapFil_C EpmCaS_phiDiffAdapMax_C EpmCaS_phiDiffLim_C EpmCaS_swtAdapStgy_C /end DEF_CHARACTERISTIC
 /begin IN_MEASUREMENT Epm_nEng Epm_stOpMode /end IN_MEASUREMENT
 /begin OUT_MEASUREMENT EpmCaS_stAdap /end OUT_MEASUREMENT
 /begin LOC_MEASUREMENT EpmCaS_phiAdapLimFil_mp EpmCaS_phiAdapRefPosI1_mp EpmCaS_phiAdap_mp EpmCaS_phiDiffCal2Adap EpmCaS_stAdapErr /end LOC_MEASUREMENT
 FUNCTION_VERSION "1.25.1" /end FUNCTION
/begin FUNCTION EpmCaS_Diag "1.24.1"
 /begin DEF_CHARACTERISTIC EpmCaS_numErrSigDef_C EpmCaS_numErrSigOk_C EpmCaS_numNoSigDef_C /end DEF_CHARACTERISTIC
 /begin IN_MEASUREMENT EpmCrS_stSigMode /end IN_MEASUREMENT
 /begin OUT_MEASUREMENT EpmCaS_stDiag EpmCaS_stDiagErr /end OUT_MEASUREMENT
 /begin LOC_MEASUREMENT EpmCaS_bActivatePatmat EpmCaS_ctEdgeLst EpmCaS_ctErrSig EpmCaS_ctNoSig EpmCaS_ctRevNoSig EpmCaS_ctRevSig EpmCaS_ctSigOk EpmCaS_numCurrEdge EpmCaS_stSegFault /end LOC_MEASUREMENT
 FUNCTION_VERSION "1.24.1" /end FUNCTION
/begin FUNCTION EpmCaS_Meas "1.23.0" /begin DEF_CHARACTERISTIC EpmCaS_swtMeasCaS_C /end DEF_CHARACTERISTIC /begin IN_MEASUREMENT EpmCrS_stSigMode Epm_stOpMode /end IN_MEASUREMENT /begin LOC_MEASUREMENT EpmCaS_numRawValue_mp EpmCaS_phiRawValue_mp /end LOC_MEASUREMENT FUNCTION_VERSION "1.23.0" /end FUNCTION
/begin FUNCTION EpmCaS_OfsDiag "1.24.0"
 /begin DEF_CHARACTERISTIC EpmCaS_numOfsErr_C EpmCaS_phiOfsMax_C EpmCaS_phiOfsMin_C EpmCaS_stOfsDiagMode_C EpmCaS_tiOfsPT1_C /end DEF_CHARACTERISTIC
 /begin REF_CHARACTERISTIC EpmSyn_dCaSSegMsk_C /end REF_CHARACTERISTIC
 /begin IN_MEASUREMENT EpmCaS_phiCor EpmRRS_bEngSwOff EpmSeq_numIntTyp Epm_stOpMode /end IN_MEASUREMENT
 /begin OUT_MEASUREMENT EpmCaS_phiCaSOfsAvg EpmCaS_phiOfsCorr EpmCaS_stOfs EpmCaS_stOfsErr /end OUT_MEASUREMENT
 /begin LOC_MEASUREMENT EpmCaS_ctOfsErr_mp EpmCaS_numBufEntry_mp EpmCaS_numSegTeeth_mp EpmCaS_numValidTeeth_mp EpmCaS_phiMissedSeg_mp EpmCaS_phiOfsTolc_mp EpmCaS_phiSegLenTolc_mp EpmCaS_phiSpeedSegLen_mp /end LOC_MEASUREMENT
 FUNCTION_VERSION "1.24.0" /end FUNCTION
/begin FUNCTION EpmCaS_Seg "1.28.0"
 /begin DEF_CHARACTERISTIC EpmCaS_dSegSeries_CA EpmCaS_facPlausHigh_GCUR EpmCaS_facPlausLow_GCUR EpmCaS_facPlaus_DST EpmCaS_numSegSerLst_C EpmCaS_phiLoLimIn_C EpmCaS_phiNCor_CUR EpmCaS_phiSegLenTol_CA EpmCaS_phiSegLen_CA EpmCaS_phiSegOfs_CA EpmCaS_phiTempCor05_DST EpmCaS_phiTempCorI1_GCUR EpmCaS_phiUpLimIn_C EpmCaS_stActEdge_C EpmCaS_stMinSyncCaSAg_C EpmCaS_swtSeg_C EpmCaS_tiGlitchFilter_C EpmCaS_tiTimeout_C /end DEF_CHARACTERISTIC
 /begin IN_MEASUREMENT EngDa_tEng EpmCaS_stAdap EpmCrS_stSigMode Epm_nEng Epm_stSync /end IN_MEASUREMENT
 /begin OUT_MEASUREMENT EpmCaS_ctEdgeEquid EpmCaS_nEng EpmCaS_phiCor EpmCaS_phiDiffLim EpmCaS_phiEdge EpmCaS_phiTempCor EpmCaS_stNEng EpmCaS_stphiDiffLim EpmCaS_tiEdge /end OUT_MEASUREMENT
 /begin LOC_MEASUREMENT EpmCaS_nCaS_mp EpmCaS_omega_mp EpmCaS_phiRefPos EpmCaS_stPosValid /end LOC_MEASUREMENT
 FUNCTION_VERSION "1.28.0" /end FUNCTION
/begin FUNCTION EpmCrS_Diag "1.28.0"
 /begin DEF_CHARACTERISTIC EpmCrS_dnEngMax_C EpmCrS_nDiagOff_C EpmCrS_nDiagOn_C EpmCrS_numErrSigIncDef_C EpmCrS_numErrSigIncOK_C EpmCrS_numErrSigMaxDef_C EpmCrS_numErrSigMinOK_C EpmCrS_numNoSigDef_C EpmCrS_stDiagT50Reset_C EpmCrS_swtEnableDiag_C EpmCrS_VehV_v_Max_C EpmCrS_VehV_v_Min_C /end DEF_CHARACTERISTIC
 /begin REF_CHARACTERISTIC EpmBCr_swtEnable_C /end REF_CHARACTERISTIC
 /begin IN_MEASUREMENT CoEng_st EngDa_tEng EpmBCr_stTmrModeStarted EpmCaS_stNEng EpmCrS_stSigMode EpmSeq_numIntTyp Epm_dnEngFlt Epm_nEng Epm_stOpMode Strt_stStaActv T15_st VehV_v /end IN_MEASUREMENT
 /begin OUT_MEASUREMENT EpmCrS_stDiag EpmCrS_stDiagErrSig EpmCrS_stDiagNoSig EpmCrS_stSigDiagSrc /end OUT_MEASUREMENT
 /begin LOC_MEASUREMENT EpmCrS_bDisturb EpmCrS_ctCaSRev_mp EpmCrS_ctErrSig EpmCrS_ctErrSigSyncIni EpmCrS_ctRev EpmCrS_ctRev100msLim_mp EpmCrS_ctRevWaitDiag EpmCrS_dnEngFltSyncIni /end LOC_MEASUREMENT
 FUNCTION_VERSION "1.28.0" /end FUNCTION
/begin FUNCTION EpmCrS_Plaus "1.23.0"
 /begin DEF_CHARACTERISTIC EpmCrS_facGapCrit1_C EpmCrS_facGapCrit2_C EpmCrS_facGapPlausHigh_CA EpmCrS_facIncPlausHigh_CA EpmCrS_facIncPlausLow_CA EpmCrS_nMaxInc_C EpmCrS_nMinInc_C EpmCrS_nThreshRange_CA EpmCrS_nTiIncPerAvrg_CA EpmCrS_numIgnInc_C EpmCrS_numTiIncPerAvrg_CA EpmCrS_tiGlitchFilter_CA EpmCrS_tiIgnSig_C /end DEF_CHARACTERISTIC
 /begin IN_MEASUREMENT EpmCrS_stSigMode Epm_nEng /end IN_MEASUREMENT
 /begin OUT_MEASUREMENT EpmCrS_phiIgnInc EpmCrS_tiIncPer /end OUT_MEASUREMENT
 /begin LOC_MEASUREMENT EpmCrS_ctRange EpmCrS_numTiIncPerAvrg_mp /end LOC_MEASUREMENT
 FUNCTION_VERSION "1.23.0" /end FUNCTION
/begin FUNCTION EpmCrS_RevCnt "1.23.0"
 /begin IN_MEASUREMENT CoEng_st EpmCrS_numSeg EpmCrS_stSigMode Epm_nEng Epm_stSync /end IN_MEASUREMENT
 /begin OUT_MEASUREMENT EpmCrS_ctRevIni EpmCrS_ctRevStrt EpmCrS_ctRevStrtExtd /end OUT_MEASUREMENT
 /begin LOC_MEASUREMENT EpmCrS_ctRevCnt /end LOC_MEASUREMENT
 FUNCTION_VERSION "1.23.0" /end FUNCTION
/begin FUNCTION EpmCrS_Seg "1.27.0" /begin DEF_CHARACTERISTIC EpmCrS_stTTMeasure_C /end DEF_CHARACTERISTIC /begin REF_CHARACTERISTIC EpmSeq_phiInt_CA EpmSeq_swtInt_C /end REF_CHARACTERISTIC
 /begin IN_MEASUREMENT EpmHCrS_stSigMode EpmSeq_numInt EpmSeq_numIntTyp EpmSyn_phiInt Epm_ctCyl Epm_nEng Epm_stOpMode /end IN_MEASUREMENT
 /begin OUT_MEASUREMENT EpmCrS_ctInc EpmCrS_numSeg EpmCrS_phiIntSeg EpmCrS_phiSeg EpmCrS_stSigMode EpmCrS_tiSeg EpmCrS_tiSegCurr /end OUT_MEASUREMENT
 /begin LOC_MEASUREMENT EpmCrS_numNewInc_mp EpmCrS_tiInc_mp /end LOC_MEASUREMENT
 FUNCTION_VERSION "1.27.0" /end FUNCTION
/begin FUNCTION EpmHCaS_SigBuf "1.23.1" /begin LOC_MEASUREMENT EpmHCaS_numMaxTryPrepBuf /end LOC_MEASUREMENT FUNCTION_VERSION "1.23.1" /end FUNCTION
/begin FUNCTION EpmHCaS_SigEval "1.25.0" FUNCTION_VERSION "1.25.0" /end FUNCTION
/begin FUNCTION EpmHCrS_Interface "1.25.0" /begin IN_MEASUREMENT EpmSyn_phiOffs EpmSyn_phiOffsCor /end IN_MEASUREMENT FUNCTION_VERSION "1.25.0" /end FUNCTION
/begin FUNCTION EpmHCrS_SigBuf "1.26.1" /begin IN_MEASUREMENT EpmCrS_phiSeg EpmSyn_phiInt Epm_phiDiffTDC /end IN_MEASUREMENT FUNCTION_VERSION "1.26.1" /end FUNCTION
/begin FUNCTION EpmHCrS_SigEval "1.27.0" /begin IN_MEASUREMENT EpmCrS_stSigMode EpmSyn_phiInt /end IN_MEASUREMENT /begin OUT_MEASUREMENT EpmHCrS_stSigErr EpmHCrS_stSigMode /end OUT_MEASUREMENT /begin LOC_MEASUREMENT EpmHCrS_ctResyncUpperLvl_mp /end LOC_MEASUREMENT FUNCTION_VERSION "1.27.0" /end FUNCTION
/begin FUNCTION EpmHInt_IntGen "1.25.0" /begin LOC_MEASUREMENT EpmHInt_tiInt4DelMeas /end LOC_MEASUREMENT FUNCTION_VERSION "1.25.0" /end FUNCTION
/begin FUNCTION EpmHwe_Ini "1.23.0" FUNCTION_VERSION "1.23.0" /end FUNCTION
/begin FUNCTION EpmHwe_Srv "1.23.0" FUNCTION_VERSION "1.23.0" /end FUNCTION
/begin FUNCTION EpmRRS_AgDetect "1.30.0"
 /begin DEF_CHARACTERISTIC EpmRRS_EnaIgnInj_CW EpmRRS_nEngMax_C EpmRRS_phiMax_C EpmRRS_phiUndef_C EpmRRS_tiMaxToothTime_C EpmRRS_tiTemp_CUR EpmRRS_vVehMax_C /end DEF_CHARACTERISTIC
 /begin IN_MEASUREMENT EngDa_tEng EpmHCrS_stSigErr EpmSeq_numIntTyp EpmSyn_stRR Epm_nEng10ms Epm_phiDiffTDC Epm_stSync Strt_stStaActv VehV_v /end IN_MEASUREMENT
 /begin OUT_MEASUREMENT EpmRRS_bEngSwOff EpmRRS_stEngStop /end OUT_MEASUREMENT
 /begin LOC_MEASUREMENT EpmRRS_actIncAr_mp EpmRRS_actIncBuf_mp EpmRRS_actIncOrig_mp EpmRRS_actInc_mp EpmRRS_ctGapInBuffer_mp EpmRRS_ctNewTeethOrig_mp EpmRRS_ctNewTeeth_mp EpmRRS_ctToothTimeout_mp EpmRRS_GapDetected_mp EpmRRS_idxWrAct_mp EpmRRS_incGapTest_mp EpmRRS_incSynOffs_mp EpmRRS_maxToothCondAr_mp EpmRRS_phiEngRR EpmRRS_phiEngStop_mp EpmRRS_phiGapPos EpmRRS_phiRelTDC_mp EpmRRS_stAgDetect EpmRRS_stEnable EpmRRS_stEngStopAg_mp EpmRRS_stGetBufNumPer_mp EpmRRS_stReason_mp EpmRRS_stRotDir_mp EpmRRS_stToothPerBuf_mp EpmRRS_tiToothPerOrg_mp EpmRRS_tiToothPer_mp /end LOC_MEASUREMENT
 FUNCTION_VERSION "1.30.0" /end FUNCTION
/begin FUNCTION EpmSeq_StateMn "1.24.0"
 /begin DEF_CHARACTERISTIC EpmSeq_nMaxStrtInt_C EpmSeq_phiDelayMax_CA EpmSeq_phiIntBCr_CA EpmSeq_phiInt_CA EpmSeq_phiStrtInt_CA EpmSeq_swtInt_C /end DEF_CHARACTERISTIC
 /begin IN_MEASUREMENT EpmBCr_stTmrModeStarted EpmCrS_stSigMode Epm_ctCyl Epm_nEng Epm_stOpMode /end IN_MEASUREMENT
 /begin OUT_MEASUREMENT EpmSeq_numIncDiffInt EpmSeq_numInt EpmSeq_numIntTyp EpmSeq_phiNxtInt EpmSeq_stInt /end OUT_MEASUREMENT
 FUNCTION_VERSION "1.24.0" /end FUNCTION
/begin FUNCTION EpmSrv_Lib "1.24.0" /begin REF_CHARACTERISTIC Epm_numFireSeg_C /end REF_CHARACTERISTIC /begin IN_MEASUREMENT Epm_nEng /end IN_MEASUREMENT /begin LOC_MEASUREMENT EpmSrv_stCnvAgT2Ag_mp /end LOC_MEASUREMENT FUNCTION_VERSION "1.24.0" /end FUNCTION
/begin FUNCTION EpmSyn_CaSPos "1.24.0" /begin DEF_CHARACTERISTIC EpmSyn_dCaSSegMsk_C /end DEF_CHARACTERISTIC /begin REF_CHARACTERISTIC Epm_phiGap2Zero_C /end REF_CHARACTERISTIC
 /begin IN_MEASUREMENT EpmCaS_stAdap EpmCrS_ctInc EpmCrS_stSigMode EpmSeq_numIntTyp Epm_stOpMode /end IN_MEASUREMENT
 /begin OUT_MEASUREMENT EpmSyn_numCaSSync EpmSyn_phiCaSPos EpmSyn_stRR /end OUT_MEASUREMENT
 /begin LOC_MEASUREMENT EpmSyn_CaSData EpmSyn_ctLstEdge_mp EpmSyn_ctSigTabLstEntr_mp EpmSyn_numMatches_mp EpmSyn_numMatchPos_mp EpmSyn_numNewEdges_mp EpmSyn_numSegInSigTab_mp EpmSyn_phiCaSPosCorrAdap EpmSyn_stCasEval EpmSyn_stCaSPos EpmSyn_stGapPos EpmSyn_stPreSeg_mp /end LOC_MEASUREMENT
 FUNCTION_VERSION "1.24.0" /end FUNCTION
/begin FUNCTION EpmSyn_CrSPos "1.26.0" /begin DEF_CHARACTERISTIC EpmSyn_phiIncCor_CUR /end DEF_CHARACTERISTIC /begin REF_CHARACTERISTIC Epm_phiGap2Zero_C /end REF_CHARACTERISTIC /begin IN_MEASUREMENT EpmCrS_ctInc EpmSeq_numIntTyp Epm_nEng Epm_stOpMode /end IN_MEASUREMENT
 /begin OUT_MEASUREMENT EpmSyn_numIntTyp EpmSyn_phiDiff EpmSyn_phiInt EpmSyn_stCrSPos EpmSyn_stCrSPosErr /end OUT_MEASUREMENT
 /begin LOC_MEASUREMENT EpmSyn_GetAngleCnt_mp EpmSyn_phiAgClk_mp EpmSyn_phiIncCor_mp EpmSyn_phiOffs EpmSyn_phiOffsCor /end LOC_MEASUREMENT
 FUNCTION_VERSION "1.26.0" /end FUNCTION
/begin FUNCTION EPM_Conf "" /end FUNCTION
/begin FUNCTION Epm_Ini "1.24.1" /begin DEF_CHARACTERISTIC Epm_numFireSeg_C Epm_phiGap2Zero_C Epm_phiTdc1_C /end DEF_CHARACTERISTIC /begin OUT_MEASUREMENT Epm_numCyl Epm_phiDiffTDC /end OUT_MEASUREMENT /begin LOC_MEASUREMENT Epm_numConfCaS Epm_numConfCrS Epm_numVersion /end LOC_MEASUREMENT FUNCTION_VERSION "1.24.1" /end FUNCTION
/begin FUNCTION Epm_OpMode "1.31.0"
 /begin DEF_CHARACTERISTIC Epm_nALESyncMax_C Epm_nNoSyncVerify_C Epm_numReSync_C Epm_swtBlkInjCaSSync_C Epm_swtOpModeStgy_C Epm_tiLockReSync_C /end DEF_CHARACTERISTIC
 /begin REF_CHARACTERISTIC EpmBCr_phiTimeoutInt_C EpmCaS_stActEdge_C EpmCaS_tiGlitchFilter_C EpmSeq_phiInt_CA EpmSeq_swtInt_C Epm_numFireSeg_C /end REF_CHARACTERISTIC
 /begin IN_MEASUREMENT EpmBCr_phiPos EpmBCr_stIntrCo EpmBCr_stTmrModeStarted EpmCaS_nEng EpmCaS_stOfsErr EpmCrS_phiIgnInc EpmCrS_stSigMode EpmRRS_bEngSwOff EpmSeq_numInt EpmSeq_numIntTyp EpmSeq_phiNxtInt EpmSyn_numCaSSync EpmSyn_numIntTyp EpmSyn_phiCaSPos EpmSyn_phiInt EpmSyn_stCrSPos EpmSyn_stCrSPosErr EpmSyn_stRR Epm_nEng Epm_numCyl Strt_stStaActv /end IN_MEASUREMENT
 /begin OUT_MEASUREMENT Epm_ctCyl Epm_ctReSync Epm_stCmbTestReq Epm_stOpMode Epm_stSync /end OUT_MEASUREMENT
 /begin LOC_MEASUREMENT Epm_ctTDCPhys_mp Epm_nEngVerify Epm_phiHCrsGetCurrPos Epm_phiIntDelay_mp Epm_stReSyncReason_mp Epm_stSyncRestore Epm_stTestInj /end LOC_MEASUREMENT
 FUNCTION_VERSION "1.31.0" /end FUNCTION
/begin FUNCTION Epm_Spd "1.28.0" /begin DEF_CHARACTERISTIC Epm_tiSpd2Zero_C /end DEF_CHARACTERISTIC /begin REF_CHARACTERISTIC EpmCrS_nDiagOff_C /end REF_CHARACTERISTIC
 /begin IN_MEASUREMENT EpmBCr_nEng EpmBCr_stPos EpmCaS_nEng EpmCaS_stNEng EpmCrS_phiSeg EpmCrS_stDiagErrSig EpmCrS_stDiagNoSig EpmCrS_stSigMode EpmCrS_tiSeg EpmCrS_tiSegCurr EpmHCrS_stSigMode EpmRRS_stEngStop Epm_stOpMode /end IN_MEASUREMENT
 /begin OUT_MEASUREMENT Epm_nEng Epm_nEng10ms Epm_nEngCurr Epm_nEngInc10ms Epm_nEngLRes Epm_nEngRaw Epm_nEngTooth10ms Epm_stSpd /end OUT_MEASUREMENT
 /begin LOC_MEASUREMENT Epm_numValidTeeth_mp Epm_tiSegNTEETH_mp Epm_tiSegONETOOTH_mp Epm_tiSegPARTSEG_mp Epm_tiSegRaw_mp Epm_tiSpd2Zero /end LOC_MEASUREMENT
 FUNCTION_VERSION "1.28.0" /end FUNCTION
/begin FUNCTION Epm_SpdGrd "1.21.0" /begin DEF_CHARACTERISTIC Epm_tiSpdGrdAvgFlt_C Epm_tiSpdGrdFlt_C /end DEF_CHARACTERISTIC
 /begin IN_MEASUREMENT EpmCrS_tiSeg EpmSeq_numInt Epm_ctCyl Epm_nEng Epm_numCyl Epm_stSync /end IN_MEASUREMENT
 /begin OUT_MEASUREMENT Epm_dnEng Epm_dnEngAvg Epm_dnEngAvgFlt Epm_dnEngFlt Epm_nEngDiff Epm_nEngDiffAvg /end OUT_MEASUREMENT
 /begin LOC_MEASUREMENT Epm_nEngOldS0_mp Epm_nEngOldS1_mp /end LOC_MEASUREMENT
 FUNCTION_VERSION "1.21.0" /end FUNCTION
/begin FUNCTION Epm_SwAdp "1.25.0" /begin DEF_CHARACTERISTIC ZNGFIL /end DEF_CHARACTERISTIC /begin REF_CHARACTERISTIC EpmCrS_nMinInc_C EpmSeq_phiDelayMax_CA /end REF_CHARACTERISTIC
 /begin IN_MEASUREMENT EpmCaS_ctEdgeEquid EpmCaS_phiDiffLim EpmCaS_phiEdge EpmCaS_tiEdge EpmCrS_phiSeg EpmCrS_stSigMode EpmCrS_tiSeg EpmRRS_bEngSwOff EpmSeq_numIntTyp Epm_ctCyl Epm_nEng Epm_nEng10ms Epm_nEngDiff Epm_nEngInc10ms Epm_nEngLRes Epm_nEngRaw Epm_nEngTooth10ms Epm_stOpMode Epm_stSpd Epm_stSync /end IN_MEASUREMENT
 /begin OUT_MEASUREMENT bmlosctr_w B_bm B_dopzue B_fbm B_motstop B_ngasok B_nldg B_nlph B_nlphwe B_nmin B_nmot B_nwkv B_optpherk B_phsinvst B_phsnl B_stprel B_synnot B_synph B_umsync B_zprel dnmot_w ngas_w ngfil ngfil2 ngfil2_w ngfil_w nmot nmotbi_w nmotll nmotst nmotst1t_w nmotz nmot_w phidelmx_w s1fl3p0c synstate tnwie_l tseg_l uzkw_w wnwadmne_w wnwadmxe_w wnwkwe_w zphfl zrph_l zzkwas_w zzyl zzylbi /end OUT_MEASUREMENT
 /begin LOC_MEASUREMENT phiOffsOld stSyncOld /end LOC_MEASUREMENT
 FUNCTION_VERSION "1.25.0" /end FUNCTION
/begin FUNCTION ErrLmp2MED "1.0.0" /begin IN_MEASUREMENT MILLmp_stMIL MILLmp_stPs /end IN_MEASUREMENT /begin OUT_MEASUREMENT B_mil B_milblk B_milst /end OUT_MEASUREMENT FUNCTION_VERSION "1.0.0" /end FUNCTION
/begin FUNCTION Eru "1.4.0" FUNCTION_VERSION "1.4.0" /end FUNCTION
/begin FUNCTION ESC_Stack "2.12.0" /begin IN_MEASUREMENT EpmCrS_tiSeg EpmCrS_tiSegCurr /end IN_MEASUREMENT /begin OUT_MEASUREMENT ESC_stErr ESC_tiSampling /end OUT_MEASUREMENT FUNCTION_VERSION "2.12.0" /end FUNCTION
/begin FUNCTION ESC_TaskLink "2.12.0" /begin DEF_CHARACTERISTIC ESC_nMaxEngReStrt_C ESC_stS1FrstSched_C /end DEF_CHARACTERISTIC
 /begin IN_MEASUREMENT CoEng_bEngReStrt EpmSeq_numInt Epm_nEng SyC_stSub SyC_tiDrv /end IN_MEASUREMENT
 FUNCTION_VERSION "2.12.0" /end FUNCTION
/begin FUNCTION ESDSDLUT "1.2.0" /begin DEF_CHARACTERISTIC KFSDLUSDMR KFSDLUSOL KFSDLUSRRI KLLUTS ZKASDLUTS ZKMSDLUTS /end DEF_CHARACTERISTIC /begin IN_MEASUREMENT anztib_w B_nmin B_sdluts dmrmx_w luts_w rri_w tmst /end IN_MEASUREMENT /begin OUT_MEASUREMENT dsdluts_w sdlutsol_w sdluts_w /end OUT_MEASUREMENT /begin LOC_MEASUREMENT lutsnorm_w tmsdluts /end LOC_MEASUREMENT FUNCTION_VERSION "1.2.0" /end FUNCTION
/begin FUNCTION ESGRU "1.5.0" /begin DEF_CHARACTERISTIC CWRKAKAP FRKAP RKAKAP /end DEF_CHARACTERISTIC /begin REF_CHARACTERISTIC N0 NRKAB /end REF_CHARACTERISTIC /begin IN_MEASUREMENT nmot /end IN_MEASUREMENT /begin OUT_MEASUREMENT fgru fgrung rkakapb /end OUT_MEASUREMENT FUNCTION_VERSION "1.5.0" /end FUNCTION
/begin FUNCTION ESNSAD "1.8.0"
 /begin DEF_CHARACTERISTIC DSDLUTSIMN DSDLUTSIMX KFFNSAMX KLFNSAMX KLNSADI KLNSADP KLZKNSADI TNSADHMX TNSEMX ZKFNSADOFF /end DEF_CHARACTERISTIC
 /begin IN_MEASUREMENT B_nsad B_nsadh dsdluts_w lamsbg_w tmot tnse_w /end IN_MEASUREMENT
 /begin OUT_MEASUREMENT fnsad_w /end OUT_MEASUREMENT
 /begin LOC_MEASUREMENT dsdliold_w dsdlutsi_w flimit_w flimuebw_w fnsadi_w fnsadlim_w fnsadp_w tmotnsad /end LOC_MEASUREMENT
 FUNCTION_VERSION "1.8.0" /end FUNCTION
/begin FUNCTION ESNSWL "3.8.0"
 /begin DEF_CHARACTERISTIC FNSSM FWSTAB FZANSSA1 FZANSSA2 FZANSSM1 FZANSSM2 FZANSSM3 KFFNSHO KFFWL KFFWLRL KFKNSTWST KFNSA KFNSWRL KFWSTAARL KFWWLML KFWWNS KLFNSKH KLFWLN KLZANSFHO SZANSSM1 SZANSSM2 ZDGZA1 ZDGZA2 ZDGZA3 /end DEF_CHARACTERISTIC
 /begin REF_CHARACTERISTIC SIM06ESUW SKS06ESUB SRP06ESUB STA06ESUB STM12ESUB STS08ESUB STS12ESUB /end REF_CHARACTERISTIC
 /begin IN_MEASUREMENT B_hst B_kh B_staa B_stendes B_wks B_wst esst_sim06esuw esst_sks06esub esst_srp06esub esst_sta06esub esst_stm12esub esst_sts08esub esst_sts12esub fho fnsad_w imlatm_w kstaa nmot rlp tans tengslst tengsq1_w tmot tmst /end IN_MEASUREMENT
 /begin OUT_MEASUREMENT B_fnsoff B_fwloff fktns_w fnswlst_w fnswl_w fns_w fwl /end OUT_MEASUREMENT
 /begin LOC_MEASUREMENT fnswkstaa fwlrl fwnsnaus_w gkfkffwl gkfkfwwlml gklfzansh1 gklfzansh2 gklfzansh3 gklszansh1 gklszansh2 kfkfwwns nsactr nsactrho NST_ABR_0.B_fnsb1 NST_ABR_0.B_fnsb2 NST_ABR_0.B_fnsb3 NST_ABR_0.abr1_count /end LOC_MEASUREMENT
 FUNCTION_VERSION "3.8.0" /end FUNCTION
/begin FUNCTION ESPLANT "1.9.0" /begin DEF_CHARACTERISTIC KFLRST KFLRSZ SNM07LSUW SRL08LSUW /end DEF_CHARACTERISTIC /begin IN_MEASUREMENT nmot_w rl_w /end IN_MEASUREMENT /begin OUT_MEASUREMENT rlinterp_w tlrsl_w tlrs_w zlrsl_w zlrs_w /end OUT_MEASUREMENT FUNCTION_VERSION "1.9.0" /end FUNCTION
/begin COMPU_METHOD AngleCrS "" RAT_FUNC "%6.4" "deg CrS" COEFFS 0 45.5111111111 0 0 0 1 /end COMPU_METHOD
/begin COMPU_METHOD B_TRUE "" TAB_VERB "%6.3" "" COMPU_TAB_REF B_TRUE /end COMPU_METHOD
/begin COMPU_VTAB B_TRUE "" TAB_VERB 2 0 "----" 1 "TRUE" /end COMPU_VTAB
/begin COMPU_METHOD CrSRev2CrSInc "" RAT_FUNC "%6.4" "-" COEFFS 0 36 0 0 0 1 /end COMPU_METHOD
/begin COMPU_METHOD dez "" RAT_FUNC "%6.2" "" COEFFS 0 1 0 0 0 1 /end COMPU_METHOD
/begin COMPU_METHOD DFC_OneToOne "" RAT_FUNC "%6.2" "-" COEFFS 0 1 0 0 0 1 /end COMPU_METHOD
/begin COMPU_METHOD DFC_Verb "" TAB_VERB "%2.1" "-" COMPU_TAB_REF DFC_Verb /end COMPU_METHOD
/begin COMPU_VTAB DFC_Verb "" TAB_VERB 212 0 "DFC_Unused" 60 "DFC_AirCClntPAnaSRCMax" 61 "DFC_AirCClntPAnaSRCMin" 41 "DFC_AirCCmprOL" 42 "DFC_AirCCmprOvrTemp" 43 "DFC_AirCCmprSCB" 44 "DFC_AirCCmprSCG" 62 "DFC_AirCSwtNpl" 63 "DFC_AirCSwtSig" 64 "DFC_AltIOLdSRCMax" 45 "DFC_AltIOLdSRCMin" 46 "DFC_AltIOOL" 47 "DFC_AltIOOvrTemp" 48 "DFC_AltIOSCB" 49 "DFC_AltIOSCG" 1 "DFC_AltMaxPwr" 2 "DFC_BrkNpl" 65 "DFC_BrkSig" 81 "DFC_BusDiagBusOffNodeA" 3 "DFC_Cj930SSp1Mon" 4 "DFC_Cj930SSp2Mon" 5 "DFC_Cj930SSp3Mon" 66 "DFC_ClthEPBNpl" 67 "DFC_ClthEPBSensErr" 68 "DFC_ClthErr" 24 "DFC_ClthNplClsd" 25 "DFC_ClthNplOpn" 69 "DFC_ClthSig" 82 "DFC_ComACSensTO" 83 "DFC_ComAWD1TO" 84 "DFC_ComBRK10TO" 85 "DFC_ComGW11TO" 86 "DFC_ComLVL1TO" 87 "DFC_ComPRKA01TO" 88 "DFC_ComPRKH01TO" 89 "DFC_ComPRKH1TO" 90 "DFC_ComTRBCH1TO" 91 "DFC_ComTRBCH2TO" 50 "DFC_DevLibBattUHi" 51 "DFC_DevLibBattULo" 92 "DFC_DK" 95 "DFC_DKmax" 96 "DFC_DKmin" 93 "DFC_DKRSA" 94 "DFC_DKVSmax" 97 "DFC_DSSmax" 98 "DFC_EEPEraseErr" 99 "DFC_EEPRdErr" 100 "DFC_EEPWrErr" 110 "DFC_EpmCaSI1ErrSig" 111 "DFC_EpmCaSI1NoSig" 112 "DFC_EpmCaSI1NoSigMax" 113 "DFC_EpmCaSI1NoSigMin" 114 "DFC_EpmCaSI1OfsErr" 115 "DFC_EpmCrSErrSig" 116 "DFC_EpmCrSNoSig" 101 "DFC_EV1max" 102 "DFC_EV1min" 103 "DFC_EV1sig" 104 "DFC_EV2max" 105 "DFC_EV2min" 106 "DFC_EV2sig" 107 "DFC_EV3max" 108 "DFC_EV3min" 109 "DFC_EV3sig" 52 "DFC_FanDIOOL" 53 "DFC_FanDIOOvrTemp" 54 "DFC_FanDIOSCB" 55 "DFC_FanDIOSCG" 56 "DFC_FanPWMOL" 57 "DFC_FanPWMOvrTemp" 58 "DFC_FanPWMSCB" 59 "DFC_FanPWMSCG" 117 "DFC_FRAmax" 118 "DFC_FRAmin" 119 "DFC_HEGOS1B1ElecMax" 120 "DFC_HEGOS1B1ElecMin" 121 "DFC_HEGOS1B1ElecNpl" 122 "DFC_HEGOS1B1ElecSig" 123 "DFC_HEGOS1B1HtgNpl" 124 "DFC_HEGOS1B1HtrPsMax" 125 "DFC_HEGOS1B1HtrPsMin" 126 "DFC_HEGOS1B1HtrPsSig" 127 "DFC_HEGOS1B1StkMax" 128 "DFC_HEGOS1B1StkMin" 129 "DFC_HEGOS2B1RstrcnLean" 130 "DFC_HEGOS2B1RstrcnRich" 6 "DFC_IdleChrgActrAMax" 7 "DFC_IdleChrgActrAMin" 8 "DFC_IdleChrgActrASig" 9 "DFC_IdleChrgActrBMax" 10 "DFC_IdleChrgActrBMin" 11 "DFC_IdleChrgActrBSig" 12 "DFC_IdleChrgActrGovDeCold" 13 "DFC_IdleChrgActrGovDeMax" 14 "DFC_IdleChrgActrGovDeMin" 131 "DFC_IdleChrgActrJamVlvClsd" 132 "DFC_IdleChrgActrJamVlvOpn" 15 "DFC_IdleChrgActrNAMax" 16 "DFC_IdleChrgActrNAMin" 17 "DFC_IdleChrgActrNASig" 18 "DFC_IdleChrgActrNBMax" 19 "DFC_IdleChrgActrNBMin" 20 "DFC_IdleChrgActrNBSig" 21 "DFC_IdleChrgActrOverTmp" 26 "DFC_IgnClPsDevComErr1" 133 "DFC_IgnClPsDevOscErr1" 27 "DFC_IgnClPsOpenLoad0" 28 "DFC_IgnClPsOpenLoad1" 29 "DFC_IgnClPsOpenLoad2" 30 "DFC_IgnClPsShCirBatt0" 31 "DFC_IgnClPsShCirBatt1" 32 "DFC_IgnClPsShCirBatt2" 33 "DFC_IgnClPsShCirGnd0" 34 "DFC_IgnClPsShCirGnd1" 35 "DFC_IgnClPsShCirGnd2" 36 "DFC_KnDetSens1PortAMax" 37 "DFC_KnDetSens1PortAMin" 38 "DFC_KnDetSens1PortBMax" 39 "DFC_KnDetSens1PortBMin" 134 "DFC_KPEmax" 135 "DFC_KPEmin" 136 "DFC_KPEsig" 137 "DFC_KS1max" 138 "DFC_KS1min" 139 "DFC_LLRKHmax" 140 "DFC_LLRKHmin" 141 "DFC_LLRKHnpl" 142 "DFC_LLRmax" 143 "DFC_LLRmin" 144 "DFC_LLRnpl" 145 "DFC_LMmax" 146 "DFC_LZSRnpl" 147 "DFC_MD" 148 "DFC_MD00min" 149 "DFC_MD00npl" 150 "DFC_MD01min" 151 "DFC_MD01npl" 152 "DFC_MD02min" 153 "DFC_MD02npl" 154 "DFC_MD03min" 155 "DFC_MD03npl" 156 "DFC_MD04min" 157 "DFC_MD04npl" 158 "DFC_MDCyl_0" 159 "DFC_MDCyl_1" 160 "DFC_MDCyl_2" 161 "DFC_MDFC" 162 "DFC_MDmin" 163 "DFC_MDnpl" 70 "DFC_MILLmpOL" 71 "DFC_MILLmpSCB" 72 "DFC_MILLmpSCG" 164 "DFC_MoCADCNTP" 165 "DFC_MoCADCTst" 166 "DFC_MoCComctErrMM" 22 "DFC_MonUMaxSupply1" 23 "DFC_MonUMinSupply1" 167 "DFC_OCWDAActv" 168 "DFC_OCWDACom" 169 "DFC_ORAmax" 170 "DFC_ORAmin" 171 "DFC_PSR1max" 172 "DFC_PSRBmax" 173 "DFC_PSRBmin" 174 "DFC_PSREmax" 175 "DFC_PSREmin" 179 "DFC_PSRmax" 176 "DFC_PSRPmax" 177 "DFC_PSRPmin" 178 "DFC_PSRPsig" 73 "DFC_SRCHighAPP1" 74 "DFC_SRCHighAPP2" 75 "DFC_SRCLowAPP1" 76 "DFC_SRCLowAPP2" 180 "DFC_SSpMon1" 181 "DFC_SSpMon2" 182 "DFC_SSpMon3" 183 "DFC_SWReset_0" 184 "DFC_SWReset_1" 185 "DFC_SWReset_2" 77 "DFC_SyncAPP" 190 "DFC_TAmax" 186 "DFC_TASREmax" 187 "DFC_TASREmin" 188 "DFC_TASREnpl" 189 "DFC_TASRmax" 191 "DFC_TEVEmax" 192 "DFC_TEVEmin" 193 "DFC_TEVEsig" 194 "DFC_TMCSmax" 195 "DFC_TMCSmin" 196 "DFC_TMEmax" 197 "DFC_TMEmin" 198 "DFC_TMEnpl" 199 "DFC_TMEsig" 203 "DFC_TMmax" 200 "DFC_TMPmax" 201 "DFC_TMPmin" 202 "DFC_TMPnpl" 204 "DFC_TUMmax" 205 "DFC_TWCCTrimMaxB1" 206 "DFC_TWCCTrimMinB1" 207 "DFC_TWCDPriCatB1" 209 "DFC_UBmax" 210 "DFC_UBmin" 211 "DFC_UBnpl" 208 "DFC_UBRmax" 78 "DFC_VehVMax" 79 "DFC_VehVPlaus" 80 "DFC_VehVSig" 40 "DFC_VehVWhlErr" DEFAULT_VALUE "---" /end COMPU_VTAB
/begin COMPU_METHOD DFES_OneToOne "" RAT_FUNC "%6.2" "-" COEFFS 0 1 0 0 0 1 /end COMPU_METHOD
/begin COMPU_METHOD dfp_verbal "" TAB_VERB "%2.1" "-" COMPU_TAB_REF dfp_verbal /end COMPU_METHOD
/begin COMPU_VTAB dfp_verbal "" TAB_VERB 87 0 "DFP_AAA" 1 "DFP_BM" 2 "DFP_DK" 3 "DFP_DKVS" 4 "DFP_DSS" 5 "DFP_DVEV" 6 "DFP_DYLSU" 7 "DFP_DZKU0" 8 "DFP_DZKU1" 9 "DFP_DZKU2" 10 "DFP_EGFE" 11 "DFP_ENWS" 12 "DFP_ENWSE" 13 "DFP_EV1" 14 "DFP_EV2" 15 "DFP_EV3" 16 "DFP_FMAS" 17 "DFP_FP1P" 18 "DFP_FP2P" 19 "DFP_FRA" 20 "DFP_FRAU" 21 "DFP_FTDLA" 22 "DFP_HELSU" 23 "DFP_HRE" 24 "DFP_HSH" 25 "DFP_HSHE" 26 "DFP_HSV" 27 "DFP_HSVE" 28 "DFP_HSVSA" 29 "DFP_ICLSU" 30 "DFP_KAT" 31 "DFP_KATF" 32 "DFP_KPE" 33 "DFP_KRNT" 34 "DFP_KROF" 35 "DFP_KRTP" 36 "DFP_KUPPL" 37 "DFP_LASH" 38 "DFP_LLR" 39 "DFP_LLRKH" 40 "DFP_LM" 41 "DFP_LSH" 42 "DFP_LSUKS" 43 "DFP_LSUUN" 44 "DFP_LSV" 45 "DFP_LUES1E" 46 "DFP_LZSR" 47 "DFP_MD" 48 "DFP_N" 49 "DFP_NWKW" 50 "DFP_NWKWE" 51 "DFP_ORA" 52 "DFP_PH" 53 "DFP_PHE" 54 "DFP_PLLSU" 55 "DFP_PS1E" 56 "DFP_PS2E" 57 "DFP_PS3E" 58 "DFP_PSR" 59 "DFP_PSR1" 60 "DFP_PSRB" 61 "DFP_PSRE" 62 "DFP_PSRP" 63 "DFP_PVD" 64 "DFP_RKAT" 65 "DFP_RKAZ" 66 "DFP_STKLSV" 67 "DFP_TA" 68 "DFP_TACS" 69 "DFP_TAR" 70 "DFP_TASR" 71 "DFP_TASRE" 72 "DFP_TES" 73 "DFP_TEVE" 74 "DFP_THM" 75 "DFP_TM" 76 "DFP_TMCS" 77 "DFP_TME" 78 "DFP_TMKI" 79 "DFP_TMP" 80 "DFP_TUM" 81 "DFP_UB" 82 "DFP_UBR" 83 "DFP_ULSU" 84 "DFP_VFZ" 85 "DFP_VFZG" 86 "DFP_ZZZ" DEFAULT_VALUE "---" /end COMPU_VTAB
/begin COMPU_METHOD DSMDUR_10m_Counter "" RAT_FUNC "%6.4" "km" COEFFS 0 100 0 0 0 1 /end COMPU_METHOD
/begin COMPU_METHOD DSMDur_EvntSel_Verb "" TAB_VERB "%6.3" "-" COMPU_TAB_REF DSMDur_EvntSel_Verb /end COMPU_METHOD
/begin COMPU_VTAB DSMDur_EvntSel_Verb "" TAB_VERB 5 0 "NoCountEvent" 1 "DistanceEvents" 2 "TimeEvents" 4 "WarmUpCycleEvents" 8 "DistanceEvents10m" /end COMPU_VTAB
/begin COMPU_METHOD DSMDur_StDispl_Verb "" TAB_VERB "%6.3" "-" COMPU_TAB_REF DSMDur_StDispl_Verb /end COMPU_METHOD
/begin COMPU_VTAB DSMDur_StDispl_Verb "" TAB_VERB 3 0 "NotEnabled" 1 "CountingEnabled" 2 "ResetCondition" /end COMPU_VTAB
/begin COMPU_METHOD DSMRdy_OneToOne "" RAT_FUNC "%6.2" "-" COEFFS 0 1 0 0 0 1 /end COMPU_METHOD
/begin COMPU_METHOD DTR_Verb "" TAB_VERB "%2.1" "-" COMPU_TAB_REF DTR_Verb /end COMPU_METHOD
/begin COMPU_VTAB DTR_Verb "" TAB_VERB 17 0 "DTR_IdleChrgActrGovDeMax" 1 "DTR_IdleChrgActrGovDeMin" 2 "DTR_OBDMID_01_TID_01" 3 "DTR_OBDMID_01_TID_02" 4 "DTR_OBDMID_02_TID_01" 5 "DTR_OBDMID_02_TID_02" 6 "DTR_OBDMID_02_TID_OSCLO" 7 "DTR_OBDMID_02_TID_OSCUP" 8 "DTR_OBDMID_21_TID_AV" 9 "DTR_OBDMID_41_TID_HTR" 10 "DTR_OBDMID_a2_TID_0b_0" 11 "DTR_OBDMID_a2_TID_0b_1" 12 "DTR_OBDMID_a2_TID_0b_2" 13 "DTR_OBDMID_a2_TID_0c_0" 14 "DTR_OBDMID_a2_TID_0c_1" 15 "DTR_OBDMID_a2_TID_0c_2" 255 "DTR_Unused" DEFAULT_VALUE "FALSE" /end COMPU_VTAB
/begin COMPU_METHOD Eeebd_EeeStates_Verb "" TAB_VERB "%6.3" "" COMPU_TAB_REF Eeebd_EeeStates_Verb /end COMPU_METHOD
/begin COMPU_VTAB Eeebd_EeeStates_Verb "" TAB_VERB 4 0 "EEEBD_EEE_NORMALRUN" 1 "EEEBD_EEE_FIRSTINIT" 2 "EEEBD_EEE_SECTORCHANGE" 3 "EEEBD_EEE_MIGRATION" /end COMPU_VTAB
/begin COMPU_METHOD Eep_MainStates_Verb "" TAB_VERB "%6.3" "" COMPU_TAB_REF Eep_MainStates_Verb /end COMPU_METHOD
/begin COMPU_VTAB Eep_MainStates_Verb "" TAB_VERB 13 0 "EEP_INI_RUN" 1 "EEP_SHUTDWN_RUN" 2 "EEP_NORMAL_RUN" 3 "EEP_BEGPD_REQUEST" 4 "EEP_BEGPD_RUN" 5 "EEP_ENDPD_REQUEST" 6 "EEP_ENDPD_RUN" 7 "EEP_PREDRV_REQUEST" 8 "EEP_PREDRV_RUN" 9 "EEP_FIRSTINIT_INI" 10 "EEP_RAM_INI" 11 "EEP_ENVRAM_INI" 12 "EEP_REINIT_INI" /end COMPU_VTAB
/begin COMPU_METHOD Eep_PostDrvState_Verb "" TAB_VERB "%6.3" "" COMPU_TAB_REF Eep_PostDrvState_Verb /end COMPU_METHOD
/begin COMPU_VTAB Eep_PostDrvState_Verb "" TAB_VERB 5 0 "EEP_POSTDRV_INI" 1 "EEP_POSTDRV_SEARCHBLKIDX" 2 "EEP_POEEP_POSTDRV_SAVEBLK" 3 "EEP_POSTDRV_SAVEBLK_PENDING" 4 "EEP_POSTDRV_WAIT" /end COMPU_VTAB
/begin COMPU_METHOD EngN "" RAT_FUNC "%6.3" "rpm" COEFFS 0 2 0 0 0 1 /end COMPU_METHOD
/begin COMPU_METHOD EngN2tiIncPer "" RAT_FUNC "%8.0" "rpm" COEFFS 0 0 1 0 2.40000012e-007 0 /end COMPU_METHOD
/begin COMPU_METHOD EngNCaS "" RAT_FUNC "%6.3" "CaSrpm" COEFFS 0 4 0 0 0 1 /end COMPU_METHOD
/begin COMPU_METHOD EngNGrd "" RAT_FUNC "%6.3" "rpm/s" COEFFS 0 2 0 0 0 1 /end COMPU_METHOD
/begin COMPU_METHOD EngN_LRes "" RAT_FUNC "%6.1" "rpm" COEFFS 0 0.025 0 0 0 1 /end COMPU_METHOD
/begin COMPU_METHOD EpmBCr_stIntrCo_State_t "" TAB_VERB "%6.3" "" COMPU_TAB_REF EpmBCr_stIntrCo_State_t /end COMPU_METHOD
/begin COMPU_VTAB EpmBCr_stIntrCo_State_t "" TAB_VERB 4 0 "EPMBCR_STINTRCO_NOPOS" 1 "EPMBCR_STINTRCO_CASEDGE" 2 "EPMBCR_STINTRCO_SYNCRO" 3 "EPMBCR_STINTRCO_WAIT" /end COMPU_VTAB
/begin COMPU_METHOD EpmBCr_stPlaus_State "" TAB_VERB "%6.3" "" COMPU_TAB_REF EpmBCr_stPlaus_State /end COMPU_METHOD
/begin COMPU_VTAB EpmBCr_stPlaus_State "" TAB_VERB 4 0 "EPMBCR_NOSYNC" 1 "EPMBCR_SYNID1" 2 "EPMBCR_SYNID2" 3 "EPMBCR_SYNID0" /end COMPU_VTAB
/begin COMPU_METHOD EpmBCr_stPos_State "" TAB_VERB "%6.3" "" COMPU_TAB_REF EpmBCr_stPos_State /end COMPU_METHOD
/begin COMPU_VTAB EpmBCr_stPos_State "" TAB_VERB 2 0 "EPMBCR_STPOS_NOPOS" 1 "EPMBCR_STPOS_POSFOUND" /end COMPU_VTAB
/begin COMPU_METHOD EpmCaS_Fac_Adap "" RAT_FUNC "%6.5" "-" COEFFS 0 1000 0 0 0 1 /end COMPU_METHOD
/begin COMPU_METHOD EpmCaS_Fac_Plaus "" RAT_FUNC "%6.5" "-" COEFFS 0 1000 0 0 0 1 /end COMPU_METHOD
/begin COMPU_METHOD EpmCaS_stAdap_State "" TAB_VERB "%6.3" "" COMPU_TAB_REF EpmCaS_stAdap_State /end COMPU_METHOD
/begin COMPU_VTAB EpmCaS_stAdap_State "" TAB_VERB 5 0 "EPMCAS_STNOADAP" 1 "EPMCAS_STERRADAP" 2 "EPMCAS_STADAP" 3 "EPMCAS_STADAPSTOP" 4 "EPMCAS_STFULLADAP" /end COMPU_VTAB
/begin COMPU_METHOD EpmCaS_stDiagErr_t "" TAB_VERB "%6.3" "" COMPU_TAB_REF EpmCaS_stDiagErr_t /end COMPU_METHOD
/begin COMPU_VTAB EpmCaS_stDiagErr_t "" TAB_VERB 4 0 "EPMCAS_DIAG_AMBI" 1 "EPMCAS_DIAG_OK" 2 "EPMCAS_DIAG_NOSIG" 3 "EPMCAS_DIAG_ERRSIG" /end COMPU_VTAB
/begin COMPU_METHOD EpmCaS_stDiag_t "" TAB_VERB "%6.3" "" COMPU_TAB_REF EpmCaS_stDiag_t /end COMPU_METHOD
/begin COMPU_VTAB EpmCaS_stDiag_t "" TAB_VERB 4 0 "EPMCAS_DIAG_OFF" 1 "EPMCAS_DIAG_PATMAT" 2 "EPMCAS_DIAG_CTEDGE" 3 "EPMCAS_DIAG_NO_SIG" /end COMPU_VTAB
/begin COMPU_METHOD EpmCaS_stOfsErr_Val "" TAB_VERB "%6.3" "" COMPU_TAB_REF EpmCaS_stOfsErr_Val /end COMPU_METHOD
/begin COMPU_VTAB EpmCaS_stOfsErr_Val "" TAB_VERB 6 0 "EPMCAS_OFS_AMBI" 1 "EPMCAS_OFS_NOEQUI_EDGE" 2 "EPMCAS_OFS_LOWEQUI_EDGE" 3 "EPMCAS_OFS_NOREFPOS" 4 "EPMCAS_OFS_EXCEED" 5 "EPMCAS_OFS_OK" /end COMPU_VTAB
/begin COMPU_METHOD EpmCas_stOfs_State "" TAB_VERB "%6.3" "" COMPU_TAB_REF EpmCas_stOfs_State /end COMPU_METHOD
/begin COMPU_VTAB EpmCas_stOfs_State "" TAB_VERB 2 0 "EPMCAS_OFS_WAITSEG" 1 "EPMCAS_OFS_SEGCALC" /end COMPU_VTAB
/begin COMPU_METHOD EpmCaS_stphiDiffLim_t "" TAB_VERB "%6.3" "" COMPU_TAB_REF EpmCaS_stphiDiffLim_t /end COMPU_METHOD
/begin COMPU_VTAB EpmCaS_stphiDiffLim_t "" TAB_VERB 8 0 "RET_OK" 1 "RET_SYNADP" 2 "RET_PERM" 3 "RET_PREP" 4 "RET_GETLST" 5 "RET_GETCUR" 6 "RET_NOVALIDEDGE" 8 "RET_MECHLIM" /end COMPU_VTAB
/begin COMPU_METHOD EpmCrS_DiagResult_State "" TAB_VERB "%6.3" "" COMPU_TAB_REF EpmCrS_DiagResult_State /end COMPU_METHOD
/begin COMPU_VTAB EpmCrS_DiagResult_State "" TAB_VERB 5 0 "EPMCRS_DIAG_PENDING" 1 "EPMCRS_DIAG_DEBHEAL" 2 "EPMCRS_DIAG_HEAL" 3 "EPMCRS_DIAG_DEBSET" 4 "EPMCRS_DIAG_SET" /end COMPU_VTAB
/begin COMPU_METHOD EpmCrS_Diag_State "" TAB_VERB "%6.3" "" COMPU_TAB_REF EpmCrS_Diag_State /end COMPU_METHOD
/begin COMPU_VTAB EpmCrS_Diag_State "" TAB_VERB 2 0 "EPMCRS_DIAG_OFF" 1 "EPMCRS_DIAG_ON" /end COMPU_VTAB
/begin COMPU_METHOD EpmHCrS_stSigMode_State_t "" TAB_VERB "%6.3" "" COMPU_TAB_REF EpmHCrS_stSigMode_State_t /end COMPU_METHOD
/begin COMPU_VTAB EpmHCrS_stSigMode_State_t "" TAB_VERB 12 0 "RESET" 1 "HALT" 2 "WAITSIG" 3 "IGNTIME" 4 "IGNFRSTEDGE" 5 "IGNEDGE" 6 "WAITGAP" 7 "GAPFOUND" 8 "TIMERMODE" 9 "DISBLNEWSYNC" 10 "DLY" 11 "KEEPDGISYNC" /end COMPU_VTAB
/begin COMPU_METHOD EpmRRS_stAgDetect_t "" TAB_VERB "%6.3" "" COMPU_TAB_REF EpmRRS_stAgDetect_t /end COMPU_METHOD
/begin COMPU_VTAB EpmRRS_stAgDetect_t "" TAB_VERB 3 0 "EPMRRS_DISABLE" 1 "EPMRRS_ENABLE" 2 "EPMRRS_CONFIRM" /end COMPU_VTAB
/begin COMPU_METHOD EpmRRS_stEngStopAg_t "" TAB_VERB "%6.3" "" COMPU_TAB_REF EpmRRS_stEngStopAg_t /end COMPU_METHOD
/begin COMPU_VTAB EpmRRS_stEngStopAg_t "" TAB_VERB 3 0 "EPMRRS_INVLD_STOP_POS" 1 "EPMRRS_VLD_PHASE_DETECT" 2 "EPMRRS_VLD_STOP_POS" /end COMPU_VTAB
/begin COMPU_METHOD EpmSeq_numInt_Compu "" TAB_VERB "%6.3" "" COMPU_TAB_REF EpmSeq_numInt_Compu /end COMPU_METHOD
/begin COMPU_VTAB EpmSeq_numInt_Compu "" TAB_VERB 9 0 "S_0" 1 "S_1" 2 "S_0_FIRST" 3 "S_1_FIRST" 6 "S_0_FIRST_START" 7 "S_1_FIRST_START" 8 "S_EPM" 16 "S_INI" 32 "S_0_H" /end COMPU_VTAB
/begin COMPU_METHOD EpmSeq_stInt_Compu "" TAB_VERB "%6.3" "" COMPU_TAB_REF EpmSeq_stInt_Compu /end COMPU_METHOD
/begin COMPU_VTAB EpmSeq_stInt_Compu "" TAB_VERB 6 0 "ST_S_0" 1 "ST_S_1" 4 "ST_S_0_START" 5 "ST_S_1_START" 8 "ST_EPM" 32 "ST_S_0_H" /end COMPU_VTAB
/begin COMPU_METHOD EpmSrv_stCnvAgT2Ag_t "" TAB_VERB "%6.3" "" COMPU_TAB_REF EpmSrv_stCnvAgT2Ag_t /end COMPU_METHOD
/begin COMPU_VTAB EpmSrv_stCnvAgT2Ag_t "" TAB_VERB 30 0 "0" 1 "1" 2 "2" 3 "3" 4 "4" 5 "5" 6 "6" 7 "7" 8 "8" 9 "9" 10 "10" 11 "11" 12 "12" 13 "13" 14 "14" 15 "15" 16 "16" 17 "17" 18 "18" 19 "19" 20 "20" 21 "21" 22 "22" 23 "23" 24 "24" 25 "AVRGSPD" 26 "EXTRAPOLATION" 253 "ERRORSTGY" 254 "ERRORCRS" 255 "ERRORMIAP" /end COMPU_VTAB
/begin COMPU_METHOD EpmSyn_stCaSEvalComp "" TAB_VERB "%6.3" "" COMPU_TAB_REF EpmSyn_stCaSEvalComp /end COMPU_METHOD
/begin COMPU_VTAB EpmSyn_stCaSEvalComp "" TAB_VERB 5 0 "NO_CASPOS" 1 "SEARCH_CASPOS" 2 "VERIFY_CASPOS" 3 "SWTOFF_CASPOS" 4 "EVAL_CASPOS" /end COMPU_VTAB
/begin COMPU_METHOD EpmSyn_stCaSPosComp "" TAB_VERB "%6.3" "" COMPU_TAB_REF EpmSyn_stCaSPosComp /end COMPU_METHOD
/begin COMPU_VTAB EpmSyn_stCaSPosComp "" TAB_VERB 9 0 "EPMSYN_CASPOS_NOTVALID" 1 "EPMSYN_SIGTAB_NOUPDATE" 2 "EPMSYN_SIGTAB_AMBI" 5 "EPMSYN_CASPOS_VALID" 10 "EPMSYN_WRONG_SEG_LEN" 11 "EPMSYN_SIGTAB_END" 12 "EPMSYN_SIGTAB_SEQ" 13 "EPMSYN_EXCEED_TOLC" 20 "EPMSYN_CASPOS_SWTOFF" /end COMPU_VTAB
/begin COMPU_METHOD EpmSyn_stCrSPos_State_t "" TAB_VERB "%6.3" "" COMPU_TAB_REF EpmSyn_stCrSPos_State_t /end COMPU_METHOD
/begin COMPU_VTAB EpmSyn_stCrSPos_State_t "" TAB_VERB 4 0 "EPMSYN_NO_SYNC" 1 "EPMSYN_CRS_SYNC" 2 "EPMSYN_CAS_SYNC" 3 "EPMSYN_FULL_SYNC" /end COMPU_VTAB
/begin COMPU_METHOD EpmSyn_stRRComp "" TAB_VERB "%6.3" "" COMPU_TAB_REF EpmSyn_stRRComp /end COMPU_METHOD
/begin COMPU_VTAB EpmSyn_stRRComp "" TAB_VERB 2 0 "EPMSYN_FORWARDS" 1 "EPMSYN_BACKWARDS" /end COMPU_VTAB
/begin COMPU_METHOD EPM_FAC_PLAUS "" RAT_FUNC "%6.4" "-" COEFFS 0 16 0 0 0 1 /end COMPU_METHOD
/begin COMPU_METHOD Epm_stCmbTestReq_State_t "" TAB_VERB "%6.3" "" COMPU_TAB_REF Epm_stCmbTestReq_State_t /end COMPU_METHOD
/begin COMPU_VTAB Epm_stCmbTestReq_State_t "" TAB_VERB 2 0 "EPM_NO_CMBTEST" 10 "EPM_CMBTEST" /end COMPU_VTAB
/begin COMPU_METHOD Epm_stOpMode_State_t "" TAB_VERB "%6.3" "" COMPU_TAB_REF Epm_stOpMode_State_t /end COMPU_METHOD
/begin COMPU_VTAB Epm_stOpMode_State_t "" TAB_VERB 8 1 "EPM_MODE_WAIT" 5 "EPM_MODE_LOCKRESYNC" 20 "EPM_MODE_ALE" 33 "EPM_MODE_VERIFY" 36 "EPM_MODE_VERIFY_EXT" 38 "EPM_MODE_BACKUP_CAS" 48 "EPM_MODE_OK" 60 "EPM_MODE_BACKUP_CRS" /end COMPU_VTAB
/begin COMPU_METHOD Epm_stReSyncReason_State_t "" TAB_VERB "%6.3" "" COMPU_TAB_REF Epm_stReSyncReason_State_t /end COMPU_METHOD
/begin COMPU_VTAB Epm_stReSyncReason_State_t "" TAB_VERB 8 0 "EPM_RESYNC_NORESYNC" 1 "EPM_RESYNC_NOCRS" 2 "EPM_RESYNC_SHIFT" 3 "EPM_RESYNC_NOPHASE" 4 "EPM_RESYNC_REVERSE" 5 "EPM_RESYNC_OFSERR" 6 "EPM_RESYNC_CANERR" 7 "EPM_RESYNC_UPPERLVL" /end COMPU_VTAB
/begin COMPU_METHOD Epm_stSpd_t "" TAB_VERB "%6.3" "" COMPU_TAB_REF Epm_stSpd_t /end COMPU_METHOD
/begin COMPU_VTAB Epm_stSpd_t "" TAB_VERB 5 0 "EPM_SPD_CRS" 1 "EPM_SPD_HOLD" 2 "EPM_SPD_ZERO" 3 "EPM_SPD_CAS" 4 "EPM_SPD_BACKUP" /end COMPU_VTAB
/begin COMPU_METHOD Epm_stSync_State_t "" TAB_VERB "%6.3" "" COMPU_TAB_REF Epm_stSync_State_t /end COMPU_METHOD
/begin COMPU_VTAB Epm_stSync_State_t "" TAB_VERB 5 0 "EPM_NO_SYNC" 10 "EPM_ALE_SYNC" 20 "EPM_CAS_SYNC" 21 "EPM_DIRSTALE_SYNC" 30 "EPM_FULL_SYNC" /end COMPU_VTAB
/begin COMPU_METHOD ESC_stS1FrstSched_t "" TAB_VERB "%6.3" "" COMPU_TAB_REF ESC_stS1FrstSched_t /end COMPU_METHOD
/begin COMPU_VTAB ESC_stS1FrstSched_t "" TAB_VERB 4 0 "ESC_SX_SCHEDSTRT" 1 "ESC_S1_SCHEDSTRT" 2 "ESC_S0_SCHEDSTRT" 3 "ESC_S1FORCED_SCHEDSTRT" /end COMPU_VTAB
/begin COMPU_METHOD fak_sw_b1 "" RAT_FUNC "%7.6" "-" COEFFS 0 65536 0 0 0 2 /end COMPU_METHOD
/begin COMPU_METHOD fak_ub_b0p25 "" RAT_FUNC "%10.7" "-" COEFFS 0 256 0 0 0 0.25 /end COMPU_METHOD
/begin COMPU_METHOD fak_ub_b2 "" RAT_FUNC "%8.5" "-" COEFFS 0 256 0 0 0 2 /end COMPU_METHOD
/begin COMPU_METHOD fak_ub_b4 "" RAT_FUNC "%6.4" "-" COEFFS 0 256 0 0 0 4 /end COMPU_METHOD
/begin COMPU_METHOD fak_uw_b1 "" RAT_FUNC "%7.6" "-" COEFFS 0 65536 0 0 0 1 /end COMPU_METHOD
/begin COMPU_METHOD fak_uw_b16 "" RAT_FUNC "%6.5" "-" COEFFS 0 65536 0 0 0 16 /end COMPU_METHOD
/begin COMPU_METHOD fak_uw_b2 "" RAT_FUNC "%7.6" "-" COEFFS 0 65536 0 0 0 2 /end COMPU_METHOD
/begin COMPU_METHOD fak_uw_b4 "" RAT_FUNC "%7.6" "-" COEFFS 0 65536 0 0 0 4 /end COMPU_METHOD
/begin COMPU_METHOD GptaClc6_ti_COMPU "" RAT_FUNC "%6.3" "us" COEFFS 0 2.5 0 0 0 1 /end COMPU_METHOD
/begin COMPU_METHOD kw_q0p0078 "" RAT_FUNC "%6.4" "Grad KW" COEFFS 0 128 0 0 0 1 /end COMPU_METHOD
/begin COMPU_METHOD kw_q0p1 "" RAT_FUNC "%6.3" "Grad KW" COEFFS 0 10 0 0 0 1 /end COMPU_METHOD
/begin COMPU_METHOD Length "" RAT_FUNC "%6.2" "m" COEFFS 0 1 0 0 0 1 /end COMPU_METHOD
/begin COMPU_METHOD lu_MEx "" RAT_FUNC "%6.4" "(Umdr./sec)^2" COEFFS 0 219.9023255552 0 0 0 1 /end COMPU_METHOD
/begin COMPU_METHOD lu_MEx_div_8 "" RAT_FUNC "%6.3" "(Umdr./sec)^2" COEFFS 0 9.895604649984 0 0 0 1 /end COMPU_METHOD
/begin COMPU_METHOD md_q0p1 "" RAT_FUNC "%6.3" "Nm" COEFFS 0 10 0 0 0 1 /end COMPU_METHOD
/begin COMPU_METHOD m_uw_b23p3 "" RAT_FUNC "%6.5" "kg" COEFFS 0 2812.5 0 0 0 1 /end COMPU_METHOD
/begin COMPU_METHOD nmotg_sb_q100 "" RAT_FUNC "%6.0" "1/(min*s)" COEFFS 0 1 0 0 0 100 /end COMPU_METHOD
/begin COMPU_METHOD nmotg_sw_q0p39 "" RAT_FUNC "%6.3" "1/(min*s)" COEFFS 0 1 0 0 0 0.39063 /end COMPU_METHOD
/begin COMPU_METHOD nmot_q10 "" RAT_FUNC "%6.1" "1/min" COEFFS 0 1 0 0 0 10 /end COMPU_METHOD
/begin COMPU_METHOD nmot_sw_q0p25 "" RAT_FUNC "%6.3" "1/min" COEFFS 0 1 0 0 0 0.25 /end COMPU_METHOD
/begin COMPU_METHOD nmot_sw_q0p5 "" RAT_FUNC "%6.3" "1/min" COEFFS 0 2 0 0 0 1 /end COMPU_METHOD
/begin COMPU_METHOD nmot_ub_q10 "" RAT_FUNC "%6.1" "1/min" COEFFS 0 1 0 0 0 10 /end COMPU_METHOD
/begin COMPU_METHOD nmot_ub_q40 "" RAT_FUNC "%6.1" "1/min" COEFFS 0 1 0 0 0 40 /end COMPU_METHOD
/begin COMPU_METHOD nmot_uw_q0p25 "" RAT_FUNC "%6.3" "1/min" COEFFS 0 1 0 0 0 0.25 /end COMPU_METHOD
/begin COMPU_METHOD OneToOne "" RAT_FUNC "%6.2" "-" COEFFS 0 1 0 0 0 1 /end COMPU_METHOD
/begin COMPU_METHOD OneToOne_ms "" RAT_FUNC "%6.2" "ms" COEFFS 0 1 0 0 0 1 /end COMPU_METHOD
/begin COMPU_METHOD OneToOne_us "" RAT_FUNC "%6.2" "us" COEFFS 0 1 0 0 0 1 /end COMPU_METHOD
/begin COMPU_METHOD Per_Dur "" RAT_FUNC "%6.2" "usec" COEFFS 0 1 0 0 0 1 /end COMPU_METHOD
/begin COMPU_METHOD Prc "" RAT_FUNC "%6.4" "%" COEFFS 0 81.92 0 0 0 1 /end COMPU_METHOD
/begin COMPU_METHOD Pres_hPa "" RAT_FUNC "%6.2" "hPa" COEFFS 0 1 0 0 0 1 /end COMPU_METHOD
/begin COMPU_METHOD rel_q0p09375 "" RAT_FUNC "%6.3" "%" COEFFS 0 1 0 0 0 0.09375 /end COMPU_METHOD
/begin COMPU_METHOD rel_ub_q0p75 "" RAT_FUNC "%6.3" "%" COEFFS 0 1 0 0 0 0.75 /end COMPU_METHOD
/begin COMPU_METHOD rel_uw_b100 "" RAT_FUNC "%6.4" "%" COEFFS 0 65536 0 0 0 100 /end COMPU_METHOD
/begin COMPU_METHOD rel_uw_q0p0234 "" RAT_FUNC "%6.4" "%" COEFFS 0 32 0 0 0 0.75 /end COMPU_METHOD
/begin COMPU_METHOD RevCnt "" RAT_FUNC "%6.4" "-" COEFFS 0 16 0 0 0 1 /end COMPU_METHOD
/begin COMPU_METHOD STRTCTL_SC_Compu "" TAB_VERB "%6.3" "" COMPU_TAB_REF STRTCTL_SC_Compu /end COMPU_METHOD
/begin COMPU_VTAB STRTCTL_SC_Compu "" TAB_VERB 5 0 "NOSTARTER" 1 "STRTCTLEXT" 2 "STRTCTLCOMMON" 3 "STRTCTLDS" 4 "STRTCTLGS" /end COMPU_VTAB
/begin COMPU_METHOD STRTCTL_SY_Compu "" TAB_VERB "%6.3" "" COMPU_TAB_REF STRTCTL_SY_Compu /end COMPU_METHOD
/begin COMPU_VTAB STRTCTL_SY_Compu "" TAB_VERB 3 0 "STRTCTLCOMMON" 1 "STRTCTLDS" 2 "STRTCTLGS" /end COMPU_VTAB
/begin COMPU_METHOD STRTSWTECU_SY_Compu "" TAB_VERB "%6.3" "" COMPU_TAB_REF STRTSWTECU_SY_Compu /end COMPU_METHOD
/begin COMPU_VTAB STRTSWTECU_SY_Compu "" TAB_VERB 2 0 "False" 1 "True" /end COMPU_VTAB
/begin COMPU_METHOD STSPSWT_SY_Compu "" TAB_VERB "%6.3" "" COMPU_TAB_REF STSPSWT_SY_Compu /end COMPU_METHOD
/begin COMPU_VTAB STSPSWT_SY_Compu "" TAB_VERB 2 0 "False" 1 "True" /end COMPU_VTAB
/begin COMPU_METHOD STSP_SY_Compu "" TAB_VERB "%6.3" "" COMPU_TAB_REF STSP_SY_Compu /end COMPU_METHOD
/begin COMPU_VTAB STSP_SY_Compu "" TAB_VERB 2 1 "TRUE" 0 "FALSE" /end COMPU_VTAB
/begin COMPU_METHOD SUPCH_SY_Compu "" TAB_VERB "%6.3" "" COMPU_TAB_REF SUPCH_SY_Compu /end COMPU_METHOD
/begin COMPU_VTAB SUPCH_SY_Compu "" TAB_VERB 2 1 "TRUE" 0 "FALSE" /end COMPU_VTAB
/begin COMPU_METHOD SVSLMP_PWRSTG_SY_Compu "" TAB_VERB "%6.3" "" COMPU_TAB_REF SVSLMP_PWRSTG_SY_Compu /end COMPU_METHOD
/begin COMPU_VTAB SVSLMP_PWRSTG_SY_Compu "" TAB_VERB 2 0 "False" 1 "True" /end COMPU_VTAB
/begin COMPU_METHOD SVSLMP_SUPRT_ATS_SY_Compu "" TAB_VERB "%6.3" "" COMPU_TAB_REF SVSLMP_SUPRT_ATS_SY_Compu /end COMPU_METHOD
/begin COMPU_VTAB SVSLMP_SUPRT_ATS_SY_Compu "" TAB_VERB 2 0 "False" 1 "True" /end COMPU_VTAB
/begin COMPU_METHOD SVS_SY_Compu "" TAB_VERB "%6.3" "" COMPU_TAB_REF SVS_SY_Compu /end COMPU_METHOD
/begin COMPU_VTAB SVS_SY_Compu "" TAB_VERB 2 0 "False" 1 "True" /end COMPU_VTAB
/begin COMPU_METHOD SWAPMP_PMP1_SY_Compu "" TAB_VERB "%6.3" "" COMPU_TAB_REF SWAPMP_PMP1_SY_Compu /end COMPU_METHOD
/begin COMPU_VTAB SWAPMP_PMP1_SY_Compu "" TAB_VERB 2 1 "SWT_ENABLED" 0 "SWT_DISABLED" /end COMPU_VTAB
/begin COMPU_METHOD SWAPMP_PMP2_SY_Compu "" TAB_VERB "%6.3" "" COMPU_TAB_REF SWAPMP_PMP2_SY_Compu /end COMPU_METHOD
/begin COMPU_VTAB SWAPMP_PMP2_SY_Compu "" TAB_VERB 2 0 "SWT_DISABLED" 1 "SWT_ENABLED" /end COMPU_VTAB
/begin COMPU_METHOD SWAPMP_PMP3_SY_Compu "" TAB_VERB "%6.3" "" COMPU_TAB_REF SWAPMP_PMP3_SY_Compu /end COMPU_METHOD
/begin COMPU_VTAB SWAPMP_PMP3_SY_Compu "" TAB_VERB 2 0 "SWT_DISABLED" 1 "SWT_ENABLED" /end COMPU_VTAB
/begin COMPU_METHOD SWAPMP_PMP4_SY_Compu "" TAB_VERB "%6.3" "" COMPU_TAB_REF SWAPMP_PMP4_SY_Compu /end COMPU_METHOD
/begin COMPU_VTAB SWAPMP_PMP4_SY_Compu "" TAB_VERB 3 0 "SWT_DISABLED" 1 "SWT_SCTPMP3_ENABLED" 2 "SWT_SCTPMP4_ENABLED" /end COMPU_VTAB
/begin COMPU_METHOD SWAPMP_PMP5_SY_Compu "" TAB_VERB "%6.3" "" COMPU_TAB_REF SWAPMP_PMP5_SY_Compu /end COMPU_METHOD
/begin COMPU_VTAB SWAPMP_PMP5_SY_Compu "" TAB_VERB 3 0 "SWT_DISABLED" 1 "SWT_SCTPMP1_ENABLED" 2 "SWT_SCTPMP5_ENABLED" /end COMPU_VTAB
/begin COMPU_METHOD SWSVW_ADAP_SY_Compu "" TAB_VERB "%6.3" "" COMPU_TAB_REF SWSVW_ADAP_SY_Compu /end COMPU_METHOD
/begin COMPU_VTAB SWSVW_ADAP_SY_Compu "" TAB_VERB 2 1 "TRUE" 0 "FALSE" /end COMPU_VTAB
/begin COMPU_METHOD SWSVW_AIRMNG_SY_Compu "" TAB_VERB "%6.3" "" COMPU_TAB_REF SWSVW_AIRMNG_SY_Compu /end COMPU_METHOD
/begin COMPU_VTAB SWSVW_AIRMNG_SY_Compu "" TAB_VERB 2 0 "no_SWS_Airmanagement" 1 "SWS_Airmanagement_Base" /end COMPU_VTAB
/begin COMPU_METHOD SWSVW_ANTITRMP_SY_Compu "" TAB_VERB "%6.3" "" COMPU_TAB_REF SWSVW_ANTITRMP_SY_Compu /end COMPU_METHOD
/begin COMPU_VTAB SWSVW_ANTITRMP_SY_Compu "" TAB_VERB 2 0 "False" 1 "True" /end COMPU_VTAB
/begin COMPU_METHOD SWSVW_CHAELGDIAG_SY_Compu "" TAB_VERB "%6.3" "" COMPU_TAB_REF SWSVW_CHAELGDIAG_SY_Compu /end COMPU_METHOD
/begin COMPU_VTAB SWSVW_CHAELGDIAG_SY_Compu "" TAB_VERB 2 1 "TRUE" 0 "FALSE" /end COMPU_VTAB
/begin COMPU_METHOD SWSVW_COMEMMNGAUXENGCMPN_SY_Compu "" TAB_VERB "%6.3" "" COMPU_TAB_REF SWSVW_COMEMMNGAUXENGCMPN_SY_Compu /end COMPU_METHOD
/begin COMPU_VTAB SWSVW_COMEMMNGAUXENGCMPN_SY_Compu "" TAB_VERB 2 0 "0" 1 "1" /end COMPU_VTAB
/begin COMPU_METHOD SWSVW_COPSPDDRVOFF_SY_Compu "" TAB_VERB "%6.3" "" COMPU_TAB_REF SWSVW_COPSPDDRVOFF_SY_Compu /end COMPU_METHOD
/begin COMPU_VTAB SWSVW_COPSPDDRVOFF_SY_Compu "" TAB_VERB 2 0 "FALSE" 1 "TRUE" /end COMPU_VTAB
/begin COMPU_METHOD SWSVW_CS_SY_Compu "" TAB_VERB "%6.3" "" COMPU_TAB_REF SWSVW_CS_SY_Compu /end COMPU_METHOD
/begin COMPU_VTAB SWSVW_CS_SY_Compu "" TAB_VERB 2 0 "False" 1 "True" /end COMPU_VTAB
/begin COMPU_METHOD SWSVW_DTEV_SY_Compu "" TAB_VERB "%6.3" "" COMPU_TAB_REF SWSVW_DTEV_SY_Compu /end COMPU_METHOD
/begin COMPU_VTAB SWSVW_DTEV_SY_Compu "" TAB_VERB 2 0 "False" 1 "True" /end COMPU_VTAB
/begin COMPU_METHOD SWSVW_ENGNDISPOPTM_SY_Compu "" TAB_VERB "%6.3" "" COMPU_TAB_REF SWSVW_ENGNDISPOPTM_SY_Compu /end COMPU_METHOD
/begin COMPU_VTAB SWSVW_ENGNDISPOPTM_SY_Compu "" TAB_VERB 2 0 "no SWSVW EngNDispOptm" 1 "EngNDispOptm Initial Version" /end COMPU_VTAB
/begin COMPU_METHOD SWSVW_ENGSTRESS_SY_Compu "" TAB_VERB "%6.3" "" COMPU_TAB_REF SWSVW_ENGSTRESS_SY_Compu /end COMPU_METHOD
/begin COMPU_VTAB SWSVW_ENGSTRESS_SY_Compu "" TAB_VERB 2 1 "TRUE" 0 "FALSE" /end COMPU_VTAB
/begin COMPU_METHOD SWSVW_FADD_SY_Compu "" TAB_VERB "%6.3" "" COMPU_TAB_REF SWSVW_FADD_SY_Compu /end COMPU_METHOD
/begin COMPU_VTAB SWSVW_FADD_SY_Compu "" TAB_VERB 3 0 "no SWSVW FAdd" 2 "SWSVW FAdd 2.x" 4 "SWSVW FAdd 4.x" /end COMPU_VTAB
/begin COMPU_METHOD SWSVW_GEARADV_SY_Compu "" TAB_VERB "%6.3" "" COMPU_TAB_REF SWSVW_GEARADV_SY_Compu /end COMPU_METHOD
/begin COMPU_VTAB SWSVW_GEARADV_SY_Compu "" TAB_VERB 2 0 "FALSE" 1 "TRUE" /end COMPU_VTAB
/begin COMPU_METHOD SWSVW_MLB_PT_HYB_SY_Compu "" TAB_VERB "%6.3" "" COMPU_TAB_REF SWSVW_MLB_PT_HYB_SY_Compu /end COMPU_METHOD
/begin COMPU_VTAB SWSVW_MLB_PT_HYB_SY_Compu "" TAB_VERB 2 0 "SWSVW_MLB_PT_HYB_INACTIVE" 1 "SWSVW_MLB_PT_HYB_ACTIVE" /end COMPU_VTAB
/begin COMPU_METHOD SWSVW_PTTQCLURED_SY_Compu "" TAB_VERB "%6.3" "" COMPU_TAB_REF SWSVW_PTTQCLURED_SY_Compu /end COMPU_METHOD
/begin COMPU_VTAB SWSVW_PTTQCLURED_SY_Compu "" TAB_VERB 2 0 "FALSE" 1 "TRUE" /end COMPU_VTAB
/begin COMPU_METHOD SWSVW_STRTSTOP_SY_Compu "" TAB_VERB "%6.3" "" COMPU_TAB_REF SWSVW_STRTSTOP_SY_Compu /end COMPU_METHOD
/begin COMPU_VTAB SWSVW_STRTSTOP_SY_Compu "" TAB_VERB 2 1 "1" 0 "0" /end COMPU_VTAB
/begin COMPU_METHOD SWSVW_THMMNG_SY_Compu "" RAT_FUNC "%6.2" "" COEFFS 0 1 0 0 0 1 /end COMPU_METHOD
/begin COMPU_METHOD SWSVW_TRAGRIPDET_SY_Compu "" TAB_VERB "%6.3" "" COMPU_TAB_REF SWSVW_TRAGRIPDET_SY_Compu /end COMPU_METHOD
/begin COMPU_VTAB SWSVW_TRAGRIPDET_SY_Compu "" TAB_VERB 3 0 "SWSVW_MTNOGEARDET_STANDARD" 1 "SWSVW_MTNOGEARDET_CUST" 2 "SWSVW_MTNOGEARDET_CLB" /end COMPU_VTAB
/begin COMPU_METHOD SWSVW_VEHMESTIM_SY_Compu "" TAB_VERB "%6.3" "" COMPU_TAB_REF SWSVW_VEHMESTIM_SY_Compu /end COMPU_METHOD
/begin COMPU_VTAB SWSVW_VEHMESTIM_SY_Compu "" TAB_VERB 2 1 "TRUE" 0 "FALSE" /end COMPU_VTAB
/begin COMPU_METHOD SYC_FSTSWOFF_SY_Compu "" TAB_VERB "%6.3" "" COMPU_TAB_REF SYC_FSTSWOFF_SY_Compu /end COMPU_METHOD
/begin COMPU_VTAB SYC_FSTSWOFF_SY_Compu "" TAB_VERB 2 0 "False" 1 "True" /end COMPU_VTAB
/begin COMPU_METHOD SYC_T15POSTPREDRV_SWRST_SY_Compu "" TAB_VERB "%6.3" "" COMPU_TAB_REF SYC_T15POSTPREDRV_SWRST_SY_Compu /end COMPU_METHOD
/begin COMPU_VTAB SYC_T15POSTPREDRV_SWRST_SY_Compu "" TAB_VERB 2 0 "False" 1 "True" /end COMPU_VTAB
/begin COMPU_METHOD SYC_T15RSTSIM_SY_Compu "" TAB_VERB "%6.3" "" COMPU_TAB_REF SYC_T15RSTSIM_SY_Compu /end COMPU_METHOD
/begin COMPU_VTAB SYC_T15RSTSIM_SY_Compu "" TAB_VERB 2 0 "False" 1 "True" /end COMPU_VTAB
/begin COMPU_METHOD SYC_UNLIMNWM_SY_Compu "" TAB_VERB "%6.3" "" COMPU_TAB_REF SYC_UNLIMNWM_SY_Compu /end COMPU_METHOD
/begin COMPU_VTAB SYC_UNLIMNWM_SY_Compu "" TAB_VERB 2 0 "False" 1 "True" /end COMPU_VTAB
/begin COMPU_METHOD SYC_WREEPBLK_SY_Compu "" TAB_VERB "%6.3" "" COMPU_TAB_REF SYC_WREEPBLK_SY_Compu /end COMPU_METHOD
/begin COMPU_VTAB SYC_WREEPBLK_SY_Compu "" TAB_VERB 2 0 "EEP-Block for SyC is not written" 1 "EEP-Block for SyC is written" /end COMPU_VTAB
/begin COMPU_METHOD SY_2HDP2_Compu "" TAB_VERB "%6.3" "" COMPU_TAB_REF SY_2HDP2_Compu /end COMPU_METHOD
/begin COMPU_VTAB SY_2HDP2_Compu "" TAB_VERB 2 0 "1 HDP" 1 "2 HDP" /end COMPU_VTAB
/begin COMPU_METHOD SY_2LBK_Compu "" TAB_VERB "%6.3" "" COMPU_TAB_REF SY_2LBK_Compu /end COMPU_METHOD
/begin COMPU_VTAB SY_2LBK_Compu "" TAB_VERB 2 0 "no LBK for Bank 2" 1 "LBK for Bank 2 is present" /end COMPU_VTAB
/begin COMPU_METHOD SY_2SGHST_Compu "" TAB_VERB "%6.3" "" COMPU_TAB_REF SY_2SGHST_Compu /end COMPU_METHOD
/begin COMPU_VTAB SY_2SGHST_Compu "" TAB_VERB 2 0 "Heißstartbed. auch im SLAVE berechnet" 1 "Heißstartbed. nur im MASTER berechnet" /end COMPU_VTAB
/begin COMPU_METHOD SY_2SG_Compu "" TAB_VERB "%6.3" "" COMPU_TAB_REF SY_2SG_Compu /end COMPU_METHOD
/begin COMPU_VTAB SY_2SG_Compu "" TAB_VERB 2 0 "1 Steuergerät" 1 "2 Steuergeräte" /end COMPU_VTAB
/begin COMPU_METHOD SY_2VD_Compu "" TAB_VERB "%6.3" "" COMPU_TAB_REF SY_2VD_Compu /end COMPU_METHOD
/begin COMPU_VTAB SY_2VD_Compu "" TAB_VERB 4 0 "kein zweit. Verdichter" 1 "ATL" 2 "Kompressor" 3 "EZV" /end COMPU_VTAB
/begin COMPU_METHOD SY_AAU_Compu "" TAB_VERB "%6.3" "" COMPU_TAB_REF SY_AAU_Compu /end COMPU_METHOD
/begin COMPU_VTAB SY_AAU_Compu "" TAB_VERB 2 0 "keine Sollambdavorgabe für AU aktiv" 1 "Sollambdavorgabe für AU aktiv" /end COMPU_VTAB
/begin COMPU_METHOD SY_AAV_Compu "" TAB_VERB "%6.3" "" COMPU_TAB_REF SY_AAV_Compu /end COMPU_METHOD
/begin COMPU_VTAB SY_AAV_Compu "" TAB_VERB 2 0 "kein Aktivkohlefilter-Absperrventil vorhanden" 1 "Aktivkohlefilter-Absperrventil vorhanden" /end COMPU_VTAB
/begin COMPU_METHOD SY_ABGKL_Compu "" TAB_VERB "%6.3" "" COMPU_TAB_REF SY_ABGKL_Compu /end COMPU_METHOD
/begin COMPU_VTAB SY_ABGKL_Compu "" TAB_VERB 2 0 "keine Abgasklappe vorhanden" 1 "Abgasklappe vorhanden" /end COMPU_VTAB
/begin COMPU_METHOD SY_ABGYVBP_Compu "" TAB_VERB "%6.3" "" COMPU_TAB_REF SY_ABGYVBP_Compu /end COMPU_METHOD
/begin COMPU_VTAB SY_ABGYVBP_Compu "" TAB_VERB 5 0 "keine Y-Zusammenführung" 5 "Y-Zusammenführung vor Bauteileposition 5" 9 "Y-Zusammenführung vor Bauteileposition 9" 13 "Y-Zusammenführung vor Bauteileposition 13" 12 "Y-Zusammenführung vor Bauteileposition 12" /end COMPU_VTAB
/begin COMPU_METHOD SY_ABGY_Compu "" TAB_VERB "%6.3" "" COMPU_TAB_REF SY_ABGY_Compu /end COMPU_METHOD
/begin COMPU_VTAB SY_ABGY_Compu "" TAB_VERB 2 0 "kein Y-Abgassystem" 1 "Y-Abgassystem" /end COMPU_VTAB
/begin COMPU_METHOD SY_ABMZND_Compu "" TAB_VERB "%6.3" "" COMPU_TAB_REF SY_ABMZND_Compu /end COMPU_METHOD
/begin COMPU_VTAB SY_ABMZND_Compu "" TAB_VERB 2 0 "keine Einspritzausblendung bei Zuendfehler" 1 "Einspritzausblendung bei Zuendfehler" /end COMPU_VTAB
/begin COMPU_METHOD SY_ACCSSRY_Compu "" TAB_VERB "%6.3" "" COMPU_TAB_REF SY_ACCSSRY_Compu /end COMPU_METHOD
/begin COMPU_VTAB SY_ACCSSRY_Compu "" TAB_VERB 2 0 "kein Zuendschloss mit ACCESSORY verbaut" 1 "Zuendschloss mit ACCESSORY verbaut" /end COMPU_VTAB
/begin COMPU_METHOD SY_ACTRQCM_Compu "" TAB_VERB "%6.3" "" COMPU_TAB_REF SY_ACTRQCM_Compu /end COMPU_METHOD
/begin COMPU_VTAB SY_ACTRQCM_Compu "" TAB_VERB 2 0 "FALSE" 1 "TRUE" /end COMPU_VTAB
/begin COMPU_METHOD SY_ADANZMI_Compu "" RAT_FUNC "%6.2" "" COEFFS 0 1 0 0 0 1 /end COMPU_METHOD
/begin COMPU_METHOD SY_ADANZNM_Compu "" RAT_FUNC "%6.2" "" COEFFS 0 1 0 0 0 1 /end COMPU_METHOD
/begin COMPU_METHOD SY_ADFPGA_Compu "" RAT_FUNC "%6.2" "" COEFFS 0 1 0 0 0 1 /end COMPU_METHOD
/begin COMPU_METHOD SY_ADTESK_Compu "" TAB_VERB "%6.3" "" COMPU_TAB_REF SY_ADTESK_Compu /end COMPU_METHOD
/begin COMPU_VTAB SY_ADTESK_Compu "" TAB_VERB 2 0 "False" 1 "True" /end COMPU_VTAB
/begin COMPU_METHOD SY_AEKPBI_Compu "" TAB_VERB "%6.3" "" COMPU_TAB_REF SY_AEKPBI_Compu /end COMPU_METHOD
/begin COMPU_VTAB SY_AEKPBI_Compu "" TAB_VERB 2 0 "keine zweite EKP vorhanden" 1 "zweite EKP vorhanden" /end COMPU_VTAB
/begin COMPU_METHOD SY_AFIMVAR_Compu "" TAB_VERB "%6.3" "" COMPU_TAB_REF SY_AFIMVAR_Compu /end COMPU_METHOD
/begin COMPU_VTAB SY_AFIMVAR_Compu "" TAB_VERB 6 0 "NOAFIM" 1 "AFIMDIS" 2 "AFIMEZLA" 3 "AFIMMFK" 4 "AFIMEZFRQ" 5 "AFIMCILCN" /end COMPU_VTAB
/begin COMPU_METHOD SY_AFR_Compu "" TAB_VERB "%6.3" "" COMPU_TAB_REF SY_AFR_Compu /end COMPU_METHOD
/begin COMPU_VTAB SY_AFR_Compu "" TAB_VERB 2 0 "kein Anfahrregler vorhanden" 1 "Anfahrregler vorhanden" /end COMPU_VTAB
/begin COMPU_METHOD SY_AGR2_Compu "" TAB_VERB "%6.3" "" COMPU_TAB_REF SY_AGR2_Compu /end COMPU_METHOD
/begin COMPU_VTAB SY_AGR2_Compu "" TAB_VERB 2 0 "FALSE" 1 "TRUE" /end COMPU_VTAB
/begin COMPU_METHOD SY_AGREDK_Compu "" TAB_VERB "%6.3" "" COMPU_TAB_REF SY_AGREDK_Compu /end COMPU_METHOD
/begin COMPU_VTAB SY_AGREDK_Compu "" TAB_VERB 2 0 "keine Erwärmung der Drosselklappe durch ext. AGR" 1 "Erwärmung der Drosselklappe durch ext. AGR" /end COMPU_VTAB
/begin COMPU_METHOD SY_AGRKOMP_Compu "" TAB_VERB "%6.3" "" COMPU_TAB_REF SY_AGRKOMP_Compu /end COMPU_METHOD
/begin COMPU_VTAB SY_AGRKOMP_Compu "" TAB_VERB 6 0 "kein AGR" 1 "Proportionalmagnet" 2 "Steppermotor" 3 "DC-Motor" 4 "MELCO Tellerstössel" 5 "Delphi Torquer-Ventil" /end COMPU_VTAB
/begin COMPU_METHOD SY_AGR_Compu "" TAB_VERB "%6.3" "" COMPU_TAB_REF SY_AGR_Compu /end COMPU_METHOD
/begin COMPU_VTAB SY_AGR_Compu "" TAB_VERB 2 0 "FALSE" 1 "TRUE" /end COMPU_VTAB
/begin COMPU_METHOD SY_AGR_DSS_Compu "" TAB_VERB "%6.3" "" COMPU_TAB_REF SY_AGR_DSS_Compu /end COMPU_METHOD
/begin COMPU_VTAB SY_AGR_DSS_Compu "" TAB_VERB 2 1 "Absolut-Drucksensor am Saugrohr" 0 "kein Absolut-Drucksensor am Saugrohr" /end COMPU_VTAB
/begin COMPU_METHOD SY_AIRBAG_Compu "" TAB_VERB "%6.3" "" COMPU_TAB_REF SY_AIRBAG_Compu /end COMPU_METHOD
/begin COMPU_VTAB SY_AIRBAG_Compu "" TAB_VERB 2 0 "kein Airbagsignal verfügbar" 1 "Airbagsignal verfügbar" /end COMPU_VTAB
/begin COMPU_METHOD SY_ALTSC_Compu "" TAB_VERB "%6.3" "" COMPU_TAB_REF SY_ALTSC_Compu /end COMPU_METHOD
/begin COMPU_VTAB SY_ALTSC_Compu "" TAB_VERB 2 0 "kein Generator mit Smart Charge" 1 "Generator mit Smart Charge" /end COMPU_VTAB
/begin COMPU_METHOD SY_AMSHFMP_Compu "" TAB_VERB "%6.3" "" COMPU_TAB_REF SY_AMSHFMP_Compu /end COMPU_METHOD
/begin COMPU_VTAB SY_AMSHFMP_Compu "" TAB_VERB 2 0 "inactiv" 1 "based on MAP" /end COMPU_VTAB
/begin COMPU_METHOD SY_ANST_Compu "" TAB_VERB "%6.3" "" COMPU_TAB_REF SY_ANST_Compu /end COMPU_METHOD
/begin COMPU_VTAB SY_ANST_Compu "" TAB_VERB 2 0 "False" 1 "True" /end COMPU_VTAB
/begin COMPU_METHOD SY_ANZEKP_Compu "" RAT_FUNC "%6.2" "" COEFFS 0 1 0 0 0 1 /end COMPU_METHOD
/begin COMPU_METHOD SY_ANZLUE_Compu "" TAB_VERB "%6.3" "" COMPU_TAB_REF SY_ANZLUE_Compu /end COMPU_METHOD
/begin COMPU_VTAB SY_ANZLUE_Compu "" TAB_VERB 5 0 "kein Lüfter" 1 "1 Lüfter" 2 "2 Lüfter" 3 "3 Lüfter" 12 "Doppellüfter" /end COMPU_VTAB
/begin COMPU_METHOD SY_ANZPSLS_Compu "" TAB_VERB "%6.3" "" COMPU_TAB_REF SY_ANZPSLS_Compu /end COMPU_METHOD
/begin COMPU_VTAB SY_ANZPSLS_Compu "" TAB_VERB 3 0 "PSLS_NO" 1 "PSLS_ONE" 2 "PSLS_TWO" /end COMPU_VTAB
/begin COMPU_METHOD SY_ANZSFST_Compu "" RAT_FUNC "%6.2" "" COEFFS 0 1 0 0 0 1 /end COMPU_METHOD
/begin COMPU_METHOD SY_ARC_Compu "" TAB_VERB "%6.3" "" COMPU_TAB_REF SY_ARC_Compu /end COMPU_METHOD
/begin COMPU_VTAB SY_ARC_Compu "" TAB_VERB 2 0 "kein Active Roll Control vorhanden" 1 "Active Roll Control vorhanden" /end COMPU_VTAB
/begin COMPU_METHOD SY_ARSTAT_Compu "" TAB_VERB "%6.3" "" COMPU_TAB_REF SY_ARSTAT_Compu /end COMPU_METHOD
/begin COMPU_VTAB SY_ARSTAT_Compu "" TAB_VERB 2 0 "False" 1 "True" /end COMPU_VTAB
/begin COMPU_METHOD SY_ASEEPR_Compu "" TAB_VERB "%6.3" "" COMPU_TAB_REF SY_ASEEPR_Compu /end COMPU_METHOD
/begin COMPU_VTAB SY_ASEEPR_Compu "" TAB_VERB 3 0 "no saving" 1 "saving without knock control" 2 "saving with knock control values" /end COMPU_VTAB
/begin COMPU_METHOD SY_ASGLC_Compu "" RAT_FUNC "%6.2" "" COEFFS 0 1 0 0 0 1 /end COMPU_METHOD
/begin COMPU_METHOD SY_ASG_Compu "" TAB_VERB "%6.3" "" COMPU_TAB_REF SY_ASG_Compu /end COMPU_METHOD
/begin COMPU_VTAB SY_ASG_Compu "" TAB_VERB 2 0 "kein automatisiertes Schaltgetriebe vorhanden" 1 "Automatisiertes Schaltgetriebe vorhanden" /end COMPU_VTAB
/begin COMPU_METHOD SY_ASM_Compu "" TAB_VERB "%6.3" "" COMPU_TAB_REF SY_ASM_Compu /end COMPU_METHOD
/begin COMPU_VTAB SY_ASM_Compu "" TAB_VERB 2 0 "kein ASM-Getriebe vorhanden" 1 "ASM-Getriebe vorhanden" /end COMPU_VTAB
/begin COMPU_METHOD SY_ASR_Compu "" TAB_VERB "%6.3" "" COMPU_TAB_REF SY_ASR_Compu /end COMPU_METHOD
/begin COMPU_VTAB SY_ASR_Compu "" TAB_VERB 2 0 "keine ASR vorhanden" 1 "ASR vorhanden" /end COMPU_VTAB
/begin COMPU_METHOD SY_ASTIKR2_Compu "" TAB_VERB "%6.3" "" COMPU_TAB_REF SY_ASTIKR2_Compu /end COMPU_METHOD
/begin COMPU_VTAB SY_ASTIKR2_Compu "" TAB_VERB 2 0 "kein Temperatursensor im Krümmer Bank 2" 1 "Temperatursensor im Krümmer Bank 2" /end COMPU_VTAB
/begin COMPU_METHOD SY_ASTIKR_Compu "" TAB_VERB "%6.3" "" COMPU_TAB_REF SY_ASTIKR_Compu /end COMPU_METHOD
/begin COMPU_VTAB SY_ASTIKR_Compu "" TAB_VERB 2 0 "kein Temperatursensor im Krümmer" 1 "Temperatursensor im Krümmer verbaut" /end COMPU_VTAB
/begin COMPU_METHOD SY_ASTNVK2_Compu "" TAB_VERB "%6.3" "" COMPU_TAB_REF SY_ASTNVK2_Compu /end COMPU_METHOD
/begin COMPU_VTAB SY_ASTNVK2_Compu "" TAB_VERB 2 0 "kein Temperatursensor nach Vorkat Bank 2" 1 "Temperatursensor nach Vorkat Bank 2" /end COMPU_VTAB
/begin COMPU_METHOD SY_ASTNVK_Compu "" TAB_VERB "%6.3" "" COMPU_TAB_REF SY_ASTNVK_Compu /end COMPU_METHOD
/begin COMPU_VTAB SY_ASTNVK_Compu "" TAB_VERB 2 0 "kein Temperatursensor nach Vorkat" 1 "Temperatursensor nach Vorkat" /end COMPU_VTAB
/begin COMPU_METHOD SY_ASTSWTINTEGNEG_Compu "" TAB_VERB "%6.3" "" COMPU_TAB_REF SY_ASTSWTINTEGNEG_Compu /end COMPU_METHOD
/begin COMPU_VTAB SY_ASTSWTINTEGNEG_Compu "" TAB_VERB 2 0 "False" 1 "True" /end COMPU_VTAB
/begin COMPU_METHOD SY_ASTVHK2_Compu "" TAB_VERB "%6.3" "" COMPU_TAB_REF SY_ASTVHK2_Compu /end COMPU_METHOD
/begin COMPU_VTAB SY_ASTVHK2_Compu "" TAB_VERB 2 0 "kein Temperatursensor vor Hauptkat Bank 2" 1 "Temperatursensor vor Hauptkat Bank 2" /end COMPU_VTAB
/begin COMPU_METHOD SY_ASTVHK_Compu "" TAB_VERB "%6.3" "" COMPU_TAB_REF SY_ASTVHK_Compu /end COMPU_METHOD
/begin COMPU_VTAB SY_ASTVHK_Compu "" TAB_VERB 2 0 "kein Temperatursensor vor Hauptkat" 1 "Temperatursensor vor Hauptkat" /end COMPU_VTAB
/begin COMPU_METHOD SY_ASTVVK2_Compu "" TAB_VERB "%6.3" "" COMPU_TAB_REF SY_ASTVVK2_Compu /end COMPU_METHOD
/begin COMPU_VTAB SY_ASTVVK2_Compu "" TAB_VERB 2 0 "KeinTemperatursensor vor Vorkat Bank 2" 1 "Temperatursensor vor Vorkat Bank2" /end COMPU_VTAB
/begin COMPU_METHOD SY_ASTVVK_Compu "" TAB_VERB "%6.3" "" COMPU_TAB_REF SY_ASTVVK_Compu /end COMPU_METHOD
/begin COMPU_VTAB SY_ASTVVK_Compu "" TAB_VERB 2 0 "Kein Temperatursensor vor Vorkat" 1 "Temperatursensor vor Vorkat" /end COMPU_VTAB
/begin COMPU_METHOD SY_ASV_Compu "" TAB_VERB "%6.3" "" COMPU_TAB_REF SY_ASV_Compu /end COMPU_METHOD
/begin COMPU_VTAB SY_ASV_Compu "" TAB_VERB 4 0 "kein ASV vorhanden" 1 "stromlos geöffnetes ASV" 2 "stromlos geschlossenes ASV" 3 "stromlos geschlossenes ASV in Leckageleitung HDP" /end COMPU_VTAB
/begin COMPU_METHOD SY_ATLB_Compu "" TAB_VERB "%6.3" "" COMPU_TAB_REF SY_ATLB_Compu /end COMPU_METHOD
/begin COMPU_VTAB SY_ATLB_Compu "" TAB_VERB 2 0 "keine Turbo-Bypassklappe" 1 "Turbo-Bypassklappe" /end COMPU_VTAB
/begin COMPU_METHOD SY_ATMAMB_Compu "" TAB_VERB "%6.3" "" COMPU_TAB_REF SY_ATMAMB_Compu /end COMPU_METHOD
/begin COMPU_VTAB SY_ATMAMB_Compu "" TAB_VERB 2 0 "False" 1 "True" /end COMPU_VTAB
/begin COMPU_METHOD SY_ATMAVDY_Compu "" TAB_VERB "%6.3" "" COMPU_TAB_REF SY_ATMAVDY_Compu /end COMPU_METHOD
/begin COMPU_VTAB SY_ATMAVDY_Compu "" TAB_VERB 3 0 "use only conventional model (low pass)" 1 "use only bridge model" 2 "use both models (select concrete model by code wor" /end COMPU_VTAB
/begin COMPU_METHOD SY_ATMBR2_Compu "" RAT_FUNC "%6.2" "" COEFFS 0 1 0 0 0 1 /end COMPU_METHOD
/begin COMPU_METHOD SY_ATMBRA2_Compu "" RAT_FUNC "%6.2" "" COEFFS 0 1 0 0 0 1 /end COMPU_METHOD
/begin COMPU_METHOD SY_ATMBRA_Compu "" RAT_FUNC "%6.2" "" COEFFS 0 1 0 0 0 1 /end COMPU_METHOD
/begin COMPU_METHOD SY_ATMBRB2_Compu "" RAT_FUNC "%6.2" "" COEFFS 0 1 0 0 0 1 /end COMPU_METHOD
/begin COMPU_METHOD SY_ATMBRB_Compu "" RAT_FUNC "%6.2" "" COEFFS 0 1 0 0 0 1 /end COMPU_METHOD
/begin COMPU_METHOD SY_ATMBRC_Compu "" RAT_FUNC "%6.2" "" COEFFS 0 1 0 0 0 1 /end COMPU_METHOD
/begin COMPU_METHOD SY_ATMBR_Compu "" RAT_FUNC "%6.2" "" COEFFS 0 1 0 0 0 1 /end COMPU_METHOD
/begin COMPU_METHOD SY_ATMCACA_Compu "" TAB_VERB "%6.3" "" COMPU_TAB_REF SY_ATMCACA_Compu /end COMPU_METHOD
/begin COMPU_VTAB SY_ATMCACA_Compu "" TAB_VERB 3 0 "0" 1 "1" 2 "2" /end COMPU_VTAB
/begin COMPU_METHOD SY_ATMELE2_Compu "" RAT_FUNC "%6.2" "" COEFFS 0 1 0 0 0 1 /end COMPU_METHOD
/begin COMPU_METHOD SY_ATMELE_Compu "" RAT_FUNC "%6.2" "" COEFFS 0 1 0 0 0 1 /end COMPU_METHOD
/begin COMPU_METHOD SY_ATMEXFB_Compu "" TAB_VERB "%6.3" "" COMPU_TAB_REF SY_ATMEXFB_Compu /end COMPU_METHOD
/begin COMPU_VTAB SY_ATMEXFB_Compu "" TAB_VERB 2 0 "False" 1 "True" /end COMPU_VTAB
/begin COMPU_METHOD SY_ATMEXO_Compu "" TAB_VERB "%6.3" "" COMPU_TAB_REF SY_ATMEXO_Compu /end COMPU_METHOD
/begin COMPU_VTAB SY_ATMEXO_Compu "" TAB_VERB 2 0 "no state/emission dependend exothermic modell cat." 1 "state/emission dependend exothermic modell cat." /end COMPU_VTAB
/begin COMPU_METHOD SY_ATMFAN_Compu "" TAB_VERB "%6.3" "" COMPU_TAB_REF SY_ATMFAN_Compu /end COMPU_METHOD
/begin COMPU_VTAB SY_ATMFAN_Compu "" TAB_VERB 2 0 "0" 1 "1" /end COMPU_VTAB
/begin COMPU_METHOD SY_ATMGD_Compu "" TAB_VERB "%6.3" "" COMPU_TAB_REF SY_ATMGD_Compu /end COMPU_METHOD
/begin COMPU_VTAB SY_ATMGD_Compu "" TAB_VERB 2 0 "False" 1 "True" /end COMPU_VTAB
/begin COMPU_METHOD SY_ATMHOOK_Compu "" TAB_VERB "%6.3" "" COMPU_TAB_REF SY_ATMHOOK_Compu /end COMPU_METHOD
/begin COMPU_VTAB SY_ATMHOOK_Compu "" TAB_VERB 2 0 "0" 1 "1" /end COMPU_VTAB
/begin COMPU_METHOD SY_ATMISEC_Compu "" TAB_VERB "%6.3" "" COMPU_TAB_REF SY_ATMISEC_Compu /end COMPU_METHOD
/begin COMPU_VTAB SY_ATMISEC_Compu "" TAB_VERB 2 0 "False" 1 "True" /end COMPU_VTAB
/begin COMPU_METHOD SY_ATMOFFS_Compu "" TAB_VERB "%6.3" "" COMPU_TAB_REF SY_ATMOFFS_Compu /end COMPU_METHOD
/begin COMPU_VTAB SY_ATMOFFS_Compu "" TAB_VERB 2 0 "False" 1 "True" /end COMPU_VTAB
/begin COMPU_METHOD SY_ATMPI2_Compu "" RAT_FUNC "%6.2" "" COEFFS 0 1 0 0 0 1 /end COMPU_METHOD
/begin COMPU_METHOD SY_ATMPIA2_Compu "" RAT_FUNC "%6.2" "" COEFFS 0 1 0 0 0 1 /end COMPU_METHOD
/begin COMPU_METHOD SY_ATMPIA_Compu "" RAT_FUNC "%6.2" "" COEFFS 0 1 0 0 0 1 /end COMPU_METHOD
/begin COMPU_METHOD SY_ATMPIB2_Compu "" RAT_FUNC "%6.2" "" COEFFS 0 1 0 0 0 1 /end COMPU_METHOD
/begin COMPU_METHOD SY_ATMPIB_Compu "" RAT_FUNC "%6.2" "" COEFFS 0 1 0 0 0 1 /end COMPU_METHOD
/begin COMPU_METHOD SY_ATMPIC_Compu "" RAT_FUNC "%6.2" "" COEFFS 0 1 0 0 0 1 /end COMPU_METHOD
/begin COMPU_METHOD SY_ATMPI_Compu "" RAT_FUNC "%6.2" "" COEFFS 0 1 0 0 0 1 /end COMPU_METHOD
/begin COMPU_METHOD SY_ATMSY_Compu "" TAB_VERB "%6.3" "" COMPU_TAB_REF SY_ATMSY_Compu /end COMPU_METHOD
/begin COMPU_VTAB SY_ATMSY_Compu "" TAB_VERB 2 0 "asymmetric calibration data" 1 "symmetric calibration data" /end COMPU_VTAB
/begin COMPU_METHOD SY_ATMTURB_Compu "" TAB_VERB "%6.3" "" COMPU_TAB_REF SY_ATMTURB_Compu /end COMPU_METHOD
/begin COMPU_VTAB SY_ATMTURB_Compu "" TAB_VERB 2 0 "ATMTURB_PRES" 1 "ATMTURB_NOPRES" /end COMPU_VTAB
/begin COMPU_METHOD SY_ATR_Compu "" TAB_VERB "%6.3" "" COMPU_TAB_REF SY_ATR_Compu /end COMPU_METHOD
/begin COMPU_VTAB SY_ATR_Compu "" TAB_VERB 2 0 "keine Abgastemperatursensoren vorhanden" 1 "Abgastemperatursensoren vorhanden" /end COMPU_VTAB
/begin COMPU_METHOD SY_ATSPWM_Compu "" TAB_VERB "%6.3" "" COMPU_TAB_REF SY_ATSPWM_Compu /end COMPU_METHOD
/begin COMPU_VTAB SY_ATSPWM_Compu "" TAB_VERB 2 0 "False" 1 "True" /end COMPU_VTAB
/begin COMPU_METHOD SY_ATURB_Compu "" TAB_VERB "%6.3" "" COMPU_TAB_REF SY_ATURB_Compu /end COMPU_METHOD
/begin COMPU_VTAB SY_ATURB_Compu "" TAB_VERB 3 0 "no_turbine" 1 "wastegate" 2 "vtg" /end COMPU_VTAB
/begin COMPU_METHOD SY_AUFLAD2_Compu "" TAB_VERB "%6.3" "" COMPU_TAB_REF SY_AUFLAD2_Compu /end COMPU_METHOD
/begin COMPU_VTAB SY_AUFLAD2_Compu "" TAB_VERB 2 0 "no_2_bank_charging" 1 "2_bank_charging" /end COMPU_VTAB
/begin COMPU_METHOD SY_AUFLAD_Compu "" TAB_VERB "%6.3" "" COMPU_TAB_REF SY_AUFLAD_Compu /end COMPU_METHOD
/begin COMPU_VTAB SY_AUFLAD_Compu "" TAB_VERB 2 0 "no_supercharging" 1 "supercharging" /end COMPU_VTAB
/begin COMPU_METHOD SY_AVS_Compu "" TAB_VERB "%6.3" "" COMPU_TAB_REF SY_AVS_Compu /end COMPU_METHOD
/begin COMPU_VTAB SY_AVS_Compu "" TAB_VERB 2 0 "False" 1 "True" /end COMPU_VTAB
/begin COMPU_METHOD SY_AWUE_Compu "" TAB_VERB "%6.3" "" COMPU_TAB_REF SY_AWUE_Compu /end COMPU_METHOD
/begin COMPU_VTAB SY_AWUE_Compu "" TAB_VERB 2 0 "keine Ev-Abschaltung über Funktion AWUE möglich" 1 "Ev-Abschaltung über Funktion AWUE möglich" /end COMPU_VTAB
/begin COMPU_METHOD SY_BATTSG_Compu "" TAB_VERB "%6.3" "" COMPU_TAB_REF SY_BATTSG_Compu /end COMPU_METHOD
/begin COMPU_VTAB SY_BATTSG_Compu "" TAB_VERB 2 0 "kein 2 Batterie Boardkonzept" 1 "2 Batterie Boardkonzept" /end COMPU_VTAB
/begin COMPU_METHOD SY_BBBO_Compu "" TAB_VERB "%6.3" "" COMPU_TAB_REF SY_BBBO_Compu /end COMPU_METHOD
/begin COMPU_VTAB SY_BBBO_Compu "" TAB_VERB 2 0 "False" 1 "True" /end COMPU_VTAB
/begin COMPU_METHOD SY_BBKOPT_Compu "" TAB_VERB "%6.3" "" COMPU_TAB_REF SY_BBKOPT_Compu /end COMPU_METHOD
/begin COMPU_VTAB SY_BBKOPT_Compu "" TAB_VERB 2 0 "SY_BBKOPT" 1 "SY_BBKOPT" /end COMPU_VTAB
/begin COMPU_METHOD SY_BBPHSYN_Compu "" TAB_VERB "%6.3" "" COMPU_TAB_REF SY_BBPHSYN_Compu /end COMPU_METHOD
/begin COMPU_VTAB SY_BBPHSYN_Compu "" TAB_VERB 2 0 "keine %BBPHSYN vorhanden" 1 "%BBPHSYN vorhanden" /end COMPU_VTAB
/begin COMPU_METHOD SY_BBSAWE_Compu "" TAB_VERB "%6.3" "" COMPU_TAB_REF SY_BBSAWE_Compu /end COMPU_METHOD
/begin COMPU_VTAB SY_BBSAWE_Compu "" TAB_VERB 2 0 "False" 1 "True" /end COMPU_VTAB
/begin COMPU_METHOD SY_BDE_Compu "" TAB_VERB "%6.3" "" COMPU_TAB_REF SY_BDE_Compu /end COMPU_METHOD
/begin COMPU_VTAB SY_BDE_Compu "" TAB_VERB 2 0 "Saugrohreinspritzer" 1 "Benzindirekteinspritzer" /end COMPU_VTAB
/begin COMPU_METHOD SY_BELA_Compu "" TAB_VERB "%6.3" "" COMPU_TAB_REF SY_BELA_Compu /end COMPU_METHOD
/begin COMPU_VTAB SY_BELA_Compu "" TAB_VERB 2 0 "0" 1 "1" /end COMPU_VTAB
/begin COMPU_METHOD SY_BGD3PK_Compu "" TAB_VERB "%6.3" "" COMPU_TAB_REF SY_BGD3PK_Compu /end COMPU_METHOD
/begin COMPU_VTAB SY_BGD3PK_Compu "" TAB_VERB 2 0 "False" 1 "True" /end COMPU_VTAB
/begin COMPU_METHOD SY_BGLWEM_Compu "" TAB_VERB "%6.3" "" COMPU_TAB_REF SY_BGLWEM_Compu /end COMPU_METHOD
/begin COMPU_VTAB SY_BGLWEM_Compu "" TAB_VERB 2 0 "no external model for BGLWM" 1 "external model for BGLWM" /end COMPU_VTAB
/begin COMPU_METHOD SY_BGSF_Compu "" TAB_VERB "%6.3" "" COMPU_TAB_REF SY_BGSF_Compu /end COMPU_METHOD
/begin COMPU_VTAB SY_BGSF_Compu "" TAB_VERB 2 0 "False" 1 "True" /end COMPU_VTAB
/begin COMPU_METHOD SY_BGVMX_Compu "" TAB_VERB "%6.3" "" COMPU_TAB_REF SY_BGVMX_Compu /end COMPU_METHOD
/begin COMPU_VTAB SY_BGVMX_Compu "" TAB_VERB 2 0 "False" 1 "True" /end COMPU_VTAB
/begin COMPU_METHOD SY_BH_Compu "" TAB_VERB "%6.3" "" COMPU_TAB_REF SY_BH_Compu /end COMPU_METHOD
/begin COMPU_VTAB SY_BH_Compu "" TAB_VERB 2 0 "keine Blockheizererkennung" 1 "Blockheizererkennung" /end COMPU_VTAB
/begin COMPU_METHOD SY_BIRE_Compu "" TAB_VERB "%6.3" "" COMPU_TAB_REF SY_BIRE_Compu /end COMPU_METHOD
/begin COMPU_VTAB SY_BIRE_Compu "" TAB_VERB 2 0 "keine Bilanzregelung vorhanden" 1 "Bilanzregelung vorhanden" /end COMPU_VTAB
/begin COMPU_METHOD SY_BKS_Compu "" TAB_VERB "%6.3" "" COMPU_TAB_REF SY_BKS_Compu /end COMPU_METHOD
/begin COMPU_VTAB SY_BKS_Compu "" TAB_VERB 2 0 "kein bedarfsgeregeltes KVS" 1 "bedarfsgeregeltes KVS" /end COMPU_VTAB
/begin COMPU_METHOD SY_BKVP_Compu "" TAB_VERB "%6.3" "" COMPU_TAB_REF SY_BKVP_Compu /end COMPU_METHOD
/begin COMPU_VTAB SY_BKVP_Compu "" TAB_VERB 4 3 "3" 0 "0" 1 "1" 2 "2" /end COMPU_VTAB
/begin COMPU_METHOD SY_BKVSRV_Compu "" TAB_VERB "%6.3" "" COMPU_TAB_REF SY_BKVSRV_Compu /end COMPU_METHOD
/begin COMPU_VTAB SY_BKVSRV_Compu "" TAB_VERB 2 0 "ohne Verbindung" 1 "mit Verbindung" /end COMPU_VTAB
/begin COMPU_METHOD SY_BKV_Compu "" TAB_VERB "%6.3" "" COMPU_TAB_REF SY_BKV_Compu /end COMPU_METHOD
/begin COMPU_VTAB SY_BKV_Compu "" TAB_VERB 3 0 "ohne Drucksensor oder -schalter" 1 "Druckschalter" 2 "Drucksensor" /end COMPU_VTAB
/begin COMPU_METHOD SY_BLDPRCE_Compu "" TAB_VERB "%6.3" "" COMPU_TAB_REF SY_BLDPRCE_Compu /end COMPU_METHOD
/begin COMPU_VTAB SY_BLDPRCE_Compu "" TAB_VERB 2 0 "no EECrypt" 1 "EECrypt is active" /end COMPU_VTAB
/begin COMPU_METHOD SY_BLOOP_Compu "" TAB_VERB "%6.3" "" COMPU_TAB_REF SY_BLOOP_Compu /end COMPU_METHOD
/begin COMPU_VTAB SY_BLOOP_Compu "" TAB_VERB 2 0 "kein Rücksetzen EGAS-Fehler möglich" 1 "Rücksetzen EGAS-Fehler möglich" /end COMPU_VTAB
/begin COMPU_METHOD SY_BOADAP_Compu "" TAB_VERB "%6.3" "" COMPU_TAB_REF SY_BOADAP_Compu /end COMPU_METHOD
/begin COMPU_VTAB SY_BOADAP_Compu "" TAB_VERB 2 0 "SY_BOADAP ==0" 1 "SY_BOADAP ==1" /end COMPU_VTAB
/begin COMPU_METHOD SY_BOGALIM_Compu "" TAB_VERB "%6.3" "" COMPU_TAB_REF SY_BOGALIM_Compu /end COMPU_METHOD
/begin COMPU_VTAB SY_BOGALIM_Compu "" TAB_VERB 2 0 "SY_BOGALIM ==0" 1 "SY_BOGALIM ==1" /end COMPU_VTAB
/begin COMPU_METHOD SY_BPEZEK_Compu "" TAB_VERB "%6.3" "" COMPU_TAB_REF SY_BPEZEK_Compu /end COMPU_METHOD
/begin COMPU_VTAB SY_BPEZEK_Compu "" TAB_VERB 2 0 "False" 1 "True" /end COMPU_VTAB
/begin COMPU_METHOD SY_C167_Compu "" TAB_VERB "%6.3" "" COMPU_TAB_REF SY_C167_Compu /end COMPU_METHOD
/begin COMPU_VTAB SY_C167_Compu "" TAB_VERB 3 0 "no C167" 1 "C167 CR" 2 "C167 CS" /end COMPU_VTAB
/begin COMPU_METHOD SY_CANAC_Compu "" TAB_VERB "%6.3" "" COMPU_TAB_REF SY_CANAC_Compu /end COMPU_METHOD
/begin COMPU_VTAB SY_CANAC_Compu "" TAB_VERB 2 0 "kein Klimakompressorsignal über CAN" 1 "Klimakompressorsignal über CAN" /end COMPU_VTAB
/begin COMPU_METHOD SY_CANALL_Compu "" TAB_VERB "%6.3" "" COMPU_TAB_REF SY_CANALL_Compu /end COMPU_METHOD
/begin COMPU_VTAB SY_CANALL_Compu "" TAB_VERB 3 0 "disable" 1 "5" 2 "8" /end COMPU_VTAB
/begin COMPU_METHOD SY_CANBSG_Compu "" TAB_VERB "%6.3" "" COMPU_TAB_REF SY_CANBSG_Compu /end COMPU_METHOD
/begin COMPU_VTAB SY_CANBSG_Compu "" TAB_VERB 4 0 "disable" 1 "Funktionsrechner" 2 "ASIC" 3 "CANB" /end COMPU_VTAB
/begin COMPU_METHOD SY_CANFLP_Compu "" TAB_VERB "%6.3" "" COMPU_TAB_REF SY_CANFLP_Compu /end COMPU_METHOD
/begin COMPU_VTAB SY_CANFLP_Compu "" TAB_VERB 2 0 "Kein EV-Abschaltung während FlashProgrammierung" 1 "EV-Abschaltung während FlashProgrammierung" /end COMPU_VTAB
/begin COMPU_METHOD SY_CANNIV_Compu "" TAB_VERB "%6.3" "" COMPU_TAB_REF SY_CANNIV_Compu /end COMPU_METHOD
/begin COMPU_VTAB SY_CANNIV_Compu "" TAB_VERB 4 0 "disable" 1 "Funktionsrechner" 2 "ASIC" 3 "CANB" /end COMPU_VTAB
/begin COMPU_METHOD SY_CANNOHK_Compu "" TAB_VERB "%6.3" "" COMPU_TAB_REF SY_CANNOHK_Compu /end COMPU_METHOD
/begin COMPU_VTAB SY_CANNOHK_Compu "" TAB_VERB 2 0 "kein NOX-Sensor über CAN" 1 "NOX-Sensor über CAN" /end COMPU_VTAB
/begin COMPU_METHOD SY_CANZAS_Compu "" TAB_VERB "%6.3" "" COMPU_TAB_REF SY_CANZAS_Compu /end COMPU_METHOD
/begin COMPU_VTAB SY_CANZAS_Compu "" TAB_VERB 4 0 "disable" 1 "Funktionsrechner" 2 "ASIC" 3 "CANB" /end COMPU_VTAB
/begin COMPU_METHOD SY_CASECU_Compu "" TAB_VERB "%6.3" "" COMPU_TAB_REF SY_CASECU_Compu /end COMPU_METHOD
/begin COMPU_VTAB SY_CASECU_Compu "" TAB_VERB 2 0 "False" 1 "True" /end COMPU_VTAB
/begin COMPU_METHOD SY_CATACT_Compu "" TAB_VERB "%6.3" "" COMPU_TAB_REF SY_CATACT_Compu /end COMPU_METHOD
/begin COMPU_VTAB SY_CATACT_Compu "" TAB_VERB 2 0 "False" 1 "True" /end COMPU_VTAB
/begin COMPU_METHOD SY_CC195_Compu "" TAB_VERB "%6.3" "" COMPU_TAB_REF SY_CC195_Compu /end COMPU_METHOD
/begin COMPU_VTAB SY_CC195_Compu "" TAB_VERB 3 0 "0 CC195 Bausteine im Steuergerät verbaut" 1 "1 CC195 Baustein im Steuergerät verbaut" 2 "2 CC195 Bausteine im Steuergerät verbaut" /end COMPU_VTAB
/begin COMPU_METHOD SY_CC196_Compu "" TAB_VERB "%6.3" "" COMPU_TAB_REF SY_CC196_Compu /end COMPU_METHOD
/begin COMPU_VTAB SY_CC196_Compu "" TAB_VERB 3 0 "0 CC196 Bausteine im Steuergerät verbaut" 1 "1 CC196 Baustein im Steuergerät verbaut" 2 "2 CC196 Bausteine im Steuergerät verbaut" /end COMPU_VTAB
/begin COMPU_METHOD SY_CC650_Compu "" TAB_VERB "%6.3" "" COMPU_TAB_REF SY_CC650_Compu /end COMPU_METHOD
/begin COMPU_VTAB SY_CC650_Compu "" TAB_VERB 2 0 "0" 1 "1" /end COMPU_VTAB
/begin COMPU_METHOD SY_CFGKSE_Compu "" TAB_VERB "%6.3" "" COMPU_TAB_REF SY_CFGKSE_Compu /end COMPU_METHOD
/begin COMPU_VTAB SY_CFGKSE_Compu "" TAB_VERB 2 0 "False" 1 "True" /end COMPU_VTAB
/begin COMPU_METHOD SY_CFMST_Compu "" TAB_VERB "%6.3" "" COMPU_TAB_REF SY_CFMST_Compu /end COMPU_METHOD
/begin COMPU_VTAB SY_CFMST_Compu "" TAB_VERB 2 0 "kein Throttle Stomp Clear Flood in Start" 1 "Throttle Stomp Clear Flood in Start vorhanden" /end COMPU_VTAB
/begin COMPU_METHOD SY_CHSPLMI_Compu "" TAB_VERB "%6.3" "" COMPU_TAB_REF SY_CHSPLMI_Compu /end COMPU_METHOD
/begin COMPU_VTAB SY_CHSPLMI_Compu "" TAB_VERB 2 0 "Direct definition of setpoint lambda" 1 "Definition by mixture lambda of exhaust gas" /end COMPU_VTAB
/begin COMPU_METHOD SY_CICSERS_Compu "" TAB_VERB "%6.3" "" COMPU_TAB_REF SY_CICSERS_Compu /end COMPU_METHOD
/begin COMPU_VTAB SY_CICSERS_Compu "" TAB_VERB 2 0 "False" 1 "True" /end COMPU_VTAB
/begin COMPU_METHOD SY_CJ110_Compu "" TAB_VERB "%6.3" "" COMPU_TAB_REF SY_CJ110_Compu /end COMPU_METHOD
/begin COMPU_VTAB SY_CJ110_Compu "" TAB_VERB 3 0 "0 CJ110 Bausteine im Steuergerät verbaut" 1 "1 CJ110 Baustein im Steuergerät verbaut" 2 "2 CJ110 Bausteine im Steuergerät verbaut" /end COMPU_VTAB
/begin COMPU_METHOD SY_CJ120_Compu "" TAB_VERB "%6.3" "" COMPU_TAB_REF SY_CJ120_Compu /end COMPU_METHOD
/begin COMPU_VTAB SY_CJ120_Compu "" TAB_VERB 3 0 "0 CJ120 Bausteine  im Steuergerät verbaut" 1 "1 CJ120 Baustein im Steuergerät verbaut" 2 "2 CJ120 Bausteine im Steuergerät verbaut" /end COMPU_VTAB
/begin COMPU_METHOD SY_CJ125_Compu "" TAB_VERB "%6.3" "" COMPU_TAB_REF SY_CJ125_Compu /end COMPU_METHOD
/begin COMPU_VTAB SY_CJ125_Compu "" TAB_VERB 3 0 "0 CJ125 Bausteine im Steuergerät verbaut" 1 "1 CJ125 Baustein im Steuergerät verbaut" 2 "2 CJ125 Bausteine im Steuergerät verbaut" /end COMPU_VTAB
/begin COMPU_METHOD SY_CJ230DM_Compu "" TAB_VERB "%6.3" "" COMPU_TAB_REF SY_CJ230DM_Compu /end COMPU_METHOD
/begin COMPU_VTAB SY_CJ230DM_Compu "" TAB_VERB 2 0 "Diagnose der ES durch Statusflag-Abfrage" 1 "Diagnose der ES über SPI" /end COMPU_VTAB
/begin COMPU_METHOD SY_CJ230_Compu "" TAB_VERB "%6.3" "" COMPU_TAB_REF SY_CJ230_Compu /end COMPU_METHOD
/begin COMPU_VTAB SY_CJ230_Compu "" TAB_VERB 4 0 "0 CJ230 Bauteine im Gerät verbaut" 1 "1 CJ230 Baustein im Gerät verbaut" 2 "2 CJ230 Bausteine im Gerät verbaut" 3 "3 CJ230 Bausteine im Gerät verbaut" /end COMPU_VTAB
/begin COMPU_METHOD SY_CJ840AT_Compu "" TAB_VERB "%6.3" "" COMPU_TAB_REF SY_CJ840AT_Compu /end COMPU_METHOD
/begin COMPU_VTAB SY_CJ840AT_Compu "" TAB_VERB 5 0 "no CJ840 PS" 1 "one CJ840 PS" 2 "two CJ840 PS" 5 "one CJ840 PS safty" 6 "two CJ840 PS safty" /end COMPU_VTAB
/begin COMPU_METHOD SY_CJ840_Compu "" RAT_FUNC "%6.2" "" COEFFS 0 1 0 0 0 1 /end COMPU_METHOD
/begin COMPU_METHOD SY_CJ841_Compu "" TAB_VERB "%6.3" "" COMPU_TAB_REF SY_CJ841_Compu /end COMPU_METHOD
/begin COMPU_VTAB SY_CJ841_Compu "" TAB_VERB 3 1 "one CJ841" 2 "two CJ841" 0 "no CJ841" /end COMPU_VTAB
/begin COMPU_METHOD SY_CJ870_Compu "" TAB_VERB "%6.3" "" COMPU_TAB_REF SY_CJ870_Compu /end COMPU_METHOD
/begin COMPU_VTAB SY_CJ870_Compu "" TAB_VERB 3 2 "two CJ870" 0 "no CJ870" 1 "one CJ870" /end COMPU_VTAB
/begin COMPU_METHOD SY_CK200LS_Compu "" TAB_VERB "%6.3" "" COMPU_TAB_REF SY_CK200LS_Compu /end COMPU_METHOD
/begin COMPU_VTAB SY_CK200LS_Compu "" TAB_VERB 2 0 "low side switch high impedance" 1 "low side switch function (input,!reset)" /end COMPU_VTAB
/begin COMPU_METHOD SY_CK200MO_Compu "" TAB_VERB "%6.3" "" COMPU_TAB_REF SY_CK200MO_Compu /end COMPU_METHOD
/begin COMPU_VTAB SY_CK200MO_Compu "" TAB_VERB 2 0 "U-Mode" 1 "I-Mode" /end COMPU_VTAB
/begin COMPU_METHOD SY_CK200_Compu "" RAT_FUNC "%6.2" "" COEFFS 0 1 0 0 0 1 /end COMPU_METHOD
/begin COMPU_METHOD SY_CK240_Compu "" RAT_FUNC "%6.2" "" COEFFS 0 1 0 0 0 1 /end COMPU_METHOD
/begin COMPU_METHOD SY_CKA_Compu "" TAB_VERB "%6.3" "" COMPU_TAB_REF SY_CKA_Compu /end COMPU_METHOD
/begin COMPU_VTAB SY_CKA_Compu "" TAB_VERB 2 0 "chemisches Katalysatoraufheizen nicht möglich" 1 "chemisches Katalysatoraufheizen möglich" /end COMPU_VTAB
/begin COMPU_METHOD SY_CNG_Compu "" TAB_VERB "%6.3" "" COMPU_TAB_REF SY_CNG_Compu /end COMPU_METHOD
/begin COMPU_VTAB SY_CNG_Compu "" TAB_VERB 5 0 "Kein System mit CNG" 1 "System mit CNG" 2 "System mit CNG und EOBD" 3 "System mit CNG Fehlerpfade ASV1...5" 4 "System mit CNG Plattform" /end COMPU_VTAB
/begin COMPU_METHOD SY_COPOTI_Compu "" TAB_VERB "%6.3" "" COMPU_TAB_REF SY_COPOTI_Compu /end COMPU_METHOD
/begin COMPU_VTAB SY_COPOTI_Compu "" TAB_VERB 2 0 "kein CO-Poti vorhanden" 1 "CO-Poti vorhanden" /end COMPU_VTAB
/begin COMPU_METHOD SY_CPRDYL_Compu "" TAB_VERB "%6.3" "" COMPU_TAB_REF SY_CPRDYL_Compu /end COMPU_METHOD
/begin COMPU_VTAB SY_CPRDYL_Compu "" TAB_VERB 2 0 "No specific enrichment at high load dynamic avail." 1 "Specific enrichment at high load dynamic available" /end COMPU_VTAB
/begin COMPU_METHOD SY_CPRLAOX_Compu "" TAB_VERB "%6.3" "" COMPU_TAB_REF SY_CPRLAOX_Compu /end COMPU_METHOD
/begin COMPU_VTAB SY_CPRLAOX_Compu "" TAB_VERB 2 0 "No lower limit of enrichment by comp. protection" 1 "Lower limit of enrichment by comp. prot. possible" /end COMPU_VTAB
/begin COMPU_METHOD SY_CPRLG_Compu "" TAB_VERB "%6.3" "" COMPU_TAB_REF SY_CPRLG_Compu /end COMPU_METHOD
/begin COMPU_VTAB SY_CPRLG_Compu "" TAB_VERB 2 0 "No spec. enrichment at high load + low gear avail." 1 "Spec. enrichment at high load + low gear available" /end COMPU_VTAB
/begin COMPU_METHOD SY_CPRSCV_Compu "" TAB_VERB "%6.3" "" COMPU_TAB_REF SY_CPRSCV_Compu /end COMPU_METHOD
/begin COMPU_VTAB SY_CPRSCV_Compu "" TAB_VERB 2 0 "Enrichment independent of swirl control valve" 1 "Specific enrichment for high/low swirl" /end COMPU_VTAB
/begin COMPU_METHOD SY_CVT_Compu "" TAB_VERB "%6.3" "" COMPU_TAB_REF SY_CVT_Compu /end COMPU_METHOD
/begin COMPU_VTAB SY_CVT_Compu "" TAB_VERB 2 0 "no CVT Gear installed" 1 "CVT Gear installed" /end COMPU_VTAB
/begin COMPU_METHOD SY_CY370_Compu "" TAB_VERB "%6.3" "" COMPU_TAB_REF SY_CY370_Compu /end COMPU_METHOD
/begin COMPU_VTAB SY_CY370_Compu "" TAB_VERB 2 0 "0 kein CY370 vorhanden" 1 "1 ein Baustein CY370 vorhanden" /end COMPU_VTAB
/begin COMPU_METHOD SY_D2CTRFLT_Compu "" RAT_FUNC "%6.2" "" COEFFS 0 1 0 0 0 1 /end COMPU_METHOD
/begin COMPU_METHOD SY_DCPVAIR_Compu "" TAB_VERB "%6.3" "" COMPU_TAB_REF SY_DCPVAIR_Compu /end COMPU_METHOD
/begin COMPU_VTAB SY_DCPVAIR_Compu "" TAB_VERB 3 1 "DTEV air test HFM" 2 "DTEV air test DSS" 0 "No DTEV air test" /end COMPU_VTAB
/begin COMPU_METHOD SY_DCPVLD_Compu "" TAB_VERB "%6.3" "" COMPU_TAB_REF SY_DCPVLD_Compu /end COMPU_METHOD
/begin COMPU_VTAB SY_DCPVLD_Compu "" TAB_VERB 2 0 "TEV Ergebnis aus TLD wird nicht berücksichtigt" 1 "TEV Ergebnis aus TLD wird berücksichtigt" /end COMPU_VTAB
/begin COMPU_METHOD SY_DCPVLRR_Compu "" TAB_VERB "%6.3" "" COMPU_TAB_REF SY_DCPVLRR_Compu /end COMPU_METHOD
/begin COMPU_VTAB SY_DCPVLRR_Compu "" TAB_VERB 2 0 "kein Lambdareglerreset nach DTEV" 1 "Lambdareglerreset aktiviert nach DTEV" /end COMPU_VTAB
/begin COMPU_METHOD t100msxs_uw_b6553p5 "" RAT_FUNC "%6.3" "s" COEFFS 0 1 0 0 0 0.1 /end COMPU_METHOD
/begin COMPU_METHOD t10msxs_ub_q0p01 "" RAT_FUNC "%6.4" "s" COEFFS 0 1 0 0 0 0.01 /end COMPU_METHOD
/begin COMPU_METHOD t6minxmin_q6 "" RAT_FUNC "%6.2" "min" COEFFS 0 1 0 0 0 6 /end COMPU_METHOD
/begin COMPU_METHOD TempDiff_Kelv "" RAT_FUNC "%6.3" "K" COEFFS 0 10 0 0 0 1 /end COMPU_METHOD
/begin COMPU_METHOD Temp_Cels "" RAT_FUNC "%6.1" "deg C" COEFFS 0 10 2731.4 0 0 1 /end COMPU_METHOD
/begin COMPU_METHOD temp_q0p01 "" RAT_FUNC "%6.4" "Grad C" COEFFS 0 100 0 0 0 1 /end COMPU_METHOD
/begin COMPU_METHOD temp_q0p0234_o273 "" RAT_FUNC "%6.1" "Grad C" COEFFS 0 1 273.15 0 0 0.0234375 /end COMPU_METHOD
/begin COMPU_METHOD temp_ub_q0p75_o48 "" RAT_FUNC "%6.2" "Grad C" COEFFS 0 1 48 0 0 0.75 /end COMPU_METHOD
/begin COMPU_METHOD TimeDelay_ms "" RAT_FUNC "%12.1" "ms" COEFFS 0 0 1 0 2.3283064365387e-007 0 /end COMPU_METHOD
/begin COMPU_METHOD Time_ms "" RAT_FUNC "%6.1" "ms" COEFFS 0 0.1 0 0 0 1 /end COMPU_METHOD
/begin COMPU_METHOD Time_ns_to_us "" RAT_FUNC "%6.5" "us" COEFFS 0 1000 0 0 0 1 /end COMPU_METHOD
/begin COMPU_METHOD Trq "" RAT_FUNC "%6.3" "Nm" COEFFS 0 10 0 0 0 1 /end COMPU_METHOD
/begin COMPU_METHOD t_q0p0001_ms "" RAT_FUNC "%7.6" "ms" COEFFS 0 10000 0 0 0 1 /end COMPU_METHOD
/begin COMPU_METHOD t_q0p01 "" RAT_FUNC "%6.4" "" COEFFS 0 100 0 0 0 1 /end COMPU_METHOD
/begin COMPU_METHOD t_q10_ms "" RAT_FUNC "%6.1" "ms" COEFFS 0 1 0 0 0 10 /end COMPU_METHOD
/begin COMPU_METHOD t_q1p024_ms "" RAT_FUNC "%6.2" "ms" COEFFS 0 1 0 0 0 1.024 /end COMPU_METHOD
/begin COMPU_METHOD Vel "" RAT_FUNC "%6.4" "km/h" COEFFS 0 100 0 0 0 1 /end COMPU_METHOD
/begin COMPU_METHOD vel_q0p01 "" RAT_FUNC "%6.4" "km/h" COEFFS 0 100 0 0 0 1 /end COMPU_METHOD
/begin COMPU_METHOD zk100msxs_uw_b6553 "" RAT_FUNC "%6.1" "s" COEFFS 0 0 65536 0 10 0 /end COMPU_METHOD
/begin COMPU_METHOD zk10msxs_uw_b655p36 "" RAT_FUNC "%6.2" "s" COEFFS 0 0 65536 0 100 0 /end COMPU_METHOD
/begin COMPU_METHOD zk5msxs_uw_b327p68 "" RAT_FUNC "%6.2" "s" COEFFS 0 0 65536 0 200 0 /end COMPU_METHOD
/begin COMPU_METHOD default "" RAT_FUNC "%6.2" "" COEFFS 0 1 0 0 0 1 /end COMPU_METHOD
/begin RECORD_LAYOUT Axis_Xs16 NO_AXIS_PTS_X 1 SWORD AXIS_PTS_X 2 SWORD INDEX_INCR DIRECT /end RECORD_LAYOUT
/begin RECORD_LAYOUT CurG_Ws16 FNC_VALUES 1 SWORD COLUMN_DIR DIRECT /end RECORD_LAYOUT
/begin RECORD_LAYOUT Cur_Xs16Ws16 NO_AXIS_PTS_X 1 SWORD AXIS_PTS_X 2 SWORD INDEX_INCR DIRECT FNC_VALUES 3 SWORD COLUMN_DIR DIRECT /end RECORD_LAYOUT
/begin RECORD_LAYOUT GkfWU16 FNC_VALUES 1 UWORD COLUMN_DIR DIRECT /end RECORD_LAYOUT
/begin RECORD_LAYOUT GkfWU8 FNC_VALUES 1 UBYTE COLUMN_DIR DIRECT /end RECORD_LAYOUT
/begin RECORD_LAYOUT GklWU8 FNC_VALUES 1 UBYTE COLUMN_DIR DIRECT /end RECORD_LAYOUT
/begin RECORD_LAYOUT KfAxU8AyU8SstxU8SstyU16WU16 NO_AXIS_PTS_X 1 UBYTE NO_AXIS_PTS_Y 2 UBYTE AXIS_PTS_X 3 UBYTE INDEX_INCR DIRECT AXIS_PTS_Y 4 UWORD INDEX_INCR DIRECT FNC_VALUES 5 UWORD COLUMN_DIR DIRECT /end RECORD_LAYOUT
/begin RECORD_LAYOUT KfAxU8AyU8SstxU8SstyU16WU8 NO_AXIS_PTS_X 1 UBYTE NO_AXIS_PTS_Y 2 UBYTE AXIS_PTS_X 3 UBYTE INDEX_INCR DIRECT AXIS_PTS_Y 4 UWORD INDEX_INCR DIRECT FNC_VALUES 5 UBYTE COLUMN_DIR DIRECT /end RECORD_LAYOUT
/begin RECORD_LAYOUT KfAxU8AyU8SstxU8SstyU8WU8 NO_AXIS_PTS_X 1 UBYTE NO_AXIS_PTS_Y 2 UBYTE AXIS_PTS_X 3 UBYTE INDEX_INCR DIRECT AXIS_PTS_Y 4 UBYTE INDEX_INCR DIRECT FNC_VALUES 5 UBYTE COLUMN_DIR DIRECT /end RECORD_LAYOUT
/begin RECORD_LAYOUT KlAxU8SstxS16WS16 NO_AXIS_PTS_X 1 SWORD AXIS_PTS_X 2 SWORD INDEX_INCR DIRECT FNC_VALUES 3 SWORD COLUMN_DIR DIRECT /end RECORD_LAYOUT
/begin RECORD_LAYOUT KlAxU8SstxS16WU16 NO_AXIS_PTS_X 1 UWORD AXIS_PTS_X 2 SWORD INDEX_INCR DIRECT FNC_VALUES 3 UWORD COLUMN_DIR DIRECT /end RECORD_LAYOUT
/begin RECORD_LAYOUT KlAxU8SstxU8WU16 NO_AXIS_PTS_X 1 UBYTE AXIS_PTS_X 2 UBYTE INDEX_INCR DIRECT FNC_VALUES 3 UWORD COLUMN_DIR DIRECT /end RECORD_LAYOUT
/begin RECORD_LAYOUT KlAxU8SstxU8WU8 NO_AXIS_PTS_X 1 UBYTE AXIS_PTS_X 2 UBYTE INDEX_INCR DIRECT FNC_VALUES 3 UBYTE COLUMN_DIR DIRECT /end RECORD_LAYOUT
/begin RECORD_LAYOUT KwbWU16 FNC_VALUES 1 UWORD COLUMN_DIR DIRECT /end RECORD_LAYOUT
/begin RECORD_LAYOUT KwSl FNC_VALUES 1 SLONG COLUMN_DIR DIRECT /end RECORD_LAYOUT
/begin RECORD_LAYOUT KwWS16 FNC_VALUES 1 SWORD COLUMN_DIR DIRECT /end RECORD_LAYOUT
/begin RECORD_LAYOUT KwWS8 FNC_VALUES 1 SBYTE COLUMN_DIR DIRECT /end RECORD_LAYOUT
/begin RECORD_LAYOUT KwWU16 FNC_VALUES 1 UWORD COLUMN_DIR DIRECT /end RECORD_LAYOUT
/begin RECORD_LAYOUT KwWU8 FNC_VALUES 1 UBYTE COLUMN_DIR DIRECT /end RECORD_LAYOUT
/begin RECORD_LAYOUT SstAU8SstU16 NO_AXIS_PTS_X 1 UWORD AXIS_PTS_X 2 UWORD INDEX_INCR DIRECT /end RECORD_LAYOUT
/begin RECORD_LAYOUT SstAUbSstUb NO_AXIS_PTS_X 1 UBYTE AXIS_PTS_X 2 UBYTE INDEX_INCR DIRECT /end RECORD_LAYOUT
/begin RECORD_LAYOUT SstAUwSstUw NO_AXIS_PTS_X 1 UWORD AXIS_PTS_X 2 UWORD INDEX_INCR DIRECT /end RECORD_LAYOUT
/begin RECORD_LAYOUT ValA_Ws16 FNC_VALUES 1 SWORD COLUMN_DIR DIRECT /end RECORD_LAYOUT
/begin RECORD_LAYOUT ValA_Ws32 FNC_VALUES 1 SLONG COLUMN_DIR DIRECT /end RECORD_LAYOUT
/begin RECORD_LAYOUT ValA_Wu16 FNC_VALUES 1 UWORD COLUMN_DIR DIRECT /end RECORD_LAYOUT
/begin RECORD_LAYOUT ValA_Wu8 FNC_VALUES 1 UBYTE COLUMN_DIR DIRECT /end RECORD_LAYOUT
/begin RECORD_LAYOUT Val_Ws16 FNC_VALUES 1 SWORD COLUMN_DIR DIRECT /end RECORD_LAYOUT
/begin RECORD_LAYOUT Val_Ws32 FNC_VALUES 1 SLONG COLUMN_DIR DIRECT /end RECORD_LAYOUT
/begin RECORD_LAYOUT Val_Wu16 FNC_VALUES 1 UWORD COLUMN_DIR DIRECT /end RECORD_LAYOUT
/begin RECORD_LAYOUT Val_Wu32 FNC_VALUES 1 ULONG COLUMN_DIR DIRECT /end RECORD_LAYOUT
/begin RECORD_LAYOUT Val_Wu8 FNC_VALUES 1 UBYTE COLUMN_DIR DIRECT /end RECORD_LAYOUT
/end MODULE
/end PROJECT
