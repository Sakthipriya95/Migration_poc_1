ASAP2_VERSION 1 4
/begin PROJECT M17955S3CC411_110Y0320 "M17955S3CC411_110Y0320"
/begin HEADER "" VERSION "M17955S3CC411_110Y0320" PROJECT_NO M17955S3CC411_110Y0320 /end HEADER
/begin MODULE DIM ""
/begin MOD_COMMON "" BYTE_ORDER MSB_LAST ALIGNMENT_BYTE 1 ALIGNMENT_WORD 2 ALIGNMENT_LONG 4 ALIGNMENT_FLOAT32_IEEE 4 /end MOD_COMMON
/begin CHARACTERISTIC ADCY "" VALUE 0x80044CAC KwUb 255.0 dez 0.00 255.0 FORMAT "%5.1" /end CHARACTERISTIC
/begin CHARACTERISTIC AFZBKLH "" VALUE 0x80044E94 KwWU8 255.0 dez 0.00 255.0 FORMAT "%5.1" /end CHARACTERISTIC
/begin CHARACTERISTIC AFZBKLN "" VALUE 0x80044E95 KwWU8 255.0 dez 0.00 255.0 FORMAT "%5.1" /end CHARACTERISTIC
/begin CHARACTERISTIC AHEAGW "" VALUE 0x80044CAE KwUw 65535.00 dez 0.00 65535.00 FORMAT "%8.2" /end CHARACTERISTIC
/begin CHARACTERISTIC AHEAGWS "" VALUE 0x80044CB0 KwUw 65535.00 dez 0.00 65535.00 FORMAT "%8.2" /end CHARACTERISTIC
/begin CHARACTERISTIC AHEAGWSK "" VALUE 0x80044CB2 KwUw 65535.00 dez 0.00 65535.00 FORMAT "%8.2" /end CHARACTERISTIC
/begin CHARACTERISTIC AHEARV "" VALUE 0x80044CB4 KwUw 65535.00 dez 0.00 65535.00 FORMAT "%8.2" /end CHARACTERISTIC
/begin CHARACTERISTIC AHEKABB "" VAL_BLK 0x80044CB6 KwbUw 65535.00 dez 0.00 65535.00 FORMAT "%8.2" NUMBER 1 /end CHARACTERISTIC
/begin CHARACTERISTIC AHEKS1A "" VAL_BLK 0x80044CB8 KwbUw 65535.00 dez 0.00 65535.00 FORMAT "%8.2" NUMBER 1 /end CHARACTERISTIC
/begin CHARACTERISTIC AHEKSA "" VAL_BLK 0x80044CBA KwbUw 65535.00 dez 0.00 65535.00 FORMAT "%8.2" NUMBER 1 /end CHARACTERISTIC
/begin CHARACTERISTIC AINTKAN "" CURVE 0x80044CBC GklWUb 255.0 dez 0.00 255.0 FORMAT "%5.1"
 /begin AXIS_DESCR COM_AXIS nmot nmot_ub_q40 8 0.00 10200. FORMAT "%5.0" AXIS_PTS_REF SNM08DMUB /end AXIS_DESCR
/end CHARACTERISTIC
/begin CHARACTERISTIC ANALUN "" CURVE 0x80044636 GklWUb 126.0 dez 1.000 127.0 FORMAT "%5.1"
 /begin AXIS_DESCR COM_AXIS nmot nmot_ub_q40 8 0.00 10200. FORMAT "%5.0" AXIS_PTS_REF SNM08DMUB /end AXIS_DESCR
/end CHARACTERISTIC
/begin CHARACTERISTIC ANALUST "" VALUE 0x8004463E KwUb 255.0 dez 0.00 255.0 FORMAT "%5.1" /end CHARACTERISTIC
/begin CHARACTERISTIC ANWFOFST "" VALUE 0x800445F0 KwUb 255.0 dez 0.00 255.0 FORMAT "%5.1" /end CHARACTERISTIC
/begin CHARACTERISTIC ANWFOST "" VALUE 0x800445F1 KwUb 255.0 dez 0.00 255.0 FORMAT "%5.1" /end CHARACTERISTIC
/begin CHARACTERISTIC ANZFSRSAMP "" VALUE 0x800443AA KwUb 254.0 dez 1.000 255.0 FORMAT "%5.1" /end CHARACTERISTIC
/begin CHARACTERISTIC AVRALU "" VALUE 0x80044D02 KwUb 20.00 dez 0.00 20.00 FORMAT "%5.2" /end CHARACTERISTIC
/begin CHARACTERISTIC AZSTLU "" VALUE 0x80044D03 KwUb 255.0 dez 0.00 255.0 FORMAT "%5.1" /end CHARACTERISTIC
/begin CHARACTERISTIC AZSTMIL "" VALUE 0x80044D04 KwUb 255.0 dez 0.00 255.0 FORMAT "%5.1" /end CHARACTERISTIC
/begin CHARACTERISTIC AZSTPFSRST "" VALUE 0x800443AC KwUw 65526.00 dez 9.000000 65535.00 FORMAT "%8.2" /end CHARACTERISTIC
/begin CHARACTERISTIC AZSTPON "" VALUE 0x80044D05 KwUb 255.0 dez 0.00 255.0 FORMAT "%5.1" /end CHARACTERISTIC
/begin CHARACTERISTIC AZYTIABB "" VAL_BLK 0x80044CC4 KwbUb 255.0 dez 0.00 255.0 FORMAT "%5.1" NUMBER 1 /end CHARACTERISTIC
/begin CHARACTERISTIC CDFO "" VALUE 0x800445F2 KwUb 255.0 dez 0.00 255.0 FORMAT "%5.1" /end CHARACTERISTIC
/begin CHARACTERISTIC CFETIME "" VALUE 0x80044E96 KwWU8 255.0 t_q1 0.00 255.0 FORMAT "%5.1" /end CHARACTERISTIC
/begin CHARACTERISTIC CWADAPAPPL "" VALUE 0x800443AE KwUb 255.0 dez 0.00 255.0 FORMAT "%5.1" /end CHARACTERISTIC
/begin CHARACTERISTIC CWDALA "" VALUE 0x80044CC5 KwUb 255.0 dez 0.00 255.0 FORMAT "%5.1" /end CHARACTERISTIC
/begin CHARACTERISTIC CWDKRSA "" VALUE 0x8004430E KwWU8 255.0 dez 0.00 255.0 FORMAT "%5.1" /end CHARACTERISTIC
/begin CHARACTERISTIC CWDLLR "" VALUE 0x8004437A KwWU8 255.0 dez 0.00 255.0 FORMAT "%5.1" /end CHARACTERISTIC
/begin CHARACTERISTIC CWDMDADAP "" VALUE 0x800443AF KwUb 255.0 dez 0.00 255.0 FORMAT "%5.1" /end CHARACTERISTIC
/begin CHARACTERISTIC CWDMDE "" VALUE 0x80044CC6 KwUb 255.0 dez 0.00 255.0 FORMAT "%5.1" /end CHARACTERISTIC
/begin CHARACTERISTIC CWDMDFCER "" VALUE 0x80044CC7 KwUb 255.0 dez 0.00 255.0 FORMAT "%5.1" /end CHARACTERISTIC
/begin CHARACTERISTIC CWDMDZAG "" VALUE 0x80044DF4 KwUb 255.0 dez 0.00 255.0 FORMAT "%5.1" /end CHARACTERISTIC
/begin CHARACTERISTIC CWDOTMCS "" VALUE 0x80044E48 KwWU8 255.0 dez 0.00 255.0 FORMAT "%5.1" /end CHARACTERISTIC
/begin CHARACTERISTIC CWKAMFZKH "" VALUE 0x80044DDA KwWU8 255.0 dez 0.00 255.0 FORMAT "%5.1" /end CHARACTERISTIC
/begin CHARACTERISTIC CWLURKH "" VALUE 0x80044870 KwUb 255.0 dez 0.00 255.0 FORMAT "%5.1" /end CHARACTERISTIC
/begin CHARACTERISTIC CWMISALI "" VALUE 0x80044D06 KwUb 255.0 dez 0.00 255.0 FORMAT "%5.1" /end CHARACTERISTIC
/begin CHARACTERISTIC CWPLTCWLSC "" VALUE 0x80044E97 KwWU8 255.0 dez 0.00 255.0 FORMAT "%5.1" /end CHARACTERISTIC
/begin CHARACTERISTIC CWPLTCWSTC "" VALUE 0x80044E98 KwWU8 255.0 dez 0.00 255.0 FORMAT "%5.1" /end CHARACTERISTIC
/begin CHARACTERISTIC CWSTDMD "" VALUE 0x80044D07 KwUb 255.0 dez 0.00 255.0 FORMAT "%5.1" /end CHARACTERISTIC
/begin CHARACTERISTIC CWSTPCNF "" VALUE 0x80044D08 KwUb 255.0 dez 0.00 255.0 FORMAT "%5.1" /end CHARACTERISTIC
/begin CHARACTERISTIC CWSTPCNF2 "" VALUE 0x80044D09 KwUb 255.0 dez 0.00 255.0 FORMAT "%5.1" /end CHARACTERISTIC
/begin CHARACTERISTIC CWSTPNOT "" VALUE 0x80044D0A KwUb 255.0 dez 0.00 255.0 FORMAT "%5.1" /end CHARACTERISTIC
/begin CHARACTERISTIC CWSTPNOT2 "" VALUE 0x80044D0B KwUb 255.0 dez 0.00 255.0 FORMAT "%5.1" /end CHARACTERISTIC
/begin CHARACTERISTIC DASA "" VALUE 0x8004437B KwWU8 255.0 dez 0.00 255.0 FORMAT "%5.1" /end CHARACTERISTIC
/begin CHARACTERISTIC DDPSRPSINI "" VALUE 0x80044E5A KwWU16 5119.922 p_q0p078 0.00 5119.922 FORMAT "%8.3" /end CHARACTERISTIC
/begin CHARACTERISTIC DFRAESTAB "" VALUE 0x8004434E KwWU16 1.999969 fak_uw_b2 0.00 1.999969 FORMAT "%8.6" /end CHARACTERISTIC
/begin CHARACTERISTIC DFRASTAB "" VALUE 0x80044350 KwWU16 1.999969 fak_uw_b2 0.00 1.999969 FORMAT "%8.6" /end CHARACTERISTIC
/begin CHARACTERISTIC DFRMSTAB "" VALUE 0x80044352 KwWU16 1.999969 fak_uw_b2 0.00 1.999969 FORMAT "%8.6" /end CHARACTERISTIC
/begin CHARACTERISTIC DFSOFMEDMX "" VALUE 0x800445F4 KwUw 9.999847 kw_q1p5259eEm4_om5 -5.000000 4.999847 FORMAT "%8.6" /end CHARACTERISTIC
/begin CHARACTERISTIC DKRSAM "" VALUE 0x80044310 KwWU16 65535.00 dez 0.00 65535.00 FORMAT "%8.2" /end CHARACTERISTIC
/begin CHARACTERISTIC DKRSAS "" VALUE 0x80044312 KwWU16 65535.00 dez 0.00 65535.00 FORMAT "%8.2" /end CHARACTERISTIC
/begin CHARACTERISTIC DLURKHE "" CURVE 0x80044418 KlAUwSstSwWUw 1.999969 fak_uw_b2 0.00 1.999969 FORMAT "%8.6"
 /begin AXIS_DESCR STD_AXIS zwavgret zw_sw_q0p75 6 -24576.00 24575.25 FORMAT "%8.2" DEPOSIT ABSOLUTE /end AXIS_DESCR
/end CHARACTERISTIC
/begin CHARACTERISTIC DLURMIN "" CURVE 0x80044432 GklWSw 298.0187 lu_MEx -149.0116 149.0071 FORMAT "%8.4"
 /begin AXIS_DESCR COM_AXIS nmot nmot_ub_q40 8 0.00 10200. FORMAT "%5.0" AXIS_PTS_REF SNM08DMUB /end AXIS_DESCR
/end CHARACTERISTIC
/begin CHARACTERISTIC DMDSEGL "" VALUE 0x80044DDC KwUw 655350.0 kw_tooth_sy 0.00 655350.0 FORMAT "%8.1" /end CHARACTERISTIC
/begin CHARACTERISTIC DMDSEGLKH "" VALUE 0x80044DDE KwWU16 655350.0 kw_tooth_sy 0.00 655350.0 FORMAT "%8.1" /end CHARACTERISTIC
/begin CHARACTERISTIC Dme_stOverlayMethodOnly_C "" VALUE 0x800400EC Val_Wu8 255.0 OneToOne 0.00 255.0 FORMAT "%5.1" /end CHARACTERISTIC
/begin CHARACTERISTIC DMXRDL "" VALUE 0x80044442 KwSw 298.0187 lu_MEx -149.0116 149.0071 FORMAT "%8.4" /end CHARACTERISTIC
/begin CHARACTERISTIC DMXRFL "" VALUE 0x80044640 KwSw 298.0187 lu_MEx -149.0116 149.0071 FORMAT "%8.4" /end CHARACTERISTIC
/begin CHARACTERISTIC DNDLLRO "" VALUE 0x8004437C KwWS8 1270. nmotd_sb_q10 0.00 1270. FORMAT "%5.0" /end CHARACTERISTIC
/begin CHARACTERISTIC DNDLLROKH "" VALUE 0x8004437D KwWS8 1270. nmotd_sb_q10 0.00 1270. FORMAT "%5.0" /end CHARACTERISTIC
/begin CHARACTERISTIC DNDLLRU "" VALUE 0x8004437E KwWS8 1280. nmotd_sb_q10 -1280. 0.00 FORMAT "%5.0" /end CHARACTERISTIC
/begin CHARACTERISTIC DNDLLRUKH "" VALUE 0x8004437F KwWS8 1280. nmotd_sb_q10 -1280. 0.00 FORMAT "%5.0" /end CHARACTERISTIC
/begin CHARACTERISTIC DNMOTG "" VALUE 0x80044380 KwWS16 8192.000 nmot_uw_q0p25 -8192.000 0.00 FORMAT "%8.3" /end CHARACTERISTIC
/begin CHARACTERISTIC DORAESTAB "" VALUE 0x80044354 KwWS16 3071.953 rel_sw_b1536 -1536.000 1535.953 FORMAT "%8.3" /end CHARACTERISTIC
/begin CHARACTERISTIC DORASTAB "" VALUE 0x80044356 KwWS16 3071.953 rel_sw_b1536 -1536.000 1535.953 FORMAT "%8.3" /end CHARACTERISTIC
/begin CHARACTERISTIC DPSRM "" VALUE 0x80044E5C KwWU8 1.992188 fak_ub_b2 0.00 1.992188 FORMAT "%8.6" /end CHARACTERISTIC
/begin CHARACTERISTIC DPSRMFA "" VALUE 0x80044E5D KwWU8 1.992188 fak_ub_b2 0.00 1.992188 FORMAT "%8.6" /end CHARACTERISTIC
/begin CHARACTERISTIC DPSRSVMN "" VALUE 0x80044E5E KwWU16 5119.922 p_q0p078 0.00 5119.922 FORMAT "%8.3" /end CHARACTERISTIC
/begin CHARACTERISTIC DPSWATCHINDEX "" VALUE 0x80045036 KwUb 255.0 dez 0.00 255.0 FORMAT "%5.1" /end CHARACTERISTIC
/begin CHARACTERISTIC DPTPSRMX "" VALUE 0x80044E60 KwWU16 5119.922 p_q0p078 0.00 5119.922 FORMAT "%8.3" /end CHARACTERISTIC
/begin CHARACTERISTIC DPUPSINIMX "" VALUE 0x80044E62 KwWU16 2559.961 p_q0p039 0.00 2559.961 FORMAT "%8.3" /end CHARACTERISTIC
/begin CHARACTERISTIC DRLSOLA "" CURVE 0x80044D0C GklWUw 1535.977 relNWU_q0p0234 0.00 1535.977 FORMAT "%8.3"
 /begin AXIS_DESCR COM_AXIS midmd rel_ub_b99p6 8 0.00 99.61 FORMAT "%5.2" AXIS_PTS_REF SMI08DMUB /end AXIS_DESCR
/end CHARACTERISTIC
/begin CHARACTERISTIC DRLSOLST "" VALUE 0x80044D1C KwUw 1535.977 relNWU_q0p0234 0.00 1535.977 FORMAT "%8.3" /end CHARACTERISTIC
/begin CHARACTERISTIC DSCHED_AsgnCheck.FID_AFRA_C "" VALUE 0x800413FE Val_Wu16 211. DFC_Verb 0.00 211. FORMAT "%2.0" /end CHARACTERISTIC
/begin CHARACTERISTIC DSCHED_AsgnCheck.FID_AORA_C "" VALUE 0x80041400 Val_Wu16 211. DFC_Verb 0.00 211. FORMAT "%2.0" /end CHARACTERISTIC
/begin CHARACTERISTIC DSCHED_AsgnCheck.FID_ATEH_C "" VALUE 0x80041402 Val_Wu16 211. DFC_Verb 0.00 211. FORMAT "%2.0" /end CHARACTERISTIC
/begin CHARACTERISTIC DSCHED_AsgnCheck.FID_ATEL_C "" VALUE 0x80041404 Val_Wu16 211. DFC_Verb 0.00 211. FORMAT "%2.0" /end CHARACTERISTIC
/begin CHARACTERISTIC DSCHED_AsgnCheck.FID_ATEN_C "" VALUE 0x80041406 Val_Wu16 211. DFC_Verb 0.00 211. FORMAT "%2.0" /end CHARACTERISTIC
/begin CHARACTERISTIC DSCHED_AsgnCheck.FId_InhibitAlways_C "" VALUE 0x80041408 Val_Wu16 211. DFC_Verb 0.00 211. FORMAT "%2.0" /end CHARACTERISTIC
/begin CHARACTERISTIC DSCHED_AsgnCheck.FID_BLLRH_C "" VALUE 0x8004140A Val_Wu16 211. DFC_Verb 0.00 211. FORMAT "%2.0" /end CHARACTERISTIC
/begin CHARACTERISTIC DSCHED_AsgnCheck.FID_BLLRKH_C "" VALUE 0x8004140C Val_Wu16 211. DFC_Verb 0.00 211. FORMAT "%2.0" /end CHARACTERISTIC
/begin CHARACTERISTIC DSCHED_AsgnCheck.FID_BMDFON_C "" VALUE 0x8004140E Val_Wu16 211. DFC_Verb 0.00 211. FORMAT "%2.0" /end CHARACTERISTIC
/begin CHARACTERISTIC DSCHED_AsgnCheck.FId_TWCCTrimB1_C "" VALUE 0x80041410 Val_Wu16 211. DFC_Verb 0.00 211. FORMAT "%2.0" /end CHARACTERISTIC
/begin CHARACTERISTIC DSCHED_AsgnCheck.FId_TWCDPriCatB1_C "" VALUE 0x80041412 Val_Wu16 211. DFC_Verb 0.00 211. FORMAT "%2.0" /end CHARACTERISTIC
/begin CHARACTERISTIC DSCHED_BsPrio.FID_AFRA_C "" VALUE 0x80041414 Val_Wu16 8191.000 DFC_OneToOne 0.00 8191.000 FORMAT "%8.3" /end CHARACTERISTIC
/begin CHARACTERISTIC DSCHED_BsPrio.FID_AORA_C "" VALUE 0x80041416 Val_Wu16 8191.000 DFC_OneToOne 0.00 8191.000 FORMAT "%8.3" /end CHARACTERISTIC
/begin CHARACTERISTIC DSCHED_BsPrio.FID_ATEH_C "" VALUE 0x80041418 Val_Wu16 8191.000 DFC_OneToOne 0.00 8191.000 FORMAT "%8.3" /end CHARACTERISTIC
/begin CHARACTERISTIC DSCHED_BsPrio.FID_ATEL_C "" VALUE 0x8004141A Val_Wu16 8191.000 DFC_OneToOne 0.00 8191.000 FORMAT "%8.3" /end CHARACTERISTIC
/begin CHARACTERISTIC DSCHED_BsPrio.FID_ATEN_C "" VALUE 0x8004141C Val_Wu16 8191.000 DFC_OneToOne 0.00 8191.000 FORMAT "%8.3" /end CHARACTERISTIC
/begin CHARACTERISTIC DSCHED_BsPrio.FId_InhibitAlways_C "" VALUE 0x8004141E Val_Wu16 8191.000 DFC_OneToOne 0.00 8191.000 FORMAT "%8.3" /end CHARACTERISTIC
/begin CHARACTERISTIC DSCHED_BsPrio.FID_BLLRH_C "" VALUE 0x80041420 Val_Wu16 8191.000 DFC_OneToOne 0.00 8191.000 FORMAT "%8.3" /end CHARACTERISTIC
/begin CHARACTERISTIC DSCHED_BsPrio.FID_BLLRKH_C "" VALUE 0x80041422 Val_Wu16 8191.000 DFC_OneToOne 0.00 8191.000 FORMAT "%8.3" /end CHARACTERISTIC
/begin CHARACTERISTIC DSCHED_BsPrio.FID_BMDFON_C "" VALUE 0x80041424 Val_Wu16 8191.000 DFC_OneToOne 0.00 8191.000 FORMAT "%8.3" /end CHARACTERISTIC
/begin CHARACTERISTIC DSCHED_BsPrio.FId_TWCCTrimB1_C "" VALUE 0x80041426 Val_Wu16 8191.000 DFC_OneToOne 0.00 8191.000 FORMAT "%8.3" /end CHARACTERISTIC
/begin CHARACTERISTIC DSCHED_BsPrio.FId_TWCDPriCatB1_C "" VALUE 0x80041428 Val_Wu16 8191.000 DFC_OneToOne 0.00 8191.000 FORMAT "%8.3" /end CHARACTERISTIC
/begin CHARACTERISTIC DSCHED_Excl.AFRA_AORA_C "" VALUE 0x80040D08 Val_Wu8 255.0 DFC_OneToOne 0.00 255.0 FORMAT "%5.1" /end CHARACTERISTIC
/begin CHARACTERISTIC DSCHED_Excl.AFRA_ATEH_C "" VALUE 0x80040D09 Val_Wu8 255.0 DFC_OneToOne 0.00 255.0 FORMAT "%5.1" /end CHARACTERISTIC
/begin CHARACTERISTIC DSCHED_Excl.AFRA_ATEL_C "" VALUE 0x80040D0A Val_Wu8 255.0 DFC_OneToOne 0.00 255.0 FORMAT "%5.1" /end CHARACTERISTIC
/begin CHARACTERISTIC DSCHED_Excl.AFRA_ATEN_C "" VALUE 0x80040D0B Val_Wu8 255.0 DFC_OneToOne 0.00 255.0 FORMAT "%5.1" /end CHARACTERISTIC
/begin CHARACTERISTIC DSCHED_Excl.AFRA_InhibitAlways_C "" VALUE 0x80040D0C Val_Wu8 255.0 DFC_OneToOne 0.00 255.0 FORMAT "%5.1" /end CHARACTERISTIC
/begin CHARACTERISTIC DSCHED_Excl.AFRA_BLLRH_C "" VALUE 0x80040D0D Val_Wu8 255.0 DFC_OneToOne 0.00 255.0 FORMAT "%5.1" /end CHARACTERISTIC
/begin CHARACTERISTIC DSCHED_Excl.AFRA_BLLRKH_C "" VALUE 0x80040D0E Val_Wu8 255.0 DFC_OneToOne 0.00 255.0 FORMAT "%5.1" /end CHARACTERISTIC
/begin CHARACTERISTIC DSCHED_Excl.AFRA_BMDFON_C "" VALUE 0x80040D0F Val_Wu8 255.0 DFC_OneToOne 0.00 255.0 FORMAT "%5.1" /end CHARACTERISTIC
/begin CHARACTERISTIC DSCHED_Excl.AFRA_TWCCTrimB1_C "" VALUE 0x80040D10 Val_Wu8 255.0 DFC_OneToOne 0.00 255.0 FORMAT "%5.1" /end CHARACTERISTIC
/begin CHARACTERISTIC DSCHED_Excl.AFRA_TWCDPriCatB1_C "" VALUE 0x80040D11 Val_Wu8 255.0 DFC_OneToOne 0.00 255.0 FORMAT "%5.1" /end CHARACTERISTIC
/begin CHARACTERISTIC DSCHED_Excl.AORA_ATEH_C "" VALUE 0x80040D12 Val_Wu8 255.0 DFC_OneToOne 0.00 255.0 FORMAT "%5.1" /end CHARACTERISTIC
/begin CHARACTERISTIC DSCHED_Excl.AORA_ATEL_C "" VALUE 0x80040D13 Val_Wu8 255.0 DFC_OneToOne 0.00 255.0 FORMAT "%5.1" /end CHARACTERISTIC
/begin CHARACTERISTIC DSCHED_Excl.AORA_ATEN_C "" VALUE 0x80040D14 Val_Wu8 255.0 DFC_OneToOne 0.00 255.0 FORMAT "%5.1" /end CHARACTERISTIC
/begin CHARACTERISTIC DSCHED_Excl.AORA_InhibitAlways_C "" VALUE 0x80040D15 Val_Wu8 255.0 DFC_OneToOne 0.00 255.0 FORMAT "%5.1" /end CHARACTERISTIC
/begin CHARACTERISTIC DSCHED_Excl.AORA_BLLRH_C "" VALUE 0x80040D16 Val_Wu8 255.0 DFC_OneToOne 0.00 255.0 FORMAT "%5.1" /end CHARACTERISTIC
/begin CHARACTERISTIC DSCHED_Excl.AORA_BLLRKH_C "" VALUE 0x80040D17 Val_Wu8 255.0 DFC_OneToOne 0.00 255.0 FORMAT "%5.1" /end CHARACTERISTIC
/begin CHARACTERISTIC DSCHED_Excl.AORA_BMDFON_C "" VALUE 0x80040D18 Val_Wu8 255.0 DFC_OneToOne 0.00 255.0 FORMAT "%5.1" /end CHARACTERISTIC
/begin CHARACTERISTIC DSCHED_Excl.AORA_TWCCTrimB1_C "" VALUE 0x80040D19 Val_Wu8 255.0 DFC_OneToOne 0.00 255.0 FORMAT "%5.1" /end CHARACTERISTIC
/begin CHARACTERISTIC DSCHED_Excl.AORA_TWCDPriCatB1_C "" VALUE 0x80040D1A Val_Wu8 255.0 DFC_OneToOne 0.00 255.0 FORMAT "%5.1" /end CHARACTERISTIC
/begin CHARACTERISTIC DSCHED_Excl.ATEH_ATEL_C "" VALUE 0x80040D1B Val_Wu8 255.0 DFC_OneToOne 0.00 255.0 FORMAT "%5.1" /end CHARACTERISTIC
/begin CHARACTERISTIC DSCHED_Excl.ATEH_ATEN_C "" VALUE 0x80040D1C Val_Wu8 255.0 DFC_OneToOne 0.00 255.0 FORMAT "%5.1" /end CHARACTERISTIC
/begin CHARACTERISTIC DSCHED_Excl.ATEH_InhibitAlways_C "" VALUE 0x80040D1D Val_Wu8 255.0 DFC_OneToOne 0.00 255.0 FORMAT "%5.1" /end CHARACTERISTIC
/begin CHARACTERISTIC DSCHED_Excl.ATEH_BLLRH_C "" VALUE 0x80040D1E Val_Wu8 255.0 DFC_OneToOne 0.00 255.0 FORMAT "%5.1" /end CHARACTERISTIC
/begin CHARACTERISTIC DSCHED_Excl.ATEH_BLLRKH_C "" VALUE 0x80040D1F Val_Wu8 255.0 DFC_OneToOne 0.00 255.0 FORMAT "%5.1" /end CHARACTERISTIC
/begin CHARACTERISTIC DSCHED_Excl.ATEH_BMDFON_C "" VALUE 0x80040D20 Val_Wu8 255.0 DFC_OneToOne 0.00 255.0 FORMAT "%5.1" /end CHARACTERISTIC
/begin CHARACTERISTIC DSCHED_Excl.ATEH_TWCCTrimB1_C "" VALUE 0x80040D21 Val_Wu8 255.0 DFC_OneToOne 0.00 255.0 FORMAT "%5.1" /end CHARACTERISTIC
/begin CHARACTERISTIC DSCHED_Excl.ATEH_TWCDPriCatB1_C "" VALUE 0x80040D22 Val_Wu8 255.0 DFC_OneToOne 0.00 255.0 FORMAT "%5.1" /end CHARACTERISTIC
/begin CHARACTERISTIC DSCHED_Excl.ATEL_ATEN_C "" VALUE 0x80040D23 Val_Wu8 255.0 DFC_OneToOne 0.00 255.0 FORMAT "%5.1" /end CHARACTERISTIC
/begin CHARACTERISTIC DSCHED_Excl.ATEL_InhibitAlways_C "" VALUE 0x80040D24 Val_Wu8 255.0 DFC_OneToOne 0.00 255.0 FORMAT "%5.1" /end CHARACTERISTIC
/begin CHARACTERISTIC DSCHED_Excl.ATEL_BLLRH_C "" VALUE 0x80040D25 Val_Wu8 255.0 DFC_OneToOne 0.00 255.0 FORMAT "%5.1" /end CHARACTERISTIC
/begin CHARACTERISTIC DSCHED_Excl.ATEL_BLLRKH_C "" VALUE 0x80040D26 Val_Wu8 255.0 DFC_OneToOne 0.00 255.0 FORMAT "%5.1" /end CHARACTERISTIC
/begin CHARACTERISTIC DSCHED_Excl.ATEL_BMDFON_C "" VALUE 0x80040D27 Val_Wu8 255.0 DFC_OneToOne 0.00 255.0 FORMAT "%5.1" /end CHARACTERISTIC
/begin CHARACTERISTIC DSCHED_Excl.ATEL_TWCCTrimB1_C "" VALUE 0x80040D28 Val_Wu8 255.0 DFC_OneToOne 0.00 255.0 FORMAT "%5.1" /end CHARACTERISTIC
/begin CHARACTERISTIC DSCHED_Excl.ATEL_TWCDPriCatB1_C "" VALUE 0x80040D29 Val_Wu8 255.0 DFC_OneToOne 0.00 255.0 FORMAT "%5.1" /end CHARACTERISTIC
/begin CHARACTERISTIC DSCHED_Excl.ATEN_InhibitAlways_C "" VALUE 0x80040D2A Val_Wu8 255.0 DFC_OneToOne 0.00 255.0 FORMAT "%5.1" /end CHARACTERISTIC
/begin CHARACTERISTIC DSCHED_Excl.ATEN_BLLRH_C "" VALUE 0x80040D2B Val_Wu8 255.0 DFC_OneToOne 0.00 255.0 FORMAT "%5.1" /end CHARACTERISTIC
/begin CHARACTERISTIC DSCHED_Excl.ATEN_BLLRKH_C "" VALUE 0x80040D2C Val_Wu8 255.0 DFC_OneToOne 0.00 255.0 FORMAT "%5.1" /end CHARACTERISTIC
/begin CHARACTERISTIC DSCHED_Excl.ATEN_BMDFON_C "" VALUE 0x80040D2D Val_Wu8 255.0 DFC_OneToOne 0.00 255.0 FORMAT "%5.1" /end CHARACTERISTIC
/begin CHARACTERISTIC DSCHED_Excl.ATEN_TWCCTrimB1_C "" VALUE 0x80040D2E Val_Wu8 255.0 DFC_OneToOne 0.00 255.0 FORMAT "%5.1" /end CHARACTERISTIC
/begin CHARACTERISTIC DSCHED_Excl.ATEN_TWCDPriCatB1_C "" VALUE 0x80040D2F Val_Wu8 255.0 DFC_OneToOne 0.00 255.0 FORMAT "%5.1" /end CHARACTERISTIC
/begin CHARACTERISTIC DSCHED_Excl.InhibitAlways_BLLRH_C "" VALUE 0x80040D30 Val_Wu8 255.0 DFC_OneToOne 0.00 255.0 FORMAT "%5.1" /end CHARACTERISTIC
/begin CHARACTERISTIC DSCHED_Excl.InhibitAlways_BLLRKH_C "" VALUE 0x80040D31 Val_Wu8 255.0 DFC_OneToOne 0.00 255.0 FORMAT "%5.1" /end CHARACTERISTIC
/begin CHARACTERISTIC DSCHED_Excl.InhibitAlways_BMDFON_C "" VALUE 0x80040D32 Val_Wu8 255.0 DFC_OneToOne 0.00 255.0 FORMAT "%5.1" /end CHARACTERISTIC
/begin CHARACTERISTIC DSCHED_Excl.InhibitAlways_TWCCTrimB1_C "" VALUE 0x80040D33 Val_Wu8 255.0 DFC_OneToOne 0.00 255.0 FORMAT "%5.1" /end CHARACTERISTIC
/begin CHARACTERISTIC DSCHED_Excl.InhibitAlways_TWCDPriCatB1_C "" VALUE 0x80040D34 Val_Wu8 255.0 DFC_OneToOne 0.00 255.0 FORMAT "%5.1" /end CHARACTERISTIC
/begin CHARACTERISTIC DSCHED_Excl.BLLRH_BLLRKH_C "" VALUE 0x80040D35 Val_Wu8 255.0 DFC_OneToOne 0.00 255.0 FORMAT "%5.1" /end CHARACTERISTIC
/begin CHARACTERISTIC DSCHED_Excl.BLLRH_BMDFON_C "" VALUE 0x80040D36 Val_Wu8 255.0 DFC_OneToOne 0.00 255.0 FORMAT "%5.1" /end CHARACTERISTIC
/begin CHARACTERISTIC DSCHED_Excl.BLLRH_TWCCTrimB1_C "" VALUE 0x80040D37 Val_Wu8 255.0 DFC_OneToOne 0.00 255.0 FORMAT "%5.1" /end CHARACTERISTIC
/begin CHARACTERISTIC DSCHED_Excl.BLLRH_TWCDPriCatB1_C "" VALUE 0x80040D38 Val_Wu8 255.0 DFC_OneToOne 0.00 255.0 FORMAT "%5.1" /end CHARACTERISTIC
/begin CHARACTERISTIC DSCHED_Excl.BLLRKH_BMDFON_C "" VALUE 0x80040D39 Val_Wu8 255.0 DFC_OneToOne 0.00 255.0 FORMAT "%5.1" /end CHARACTERISTIC
/begin CHARACTERISTIC DSCHED_Excl.BLLRKH_TWCCTrimB1_C "" VALUE 0x80040D3A Val_Wu8 255.0 DFC_OneToOne 0.00 255.0 FORMAT "%5.1" /end CHARACTERISTIC
/begin CHARACTERISTIC DSCHED_Excl.BLLRKH_TWCDPriCatB1_C "" VALUE 0x80040D3B Val_Wu8 255.0 DFC_OneToOne 0.00 255.0 FORMAT "%5.1" /end CHARACTERISTIC
/begin CHARACTERISTIC DSCHED_Excl.BMDFON_TWCCTrimB1_C "" VALUE 0x80040D3C Val_Wu8 255.0 DFC_OneToOne 0.00 255.0 FORMAT "%5.1" /end CHARACTERISTIC
/begin CHARACTERISTIC DSCHED_Excl.BMDFON_TWCDPriCatB1_C "" VALUE 0x80040D3D Val_Wu8 255.0 DFC_OneToOne 0.00 255.0 FORMAT "%5.1" /end CHARACTERISTIC
/begin CHARACTERISTIC DSCHED_Excl.TWCCTrimB1_TWCDPriCatB1_C "" VALUE 0x80040D3E Val_Wu8 255.0 DFC_OneToOne 0.00 255.0 FORMAT "%5.1" /end CHARACTERISTIC
/begin CHARACTERISTIC DSCHED_FacPhys.FID_AFRA_C "" VALUE 0x8004142A Val_Wu8 255.0 DFC_OneToOne 0.00 255.0 FORMAT "%5.1" /end CHARACTERISTIC
/begin CHARACTERISTIC DSCHED_FacPhys.FID_AORA_C "" VALUE 0x8004142B Val_Wu8 255.0 DFC_OneToOne 0.00 255.0 FORMAT "%5.1" /end CHARACTERISTIC
/begin CHARACTERISTIC DSCHED_FacPhys.FID_ATEH_C "" VALUE 0x8004142C Val_Wu8 255.0 DFC_OneToOne 0.00 255.0 FORMAT "%5.1" /end CHARACTERISTIC
/begin CHARACTERISTIC DSCHED_FacPhys.FID_ATEL_C "" VALUE 0x8004142D Val_Wu8 255.0 DFC_OneToOne 0.00 255.0 FORMAT "%5.1" /end CHARACTERISTIC
/begin CHARACTERISTIC DSCHED_FacPhys.FID_ATEN_C "" VALUE 0x8004142E Val_Wu8 255.0 DFC_OneToOne 0.00 255.0 FORMAT "%5.1" /end CHARACTERISTIC
/begin CHARACTERISTIC DSCHED_FacPhys.FId_InhibitAlways_C "" VALUE 0x8004142F Val_Wu8 255.0 DFC_OneToOne 0.00 255.0 FORMAT "%5.1" /end CHARACTERISTIC
/begin CHARACTERISTIC DSCHED_FacPhys.FID_BLLRH_C "" VALUE 0x80041430 Val_Wu8 255.0 DFC_OneToOne 0.00 255.0 FORMAT "%5.1" /end CHARACTERISTIC
/begin CHARACTERISTIC DSCHED_FacPhys.FID_BLLRKH_C "" VALUE 0x80041431 Val_Wu8 255.0 DFC_OneToOne 0.00 255.0 FORMAT "%5.1" /end CHARACTERISTIC
/begin CHARACTERISTIC DSCHED_FacPhys.FID_BMDFON_C "" VALUE 0x80041432 Val_Wu8 255.0 DFC_OneToOne 0.00 255.0 FORMAT "%5.1" /end CHARACTERISTIC
/begin CHARACTERISTIC DSCHED_FacPhys.FId_TWCCTrimB1_C "" VALUE 0x80041433 Val_Wu8 255.0 DFC_OneToOne 0.00 255.0 FORMAT "%5.1" /end CHARACTERISTIC
/begin CHARACTERISTIC DSCHED_FacPhys.FId_TWCDPriCatB1_C "" VALUE 0x80041434 Val_Wu8 255.0 DFC_OneToOne 0.00 255.0 FORMAT "%5.1" /end CHARACTERISTIC
/begin CHARACTERISTIC DSCHED_idxWTTEnd_C "" VALUE 0x80041436 Val_Wu8 255.0 DINH_OneToOne 0.00 255.0 FORMAT "%5.1" /end CHARACTERISTIC
/begin CHARACTERISTIC DSCHED_idxWTTStrt_C "" VALUE 0x80041437 Val_Wu8 255.0 DINH_OneToOne 0.00 255.0 FORMAT "%5.1" /end CHARACTERISTIC
/begin CHARACTERISTIC DSCHED_JmpActvPrio.FID_AFRA_C "" VALUE 0x80041438 Val_Wu16 8191.000 DFC_OneToOne 0.00 8191.000 FORMAT "%8.3" /end CHARACTERISTIC
/begin CHARACTERISTIC DSCHED_JmpActvPrio.FID_AORA_C "" VALUE 0x8004143A Val_Wu16 8191.000 DFC_OneToOne 0.00 8191.000 FORMAT "%8.3" /end CHARACTERISTIC
/begin CHARACTERISTIC DSCHED_JmpActvPrio.FID_ATEH_C "" VALUE 0x8004143C Val_Wu16 8191.000 DFC_OneToOne 0.00 8191.000 FORMAT "%8.3" /end CHARACTERISTIC
/begin CHARACTERISTIC DSCHED_JmpActvPrio.FID_ATEL_C "" VALUE 0x8004143E Val_Wu16 8191.000 DFC_OneToOne 0.00 8191.000 FORMAT "%8.3" /end CHARACTERISTIC
/begin CHARACTERISTIC DSCHED_JmpActvPrio.FID_ATEN_C "" VALUE 0x80041440 Val_Wu16 8191.000 DFC_OneToOne 0.00 8191.000 FORMAT "%8.3" /end CHARACTERISTIC
/begin CHARACTERISTIC DSCHED_JmpActvPrio.FId_InhibitAlways_C "" VALUE 0x80041442 Val_Wu16 8191.000 DFC_OneToOne 0.00 8191.000 FORMAT "%8.3" /end CHARACTERISTIC
/begin CHARACTERISTIC DSCHED_JmpActvPrio.FID_BLLRH_C "" VALUE 0x80041444 Val_Wu16 8191.000 DFC_OneToOne 0.00 8191.000 FORMAT "%8.3" /end CHARACTERISTIC
/begin CHARACTERISTIC DSCHED_JmpActvPrio.FID_BLLRKH_C "" VALUE 0x80041446 Val_Wu16 8191.000 DFC_OneToOne 0.00 8191.000 FORMAT "%8.3" /end CHARACTERISTIC
/begin CHARACTERISTIC DSCHED_JmpActvPrio.FID_BMDFON_C "" VALUE 0x80041448 Val_Wu16 8191.000 DFC_OneToOne 0.00 8191.000 FORMAT "%8.3" /end CHARACTERISTIC
/begin CHARACTERISTIC DSCHED_JmpActvPrio.FId_TWCCTrimB1_C "" VALUE 0x8004144A Val_Wu16 8191.000 DFC_OneToOne 0.00 8191.000 FORMAT "%8.3" /end CHARACTERISTIC
/begin CHARACTERISTIC DSCHED_JmpActvPrio.FId_TWCDPriCatB1_C "" VALUE 0x8004144C Val_Wu16 8191.000 DFC_OneToOne 0.00 8191.000 FORMAT "%8.3" /end CHARACTERISTIC
/begin CHARACTERISTIC DSCHED_SetPointRateActv.FID_AFRA_C "" VALUE 0x8004144E Val_Wu16 13107.00 DSCHED_Time200ms 0.00 13107.00 FORMAT "%8.2" /end CHARACTERISTIC
/begin CHARACTERISTIC DSCHED_SetPointRateActv.FID_AORA_C "" VALUE 0x80041450 Val_Wu16 13107.00 DSCHED_Time200ms 0.00 13107.00 FORMAT "%8.2" /end CHARACTERISTIC
/begin CHARACTERISTIC DSCHED_SetPointRateActv.FID_ATEH_C "" VALUE 0x80041452 Val_Wu16 13107.00 DSCHED_Time200ms 0.00 13107.00 FORMAT "%8.2" /end CHARACTERISTIC
/begin CHARACTERISTIC DSCHED_SetPointRateActv.FID_ATEL_C "" VALUE 0x80041454 Val_Wu16 13107.00 DSCHED_Time200ms 0.00 13107.00 FORMAT "%8.2" /end CHARACTERISTIC
/begin CHARACTERISTIC DSCHED_SetPointRateActv.FID_ATEN_C "" VALUE 0x80041456 Val_Wu16 13107.00 DSCHED_Time200ms 0.00 13107.00 FORMAT "%8.2" /end CHARACTERISTIC
/begin CHARACTERISTIC DSCHED_SetPointRateActv.FId_InhibitAlways_C "" VALUE 0x80041458 Val_Wu16 13107.00 DSCHED_Time200ms 0.00 13107.00 FORMAT "%8.2" /end CHARACTERISTIC
/begin CHARACTERISTIC DSCHED_SetPointRateActv.FID_BLLRH_C "" VALUE 0x8004145A Val_Wu16 13107.00 DSCHED_Time200ms 0.00 13107.00 FORMAT "%8.2" /end CHARACTERISTIC
/begin CHARACTERISTIC DSCHED_SetPointRateActv.FID_BLLRKH_C "" VALUE 0x8004145C Val_Wu16 13107.00 DSCHED_Time200ms 0.00 13107.00 FORMAT "%8.2" /end CHARACTERISTIC
/begin CHARACTERISTIC DSCHED_SetPointRateActv.FID_BMDFON_C "" VALUE 0x8004145E Val_Wu16 13107.00 DSCHED_Time200ms 0.00 13107.00 FORMAT "%8.2" /end CHARACTERISTIC
/begin CHARACTERISTIC DSCHED_SetPointRateActv.FId_TWCCTrimB1_C "" VALUE 0x80041460 Val_Wu16 13107.00 DSCHED_Time200ms 0.00 13107.00 FORMAT "%8.2" /end CHARACTERISTIC
/begin CHARACTERISTIC DSCHED_SetPointRateActv.FId_TWCDPriCatB1_C "" VALUE 0x80041462 Val_Wu16 13107.00 DSCHED_Time200ms 0.00 13107.00 FORMAT "%8.2" /end CHARACTERISTIC
/begin CHARACTERISTIC DSCHED_SetPointRatePas.FID_AFRA_C "" VALUE 0x80041464 Val_Wu16 13107.00 DSCHED_Time200ms 0.00 13107.00 FORMAT "%8.2" /end CHARACTERISTIC
/begin CHARACTERISTIC DSCHED_SetPointRatePas.FID_AORA_C "" VALUE 0x80041466 Val_Wu16 13107.00 DSCHED_Time200ms 0.00 13107.00 FORMAT "%8.2" /end CHARACTERISTIC
/begin CHARACTERISTIC DSCHED_SetPointRatePas.FID_ATEH_C "" VALUE 0x80041468 Val_Wu16 13107.00 DSCHED_Time200ms 0.00 13107.00 FORMAT "%8.2" /end CHARACTERISTIC
/begin CHARACTERISTIC DSCHED_SetPointRatePas.FID_ATEL_C "" VALUE 0x8004146A Val_Wu16 13107.00 DSCHED_Time200ms 0.00 13107.00 FORMAT "%8.2" /end CHARACTERISTIC
/begin CHARACTERISTIC DSCHED_SetPointRatePas.FID_ATEN_C "" VALUE 0x8004146C Val_Wu16 13107.00 DSCHED_Time200ms 0.00 13107.00 FORMAT "%8.2" /end CHARACTERISTIC
/begin CHARACTERISTIC DSCHED_SetPointRatePas.FId_InhibitAlways_C "" VALUE 0x8004146E Val_Wu16 13107.00 DSCHED_Time200ms 0.00 13107.00 FORMAT "%8.2" /end CHARACTERISTIC
/begin CHARACTERISTIC DSCHED_SetPointRatePas.FID_BLLRH_C "" VALUE 0x80041470 Val_Wu16 13107.00 DSCHED_Time200ms 0.00 13107.00 FORMAT "%8.2" /end CHARACTERISTIC
/begin CHARACTERISTIC DSCHED_SetPointRatePas.FID_BLLRKH_C "" VALUE 0x80041472 Val_Wu16 13107.00 DSCHED_Time200ms 0.00 13107.00 FORMAT "%8.2" /end CHARACTERISTIC
/begin CHARACTERISTIC DSCHED_SetPointRatePas.FID_BMDFON_C "" VALUE 0x80041474 Val_Wu16 13107.00 DSCHED_Time200ms 0.00 13107.00 FORMAT "%8.2" /end CHARACTERISTIC
/begin CHARACTERISTIC DSCHED_SetPointRatePas.FId_TWCCTrimB1_C "" VALUE 0x80041476 Val_Wu16 13107.00 DSCHED_Time200ms 0.00 13107.00 FORMAT "%8.2" /end CHARACTERISTIC
/begin CHARACTERISTIC DSCHED_SetPointRatePas.FId_TWCDPriCatB1_C "" VALUE 0x80041478 Val_Wu16 13107.00 DSCHED_Time200ms 0.00 13107.00 FORMAT "%8.2" /end CHARACTERISTIC
/begin CHARACTERISTIC DSCHED_stMode_C "" VALUE 0x80041578 Val_Wu8 255.0 DINH_OneToOne 0.00 255.0 FORMAT "%5.1" /end CHARACTERISTIC
/begin CHARACTERISTIC DSCHED_tiWTT_CA "" VAL_BLK 0x8004147A ValA_Wu16 6553.500 DSCHED_Time100ms 0.00 6553.500 FORMAT "%8.3" NUMBER 50 /end CHARACTERISTIC
/begin CHARACTERISTIC DSCHED_UpLimRateLow.FID_AFRA_C "" VALUE 0x800414DE Val_Wu16 8191.000 DFC_OneToOne 0.00 8191.000 FORMAT "%8.3" /end CHARACTERISTIC
/begin CHARACTERISTIC DSCHED_UpLimRateLow.FID_AORA_C "" VALUE 0x800414E0 Val_Wu16 8191.000 DFC_OneToOne 0.00 8191.000 FORMAT "%8.3" /end CHARACTERISTIC
/begin CHARACTERISTIC DSCHED_UpLimRateLow.FID_ATEH_C "" VALUE 0x800414E2 Val_Wu16 8191.000 DFC_OneToOne 0.00 8191.000 FORMAT "%8.3" /end CHARACTERISTIC
/begin CHARACTERISTIC DSCHED_UpLimRateLow.FID_ATEL_C "" VALUE 0x800414E4 Val_Wu16 8191.000 DFC_OneToOne 0.00 8191.000 FORMAT "%8.3" /end CHARACTERISTIC
/begin CHARACTERISTIC DSCHED_UpLimRateLow.FID_ATEN_C "" VALUE 0x800414E6 Val_Wu16 8191.000 DFC_OneToOne 0.00 8191.000 FORMAT "%8.3" /end CHARACTERISTIC
/begin CHARACTERISTIC DSCHED_UpLimRateLow.FId_InhibitAlways_C "" VALUE 0x800414E8 Val_Wu16 8191.000 DFC_OneToOne 0.00 8191.000 FORMAT "%8.3" /end CHARACTERISTIC
/begin CHARACTERISTIC DSCHED_UpLimRateLow.FID_BLLRH_C "" VALUE 0x800414EA Val_Wu16 8191.000 DFC_OneToOne 0.00 8191.000 FORMAT "%8.3" /end CHARACTERISTIC
/begin CHARACTERISTIC DSCHED_UpLimRateLow.FID_BLLRKH_C "" VALUE 0x800414EC Val_Wu16 8191.000 DFC_OneToOne 0.00 8191.000 FORMAT "%8.3" /end CHARACTERISTIC
/begin CHARACTERISTIC DSCHED_UpLimRateLow.FID_BMDFON_C "" VALUE 0x800414EE Val_Wu16 8191.000 DFC_OneToOne 0.00 8191.000 FORMAT "%8.3" /end CHARACTERISTIC
/begin CHARACTERISTIC DSCHED_UpLimRateLow.FId_TWCCTrimB1_C "" VALUE 0x800414F0 Val_Wu16 8191.000 DFC_OneToOne 0.00 8191.000 FORMAT "%8.3" /end CHARACTERISTIC
/begin CHARACTERISTIC DSCHED_UpLimRateLow.FId_TWCDPriCatB1_C "" VALUE 0x800414F2 Val_Wu16 8191.000 DFC_OneToOne 0.00 8191.000 FORMAT "%8.3" /end CHARACTERISTIC
/begin CHARACTERISTIC DSCHED_UpLimRateOk.FID_AFRA_C "" VALUE 0x800414F4 Val_Wu16 8191.000 DFC_OneToOne 0.00 8191.000 FORMAT "%8.3" /end CHARACTERISTIC
/begin CHARACTERISTIC DSCHED_UpLimRateOk.FID_AORA_C "" VALUE 0x800414F6 Val_Wu16 8191.000 DFC_OneToOne 0.00 8191.000 FORMAT "%8.3" /end CHARACTERISTIC
/begin CHARACTERISTIC DSCHED_UpLimRateOk.FID_ATEH_C "" VALUE 0x800414F8 Val_Wu16 8191.000 DFC_OneToOne 0.00 8191.000 FORMAT "%8.3" /end CHARACTERISTIC
/begin CHARACTERISTIC DSCHED_UpLimRateOk.FID_ATEL_C "" VALUE 0x800414FA Val_Wu16 8191.000 DFC_OneToOne 0.00 8191.000 FORMAT "%8.3" /end CHARACTERISTIC
/begin CHARACTERISTIC DSCHED_UpLimRateOk.FID_ATEN_C "" VALUE 0x800414FC Val_Wu16 8191.000 DFC_OneToOne 0.00 8191.000 FORMAT "%8.3" /end CHARACTERISTIC
/begin CHARACTERISTIC DSCHED_UpLimRateOk.FId_InhibitAlways_C "" VALUE 0x800414FE Val_Wu16 8191.000 DFC_OneToOne 0.00 8191.000 FORMAT "%8.3" /end CHARACTERISTIC
/begin CHARACTERISTIC DSCHED_UpLimRateOk.FID_BLLRH_C "" VALUE 0x80041500 Val_Wu16 8191.000 DFC_OneToOne 0.00 8191.000 FORMAT "%8.3" /end CHARACTERISTIC
/begin CHARACTERISTIC DSCHED_UpLimRateOk.FID_BLLRKH_C "" VALUE 0x80041502 Val_Wu16 8191.000 DFC_OneToOne 0.00 8191.000 FORMAT "%8.3" /end CHARACTERISTIC
/begin CHARACTERISTIC DSCHED_UpLimRateOk.FID_BMDFON_C "" VALUE 0x80041504 Val_Wu16 8191.000 DFC_OneToOne 0.00 8191.000 FORMAT "%8.3" /end CHARACTERISTIC
/begin CHARACTERISTIC DSCHED_UpLimRateOk.FId_TWCCTrimB1_C "" VALUE 0x80041506 Val_Wu16 8191.000 DFC_OneToOne 0.00 8191.000 FORMAT "%8.3" /end CHARACTERISTIC
/begin CHARACTERISTIC DSCHED_UpLimRateOk.FId_TWCDPriCatB1_C "" VALUE 0x80041508 Val_Wu16 8191.000 DFC_OneToOne 0.00 8191.000 FORMAT "%8.3" /end CHARACTERISTIC
/begin CHARACTERISTIC DSCHED_valDflOpMode_C "" VALUE 0x8004157A Val_Wu16 65535.00 DINH_OneToOne 0.00 65535.00 FORMAT "%8.2" /end CHARACTERISTIC
/begin CHARACTERISTIC DSCHED_valOfsPrioOpMode_C "" VALUE 0x8004150A Val_Wu16 65535.00 DINH_OneToOne 0.00 65535.00 FORMAT "%8.2" /end CHARACTERISTIC
/begin CHARACTERISTIC DSCHED_valOfsPrioTst_C "" VALUE 0x8004150C Val_Wu16 65535.00 DINH_OneToOne 0.00 65535.00 FORMAT "%8.2" /end CHARACTERISTIC
/begin CHARACTERISTIC DSCHED_xFctTstFId_CA "" VAL_BLK 0x8004150E ValA_Wu8 11. DSCHED_FIdVerb 0.00 11. FORMAT "%2.0" NUMBER 5 /end CHARACTERISTIC
/begin CHARACTERISTIC DSCHED_xWTTFId_CA "" VAL_BLK 0x80041514 ValA_Wu16 32779. DSCHED_FIdWTTVerb 0.00 32779. FORMAT "%2.0" NUMBER 50 /end CHARACTERISTIC
/begin CHARACTERISTIC DTDOTMCSMN "" VALUE 0x80044E49 KwWU8 191.3 temp_q0p75 0.00 191.3 FORMAT "%5.1" /end CHARACTERISTIC
/begin CHARACTERISTIC DTDOTMCSMX "" VALUE 0x80044E4A KwWU8 191.3 temp_q0p75 0.00 191.3 FORMAT "%5.1" /end CHARACTERISTIC
/begin CHARACTERISTIC DTMDMA "" VALUE 0x80044E99 KwWU8 191.3 temp_ub_b191p25 0.00 191.3 FORMAT "%5.1" /end CHARACTERISTIC
/begin CHARACTERISTIC DTMDNPO "" VALUE 0x80044E9A KwWU8 191.3 temp_ub_b191p25 0.00 191.3 FORMAT "%5.1" /end CHARACTERISTIC
/begin CHARACTERISTIC DTTOTMCS "" VALUE 0x80044E4B KwWU8 191.3 temp_ub_q0p75_o48 -48.00 143.3 FORMAT "%5.1" /end CHARACTERISTIC
/begin CHARACTERISTIC FAINTEN "" VALUE 0x80044CC8 KwUb 255.0 dez 0.00 255.0 FORMAT "%5.1" /end CHARACTERISTIC
/begin CHARACTERISTIC FASKIV1 "" VALUE 0x80044CC9 KwUb 4.000 dez 1.000 5.000 FORMAT "%5.3" /end CHARACTERISTIC
/begin CHARACTERISTIC FFZWKH "" VALUE 0x80044DE0 KwUb 0.9961 fak_ub_b1 0.00 0.9961 /end CHARACTERISTIC
/begin CHARACTERISTIC FHDLLR "" VALUE 0x80044382 KwWU8 3.984 fak_ub_b4 0.00 3.984 FORMAT "%5.3" /end CHARACTERISTIC
/begin CHARACTERISTIC FIAMALU "" VALUE 0x80044871 KwUb 3.984 fak_ub_b4 0.00 3.984 FORMAT "%5.3" /end CHARACTERISTIC
/begin CHARACTERISTIC FIMALU "" VALUE 0x80044872 KwUw 0.9999847 fak_uw_b1 0.00 0.9999847 FORMAT "%9.7" /end CHARACTERISTIC
/begin CHARACTERISTIC FLMXOFMXKH "" VALUE 0x800445F6 KwUw 9.999847 kw_q1p5259eEm4_om5 -5.000000 4.999847 FORMAT "%8.6" /end CHARACTERISTIC
/begin CHARACTERISTIC FLUTSRTIOF "" VALUE 0x800443B0 KwUw 0.9999847 fak_uw_b1 0.00 0.9999847 FORMAT "%9.7" /end CHARACTERISTIC
/begin CHARACTERISTIC FOFAKT "" VALUE 0x800445F8 KwUb 255.0 dez 0.00 255.0 FORMAT "%5.1" /end CHARACTERISTIC
/begin CHARACTERISTIC FOFPLAUS "" VALUE 0x800445FA KwUw 9.999847 kw_q1p5259eEm4_om5 -5.000000 4.999847 FORMAT "%8.6" /end CHARACTERISTIC
/begin CHARACTERISTIC FOFPLAUSKH "" VALUE 0x800445FC KwUw 9.999847 kw_q1p5259eEm4_om5 -5.000000 4.999847 FORMAT "%8.6" /end CHARACTERISTIC
/begin CHARACTERISTIC FOFSMPEOL "" VALUE 0x800445FE KwUb 8.000 dez 3.000 11.00 FORMAT "%5.2" /end CHARACTERISTIC
/begin CHARACTERISTIC FRADN "" VALUE 0x80044358 KwWU16 1.999969 fak_uw_b2 0.00 1.999969 FORMAT "%8.6" /end CHARACTERISTIC
/begin CHARACTERISTIC FRADNFA "" VALUE 0x8004435A KwWU16 1.999969 fak_uw_b2 0.00 1.999969 FORMAT "%8.6" /end CHARACTERISTIC
/begin CHARACTERISTIC FRADX "" VALUE 0x8004435C KwWU16 1.999969 fak_uw_b2 0.00 1.999969 FORMAT "%8.6" /end CHARACTERISTIC
/begin CHARACTERISTIC FRADXFA "" VALUE 0x8004435E KwWU16 1.999969 fak_uw_b2 0.00 1.999969 FORMAT "%8.6" /end CHARACTERISTIC
/begin CHARACTERISTIC FS1FOFDEC "" VALUE 0x80044600 KwUw 0.9999847 fak_uw_b1 0.00 0.9999847 FORMAT "%9.7" /end CHARACTERISTIC
/begin CHARACTERISTIC FS1FOFKH "" VALUE 0x80044602 KwUw 0.9999847 fak_uw_b1 0.00 0.9999847 FORMAT "%9.7" /end CHARACTERISTIC
/begin CHARACTERISTIC FS1FOFO "" VALUE 0x80044604 KwUw 0.9999847 fak_uw_b1 0.00 0.9999847 FORMAT "%9.7" /end CHARACTERISTIC
/begin CHARACTERISTIC FS1FOFU "" VALUE 0x80044606 KwUw 0.9999847 fak_uw_b1 0.00 0.9999847 FORMAT "%9.7" /end CHARACTERISTIC
/begin CHARACTERISTIC FSEOFPLAUSKH "" VALUE 0x80044608 KwUw 9.999847 kw_q1p5259eEm4_om5 -5.000000 4.999847 FORMAT "%8.6" /end CHARACTERISTIC
/begin CHARACTERISTIC FSMXPLCNT "" VALUE 0x800443B2 KwUb 255.0 dez 0.00 255.0 FORMAT "%5.1" /end CHARACTERISTIC
/begin CHARACTERISTIC FSRFIL "" VALUE 0x800443B4 KwUw 0.9999847 fak_uw_b1 0.00 0.9999847 FORMAT "%9.7" /end CHARACTERISTIC
/begin CHARACTERISTIC FSRPLSLVL "" CURVE 0x800443B6 KlAUwSstUwWUw 149.9984 lu_MEx 0.00 149.9984 FORMAT "%8.4"
 /begin AXIS_DESCR STD_AXIS nmotdelay_w nmot_uw_q0p25 6 0.00 16383.75 FORMAT "%8.2" DEPOSIT ABSOLUTE /end AXIS_DESCR
/end CHARACTERISTIC
/begin CHARACTERISTIC FSRPLSLVLOFFSKH "" VALUE 0x800443D0 KwSw 49.99947 lu_MEx 0.00 49.99947 FORMAT "%8.5" /end CHARACTERISTIC
/begin CHARACTERISTIC FSRSTMXSUM "" VALUE 0x800443D2 KwSw 298.0187 lu_MEx -149.0116 149.0071 FORMAT "%8.4" /end CHARACTERISTIC
/begin CHARACTERISTIC IMG_BLLRH "" VALUE 0x80044374 KwWU8 64.0000000000 iumpr_img_verbal 0.00 64.0000000000 FORMAT "%13.10" /end CHARACTERISTIC
/begin CHARACTERISTIC IMG_BLLRKH "" VALUE 0x80044375 KwWU8 64.0000000000 iumpr_img_verbal 0.00 64.0000000000 FORMAT "%13.10" /end CHARACTERISTIC
/begin CHARACTERISTIC INJ2TSDEL "" VALUE 0x80044D1E KwSb 255.0 dez -128.0 127.0 FORMAT "%5.1" /end CHARACTERISTIC
/begin CHARACTERISTIC KAMFZ "" VALUE 0x80044DE2 KwUw 655350.0 kw_tooth_sy 0.00 655350.0 FORMAT "%8.1" /end CHARACTERISTIC
/begin CHARACTERISTIC KAMFZKH "" VALUE 0x80044DE4 KwWU16 655350.0 kw_tooth_sy 0.00 655350.0 FORMAT "%8.1" /end CHARACTERISTIC
/begin CHARACTERISTIC KFAMAL "" MAP 0x80044874 GkfWUb 1.992188 fak_ub_b2 0.00 1.992188 FORMAT "%8.6"
 /begin AXIS_DESCR COM_AXIS midmd rel_ub_b99p6 8 0.00 99.61 FORMAT "%5.2" AXIS_PTS_REF SMI08DMUB /end AXIS_DESCR
 /begin AXIS_DESCR COM_AXIS nmot nmot_ub_q40 8 0.00 10200. FORMAT "%5.0" AXIS_PTS_REF SNM08DMUB /end AXIS_DESCR
/end CHARACTERISTIC
/begin CHARACTERISTIC KFAMAL1 "" MAP 0x800448B4 GkfWUb 1.992188 fak_ub_b2 0.00 1.992188 FORMAT "%8.6"
 /begin AXIS_DESCR COM_AXIS midmd rel_ub_b99p6 8 0.00 99.61 FORMAT "%5.2" AXIS_PTS_REF SMI08DMUB /end AXIS_DESCR
 /begin AXIS_DESCR COM_AXIS nmot nmot_ub_q40 8 0.00 10200. FORMAT "%5.0" AXIS_PTS_REF SNM08DMUB /end AXIS_DESCR
/end CHARACTERISTIC
/begin CHARACTERISTIC KFAMAL2 "" MAP 0x800448F4 GkfWUb 1.992188 fak_ub_b2 0.00 1.992188 FORMAT "%8.6"
 /begin AXIS_DESCR COM_AXIS midmd rel_ub_b99p6 8 0.00 99.61 FORMAT "%5.2" AXIS_PTS_REF SMI08DMUB /end AXIS_DESCR
 /begin AXIS_DESCR COM_AXIS nmot nmot_ub_q40 8 0.00 10200. FORMAT "%5.0" AXIS_PTS_REF SNM08DMUB /end AXIS_DESCR
/end CHARACTERISTIC
/begin CHARACTERISTIC KFDLUR "" MAP 0x80044444 GkfWSw 298.0187 lu_MEx -149.0116 149.0071 FORMAT "%8.4"
 /begin AXIS_DESCR COM_AXIS midmd rel_ub_b99p6 8 0.00 99.61 FORMAT "%5.2" AXIS_PTS_REF SMI08DMUB /end AXIS_DESCR
 /begin AXIS_DESCR COM_AXIS nmot nmot_ub_q40 8 0.00 10200. FORMAT "%5.0" AXIS_PTS_REF SNM08DMUB /end AXIS_DESCR
/end CHARACTERISTIC
/begin CHARACTERISTIC KFDLUR1 "" MAP 0x800444C4 GkfWSw 298.0187 lu_MEx -149.0116 149.0071 FORMAT "%8.4"
 /begin AXIS_DESCR COM_AXIS midmd rel_ub_b99p6 8 0.00 99.61 FORMAT "%5.2" AXIS_PTS_REF SMI08DMUB /end AXIS_DESCR
 /begin AXIS_DESCR COM_AXIS nmot nmot_ub_q40 8 0.00 10200. FORMAT "%5.0" AXIS_PTS_REF SNM08DMUB /end AXIS_DESCR
/end CHARACTERISTIC
/begin CHARACTERISTIC KFDLUR2 "" MAP 0x80044544 GkfWSw 298.0187 lu_MEx -149.0116 149.0071 FORMAT "%8.4"
 /begin AXIS_DESCR COM_AXIS midmd rel_ub_b99p6 8 0.00 99.61 FORMAT "%5.2" AXIS_PTS_REF SMI08DMUB /end AXIS_DESCR
 /begin AXIS_DESCR COM_AXIS nmot nmot_ub_q40 8 0.00 10200. FORMAT "%5.0" AXIS_PTS_REF SNM08DMUB /end AXIS_DESCR
/end CHARACTERISTIC
/begin CHARACTERISTIC KFDLURMI "" MAP 0x800445C4 KfAxU8AyU8SstxU16SstyU16WS16 298.0187 lu_MEx -149.0116 149.0071 FORMAT "%8.4"
 /begin AXIS_DESCR STD_AXIS midmd_w rel_uw_b100 4 0.00 99.99847 FORMAT "%8.5" DEPOSIT ABSOLUTE /end AXIS_DESCR
 /begin AXIS_DESCR STD_AXIS nmot_w nmot_uw_q0p25 3 0.00 16383.75 FORMAT "%8.2" DEPOSIT ABSOLUTE /end AXIS_DESCR
/end CHARACTERISTIC
/begin CHARACTERISTIC KFDTMRO "" MAP 0x80044E9C KfAxU8AyU8SstxU16SstyU16WU16 19.99805 temp_uw_q0p0029_o48 -9.999023 9.999023 FORMAT "%8.6"
 /begin AXIS_DESCR STD_AXIS dtmrwtumg temp_ub_q0p75_o48 4 -48.00000 143.2500 FORMAT "%8.4" DEPOSIT ABSOLUTE /end AXIS_DESCR
 /begin AXIS_DESCR STD_AXIS vfzg vfzg_ub_q1p25 4 0.00 318.7500 FORMAT "%8.4" DEPOSIT ABSOLUTE /end AXIS_DESCR
/end CHARACTERISTIC
/begin CHARACTERISTIC KFDTMRS "" MAP 0x80044ED0 KfAxU8AyU8SstxU16SstyU16WU16 19.99805 temp_uw_q0p0029_o48 -9.999023 9.999023 FORMAT "%8.6"
 /begin AXIS_DESCR STD_AXIS mll1 m_ub_b1020 5 0.00 1020.000 FORMAT "%8.3" DEPOSIT ABSOLUTE /end AXIS_DESCR
 /begin AXIS_DESCR STD_AXIS tmrw temp_ub_q0p75_o48 4 -48.00000 143.2500 FORMAT "%8.4" DEPOSIT ABSOLUTE /end AXIS_DESCR
/end CHARACTERISTIC
/begin CHARACTERISTIC KFDTMRVFZ "" MAP 0x80044F0E KfAxU8AyU8SstxU16SstyU16WU16 19.99805 temp_uw_q0p0029_o48 -9.999023 9.999023 FORMAT "%8.6"
 /begin AXIS_DESCR STD_AXIS dtmrwtumg temp_ub_q0p75_o48 4 -48.00000 143.2500 FORMAT "%8.4" DEPOSIT ABSOLUTE /end AXIS_DESCR
 /begin AXIS_DESCR STD_AXIS vfzg vfzg_ub_q1p25 6 0.00 318.7500 FORMAT "%8.4" DEPOSIT ABSOLUTE /end AXIS_DESCR
/end CHARACTERISTIC
/begin CHARACTERISTIC KFDTMTR "" MAP 0x80044F56 KfAxU8AyU8SstxU16SstyU16WU16 19.99805 temp_uw_q0p0029_o48 -9.999023 9.999023 FORMAT "%8.6"
 /begin AXIS_DESCR STD_AXIS mll1 m_ub_b1020 5 0.00 1020.000 FORMAT "%8.3" DEPOSIT ABSOLUTE /end AXIS_DESCR
 /begin AXIS_DESCR STD_AXIS tmrw temp_ub_q0p75_o48 4 -48.00000 143.2500 FORMAT "%8.4" DEPOSIT ABSOLUTE /end AXIS_DESCR
/end CHARACTERISTIC
/begin CHARACTERISTIC KFDTMTU "" MAP 0x80044F94 KfAxU8AyU8SstxU16SstyU16WU16 19.99805 temp_uw_q0p0029_o48 -9.999023 9.999023 FORMAT "%8.6"
 /begin AXIS_DESCR STD_AXIS mll1 m_ub_b1020 5 0.00 1020.000 FORMAT "%8.3" DEPOSIT ABSOLUTE /end AXIS_DESCR
 /begin AXIS_DESCR STD_AXIS tumlok temp_ub_q0p75_o48 4 -48.00000 143.2500 FORMAT "%8.4" DEPOSIT ABSOLUTE /end AXIS_DESCR
/end CHARACTERISTIC
/begin CHARACTERISTIC KFKSWF "" MAP 0x80044CCA KfAxUbAyUbSstxUbSstyUbWUb 255.0 dez 0.00 255.0 FORMAT "%5.1"
 /begin AXIS_DESCR STD_AXIS nmot nmot_ub_q40 6 0.00 10200. FORMAT "%5.0" DEPOSIT ABSOLUTE /end AXIS_DESCR
 /begin AXIS_DESCR STD_AXIS midmd rel_ub_b99p6 6 0.00 99.61 FORMAT "%5.2" DEPOSIT ABSOLUTE /end AXIS_DESCR
/end CHARACTERISTIC
/begin CHARACTERISTIC KFLUAR "" MAP 0x80044642 GkfWSw 298.0187 lu_MEx -149.0116 149.0071 FORMAT "%8.4"
 /begin AXIS_DESCR COM_AXIS midmd rel_ub_b99p6 8 0.00 99.61 FORMAT "%5.2" AXIS_PTS_REF SMI08DMUB /end AXIS_DESCR
 /begin AXIS_DESCR COM_AXIS nmot nmot_ub_q40 8 0.00 10200. FORMAT "%5.0" AXIS_PTS_REF SNM08DMUB /end AXIS_DESCR
/end CHARACTERISTIC
/begin CHARACTERISTIC KFLUAR1 "" MAP 0x800446C2 GkfWSw 298.0187 lu_MEx -149.0116 149.0071 FORMAT "%8.4"
 /begin AXIS_DESCR COM_AXIS midmd rel_ub_b99p6 8 0.00 99.61 FORMAT "%5.2" AXIS_PTS_REF SMI08DMUB /end AXIS_DESCR
 /begin AXIS_DESCR COM_AXIS nmot nmot_ub_q40 8 0.00 10200. FORMAT "%5.0" AXIS_PTS_REF SNM08DMUB /end AXIS_DESCR
/end CHARACTERISTIC
/begin CHARACTERISTIC KFLUAR2 "" MAP 0x80044742 GkfWSw 298.0187 lu_MEx -149.0116 149.0071 FORMAT "%8.4"
 /begin AXIS_DESCR COM_AXIS midmd rel_ub_b99p6 8 0.00 99.61 FORMAT "%5.2" AXIS_PTS_REF SMI08DMUB /end AXIS_DESCR
 /begin AXIS_DESCR COM_AXIS nmot nmot_ub_q40 8 0.00 10200. FORMAT "%5.0" AXIS_PTS_REF SNM08DMUB /end AXIS_DESCR
/end CHARACTERISTIC
/begin CHARACTERISTIC KFLUARMN "" MAP 0x800447C2 GkfWSw 298.0187 lu_MEx -149.0116 149.0071 FORMAT "%8.4"
 /begin AXIS_DESCR COM_AXIS midmd rel_ub_b99p6 8 0.00 99.61 FORMAT "%5.2" AXIS_PTS_REF SMI08DMUB /end AXIS_DESCR
 /begin AXIS_DESCR COM_AXIS nmot nmot_ub_q40 8 0.00 10200. FORMAT "%5.0" AXIS_PTS_REF SNM08DMUB /end AXIS_DESCR
/end CHARACTERISTIC
/begin CHARACTERISTIC KFLURB "" MAP 0x80044934 GkfWSw 298.0187 lu_MEx -149.0116 149.0071 FORMAT "%8.4"
 /begin AXIS_DESCR COM_AXIS midmd rel_ub_b99p6 8 0.00 99.61 FORMAT "%5.2" AXIS_PTS_REF SMI08DMUB /end AXIS_DESCR
 /begin AXIS_DESCR COM_AXIS nmot nmot_ub_q40 8 0.00 10200. FORMAT "%5.0" AXIS_PTS_REF SNM08DMUB /end AXIS_DESCR
/end CHARACTERISTIC
/begin CHARACTERISTIC KFLURB1 "" MAP 0x800449B4 GkfWSw 298.0187 lu_MEx -149.0116 149.0071 FORMAT "%8.4"
 /begin AXIS_DESCR COM_AXIS midmd rel_ub_b99p6 8 0.00 99.61 FORMAT "%5.2" AXIS_PTS_REF SMI08DMUB /end AXIS_DESCR
 /begin AXIS_DESCR COM_AXIS nmot nmot_ub_q40 8 0.00 10200. FORMAT "%5.0" AXIS_PTS_REF SNM08DMUB /end AXIS_DESCR
/end CHARACTERISTIC
/begin CHARACTERISTIC KFLURB2 "" MAP 0x80044A34 GkfWSw 298.0187 lu_MEx -149.0116 149.0071 FORMAT "%8.4"
 /begin AXIS_DESCR COM_AXIS midmd rel_ub_b99p6 8 0.00 99.61 FORMAT "%5.2" AXIS_PTS_REF SMI08DMUB /end AXIS_DESCR
 /begin AXIS_DESCR COM_AXIS nmot nmot_ub_q40 8 0.00 10200. FORMAT "%5.0" AXIS_PTS_REF SNM08DMUB /end AXIS_DESCR
/end CHARACTERISTIC
/begin CHARACTERISTIC KFLURM "" MAP 0x80044AB4 GkfWSw 298.0187 lu_MEx -149.0116 149.0071 FORMAT "%8.4"
 /begin AXIS_DESCR COM_AXIS midmd rel_ub_b99p6 8 0.00 99.61 FORMAT "%5.2" AXIS_PTS_REF SMI08DMUB /end AXIS_DESCR
 /begin AXIS_DESCR COM_AXIS nmot nmot_ub_q40 8 0.00 10200. FORMAT "%5.0" AXIS_PTS_REF SNM08DMUB /end AXIS_DESCR
/end CHARACTERISTIC
/begin CHARACTERISTIC KFLURM1 "" MAP 0x80044B34 GkfWSw 298.0187 lu_MEx -149.0116 149.0071 FORMAT "%8.4"
 /begin AXIS_DESCR COM_AXIS midmd rel_ub_b99p6 8 0.00 99.61 FORMAT "%5.2" AXIS_PTS_REF SMI08DMUB /end AXIS_DESCR
 /begin AXIS_DESCR COM_AXIS nmot nmot_ub_q40 8 0.00 10200. FORMAT "%5.0" AXIS_PTS_REF SNM08DMUB /end AXIS_DESCR
/end CHARACTERISTIC
/begin CHARACTERISTIC KFMISALFHO "" MAP 0x80044D20 KfAxUbAyUbSstxUbSstyUbWSb 99.60 rel_sb_q0p39 -50.00 49.61 FORMAT "%5.2"
 /begin AXIS_DESCR STD_AXIS nmot nmot_ub_q40 5 0.00 10200. FORMAT "%5.0" DEPOSIT ABSOLUTE /end AXIS_DESCR
 /begin AXIS_DESCR STD_AXIS fho fak_ub_b4 2 0.00 3.984 FORMAT "%5.3" DEPOSIT ABSOLUTE /end AXIS_DESCR
/end CHARACTERISTIC
/begin CHARACTERISTIC KFMISALTMT "" MAP 0x80044D34 KfAxUbAyUbSstxUbSstyUbWSb 99.60 rel_sb_q0p39 -50.00 49.61 FORMAT "%5.2"
 /begin AXIS_DESCR STD_AXIS nmot nmot_ub_q40 6 0.00 10200. FORMAT "%5.0" DEPOSIT ABSOLUTE /end AXIS_DESCR
 /begin AXIS_DESCR STD_AXIS tengdmd temp_ub_q0p75_o48 4 -48.00 143.3 FORMAT "%5.1" DEPOSIT ABSOLUTE /end AXIS_DESCR
/end CHARACTERISTIC
/begin CHARACTERISTIC KLADAPSMPLMN "" CURVE 0x800443D4 KlAUbSstUbWUb 255.0 dez 0.00 255.0 FORMAT "%5.1"
 /begin AXIS_DESCR STD_AXIS midmd rel_ub_b99p6 4 0.00 99.61 FORMAT "%5.2" DEPOSIT ABSOLUTE /end AXIS_DESCR
/end CHARACTERISTIC
/begin CHARACTERISTIC KLDMDSTPADP "" CURVE 0x800443DD KlAUbSstUbWUb 246.0 dez 9.000 255.0 FORMAT "%5.1"
 /begin AXIS_DESCR STD_AXIS nmot nmot_ub_q40 4 0.00 10200. FORMAT "%5.0" DEPOSIT ABSOLUTE /end AXIS_DESCR
/end CHARACTERISTIC
/begin CHARACTERISTIC KLDMWDK "" CURVE 0x80044D58 KlAUbSstUbWUb 100.0 relDK_ub_b100 0.00 100.0 FORMAT "%5.1"
 /begin AXIS_DESCR STD_AXIS nmot nmot_ub_q40 6 0.00 10200. FORMAT "%5.0" DEPOSIT ABSOLUTE /end AXIS_DESCR
/end CHARACTERISTIC
/begin CHARACTERISTIC KLDMXRLU "" CURVE 0x80044BB4 GklWSw 298.0187 lu_MEx -149.0116 149.0071 FORMAT "%8.4"
 /begin AXIS_DESCR COM_AXIS nmot nmot_ub_q40 8 0.00 10200. FORMAT "%5.0" AXIS_PTS_REF SNM08DMUB /end AXIS_DESCR
/end CHARACTERISTIC
/begin CHARACTERISTIC KLDTMFXTM "" CURVE 0x80044FD2 KlAxU8SstxU8WU8 191.3 temp_ub_b191p25 0.00 191.3 FORMAT "%5.1"
 /begin AXIS_DESCR STD_AXIS tmotlinstz temp_ub_q0p75_o48 8 -48.00 143.3 FORMAT "%5.1" DEPOSIT ABSOLUTE /end AXIS_DESCR
/end CHARACTERISTIC
/begin CHARACTERISTIC KLDTMRSUM "" CURVE 0x80044FE4 KlAxU8SstxU8WU16 19.99805 temp_uw_q0p0029_o48 -9.999023 9.999023 FORMAT "%8.6"
 /begin AXIS_DESCR STD_AXIS tumlok temp_ub_q0p75_o48 4 -48.00 143.3 FORMAT "%5.1" DEPOSIT ABSOLUTE /end AXIS_DESCR
/end CHARACTERISTIC
/begin CHARACTERISTIC KLLURSFAKPLS "" CURVE 0x800443E6 KlAUbSstUbWUb 1.992188 fak_ub_b2 0.00 1.992188 FORMAT "%8.6"
 /begin AXIS_DESCR STD_AXIS nmot nmot_ub_q40 4 0.00 10200. FORMAT "%5.0" DEPOSIT ABSOLUTE /end AXIS_DESCR
/end CHARACTERISTIC
/begin CHARACTERISTIC KLMIOFOF1 "" CURVE 0x8004460A KlAUbSstUbWUb 99.61 rel_ub_b100 0.00 99.61 FORMAT "%5.2"
 /begin AXIS_DESCR STD_AXIS nmot nmot_ub_q40 4 0.00 10200. FORMAT "%5.0" DEPOSIT ABSOLUTE /end AXIS_DESCR
/end CHARACTERISTIC
/begin CHARACTERISTIC KLMIOFOF2 "" CURVE 0x80044613 KlAUbSstUbWUb 99.61 rel_ub_b100 0.00 99.61 FORMAT "%5.2"
 /begin AXIS_DESCR STD_AXIS nmot nmot_ub_q40 4 0.00 10200. FORMAT "%5.0" DEPOSIT ABSOLUTE /end AXIS_DESCR
/end CHARACTERISTIC
/begin CHARACTERISTIC KLMISAFON1 "" CURVE 0x80044D65 GklWUb 99.61 rel_ub_b99p6 0.00 99.61 FORMAT "%5.2"
 /begin AXIS_DESCR COM_AXIS nmot nmot_ub_q40 9 0.00 10200. FORMAT "%5.0" AXIS_PTS_REF SNM09DM1UB /end AXIS_DESCR
/end CHARACTERISTIC
/begin CHARACTERISTIC KLMISAFON2 "" CURVE 0x80044D6E GklWUb 99.61 rel_ub_b99p6 0.00 99.61 FORMAT "%5.2"
 /begin AXIS_DESCR COM_AXIS nmot nmot_ub_q40 9 0.00 10200. FORMAT "%5.0" AXIS_PTS_REF SNM09DM2UB /end AXIS_DESCR
/end CHARACTERISTIC
/begin CHARACTERISTIC KLMISALULL "" CURVE 0x80044D77 GklWUb 99.61 rel_ub_b99p6 0.00 99.61 FORMAT "%5.2"
 /begin AXIS_DESCR COM_AXIS nmot nmot_ub_q40 8 0.00 10200. FORMAT "%5.0" AXIS_PTS_REF SNM08DMUB /end AXIS_DESCR
/end CHARACTERISTIC
/begin CHARACTERISTIC KLTALUST "" CURVE 0x80044D80 KlAUbSstUbWUw 6553.500 t_q0p1 0.00 6553.500 FORMAT "%8.3"
 /begin AXIS_DESCR STD_AXIS tengstdmd temp_ub_q0p75_o48 4 -48.00 143.3 FORMAT "%5.1" DEPOSIT ABSOLUTE /end AXIS_DESCR
/end CHARACTERISTIC
/begin CHARACTERISTIC KLTLUSTEOL "" CURVE 0x80044D8E KlAUbSstUbWUw 6553.500 t_q0p1 0.00 6553.500 FORMAT "%8.3"
 /begin AXIS_DESCR STD_AXIS tengstdmd temp_ub_q0p75_o48 4 -48.00 143.3 FORMAT "%5.1" DEPOSIT ABSOLUTE /end AXIS_DESCR
/end CHARACTERISTIC
/begin CHARACTERISTIC KLTMOTAB "" CURVE 0x80044E4C KlAxU8SstxU8WU16 262140.0 t_q4_s 0.00 262140.0 FORMAT "%8.1"
 /begin AXIS_DESCR STD_AXIS tmotab temp_ub_q0p75_o48 3 -48.00 143.3 FORMAT "%5.1" DEPOSIT ABSOLUTE /end AXIS_DESCR
/end CHARACTERISTIC
/begin CHARACTERISTIC KLTMRWEND "" CURVE 0x80044FF2 KlAxU8SstxU8WU8 191.3 temp_ub_q0p75_o48 -48.00 143.3 FORMAT "%5.1"
 /begin AXIS_DESCR STD_AXIS tumlok temp_ub_q0p75_o48 4 -48.00 143.3 FORMAT "%5.1" DEPOSIT ABSOLUTE /end AXIS_DESCR
/end CHARACTERISTIC
/begin CHARACTERISTIC KSWFEVE "" VALUE 0x80044CFC KwUb 255.0 dez 0.00 255.0 FORMAT "%5.1" /end CHARACTERISTIC
/begin CHARACTERISTIC KWBNMXALU "" VAL_BLK 0x80044D9C KwbUw 16383.75 nmot_uw_q0p25 0.00 16383.75 FORMAT "%8.2" NUMBER 11 /end CHARACTERISTIC
/begin CHARACTERISTIC LLVFZGZCTR "" VALUE 0x80044DE6 KwUb 12.75 t_q0p05 0.00 12.75 FORMAT "%5.2" /end CHARACTERISTIC
/begin CHARACTERISTIC LUARKHE "" CURVE 0x80044842 KlAUwSstSwWUw 1.999969 fak_uw_b2 0.00 1.999969 FORMAT "%8.6"
 /begin AXIS_DESCR STD_AXIS zwavgret zw_sw_q0p75 6 -24576.00 24575.25 FORMAT "%8.2" DEPOSIT ABSOLUTE /end AXIS_DESCR
/end CHARACTERISTIC
/begin CHARACTERISTIC LUARMI "" CURVE 0x8004485C KlAUwSstUwWSw 298.0187 lu_MEx -149.0116 149.0071 FORMAT "%8.4"
 /begin AXIS_DESCR STD_AXIS midmd_w rel_uw_b100 4 0.00 99.99847 FORMAT "%8.5" DEPOSIT ABSOLUTE /end AXIS_DESCR
/end CHARACTERISTIC
/begin CHARACTERISTIC LURBMI "" CURVE 0x80044BC4 KlAUwSstUwWSw 298.0187 lu_MEx -149.0116 149.0071 FORMAT "%8.4"
 /begin AXIS_DESCR STD_AXIS midmd_w rel_uw_b100 6 0.00 99.99847 FORMAT "%8.5" DEPOSIT ABSOLUTE /end AXIS_DESCR
/end CHARACTERISTIC
/begin CHARACTERISTIC LURBMIKH "" CURVE 0x80044BDE KlAUwSstUwWSw 298.0187 lu_MEx -149.0116 149.0071 FORMAT "%8.4"
 /begin AXIS_DESCR STD_AXIS midmd_w rel_uw_b100 6 0.00 99.99847 FORMAT "%8.5" DEPOSIT ABSOLUTE /end AXIS_DESCR
/end CHARACTERISTIC
/begin CHARACTERISTIC LURBMIKO "" CURVE 0x80044BF8 KlAUwSstUwWSw 298.0187 lu_MEx -149.0116 149.0071 FORMAT "%8.4"
 /begin AXIS_DESCR STD_AXIS midmd_w rel_uw_b100 6 0.00 99.99847 FORMAT "%8.5" DEPOSIT ABSOLUTE /end AXIS_DESCR
/end CHARACTERISTIC
/begin CHARACTERISTIC LURFOST "" VALUE 0x8004461C KwUw 298.0187 lu_MEx 0.00 298.0187 FORMAT "%8.4" /end CHARACTERISTIC
/begin CHARACTERISTIC LURKHE "" CURVE 0x80044C12 KlAUwSstSwWUw 1.999969 fak_uw_b2 0.00 1.999969 FORMAT "%8.6"
 /begin AXIS_DESCR STD_AXIS zwavgret zw_sw_q0p75 6 -24576.00 24575.25 FORMAT "%8.2" DEPOSIT ABSOLUTE /end AXIS_DESCR
/end CHARACTERISTIC
/begin CHARACTERISTIC LURKTM "" CURVE 0x80044C2C KlAUwSstUwWSw 298.0187 lu_MEx -149.0116 149.0071 FORMAT "%8.4"
 /begin AXIS_DESCR STD_AXIS tengdmd temp_ub_q0p75_o48 8 -48.00 49103. FORMAT "%5.0" DEPOSIT ABSOLUTE /end AXIS_DESCR
/end CHARACTERISTIC
/begin CHARACTERISTIC LURMIN1 "" CURVE 0x80044C4E GklWSw 298.0187 lu_MEx -149.0116 149.0071 FORMAT "%8.4"
 /begin AXIS_DESCR COM_AXIS nmot nmot_ub_q40 8 0.00 10200. FORMAT "%5.0" AXIS_PTS_REF SNM08DMUB /end AXIS_DESCR
/end CHARACTERISTIC
/begin CHARACTERISTIC LURMIN2 "" CURVE 0x80044C5E GklWSw 298.0187 lu_MEx -149.0116 149.0071 FORMAT "%8.4"
 /begin AXIS_DESCR COM_AXIS nmot nmot_ub_q40 8 0.00 10200. FORMAT "%5.0" AXIS_PTS_REF SNM08DMUB /end AXIS_DESCR
/end CHARACTERISTIC
/begin CHARACTERISTIC LURMIN3 "" CURVE 0x80044C6E GklWSw 298.0187 lu_MEx -149.0116 149.0071 FORMAT "%8.4"
 /begin AXIS_DESCR COM_AXIS nmot nmot_ub_q40 8 0.00 10200. FORMAT "%5.0" AXIS_PTS_REF SNM08DMUB /end AXIS_DESCR
/end CHARACTERISTIC
/begin CHARACTERISTIC LURMIN3KH "" CURVE 0x80044C7E GklWSw 298.0187 lu_MEx -149.0116 149.0071 FORMAT "%8.4"
 /begin AXIS_DESCR COM_AXIS nmot nmot_ub_q40 8 0.00 10200. FORMAT "%5.0" AXIS_PTS_REF SNM08DMUB /end AXIS_DESCR
/end CHARACTERISTIC
/begin CHARACTERISTIC LURMINKHE "" VALUE 0x80044C8E KwSw 298.0187 lu_MEx -149.0116 149.0071 FORMAT "%8.4" /end CHARACTERISTIC
/begin CHARACTERISTIC LURSFAKMAXLU "" VALUE 0x800443EF KwUb 0.9961 fak_ub_b1 0.00 0.9961 /end CHARACTERISTIC
/begin CHARACTERISTIC LURSFAKPLSKH "" VALUE 0x800443F0 KwUb 1.992188 fak_ub_b2 0.00 1.992188 FORMAT "%8.6" /end CHARACTERISTIC
/begin CHARACTERISTIC LURSFAKPLSLL "" VALUE 0x800443F1 KwUb 1.992188 fak_ub_b2 0.00 1.992188 FORMAT "%8.6" /end CHARACTERISTIC
/begin CHARACTERISTIC LURST "" CURVE 0x80044C90 KlAUwSstUwWUw 1.999969 fak_uw_b2 0.00 1.999969 FORMAT "%8.6"
 /begin AXIS_DESCR STD_AXIS tnst_w t10msxs_uw_b655p35 6 0.00 655.3500 FORMAT "%8.4" DEPOSIT ABSOLUTE /end AXIS_DESCR
/end CHARACTERISTIC
/begin CHARACTERISTIC MIFLDWN "" VALUE 0x80044DB2 KwUb 99.61 rel_ub_b99p6 0.00 99.61 FORMAT "%5.2" /end CHARACTERISTIC
/begin CHARACTERISTIC MIKHMXSWOOFF "" VALUE 0x80044DE7 KwUb 99.61 rel_ub_b99p6 0.00 99.61 FORMAT "%5.2" /end CHARACTERISTIC
/begin CHARACTERISTIC MIKHMXSWOON "" VALUE 0x80044DE8 KwUb 99.61 rel_ub_b99p6 0.00 99.61 FORMAT "%5.2" /end CHARACTERISTIC
/begin CHARACTERISTIC MISAGANGSISTDEL "" VALUE 0x80044DB3 KwUb 5.100 t_q0p02 0.00 5.100 FORMAT "%5.3" /end CHARACTERISTIC
/begin CHARACTERISTIC MISALUN "" CURVE 0x80044DB4 GklWUb 99.61 rel_ub_b99p6 0.00 99.61 FORMAT "%5.2"
 /begin AXIS_DESCR COM_AXIS nmot nmot_ub_q40 8 0.00 10200. FORMAT "%5.0" AXIS_PTS_REF SNM08DMUB /end AXIS_DESCR
/end CHARACTERISTIC
/begin CHARACTERISTIC MISANLIOFS "" VALUE 0x80044DBC KwSw 32767.50 nmot_q0p5 -16384.00 16383.50 FORMAT "%8.2" /end CHARACTERISTIC
/begin CHARACTERISTIC MISFPATTRN "" MAP 0x80044DF6 FkfNoShNoOffWSw 65535.00 dez -32768.00 32767.00 FORMAT "%8.2"
 /begin AXIS_DESCR FIX_AXIS mfpattidx dez 4 0.00 3.000 FORMAT "%5.3" FIX_AXIS_PAR 0 0 4 /end AXIS_DESCR
 /begin AXIS_DESCR FIX_AXIS mfpattidx dez 10 0.00 9.000 FORMAT "%5.3" FIX_AXIS_PAR 0 0 10 /end AXIS_DESCR
/end CHARACTERISTIC
/begin CHARACTERISTIC MISFRATE "" VALUE 0x80044CFE KwUw 99.99847 rel_uw_b100 0.00 99.99847 FORMAT "%8.5" /end CHARACTERISTIC
/begin CHARACTERISTIC MIUFOF1 "" VALUE 0x8004461E KwUb 99.61 rel_ub_b100 0.00 99.61 FORMAT "%5.2" /end CHARACTERISTIC
/begin CHARACTERISTIC MIUFOF2 "" VALUE 0x8004461F KwUb 99.61 rel_ub_b100 0.00 99.61 FORMAT "%5.2" /end CHARACTERISTIC
/begin CHARACTERISTIC MLOBKLHV "" CURVE 0x80044FFB KlAxU8SstxU8WU8 1020. m_ub_b1020 0.00 1020. FORMAT "%5.0"
 /begin AXIS_DESCR STD_AXIS vfzg vfzg_ub_q1p25 5 0.00 318.8 FORMAT "%5.1" DEPOSIT ABSOLUTE /end AXIS_DESCR
/end CHARACTERISTIC
/begin CHARACTERISTIC MLOBKLNV "" CURVE 0x80045006 KlAxU8SstxU8WU8 1020. m_ub_b1020 0.00 1020. FORMAT "%5.0"
 /begin AXIS_DESCR STD_AXIS vfzg vfzg_ub_q1p25 5 0.00 318.8 FORMAT "%5.1" DEPOSIT ABSOLUTE /end AXIS_DESCR
/end CHARACTERISTIC
/begin CHARACTERISTIC MLUBKLHV "" CURVE 0x80045011 KlAxU8SstxU8WU8 1020. m_ub_b1020 0.00 1020. FORMAT "%5.0"
 /begin AXIS_DESCR STD_AXIS vfzg vfzg_ub_q1p25 5 0.00 318.8 FORMAT "%5.1" DEPOSIT ABSOLUTE /end AXIS_DESCR
/end CHARACTERISTIC
/begin CHARACTERISTIC MLUBKLNV "" CURVE 0x8004501C KlAxU8SstxU8WU8 1020. m_ub_b1020 0.00 1020. FORMAT "%5.0"
 /begin AXIS_DESCR STD_AXIS vfzg vfzg_ub_q1p25 5 0.00 318.8 FORMAT "%5.1" DEPOSIT ABSOLUTE /end AXIS_DESCR
/end CHARACTERISTIC
/begin CHARACTERISTIC NGALUN "" CURVE 0x80044DBE GklWUw 25599.94 nmotg_sw_q0p39 0.00 25599.94 FORMAT "%8.2"
 /begin AXIS_DESCR COM_AXIS nmot nmot_ub_q40 8 0.00 10200. FORMAT "%5.0" AXIS_PTS_REF SNM08DMUB /end AXIS_DESCR
/end CHARACTERISTIC
/begin CHARACTERISTIC NGALUST "" VALUE 0x80044DCE KwUw 25599.94 nmotg_sw_q0p39 0.00 25599.94 FORMAT "%8.2" /end CHARACTERISTIC
/begin CHARACTERISTIC NMAXFLUTS "" VALUE 0x8004486E KwUw 16383.75 nmot_uw_q0p25 0.00 16383.75 FORMAT "%8.2" /end CHARACTERISTIC
/begin CHARACTERISTIC NMFSRMX "" VALUE 0x800443F2 KwUb 10200. nmot_q40 0.00 10200. FORMAT "%5.0" /end CHARACTERISTIC
/begin CHARACTERISTIC NMIALU "" VALUE 0x80044DD0 KwUw 16383.75 nmot_uw_q0p25 0.00 16383.75 FORMAT "%8.2" /end CHARACTERISTIC
/begin CHARACTERISTIC NMIDLU "" VALUE 0x800445EE KwUb 10200. nmot_ub_q40 0.00 10200. FORMAT "%5.0" /end CHARACTERISTIC
/begin CHARACTERISTIC NMKAMFZKH "" VALUE 0x80044DEA KwWU16 16383.75 nmot_uw_q0p25 0.00 16383.75 FORMAT "%8.2" /end CHARACTERISTIC
/begin CHARACTERISTIC NMOTGNP "" VALUE 0x80044384 KwWU16 16383.75 nmot_uw_q0p25 0.00 16383.75 FORMAT "%8.2" /end CHARACTERISTIC
/begin CHARACTERISTIC NMOTMNDDSS "" VALUE 0x80044E64 KwWU16 16383.75 nmot_q0p25 0.00 16383.75 FORMAT "%8.2" /end CHARACTERISTIC
/begin CHARACTERISTIC NOFOF1 "" VALUE 0x80044620 KwUb 10200. nmot_ub_q40 0.00 10200. FORMAT "%5.0" /end CHARACTERISTIC
/begin CHARACTERISTIC NOFOF2 "" VALUE 0x80044621 KwUb 10200. nmot_ub_q40 0.00 10200. FORMAT "%5.0" /end CHARACTERISTIC
/begin CHARACTERISTIC NOFOFSA1 "" VALUE 0x80044622 KwUb 10200. nmot_ub_q40 0.00 10200. FORMAT "%5.0" /end CHARACTERISTIC
/begin CHARACTERISTIC NOFOFSA2 "" VALUE 0x80044623 KwUb 10200. nmot_ub_q40 0.00 10200. FORMAT "%5.0" /end CHARACTERISTIC
/begin CHARACTERISTIC NPSRSVMN "" VALUE 0x80044E66 KwWU16 16383.75 nmot_q0p25 0.00 16383.75 FORMAT "%8.2" /end CHARACTERISTIC
/begin CHARACTERISTIC NPSRSVMX "" VALUE 0x80044E68 KwWU16 16383.75 nmot_q0p25 0.00 16383.75 FORMAT "%8.2" /end CHARACTERISTIC
/begin CHARACTERISTIC NSTDMD "" VALUE 0x80044DD2 KwUw 16383.75 nmot_uw_q0p25 0.00 16383.75 FORMAT "%8.2" /end CHARACTERISTIC
/begin CHARACTERISTIC NUFOF1 "" VALUE 0x80044624 KwUb 10200. nmot_ub_q40 0.00 10200. FORMAT "%5.0" /end CHARACTERISTIC
/begin CHARACTERISTIC NUFOF2 "" VALUE 0x80044625 KwUb 10200. nmot_ub_q40 0.00 10200. FORMAT "%5.0" /end CHARACTERISTIC
/begin CHARACTERISTIC NUFOFSA1 "" VALUE 0x80044626 KwUb 10200. nmot_ub_q40 0.00 10200. FORMAT "%5.0" /end CHARACTERISTIC
/begin CHARACTERISTIC NUFOFSA2 "" VALUE 0x80044627 KwUb 10200. nmot_ub_q40 0.00 10200. FORMAT "%5.0" /end CHARACTERISTIC
/begin CHARACTERISTIC ORADN "" VALUE 0x80044360 KwWS16 3071.953 rel_sw_b1536 -1536.000 1535.953 FORMAT "%8.3" /end CHARACTERISTIC
/begin CHARACTERISTIC ORADNFA "" VALUE 0x80044362 KwWS16 3071.953 rel_sw_b1536 -1536.000 1535.953 FORMAT "%8.3" /end CHARACTERISTIC
/begin CHARACTERISTIC ORADX "" VALUE 0x80044364 KwWS16 3071.953 rel_sw_b1536 -1536.000 1535.953 FORMAT "%8.3" /end CHARACTERISTIC
/begin CHARACTERISTIC ORADXFA "" VALUE 0x80044366 KwWS16 3071.953 rel_sw_b1536 -1536.000 1535.953 FORMAT "%8.3" /end CHARACTERISTIC
/begin CHARACTERISTIC PSRMN "" VALUE 0x80044E6A KwWU16 5119.922 p_uw_q0p078 0.00 5119.922 FORMAT "%8.3" /end CHARACTERISTIC
/begin CHARACTERISTIC PSRMX "" VALUE 0x80044E6C KwWU16 5119.922 p_uw_q0p078 0.00 5119.922 FORMAT "%8.3" /end CHARACTERISTIC
/begin CHARACTERISTIC PUPLPSRMN "" VALUE 0x80044E6E KwWU16 2559.961 p_q0p039 0.00 2559.961 FORMAT "%8.3" /end CHARACTERISTIC
/begin CHARACTERISTIC RLMDVERL "" CURVE 0x80044386 KlAxU8SstxU16WU8 99.75 rel_ub_q0p75 0.00 99.75 FORMAT "%5.2"
 /begin AXIS_DESCR STD_AXIS mdverl_w rel_uw_b100 3 0.00 99.99847 FORMAT "%8.5" DEPOSIT ABSOLUTE /end AXIS_DESCR
/end CHARACTERISTIC
/begin CHARACTERISTIC RLMDVERLKH "" CURVE 0x80044392 KlAxU8SstxU16WU8 99.75 rel_ub_q0p75 0.00 99.75 FORMAT "%5.2"
 /begin AXIS_DESCR STD_AXIS mdverl_w rel_uw_b100 3 0.00 99.99847 FORMAT "%8.5" DEPOSIT ABSOLUTE /end AXIS_DESCR
/end CHARACTERISTIC
/begin CHARACTERISTIC SDFRA "" VALUE 0x80044368 KwWU16 1.999969 fak_uw_b2 0.00 1.999969 FORMAT "%8.6" /end CHARACTERISTIC
/begin CHARACTERISTIC SDORA "" VALUE 0x8004436A KwWS16 3071.953 rel_sw_b1536 -1536.000 1535.953 FORMAT "%8.3" /end CHARACTERISTIC
/begin CHARACTERISTIC SFOFTM "" VALUE 0x80044DD4 KwUb 191.3 temp_ub_q0p75_o48 -48.00 143.3 FORMAT "%5.1" /end CHARACTERISTIC
/begin CHARACTERISTIC SFONTM "" VALUE 0x80044DD5 KwUb 191.3 temp_ub_q0p75_o48 -48.00 143.3 FORMAT "%5.1" /end CHARACTERISTIC
/begin CHARACTERISTIC SF_PSR "" VAL_BLK 0x80044E70 KwbWU16 86. dfp_verbal 0.00 86. FORMAT "%2.0" READ_ONLY NUMBER 3 /end CHARACTERISTIC
/begin CHARACTERISTIC SF_PSR1 "" VAL_BLK 0x80044E76 KwbWU16 86. dfp_verbal 0.00 86. FORMAT "%2.0" READ_ONLY NUMBER 6 /end CHARACTERISTIC
/begin AXIS_PTS SMI04ADUW "" 0x800443F4 midmd_w SstAUwSstUw 99.99847 rel_uw_b100 3 0.00 99.99847 FORMAT "%8.5" DEPOSIT ABSOLUTE /end AXIS_PTS
/begin AXIS_PTS SMI08DMUB "" 0x80049FD9 midmd SstAUbSstUb 99.61 rel_ub_b99p6 8 0.00 99.61 FORMAT "%5.2" DEPOSIT ABSOLUTE /end AXIS_PTS
/begin CHARACTERISTIC SNM02ADUW "" VAL_BLK 0x800443FC KwbUw 16383.75 nmot_uw_q0p25 0.00 16383.75 FORMAT "%8.2" NUMBER 2 /end CHARACTERISTIC
/begin AXIS_PTS SNM08DMUB "" 0x80049FE2 nmot SstAUbSstUb 10200. nmot_ub_q40 8 0.00 10200. FORMAT "%5.0" DEPOSIT ABSOLUTE /end AXIS_PTS
/begin AXIS_PTS SNM09DM1UB "" 0x80049FEB nmot SstAUbSstUb 10200. nmot_ub_q40 9 0.00 10200. FORMAT "%5.0" DEPOSIT ABSOLUTE /end AXIS_PTS
/begin AXIS_PTS SNM09DM2UB "" 0x80049FF5 nmot SstAUbSstUb 10200. nmot_ub_q40 9 0.00 10200. FORMAT "%5.0" DEPOSIT ABSOLUTE /end AXIS_PTS
/begin AXIS_PTS SNM12ADUW "" 0x80044400 nmot_w SstAUwSstUw 16383.75 nmot_uw_q0p25 8 0.00 16383.75 FORMAT "%8.2" DEPOSIT ABSOLUTE /end AXIS_PTS
/begin CHARACTERISTIC SPANXSMAX "" VALUE 0x80044628 KwUw 9.999847 kw_q1p5259eEm4_om5 -5.000000 4.999847 FORMAT "%8.6" /end CHARACTERISTIC
/begin CHARACTERISTIC SPANXSMXKH "" VALUE 0x8004462A KwUw 9.999847 kw_q1p5259eEm4_om5 -5.000000 4.999847 FORMAT "%8.6" /end CHARACTERISTIC
/begin CHARACTERISTIC STPADPST "" VALUE 0x80044412 KwUw 65535.00 dez 0.00 65535.00 FORMAT "%8.2" /end CHARACTERISTIC
/begin CHARACTERISTIC TADLLR "" VALUE 0x8004439E KwWU8 191.3 temp_ub_q0p75_o48 -48.00 143.3 FORMAT "%5.1" /end CHARACTERISTIC
/begin CHARACTERISTIC TAMIALU "" VALUE 0x80044DD6 KwUb 191.3 temp_ub_q0p75_o48 -48.00 143.3 FORMAT "%5.1" /end CHARACTERISTIC
/begin CHARACTERISTIC TDBLKHTRC "" VALUE 0x80044E56 KwWU8 255.0 t_q1 0.00 255.0 FORMAT "%5.1" /end CHARACTERISTIC
/begin CHARACTERISTIC TDDLSC "" VALUE 0x80045027 KwWU8 255.0 t_q1 0.00 255.0 FORMAT "%5.1" /end CHARACTERISTIC
/begin CHARACTERISTIC TDEPSRB "" VALUE 0x80044E82 KwWU8 25.50 t_q0p1 0.00 25.50 FORMAT "%5.2" /end CHARACTERISTIC
/begin CHARACTERISTIC TDEPSRP "" VALUE 0x80044E83 KwWU8 25.50 t_q0p1 0.00 25.50 FORMAT "%5.2" /end CHARACTERISTIC
/begin CHARACTERISTIC TDLKHNUM "" VALUE 0x80044376 KwWU16 13107.00 t_q0p2 0.00 13107.00 FORMAT "%8.2" /end CHARACTERISTIC
/begin CHARACTERISTIC TDLLFG1 "" VALUE 0x8004439F KwWU8 51.00 t200msxs_ub_b51 0.00 51.00 FORMAT "%5.2" /end CHARACTERISTIC
/begin CHARACTERISTIC TDLLR "" VALUE 0x800443A0 KwWU8 51.00 t200msxs_ub_b51 0.00 51.00 FORMAT "%5.2" /end CHARACTERISTIC
/begin CHARACTERISTIC TDLLRMN "" VALUE 0x800443A1 KwWU8 51.00 t200msxs_ub_b51 0.00 51.00 FORMAT "%5.2" /end CHARACTERISTIC
/begin CHARACTERISTIC TDLLRMNKH "" VALUE 0x800443A2 KwWU8 51.00 t200msxs_ub_b51 0.00 51.00 FORMAT "%5.2" /end CHARACTERISTIC
/begin CHARACTERISTIC TDLLRMX "" VALUE 0x800443A3 KwWU8 51.00 t200msxs_ub_b51 0.00 51.00 FORMAT "%5.2" /end CHARACTERISTIC
/begin CHARACTERISTIC TDLLRMXKH "" VALUE 0x800443A4 KwWU8 51.00 t200msxs_ub_b51 0.00 51.00 FORMAT "%5.2" /end CHARACTERISTIC
/begin CHARACTERISTIC TDLLRNF "" VALUE 0x800443A5 KwWU8 51.00 t200msxs_ub_b51 0.00 51.00 FORMAT "%5.2" /end CHARACTERISTIC
/begin CHARACTERISTIC TDLLRNFKH "" VALUE 0x800443A6 KwWU8 51.00 t200msxs_ub_b51 0.00 51.00 FORMAT "%5.2" /end CHARACTERISTIC
/begin CHARACTERISTIC TDLLRNUM "" VALUE 0x80044378 KwWU16 13107.00 t_q0p2 0.00 13107.00 FORMAT "%8.2" /end CHARACTERISTIC
/begin CHARACTERISTIC TDOTMCS "" VALUE 0x80044E57 KwWU8 50.80 t_q0p2 0.2000 51.00 FORMAT "%5.2" /end CHARACTERISTIC
/begin CHARACTERISTIC TDOTMCSESD "" VALUE 0x80044E58 KwWU8 51.00 t_q0p2 0.00 51.00 FORMAT "%5.2" /end CHARACTERISTIC
/begin CHARACTERISTIC TDPSRRG "" VALUE 0x80044E84 KwWU16 1310.700 t_q0p02 0.00 1310.700 FORMAT "%8.3" /end CHARACTERISTIC
/begin CHARACTERISTIC TDTGC "" VALUE 0x80045028 KwWU16 65535.00 t_q1 0.00 65535.00 FORMAT "%8.2" /end CHARACTERISTIC
/begin CHARACTERISTIC TDTSTMST2 "" VALUE 0x80044E59 KwWU8 255.0 t_q1 0.00 255.0 FORMAT "%5.1" /end CHARACTERISTIC
/begin CHARACTERISTIC TEFRA "" VALUE 0x8004436C KwWU8 51.00 t200msxs_ub_b51 0.00 51.00 FORMAT "%5.2" /end CHARACTERISTIC
/begin CHARACTERISTIC TEORA "" VALUE 0x8004436D KwWU8 51.00 t200msxs_ub_b51 0.00 51.00 FORMAT "%5.2" /end CHARACTERISTIC
/begin CHARACTERISTIC TFRA "" VALUE 0x8004436E KwWU8 51.00 t200msxs_ub_b51 0.00 51.00 FORMAT "%5.2" /end CHARACTERISTIC
/begin CHARACTERISTIC THP "" VALUE 0x80045037 KwUb 25.00 t_q0p1 0.5000 25.50 FORMAT "%5.2" /end CHARACTERISTIC
/begin CHARACTERISTIC TLRASTMN "" VALUE 0x8004436F KwWU8 51.00 t200msxs_ub_b51 0.00 51.00 FORMAT "%5.2" /end CHARACTERISTIC
/begin CHARACTERISTIC TMASKIV1 "" VALUE 0x80044D00 KwUb 191.3 temp_ub_q0p75_o48 -48.00 143.3 FORMAT "%5.1" /end CHARACTERISTIC
/begin CHARACTERISTIC TMDLLR "" VALUE 0x800443A7 KwWU8 191.3 temp_ub_q0p75_o48 -48.00 143.3 FORMAT "%5.1" /end CHARACTERISTIC
/begin CHARACTERISTIC TMESSCMN "" VALUE 0x8004502A KwWU8 191.3 temp_ub_q0p75_o48 -48.00 143.3 FORMAT "%5.1" /end CHARACTERISTIC
/begin CHARACTERISTIC TMOTDMD "" VALUE 0x80044DD7 KwUb 191.3 temp_ub_q0p75_o48 -48.00 143.3 FORMAT "%5.1" /end CHARACTERISTIC
/begin CHARACTERISTIC TMOTPSSVMN "" VALUE 0x80044E86 KwWU8 191.3 temp_ub_q0p75_o48 -48.00 143.3 FORMAT "%5.1" /end CHARACTERISTIC
/begin CHARACTERISTIC TMOTPSSVMX "" VALUE 0x80044E87 KwWU8 191.3 temp_ub_q0p75_o48 -48.00 143.3 FORMAT "%5.1" /end CHARACTERISTIC
/begin CHARACTERISTIC TMSSSCO "" VALUE 0x8004502B KwWU8 191.3 temp_ub_q0p75_o48 -48.00 143.3 FORMAT "%5.1" /end CHARACTERISTIC
/begin CHARACTERISTIC TMSSSCU "" VALUE 0x8004502C KwWU8 191.3 temp_ub_q0p75_o48 -48.00 143.3 FORMAT "%5.1" /end CHARACTERISTIC
/begin CHARACTERISTIC TMSTDMD "" VALUE 0x80044DD8 KwUb 191.3 temp_ub_q0p75_o48 -48.00 143.3 FORMAT "%5.1" /end CHARACTERISTIC
/begin CHARACTERISTIC TNALU "" VALUE 0x8004463F KwUb 126.0 dez 1.000 127.0 FORMAT "%5.1" /end CHARACTERISTIC
/begin CHARACTERISTIC TNMNPSR "" VALUE 0x80044E88 KwWU8 25.50 t_q0p1 0.00 25.50 FORMAT "%5.2" /end CHARACTERISTIC
/begin CHARACTERISTIC TNSDMXRLU "" VALUE 0x80044CAA KwUb 5.000 t1sxs_q1 0.00 5.000 FORMAT "%5.3" /end CHARACTERISTIC
/begin CHARACTERISTIC TNSTDLLR "" VALUE 0x800443A8 KwWU16 655.3500 t10msxs_uw_b655p35 0.00 655.3500 FORMAT "%8.4" /end CHARACTERISTIC
/begin CHARACTERISTIC TOFEORAFFR "" VALUE 0x8004434C KwWU8 51.00 t_q0p2 0.00 51.00 FORMAT "%5.2" /end CHARACTERISTIC
/begin CHARACTERISTIC TORA "" VALUE 0x80044370 KwWU8 51.00 t200msxs_ub_b51 0.00 51.00 FORMAT "%5.2" /end CHARACTERISTIC
/begin CHARACTERISTIC TPSINIG "" VALUE 0x80044E8A KwWU16 6553.500 t100msxs_uw_b6553p5 0.00 6553.500 FORMAT "%8.3" /end CHARACTERISTIC
/begin CHARACTERISTIC TPSRSVMN "" VALUE 0x80044E8C KwWU16 1310.700 t_q0p02 0.00 1310.700 FORMAT "%8.3" /end CHARACTERISTIC
/begin CHARACTERISTIC TPSRSVN "" VALUE 0x80044E8E KwWU16 1310.700 t_q0p02 0.00 1310.700 FORMAT "%8.3" /end CHARACTERISTIC
/begin CHARACTERISTIC TRANSMACTTIMEMN "" VALUE 0x80044414 KwUw 32767.50 t_q0p5 0.00 32767.50 FORMAT "%8.2" /end CHARACTERISTIC
/begin CHARACTERISTIC TRANSMACTTRQ "" VALUE 0x80044416 KwUb 99.61 rel_ub_b99p6 0.00 99.61 FORMAT "%5.2" /end CHARACTERISTIC
/begin CHARACTERISTIC TSBINVALID "" VALUE 0x80044DEC KwUb 255.0 dez 0.00 255.0 FORMAT "%5.1" /end CHARACTERISTIC
/begin CHARACTERISTIC TSBSEGINI "" VALUE 0x80044DEE KwUw 65.53500 t1msxs_b65p535 0.00 65.53500 FORMAT "%8.5" /end CHARACTERISTIC
/begin CHARACTERISTIC TSROHDEV "" VAL_BLK 0x8004462C KwbWU16 9.999847 kw_q1p5259eEm4_om5 -5.000000 4.999847 FORMAT "%8.6" NUMBER 2 /end CHARACTERISTIC
/begin CHARACTERISTIC TSROHDEVKH "" VAL_BLK 0x80044630 KwbWU16 9.999847 kw_q1p5259eEm4_om5 -5.000000 4.999847 FORMAT "%8.6" NUMBER 2 /end CHARACTERISTIC
/begin CHARACTERISTIC TVP "" VALUE 0x80045038 KwUb 25.00 t_q0p1 0.5000 25.50 FORMAT "%5.2" /end CHARACTERISTIC
/begin CHARACTERISTIC TWBKLHOFF "" VALUE 0x8004502D KwWU8 255.0 t_q1 0.00 255.0 FORMAT "%5.1" /end CHARACTERISTIC
/begin CHARACTERISTIC TWBKLHON "" VALUE 0x8004502E KwWU8 255.0 t_q1 0.00 255.0 FORMAT "%5.1" /end CHARACTERISTIC
/begin CHARACTERISTIC TWBKLNOFF "" VALUE 0x8004502F KwWU8 255.0 t_q1 0.00 255.0 FORMAT "%5.1" /end CHARACTERISTIC
/begin CHARACTERISTIC TWBKLNON "" VALUE 0x80045030 KwWU8 255.0 t_q1 0.00 255.0 FORMAT "%5.1" /end CHARACTERISTIC
/begin CHARACTERISTIC VBKLHO "" VALUE 0x80045031 KwWU8 318.8 vfzg_ub_q1p25 0.00 318.8 FORMAT "%5.1" /end CHARACTERISTIC
/begin CHARACTERISTIC VBKLHU "" VALUE 0x80045032 KwWU8 318.8 vfzg_ub_q1p25 0.00 318.8 FORMAT "%5.1" /end CHARACTERISTIC
/begin CHARACTERISTIC VBKLNO "" VALUE 0x80045033 KwWU8 318.8 vfzg_ub_q1p25 0.00 318.8 FORMAT "%5.1" /end CHARACTERISTIC
/begin CHARACTERISTIC VBKLNU "" VALUE 0x80045034 KwWU8 318.8 vfzg_ub_q1p25 0.00 318.8 FORMAT "%5.1" /end CHARACTERISTIC
/begin CHARACTERISTIC WDKPSRSVMN "" VALUE 0x80044E90 KwWS16 1599.976 relDK_q0p02441 -800.0000 799.9756 FORMAT "%8.4" /end CHARACTERISTIC
/begin CHARACTERISTIC WDKPSRSVMX "" VALUE 0x80044E92 KwWS16 1599.976 relDK_q0p02441 -800.0000 799.9756 FORMAT "%8.4" /end CHARACTERISTIC
/begin CHARACTERISTIC ZAGRUN "" VALUE 0x80044E46 KwUb 255.0 dez 0.00 255.0 FORMAT "%5.1" /end CHARACTERISTIC
/begin CHARACTERISTIC ZKDFRM "" VALUE 0x80044372 KwWU16 13106.999997 zk200msxs_uw_b13107p2 0.20000305180 13107.200000 FORMAT "%12.6" /end CHARACTERISTIC
/begin CHARACTERISTIC ZWDIFFLATE "" VALUE 0x80044DF0 KwSb 191.3 zw_sb_q0p75 -96.00 95.25 FORMAT "%5.2" /end CHARACTERISTIC
/begin CHARACTERISTIC ZWKRMAXOF "" VALUE 0x80044634 KwSb 191.3 zw_sb_q0p75 -96.00 95.25 FORMAT "%5.2" /end CHARACTERISTIC
/begin CHARACTERISTIC ZWLATEDEL "" VALUE 0x80044DF1 KwUb 255.0 dez 0.00 255.0 FORMAT "%5.1" /end CHARACTERISTIC
/begin CHARACTERISTIC ZYLKOR "" VALUE 0x80044DF2 KwUb 255.0 dez 0.00 255.0 FORMAT "%5.1" /end CHARACTERISTIC
/begin CHARACTERISTIC ZYLKORKH "" VALUE 0x80044DF3 KwUb 255.0 dez 0.00 255.0 FORMAT "%5.1" /end CHARACTERISTIC
/begin MEASUREMENT abgivctr "" UBYTE dez 1 100 0.00 255.0 FORMAT "%5.1" ECU_ADDRESS 0xD0000C86 /end MEASUREMENT
/begin MEASUREMENT adapidx "" UBYTE dez 1 100 0.00 255.0 FORMAT "%5.1" ECU_ADDRESS 0xD0000C5D /end MEASUREMENT
/begin MEASUREMENT afzklh "" UBYTE dez 1 100 0.00 255.0 FORMAT "%5.1" ECU_ADDRESS 0xD0000CB4 /end MEASUREMENT
/begin MEASUREMENT afzkln "" UBYTE dez 1 100 0.00 255.0 FORMAT "%5.1" ECU_ADDRESS 0xD0000CB5 /end MEASUREMENT
/begin MEASUREMENT ahearv_w "" UWORD dez 1 100 0.00 65535.00 FORMAT "%8.2" ECU_ADDRESS 0xD0000656 /end MEASUREMENT
/begin MEASUREMENT aintkamin "" UBYTE dez 1 100 0.00 255.0 FORMAT "%5.1" ECU_ADDRESS 0xD0000C87 /end MEASUREMENT
/begin MEASUREMENT aintzyl "" UBYTE dez 1 100 0.00 255.0 FORMAT "%5.1" ARRAY_SIZE 3 ECU_ADDRESS 0xD0000C88 /end MEASUREMENT
/begin MEASUREMENT anwfofs "" UBYTE dez 1 100 0.00 255.0 FORMAT "%5.1" ECU_ADDRESS 0xD0000C6D /end MEASUREMENT
/begin MEASUREMENT anzainten "" UBYTE dez 1 100 0.00 255.0 FORMAT "%5.1" ECU_ADDRESS 0xD0000C8B /end MEASUREMENT
/begin MEASUREMENT anzfofsamp "" UBYTE dez 1 100 0.00 255.0 FORMAT "%5.1" ECU_ADDRESS 0xD0000C6E /end MEASUREMENT
/begin MEASUREMENT azycntb "" UBYTE dez 1 100 0.00 255.0 FORMAT "%5.1" ARRAY_SIZE 1 ECU_ADDRESS 0xD0000C8C /end MEASUREMENT
/begin MEASUREMENT bitsadapr "" UBYTE dez 1 100 0.00 255.0 FORMAT "%5.1" ARRAY_SIZE 3 ECU_ADDRESS 0xAFE80177 /end MEASUREMENT
/begin MEASUREMENT B_abfzdc "" UBYTE B_TRUE 1 100 0.00 1.00000000000 BIT_MASK 0x1 FORMAT "%13.11" ECU_ADDRESS 0xD0000035 /end MEASUREMENT
/begin MEASUREMENT B_adapfsr "" UBYTE B_TRUE 1 100 0.00 1.00000000000 BIT_MASK 0x4 FORMAT "%13.11" ECU_ADDRESS 0xD0000033 /end MEASUREMENT
/begin MEASUREMENT B_adapfsrst "" UBYTE B_TRUE 1 100 0.00 1.00000000000 BIT_MASK 0x40 FORMAT "%13.11" ECU_ADDRESS 0xD0000079 /end MEASUREMENT
/begin MEASUREMENT B_adpstpmf "" UBYTE B_TRUE 1 100 0.00 1.00000000000 BIT_MASK 0x10 FORMAT "%13.11" ECU_ADDRESS 0xD000009C /end MEASUREMENT
/begin MEASUREMENT B_analu "" UBYTE B_TRUE 1 100 0.00 1.00000000000 BIT_MASK 0x2 FORMAT "%13.11" ECU_ADDRESS 0xD0000076 /end MEASUREMENT
/begin MEASUREMENT B_blckhtrc "" UBYTE B_TRUE 1 100 0.00 1.00000000000 BIT_MASK 0x40 FORMAT "%13.11" ECU_ADDRESS 0xD0000CAE /end MEASUREMENT
/begin MEASUREMENT B_cntmde "" UBYTE B_TRUE 1 100 0.00 1.00000000000 BIT_MASK 0x4 FORMAT "%13.11" ECU_ADDRESS 0xD0000070 /end MEASUREMENT
/begin MEASUREMENT B_com1 "" UBYTE B_TRUE 1 100 0.00 1.00000000000 BIT_MASK 0x4 FORMAT "%13.11" ECU_ADDRESS 0xD0000065 /end MEASUREMENT
/begin MEASUREMENT B_com2 "" UBYTE B_TRUE 1 100 0.00 1.00000000000 BIT_MASK 0x80 FORMAT "%13.11" ECU_ADDRESS 0xD0000035 /end MEASUREMENT
/begin MEASUREMENT B_com3 "" UBYTE B_TRUE 1 100 0.00 1.00000000000 BIT_MASK 0x1 FORMAT "%13.11" ECU_ADDRESS 0xD0000039 /end MEASUREMENT
/begin MEASUREMENT B_ctrvalid "" UBYTE B_TRUE 1 100 0.00 1.00000000000 BIT_MASK 0x1 FORMAT "%13.11" ECU_ADDRESS 0xAFE80182 /end MEASUREMENT
/begin MEASUREMENT B_dedotmcs "" UBYTE B_TRUE 1 100 0.00 1.00000000000 BIT_MASK 0x1 FORMAT "%13.11" ECU_ADDRESS 0xD0000CAF /end MEASUREMENT
/begin MEASUREMENT B_dfsofmed "" UBYTE B_TRUE 1 100 0.00 1.00000000000 BIT_MASK 0x2 FORMAT "%13.11" ECU_ADDRESS 0xD0000034 /end MEASUREMENT
/begin MEASUREMENT B_dllr "" UBYTE B_TRUE 1 100 0.00 1.00000000000 BIT_MASK 0x2 FORMAT "%13.11" ECU_ADDRESS 0xD0000086 /end MEASUREMENT
/begin MEASUREMENT B_dllractv "" UBYTE B_TRUE 1 100 0.00 1.00000000000 BIT_MASK 0x4 FORMAT "%13.11" ECU_ADDRESS 0xD0000032 /end MEASUREMENT
/begin MEASUREMENT B_dllrebd "" UBYTE B_TRUE 1 100 0.00 1.00000000000 BIT_MASK 0x8 FORMAT "%13.11" ECU_ADDRESS 0xD0000031 /end MEASUREMENT
/begin MEASUREMENT B_dllrfg "" UBYTE B_TRUE 1 100 0.00 1.00000000000 BIT_MASK 0x4 FORMAT "%13.11" ECU_ADDRESS 0xD000006B /end MEASUREMENT
/begin MEASUREMENT B_dllrh "" UBYTE B_TRUE 1 100 0.00 1.00000000000 BIT_MASK 0x1 FORMAT "%13.11" ECU_ADDRESS 0xD000005A /end MEASUREMENT
/begin MEASUREMENT B_dllrkh "" UBYTE B_TRUE 1 100 0.00 1.00000000000 BIT_MASK 0x1 FORMAT "%13.11" ECU_ADDRESS 0xD0000081 /end MEASUREMENT
/begin MEASUREMENT B_dllrkha "" UBYTE B_TRUE 1 100 0.00 1.00000000000 BIT_MASK 0x20 FORMAT "%13.11" ECU_ADDRESS 0xD0000062 /end MEASUREMENT
/begin MEASUREMENT B_dllrtdly "" UBYTE B_TRUE 1 100 0.00 1.00000000000 BIT_MASK 0x8 FORMAT "%13.11" ECU_ADDRESS 0xD0000032 /end MEASUREMENT
/begin MEASUREMENT B_dllrton "" UBYTE B_TRUE 1 100 0.00 1.00000000000 BIT_MASK 0x10 FORMAT "%13.11" ECU_ADDRESS 0xD0000032 /end MEASUREMENT
/begin MEASUREMENT B_dluerk "" UBYTE B_TRUE 1 100 0.00 1.00000000000 BIT_MASK 0x8 FORMAT "%13.11" ECU_ADDRESS 0xD0000069 /end MEASUREMENT
/begin MEASUREMENT B_dlutsk "" UBYTE B_TRUE 1 100 0.00 1.00000000000 BIT_MASK 0x40 FORMAT "%13.11" ECU_ADDRESS 0xD0000069 /end MEASUREMENT
/begin MEASUREMENT B_DmdmilComplete "" UBYTE B_TRUE 1 100 0.00 1.00000000000 BIT_MASK 0x10 FORMAT "%13.11" ECU_ADDRESS 0xD0000035 /end MEASUREMENT
/begin MEASUREMENT B_dmdsvclr "" UBYTE B_TRUE 1 100 0.00 1.00000000000 BIT_MASK 0x4 FORMAT "%13.11" ECU_ADDRESS 0xD0000069 /end MEASUREMENT
/begin MEASUREMENT B_dmxrl "" UBYTE B_TRUE 1 100 0.00 1.00000000000 BIT_MASK 0x20 FORMAT "%13.11" ECU_ADDRESS 0xD0000034 /end MEASUREMENT
/begin MEASUREMENT B_dotmcse1 "" UBYTE B_TRUE 1 100 0.00 1.00000000000 BIT_MASK 0x40 FORMAT "%13.11" ECU_ADDRESS 0xD0000CAD /end MEASUREMENT
/begin MEASUREMENT B_dpsrsvmn "" UBYTE B_TRUE 1 100 0.00 1.00000000000 BIT_MASK 0x80 FORMAT "%13.11" ECU_ADDRESS 0xD000005A /end MEASUREMENT
/begin MEASUREMENT B_edkvs "" UBYTE B_TRUE 1 100 0.00 1.00000000000 BIT_MASK 0x80 FORMAT "%13.11" ECU_ADDRESS 0xD000005B /end MEASUREMENT
/begin MEASUREMENT B_efra "" UBYTE B_TRUE 1 100 0.00 1.00000000000 BIT_MASK 0x10 FORMAT "%13.11" ECU_ADDRESS 0xD000007A /end MEASUREMENT
/begin MEASUREMENT B_eframax "" UBYTE B_TRUE 1 100 0.00 1.00000000000 BIT_MASK 0x80 FORMAT "%13.11" ECU_ADDRESS 0xD000005E /end MEASUREMENT
/begin MEASUREMENT B_eframin "" UBYTE B_TRUE 1 100 0.00 1.00000000000 BIT_MASK 0x2 FORMAT "%13.11" ECU_ADDRESS 0xD0000077 /end MEASUREMENT
/begin MEASUREMENT B_emnrkh "" UBYTE B_TRUE 1 100 0.00 1.00000000000 BIT_MASK 0x80 FORMAT "%13.11" ECU_ADDRESS 0xD0000031 /end MEASUREMENT
/begin MEASUREMENT B_emntcwcs "" UBYTE B_TRUE 1 100 0.00 1.00000000000 BIT_MASK 0x1 FORMAT "%13.11" ECU_ADDRESS 0xD0000CB2 /end MEASUREMENT
/begin MEASUREMENT B_emxrkh "" UBYTE B_TRUE 1 100 0.00 1.00000000000 BIT_MASK 0x2 FORMAT "%13.11" ECU_ADDRESS 0xD0000032 /end MEASUREMENT
/begin MEASUREMENT B_emxtcwcs "" UBYTE B_TRUE 1 100 0.00 1.00000000000 BIT_MASK 0x2 FORMAT "%13.11" ECU_ADDRESS 0xD0000CB2 /end MEASUREMENT
/begin MEASUREMENT B_engsfld "" UBYTE B_TRUE 1 100 0.00 1.00000000000 BIT_MASK 0x80 FORMAT "%13.11" ECU_ADDRESS 0xD0000CAE /end MEASUREMENT
/begin MEASUREMENT B_enlsc "" UBYTE B_TRUE 1 100 0.00 1.00000000000 BIT_MASK 0x2 FORMAT "%13.11" ECU_ADDRESS 0xD0000CB6 /end MEASUREMENT
/begin MEASUREMENT B_enstc "" UBYTE B_TRUE 1 100 0.00 1.00000000000 BIT_MASK 0x4 FORMAT "%13.11" ECU_ADDRESS 0xD0000CB6 /end MEASUREMENT
/begin MEASUREMENT B_eora "" UBYTE B_TRUE 1 100 0.00 1.00000000000 BIT_MASK 0x2 FORMAT "%13.11" ECU_ADDRESS 0xD000007F /end MEASUREMENT
/begin MEASUREMENT B_eoramax "" UBYTE B_TRUE 1 100 0.00 1.00000000000 BIT_MASK 0x1 FORMAT "%13.11" ECU_ADDRESS 0xD000006A /end MEASUREMENT
/begin MEASUREMENT B_eoramin "" UBYTE B_TRUE 1 100 0.00 1.00000000000 BIT_MASK 0x20 FORMAT "%13.11" ECU_ADDRESS 0xD000008E /end MEASUREMENT
/begin MEASUREMENT B_eplpsr "" UBYTE B_TRUE 1 100 0.00 1.00000000000 BIT_MASK 0x80 FORMAT "%13.11" ECU_ADDRESS 0xD000003B /end MEASUREMENT
/begin MEASUREMENT B_epsrplmn "" UBYTE B_TRUE 1 100 0.00 1.00000000000 BIT_MASK 0x20 FORMAT "%13.11" ECU_ADDRESS 0xD0000095 /end MEASUREMENT
/begin MEASUREMENT B_epsrplmx "" UBYTE B_TRUE 1 100 0.00 1.00000000000 BIT_MASK 0x10 FORMAT "%13.11" ECU_ADDRESS 0xD0000086 /end MEASUREMENT
/begin MEASUREMENT B_epsrsv "" UBYTE B_TRUE 1 100 0.00 1.00000000000 BIT_MASK 0x20 FORMAT "%13.11" ECU_ADDRESS 0xD000003A /end MEASUREMENT
/begin MEASUREMENT B_erhsctcw "" UBYTE B_TRUE 1 100 0.00 1.00000000000 BIT_MASK 0x1 FORMAT "%13.11" ECU_ADDRESS 0xD0000CC2 /end MEASUREMENT
/begin MEASUREMENT B_erlsctcw "" UBYTE B_TRUE 1 100 0.00 1.00000000000 BIT_MASK 0x2 FORMAT "%13.11" ECU_ADDRESS 0xD0000CC2 /end MEASUREMENT
/begin MEASUREMENT B_erstctcw "" UBYTE B_TRUE 1 100 0.00 1.00000000000 BIT_MASK 0x4 FORMAT "%13.11" ECU_ADDRESS 0xD0000CC2 /end MEASUREMENT
/begin MEASUREMENT B_esmnllr "" UBYTE B_TRUE 1 100 0.00 1.00000000000 BIT_MASK 0x10 FORMAT "%13.11" ECU_ADDRESS 0xD0000031 /end MEASUREMENT
/begin MEASUREMENT B_esmxllr "" UBYTE B_TRUE 1 100 0.00 1.00000000000 BIT_MASK 0x20 FORMAT "%13.11" ECU_ADDRESS 0xD0000031 /end MEASUREMENT
/begin MEASUREMENT B_esnpllr "" UBYTE B_TRUE 1 100 0.00 1.00000000000 BIT_MASK 0x40 FORMAT "%13.11" ECU_ADDRESS 0xD0000031 /end MEASUREMENT
/begin MEASUREMENT B_fdgser "" UBYTE B_TRUE 1 100 0.00 1.00000000000 BIT_MASK 0x1 FORMAT "%13.11" ECU_ADDRESS 0xD000006C /end MEASUREMENT
/begin MEASUREMENT B_fdpsrb "" UBYTE B_TRUE 1 100 0.00 1.00000000000 BIT_MASK 0x1 FORMAT "%13.11" ECU_ADDRESS 0xD000003A /end MEASUREMENT
/begin MEASUREMENT B_fdpsrp "" UBYTE B_TRUE 1 100 0.00 1.00000000000 BIT_MASK 0x20 FORMAT "%13.11" ECU_ADDRESS 0xD000007C /end MEASUREMENT
/begin MEASUREMENT B_FFcom1 "" UBYTE B_TRUE 1 100 0.00 1.00000000000 BIT_MASK 0x20 FORMAT "%13.11" ECU_ADDRESS 0xD0000036 /end MEASUREMENT
/begin MEASUREMENT B_ffrset "" UBYTE B_TRUE 1 100 0.00 1.00000000000 BIT_MASK 0x2 FORMAT "%13.11" ECU_ADDRESS 0xD0000035 /end MEASUREMENT
/begin MEASUREMENT B_fofadpen "" UBYTE B_TRUE 1 100 0.00 1.00000000000 BIT_MASK 0x40 FORMAT "%13.11" ECU_ADDRESS 0xD0000076 /end MEASUREMENT
/begin MEASUREMENT B_fofcalc "" UBYTE B_TRUE 1 100 0.00 1.00000000000 BIT_MASK 0x80 FORMAT "%13.11" ECU_ADDRESS 0xD0000033 /end MEASUREMENT
/begin MEASUREMENT B_fofr "" UBYTE B_TRUE 1 100 0.00 1.00000000000 BIT_MASK 0x1 FORMAT "%13.11" ECU_ADDRESS 0xAFE8017D /end MEASUREMENT
/begin MEASUREMENT B_fofreskh "" UBYTE B_TRUE 1 100 0.00 1.00000000000 BIT_MASK 0x1 FORMAT "%13.11" ECU_ADDRESS 0xD0000034 /end MEASUREMENT
/begin MEASUREMENT B_fofrkh "" UBYTE B_TRUE 1 100 0.00 1.00000000000 BIT_MASK 0x1 FORMAT "%13.11" ECU_ADDRESS 0xAFE8017E /end MEASUREMENT
/begin MEASUREMENT B_fofrset "" UBYTE B_TRUE 1 100 0.00 1.00000000000 BIT_MASK 0x4 FORMAT "%13.11" ECU_ADDRESS 0xD0000078 /end MEASUREMENT
/begin MEASUREMENT B_fofrun "" UBYTE B_TRUE 1 100 0.00 1.00000000000 BIT_MASK 0x2 FORMAT "%13.11" ECU_ADDRESS 0xD000008D /end MEASUREMENT
/begin MEASUREMENT B_fofsamp "" UBYTE B_TRUE 1 100 0.00 1.00000000000 BIT_MASK 0x40 FORMAT "%13.11" ECU_ADDRESS 0xD0000033 /end MEASUREMENT
/begin MEASUREMENT B_fofstp "" UBYTE B_TRUE 1 100 0.00 1.00000000000 BIT_MASK 0x40 FORMAT "%13.11" ECU_ADDRESS 0xD0000097 /end MEASUREMENT
/begin MEASUREMENT B_fokstp "" UBYTE B_TRUE 1 100 0.00 1.00000000000 BIT_MASK 0x80 FORMAT "%13.11" ECU_ADDRESS 0xD0000072 /end MEASUREMENT
/begin MEASUREMENT B_folunw "" UBYTE B_TRUE 1 100 0.00 1.00000000000 BIT_MASK 0x2 FORMAT "%13.11" ECU_ADDRESS 0xD0000098 /end MEASUREMENT
/begin MEASUREMENT B_fonr "" UBYTE B_TRUE 1 100 0.00 1.00000000000 BIT_MASK 0x8 FORMAT "%13.11" ECU_ADDRESS 0xD000008C /end MEASUREMENT
/begin MEASUREMENT B_fonr1st "" UBYTE B_TRUE 1 100 0.00 1.00000000000 BIT_MASK 0x2 FORMAT "%13.11" ECU_ADDRESS 0xD0000033 /end MEASUREMENT
/begin MEASUREMENT B_fonresd "" UBYTE B_TRUE 1 100 0.00 1.00000000000 BIT_MASK 0x20 FORMAT "%13.11" ECU_ADDRESS 0xD000008A /end MEASUREMENT
/begin MEASUREMENT B_fonresf "" UBYTE B_TRUE 1 100 0.00 1.00000000000 BIT_MASK 0x20 FORMAT "%13.11" ECU_ADDRESS 0xD0000077 /end MEASUREMENT
/begin MEASUREMENT B_fonrset "" UBYTE B_TRUE 1 100 0.00 1.00000000000 BIT_MASK 0x10 FORMAT "%13.11" ECU_ADDRESS 0xD000005F /end MEASUREMENT
/begin MEASUREMENT B_fonstp "" UBYTE B_TRUE 1 100 0.00 1.00000000000 BIT_MASK 0x80 FORMAT "%13.11" ECU_ADDRESS 0xD0000092 /end MEASUREMENT
/begin MEASUREMENT B_fontm "" UBYTE B_TRUE 1 100 0.00 1.00000000000 BIT_MASK 0x2 FORMAT "%13.11" ECU_ADDRESS 0xD0000039 /end MEASUREMENT
/begin MEASUREMENT B_fps2plsv "" UBYTE B_TRUE 1 100 0.00 1.00000000000 BIT_MASK 0x1 FORMAT "%13.11" ECU_ADDRESS 0xAFE80183 /end MEASUREMENT
/begin MEASUREMENT B_fpsrplsv "" UBYTE B_TRUE 1 100 0.00 1.00000000000 BIT_MASK 0x1 FORMAT "%13.11" ECU_ADDRESS 0xAFE80184 /end MEASUREMENT
/begin MEASUREMENT B_frast "" UBYTE B_TRUE 1 100 0.00 1.00000000000 BIT_MASK 0x80 FORMAT "%13.11" ECU_ADDRESS 0xD0000030 /end MEASUREMENT
/begin MEASUREMENT B_frastab "" UBYTE B_TRUE 1 100 0.00 1.00000000000 BIT_MASK 0x4 FORMAT "%13.11" ECU_ADDRESS 0xD0000099 /end MEASUREMENT
/begin MEASUREMENT B_fsmaxplaus "" UBYTE B_TRUE 1 100 0.00 1.00000000000 BIT_MASK 0x1 FORMAT "%13.11" ECU_ADDRESS 0xD0000033 /end MEASUREMENT
/begin MEASUREMENT B_fsmxplsc "" UBYTE B_TRUE 1 100 0.00 1.00000000000 BIT_MASK 0x1 FORMAT "%13.11" ECU_ADDRESS 0xD0000097 /end MEASUREMENT
/begin MEASUREMENT B_fsrnp "" UBYTE B_TRUE 1 100 0.00 1.00000000000 BIT_MASK 0x80 FORMAT "%13.11" ECU_ADDRESS 0xD000008E /end MEASUREMENT
/begin MEASUREMENT B_fsrst "" UBYTE B_TRUE 1 100 0.00 1.00000000000 BIT_MASK 0x1 FORMAT "%13.11" ECU_ADDRESS 0xD000009E /end MEASUREMENT
/begin MEASUREMENT B_fsrstmxsum "" UBYTE B_TRUE 1 100 0.00 1.00000000000 BIT_MASK 0x8 FORMAT "%13.11" ECU_ADDRESS 0xD0000033 /end MEASUREMENT
/begin MEASUREMENT B_fsrstnp "" UBYTE B_TRUE 1 100 0.00 1.00000000000 BIT_MASK 0x2 FORMAT "%13.11" ECU_ADDRESS 0xD0000058 /end MEASUREMENT
/begin MEASUREMENT B_fsrstused "" UBYTE B_TRUE 1 100 0.00 1.00000000000 BIT_MASK 0x80 FORMAT "%13.11" ECU_ADDRESS 0xD0000032 /end MEASUREMENT
/begin MEASUREMENT B_fstabzs "" UBYTE B_TRUE 1 100 0.00 1.00000000000 BIT_MASK 0x20 FORMAT "%13.11" ECU_ADDRESS 0xD000008D /end MEASUREMENT
/begin MEASUREMENT B_gae "" UBYTE B_TRUE 1 100 0.00 1.00000000000 BIT_MASK 0x2 FORMAT "%13.11" ECU_ADDRESS 0xD0000082 /end MEASUREMENT
/begin MEASUREMENT B_gaefra "" UBYTE B_TRUE 1 100 0.00 1.00000000000 BIT_MASK 0x1 FORMAT "%13.11" ECU_ADDRESS 0xAFE80172 /end MEASUREMENT
/begin MEASUREMENT B_gaeing "" UBYTE B_TRUE 1 100 0.00 1.00000000000 BIT_MASK 0x4 FORMAT "%13.11" ECU_ADDRESS 0xAFE80172 /end MEASUREMENT
/begin MEASUREMENT B_gemadapr "" UBYTE B_TRUE 1 100 0.00 1.00000000000 BIT_MASK 0x1 FORMAT "%13.11" ECU_ADDRESS 0xAFE8017C /end MEASUREMENT
/begin MEASUREMENT B_hepsrmn "" UBYTE B_TRUE 1 100 0.00 1.00000000000 BIT_MASK 0x4 FORMAT "%13.11" ECU_ADDRESS 0xD000003A /end MEASUREMENT
/begin MEASUREMENT B_hepsrmx "" UBYTE B_TRUE 1 100 0.00 1.00000000000 BIT_MASK 0x2 FORMAT "%13.11" ECU_ADDRESS 0xD000003A /end MEASUREMENT
/begin MEASUREMENT B_hepsrsv "" UBYTE B_TRUE 1 100 0.00 1.00000000000 BIT_MASK 0x80 FORMAT "%13.11" ECU_ADDRESS 0xD000003A /end MEASUREMENT
/begin MEASUREMENT B_hlhsctcw "" UBYTE B_TRUE 1 100 0.00 1.00000000000 BIT_MASK 0x8 FORMAT "%13.11" ECU_ADDRESS 0xD0000CC2 /end MEASUREMENT
/begin MEASUREMENT B_hllsctcw "" UBYTE B_TRUE 1 100 0.00 1.00000000000 BIT_MASK 0x10 FORMAT "%13.11" ECU_ADDRESS 0xD0000CC2 /end MEASUREMENT
/begin MEASUREMENT B_hlpkrsme "" UBYTE B_TRUE 1 100 0.00 1.00000000000 BIT_MASK 0x1 FORMAT "%13.11" ECU_ADDRESS 0xD0000030 /end MEASUREMENT
/begin MEASUREMENT B_hlpkrsmz "" UBYTE B_TRUE 1 100 0.00 1.00000000000 BIT_MASK 0x2 FORMAT "%13.11" ECU_ADDRESS 0xD0000030 /end MEASUREMENT
/begin MEASUREMENT B_hlpkrsse "" UBYTE B_TRUE 1 100 0.00 1.00000000000 BIT_MASK 0x20 FORMAT "%13.11" ECU_ADDRESS 0xD0000030 /end MEASUREMENT
/begin MEASUREMENT B_hlpkrssz "" UBYTE B_TRUE 1 100 0.00 1.00000000000 BIT_MASK 0x10 FORMAT "%13.11" ECU_ADDRESS 0xD0000030 /end MEASUREMENT
/begin MEASUREMENT B_hlstctcw "" UBYTE B_TRUE 1 100 0.00 1.00000000000 BIT_MASK 0x20 FORMAT "%13.11" ECU_ADDRESS 0xD0000CC2 /end MEASUREMENT
/begin MEASUREMENT B_htcwcs "" UBYTE B_TRUE 1 100 0.00 1.00000000000 BIT_MASK 0x4 FORMAT "%13.11" ECU_ADDRESS 0xD0000CB2 /end MEASUREMENT
/begin MEASUREMENT B_idxfof1 "" UBYTE B_TRUE 1 100 0.00 1.00000000000 BIT_MASK 0x10 FORMAT "%13.11" ECU_ADDRESS 0xD0000033 /end MEASUREMENT
/begin MEASUREMENT B_inidkvs "" UBYTE B_TRUE 1 100 0.00 1.00000000000 BIT_MASK 0x40 FORMAT "%13.11" ECU_ADDRESS 0xD0000030 /end MEASUREMENT
/begin MEASUREMENT B_irhsc "" UBYTE B_TRUE 1 100 0.00 1.00000000000 BIT_MASK 0x10 FORMAT "%13.11" ECU_ADDRESS 0xD0000CB6 /end MEASUREMENT
/begin MEASUREMENT B_irtcwcs "" UBYTE B_TRUE 1 100 0.00 1.00000000000 BIT_MASK 0x8 FORMAT "%13.11" ECU_ADDRESS 0xD0000CB2 /end MEASUREMENT
/begin MEASUREMENT B_ivzabg1 "" UBYTE B_TRUE 1 100 0.00 1.00000000000 BIT_MASK 0x8 FORMAT "%13.11" ECU_ADDRESS 0xD0000090 /end MEASUREMENT
/begin MEASUREMENT B_ivzkat1 "" UBYTE B_TRUE 1 100 0.00 1.00000000000 BIT_MASK 0x80 FORMAT "%13.11" ECU_ADDRESS 0xD0000034 /end MEASUREMENT
/begin MEASUREMENT B_kamfzkh "" UBYTE B_TRUE 1 100 0.00 1.00000000000 BIT_MASK 0x2 FORMAT "%13.11" ECU_ADDRESS 0xD000007A /end MEASUREMENT
/begin MEASUREMENT B_katerr "" UBYTE B_TRUE 1 100 0.00 1.00000000000 BIT_MASK 0x20 FORMAT "%13.11" ECU_ADDRESS 0xD0000035 /end MEASUREMENT
/begin MEASUREMENT B_kh1i "" UBYTE B_TRUE 1 100 0.00 1.00000000000 BIT_MASK 0x4 FORMAT "%13.11" ECU_ADDRESS 0xD0000089 /end MEASUREMENT
/begin MEASUREMENT B_klh "" UBYTE B_TRUE 1 100 0.00 1.00000000000 BIT_MASK 0x80 FORMAT "%13.11" ECU_ADDRESS 0xD0000CB6 /end MEASUREMENT
/begin MEASUREMENT B_kln "" UBYTE B_TRUE 1 100 0.00 1.00000000000 BIT_MASK 0x1 FORMAT "%13.11" ECU_ADDRESS 0xD0000CB7 /end MEASUREMENT
/begin MEASUREMENT B_krensam "" UBYTE B_TRUE 1 100 0.00 1.00000000000 BIT_MASK 0x4 FORMAT "%13.11" ECU_ADDRESS 0xD0000030 /end MEASUREMENT
/begin MEASUREMENT B_krensas "" UBYTE B_TRUE 1 100 0.00 1.00000000000 BIT_MASK 0x8 FORMAT "%13.11" ECU_ADDRESS 0xD0000030 /end MEASUREMENT
/begin MEASUREMENT B_llvfzgz "" UBYTE B_TRUE 1 100 0.00 1.00000000000 BIT_MASK 0x80 FORMAT "%13.11" ECU_ADDRESS 0xD0000064 /end MEASUREMENT
/begin MEASUREMENT B_lscdis "" UBYTE B_TRUE 1 100 0.00 1.00000000000 BIT_MASK 0x2 FORMAT "%13.11" ECU_ADDRESS 0xD0000CB7 /end MEASUREMENT
/begin MEASUREMENT B_luaerk "" UBYTE B_TRUE 1 100 0.00 1.00000000000 BIT_MASK 0x4 FORMAT "%13.11" ECU_ADDRESS 0xD0000090 /end MEASUREMENT
/begin MEASUREMENT B_luarmn "" UBYTE B_TRUE 1 100 0.00 1.00000000000 BIT_MASK 0x40 FORMAT "%13.11" ECU_ADDRESS 0xD0000034 /end MEASUREMENT
/begin MEASUREMENT B_luerk "" UBYTE B_TRUE 1 100 0.00 1.00000000000 BIT_MASK 0x2 FORMAT "%13.11" ECU_ADDRESS 0xD0000092 /end MEASUREMENT
/begin MEASUREMENT B_lurkhe_corr "" UBYTE B_TRUE 1 100 0.00 1.00000000000 BIT_MASK 0x40 FORMAT "%13.11" ECU_ADDRESS 0xD0000080 /end MEASUREMENT
/begin MEASUREMENT B_lustop "" UBYTE B_TRUE 1 100 0.00 1.00000000000 BIT_MASK 0x2 FORMAT "%13.11" ECU_ADDRESS 0xD0000084 /end MEASUREMENT
/begin MEASUREMENT B_lustops "" UBYTE B_TRUE 1 100 0.00 1.00000000000 BIT_MASK 0x80 FORMAT "%13.11" ECU_ADDRESS 0xD0000036 /end MEASUREMENT
/begin MEASUREMENT B_lutsk "" UBYTE B_TRUE 1 100 0.00 1.00000000000 BIT_MASK 0x10 FORMAT "%13.11" ECU_ADDRESS 0xD0000075 /end MEASUREMENT
/begin MEASUREMENT B_lutsval "" UBYTE B_TRUE 1 100 0.00 1.00000000000 BIT_MASK 0x1 FORMAT "%13.11" ECU_ADDRESS 0xD0000072 /end MEASUREMENT
/begin MEASUREMENT B_mdarv "" UBYTE B_TRUE 1 100 0.00 1.00000000000 BIT_MASK 0x8 FORMAT "%13.11" ECU_ADDRESS 0xD0000089 /end MEASUREMENT
/begin MEASUREMENT B_mdarvdmd "" UBYTE B_TRUE 1 100 0.00 1.00000000000 BIT_MASK 0x80 FORMAT "%13.11" ECU_ADDRESS 0xD0000066 /end MEASUREMENT
/begin MEASUREMENT B_mddrla "" UBYTE B_TRUE 1 100 0.00 1.00000000000 BIT_MASK 0x8 FORMAT "%13.11" ECU_ADDRESS 0xD0000066 /end MEASUREMENT
/begin MEASUREMENT B_mderk "" UBYTE B_TRUE 1 100 0.00 1.00000000000 BIT_MASK 0x40 FORMAT "%13.11" ECU_ADDRESS 0xD0000068 /end MEASUREMENT
/begin MEASUREMENT B_mdkat "" UBYTE B_TRUE 1 100 0.00 1.00000000000 BIT_MASK 0x1 FORMAT "%13.11" ECU_ADDRESS 0xD0000087 /end MEASUREMENT
/begin MEASUREMENT B_mdmi "" UBYTE B_TRUE 1 100 0.00 1.00000000000 BIT_MASK 0x1 FORMAT "%13.11" ECU_ADDRESS 0xD000008C /end MEASUREMENT
/begin MEASUREMENT B_mdng "" UBYTE B_TRUE 1 100 0.00 1.00000000000 BIT_MASK 0x20 FORMAT "%13.11" ECU_ADDRESS 0xD000006D /end MEASUREMENT
/begin MEASUREMENT B_mdnmn "" UBYTE B_TRUE 1 100 0.00 1.00000000000 BIT_MASK 0x2 FORMAT "%13.11" ECU_ADDRESS 0xD0000078 /end MEASUREMENT
/begin MEASUREMENT B_mdnmx "" UBYTE B_TRUE 1 100 0.00 1.00000000000 BIT_MASK 0x1 FORMAT "%13.11" ECU_ADDRESS 0xD0000075 /end MEASUREMENT
/begin MEASUREMENT B_mdstim "" UBYTE B_TRUE 1 100 0.00 1.00000000000 BIT_MASK 0x80 FORMAT "%13.11" ECU_ADDRESS 0xD0000079 /end MEASUREMENT
/begin MEASUREMENT B_mdstop "" UBYTE B_TRUE 1 100 0.00 1.00000000000 BIT_MASK 0x40 FORMAT "%13.11" ECU_ADDRESS 0xD0000066 /end MEASUREMENT
/begin MEASUREMENT B_mdtnst "" UBYTE B_TRUE 1 100 0.00 1.00000000000 BIT_MASK 0x10 FORMAT "%13.11" ECU_ADDRESS 0xD000006D /end MEASUREMENT
/begin MEASUREMENT B_mdzag "" UBYTE B_TRUE 1 100 0.00 1.00000000000 BIT_MASK 0x2 FORMAT "%13.11" ECU_ADDRESS 0xD000005B /end MEASUREMENT
/begin MEASUREMENT B_mdzgstp "" UBYTE B_TRUE 1 100 0.00 1.00000000000 BIT_MASK 0x20 FORMAT "%13.11" ECU_ADDRESS 0xD0000074 /end MEASUREMENT
/begin MEASUREMENT B_milstp "" UBYTE B_TRUE 1 100 0.00 1.00000000000 BIT_MASK 0x10 FORMAT "%13.11" ECU_ADDRESS 0xD0000065 /end MEASUREMENT
/begin MEASUREMENT B_milstps "" UBYTE B_TRUE 1 100 0.00 1.00000000000 BIT_MASK 0x8 FORMAT "%13.11" ECU_ADDRESS 0xD0000037 /end MEASUREMENT
/begin MEASUREMENT B_misafon "" UBYTE B_TRUE 1 100 0.00 1.00000000000 BIT_MASK 0x20 FORMAT "%13.11" ECU_ADDRESS 0xD000006C /end MEASUREMENT
/begin MEASUREMENT B_misaLI "" UBYTE B_TRUE 1 100 0.00 1.00000000000 BIT_MASK 0x10 FORMAT "%13.11" ECU_ADDRESS 0xD0000092 /end MEASUREMENT
/begin MEASUREMENT B_misaZero "" UBYTE B_TRUE 1 100 0.00 1.00000000000 BIT_MASK 0x2 FORMAT "%13.11" ECU_ADDRESS 0xD0000089 /end MEASUREMENT
/begin MEASUREMENT B_modactiv "" UBYTE B_TRUE 1 100 0.00 1.00000000000 BIT_MASK 0x20 FORMAT "%13.11" ECU_ADDRESS 0xD0000039 /end MEASUREMENT
/begin MEASUREMENT B_nirhsc "" UBYTE B_TRUE 1 100 0.00 1.00000000000 BIT_MASK 0x4 FORMAT "%13.11" ECU_ADDRESS 0xD0000CB7 /end MEASUREMENT
/begin MEASUREMENT B_nirtcwcs "" UBYTE B_TRUE 1 100 0.00 1.00000000000 BIT_MASK 0x10 FORMAT "%13.11" ECU_ADDRESS 0xD0000CB2 /end MEASUREMENT
/begin MEASUREMENT B_nltcw "" UBYTE B_TRUE 1 100 0.00 1.00000000000 BIT_MASK 0x10 FORMAT "%13.11" ECU_ADDRESS 0xD0000CB3 /end MEASUREMENT
/begin MEASUREMENT B_nmnpsr "" UBYTE B_TRUE 1 100 0.00 1.00000000000 BIT_MASK 0x1 FORMAT "%13.11" ECU_ADDRESS 0xAFE80185 /end MEASUREMENT
/begin MEASUREMENT B_odgser "" UBYTE B_TRUE 1 100 0.00 1.00000000000 BIT_MASK 0x4 FORMAT "%13.11" ECU_ADDRESS 0xD0000076 /end MEASUREMENT
/begin MEASUREMENT B_orast "" UBYTE B_TRUE 1 100 0.00 1.00000000000 BIT_MASK 0x1 FORMAT "%13.11" ECU_ADDRESS 0xD0000031 /end MEASUREMENT
/begin MEASUREMENT B_orastab "" UBYTE B_TRUE 1 100 0.00 1.00000000000 BIT_MASK 0x4 FORMAT "%13.11" ECU_ADDRESS 0xD0000068 /end MEASUREMENT
/begin MEASUREMENT B_ostabzs "" UBYTE B_TRUE 1 100 0.00 1.00000000000 BIT_MASK 0x1 FORMAT "%13.11" ECU_ADDRESS 0xD0000091 /end MEASUREMENT
/begin MEASUREMENT B_otmcsesd "" UBYTE B_TRUE 1 100 0.00 1.00000000000 BIT_MASK 0x80 FORMAT "%13.11" ECU_ADDRESS 0xD0000CAD /end MEASUREMENT
/begin MEASUREMENT B_otmcsfst "" UBYTE B_TRUE 1 100 0.00 1.00000000000 BIT_MASK 0x2 FORMAT "%13.11" ECU_ADDRESS 0xD0000CAF /end MEASUREMENT
/begin MEASUREMENT B_pemntcw "" UBYTE B_TRUE 1 100 0.00 1.00000000000 BIT_MASK 0x2 FORMAT "%13.11" ECU_ADDRESS 0xD0000CAD /end MEASUREMENT
/begin MEASUREMENT B_pemxtcw "" UBYTE B_TRUE 1 100 0.00 1.00000000000 BIT_MASK 0x1 FORMAT "%13.11" ECU_ADDRESS 0xD0000CAD /end MEASUREMENT
/begin MEASUREMENT B_perlsc "" UBYTE B_TRUE 1 100 0.00 1.00000000000 BIT_MASK 0x2 FORMAT "%13.11" ECU_ADDRESS 0xD0000CB8 /end MEASUREMENT
/begin MEASUREMENT B_perstc "" UBYTE B_TRUE 1 100 0.00 1.00000000000 BIT_MASK 0x4 FORMAT "%13.11" ECU_ADDRESS 0xD0000CB8 /end MEASUREMENT
/begin MEASUREMENT B_phllsc "" UBYTE B_TRUE 1 100 0.00 1.00000000000 BIT_MASK 0x10 FORMAT "%13.11" ECU_ADDRESS 0xD0000CB8 /end MEASUREMENT
/begin MEASUREMENT B_phlstc "" UBYTE B_TRUE 1 100 0.00 1.00000000000 BIT_MASK 0x20 FORMAT "%13.11" ECU_ADDRESS 0xD0000CB8 /end MEASUREMENT
/begin MEASUREMENT B_phtcwcs "" UBYTE B_TRUE 1 100 0.00 1.00000000000 BIT_MASK 0x4 FORMAT "%13.11" ECU_ADDRESS 0xD0000CAD /end MEASUREMENT
/begin MEASUREMENT B_psini "" UBYTE B_TRUE 1 100 0.00 1.00000000000 BIT_MASK 0x4 FORMAT "%13.11" ECU_ADDRESS 0xD0000064 /end MEASUREMENT
/begin MEASUREMENT B_psrpl "" UBYTE B_TRUE 1 100 0.00 1.00000000000 BIT_MASK 0x1 FORMAT "%13.11" ECU_ADDRESS 0xD000006F /end MEASUREMENT
/begin MEASUREMENT B_psrrgmn "" UBYTE B_TRUE 1 100 0.00 1.00000000000 BIT_MASK 0x10 FORMAT "%13.11" ECU_ADDRESS 0xD0000081 /end MEASUREMENT
/begin MEASUREMENT B_psrrgmx "" UBYTE B_TRUE 1 100 0.00 1.00000000000 BIT_MASK 0x80 FORMAT "%13.11" ECU_ADDRESS 0xD0000063 /end MEASUREMENT
/begin MEASUREMENT B_psrrgtd "" UBYTE B_TRUE 1 100 0.00 1.00000000000 BIT_MASK 0x1 FORMAT "%13.11" ECU_ADDRESS 0xD000003B /end MEASUREMENT
/begin MEASUREMENT B_psrsvmn "" UBYTE B_TRUE 1 100 0.00 1.00000000000 BIT_MASK 0x4 FORMAT "%13.11" ECU_ADDRESS 0xD000003B /end MEASUREMENT
/begin MEASUREMENT B_psrsvmni "" UBYTE B_TRUE 1 100 0.00 1.00000000000 BIT_MASK 0x20 FORMAT "%13.11" ECU_ADDRESS 0xD000003B /end MEASUREMENT
/begin MEASUREMENT B_psrsvmx "" UBYTE B_TRUE 1 100 0.00 1.00000000000 BIT_MASK 0x8 FORMAT "%13.11" ECU_ADDRESS 0xD000003B /end MEASUREMENT
/begin MEASUREMENT B_psrsvmxi "" UBYTE B_TRUE 1 100 0.00 1.00000000000 BIT_MASK 0x40 FORMAT "%13.11" ECU_ADDRESS 0xD000003B /end MEASUREMENT
/begin MEASUREMENT B_sppsrr "" UBYTE B_TRUE 1 100 0.00 1.00000000000 BIT_MASK 0x10 FORMAT "%13.11" ECU_ADDRESS 0xD000003A /end MEASUREMENT
/begin MEASUREMENT B_stccold "" UBYTE B_TRUE 1 100 0.00 1.00000000000 BIT_MASK 0x20 FORMAT "%13.11" ECU_ADDRESS 0xD0000CB7 /end MEASUREMENT
/begin MEASUREMENT B_stcdis "" UBYTE B_TRUE 1 100 0.00 1.00000000000 BIT_MASK 0x80 FORMAT "%13.11" ECU_ADDRESS 0xD0000CB7 /end MEASUREMENT
/begin MEASUREMENT B_stchot "" UBYTE B_TRUE 1 100 0.00 1.00000000000 BIT_MASK 0x40 FORMAT "%13.11" ECU_ADDRESS 0xD0000CB7 /end MEASUREMENT
/begin MEASUREMENT B_stdmd "" UBYTE B_TRUE 1 100 0.00 1.00000000000 BIT_MASK 0x1 FORMAT "%13.11" ECU_ADDRESS 0xD0000036 /end MEASUREMENT
/begin MEASUREMENT B_stHys "" UBYTE B_TRUE 1 100 0.00 1.00000000000 BIT_MASK 0x8 FORMAT "%13.11" ECU_ADDRESS 0xD0000039 /end MEASUREMENT
/begin MEASUREMENT B_stpadpst "" UBYTE B_TRUE 1 100 0.00 1.00000000000 BIT_MASK 0x1 FORMAT "%13.11" ECU_ADDRESS 0xD0000059 /end MEASUREMENT
/begin MEASUREMENT B_stpon "" UBYTE B_TRUE 1 100 0.00 1.00000000000 BIT_MASK 0x1 FORMAT "%13.11" ECU_ADDRESS 0xD000009D /end MEASUREMENT
/begin MEASUREMENT B_swe "" UBYTE B_TRUE 1 100 0.00 1.00000000000 BIT_MASK 0x10 FORMAT "%13.11" ECU_ADDRESS 0xD0000055 /end MEASUREMENT
/begin MEASUREMENT B_thigh "" UBYTE B_TRUE 1 100 0.00 1.00000000000 BIT_MASK 0x2 FORMAT "%13.11" ECU_ADDRESS 0xD000003B /end MEASUREMENT
/begin MEASUREMENT B_tmrwfvr "" UBYTE B_TRUE 1 100 0.00 1.00000000000 BIT_MASK 0x40 FORMAT "%13.11" ECU_ADDRESS 0xD0000CB8 /end MEASUREMENT
/begin MEASUREMENT B_tmrwset "" UBYTE B_TRUE 1 100 0.00 1.00000000000 BIT_MASK 0x1 FORMAT "%13.11" ECU_ADDRESS 0xD0000CB9 /end MEASUREMENT
/begin MEASUREMENT B_tmrwstrt "" UBYTE B_TRUE 1 100 0.00 1.00000000000 BIT_MASK 0x2 FORMAT "%13.11" ECU_ADDRESS 0xD0000CB9 /end MEASUREMENT
/begin MEASUREMENT B_tmstdmd "" UBYTE B_TRUE 1 100 0.00 1.00000000000 BIT_MASK 0x2 FORMAT "%13.11" ECU_ADDRESS 0xD0000036 /end MEASUREMENT
/begin MEASUREMENT B_tnalu "" UBYTE B_TRUE 1 100 0.00 1.00000000000 BIT_MASK 0x8 FORMAT "%13.11" ECU_ADDRESS 0xD000008B /end MEASUREMENT
/begin MEASUREMENT B_tsbready "" UBYTE B_TRUE 1 100 0.00 1.00000000000 BIT_MASK 0x8 FORMAT "%13.11" ECU_ADDRESS 0xD0000055 /end MEASUREMENT
/begin MEASUREMENT B_tsroov "" UBYTE B_TRUE 1 100 0.00 1.00000000000 BIT_MASK 0x1 FORMAT "%13.11" ECU_ADDRESS 0xD0000073 /end MEASUREMENT
/begin MEASUREMENT B_zagena "" UBYTE B_TRUE 1 100 0.00 1.00000000000 BIT_MASK 0x10 FORMAT "%13.11" ECU_ADDRESS 0xD0000039 /end MEASUREMENT
/begin MEASUREMENT B_zagrun "" UBYTE B_TRUE 1 100 0.00 1.00000000000 BIT_MASK 0x40 FORMAT "%13.11" ECU_ADDRESS 0xD0000039 /end MEASUREMENT
/begin MEASUREMENT B_zfra "" UBYTE B_TRUE 1 100 0.00 1.00000000000 BIT_MASK 0x80 FORMAT "%13.11" ECU_ADDRESS 0xD0000098 /end MEASUREMENT
/begin MEASUREMENT B_zora "" UBYTE B_TRUE 1 100 0.00 1.00000000000 BIT_MASK 0x10 FORMAT "%13.11" ECU_ADDRESS 0xD0000094 /end MEASUREMENT
/begin MEASUREMENT B_zpsrsv "" UBYTE B_TRUE 1 100 0.00 1.00000000000 BIT_MASK 0x10 FORMAT "%13.11" ECU_ADDRESS 0xD000003B /end MEASUREMENT
/begin MEASUREMENT B_zwlate "" UBYTE B_TRUE 1 100 0.00 1.00000000000 BIT_MASK 0x4 FORMAT "%13.11" ECU_ADDRESS 0xD0000039 /end MEASUREMENT
/begin MEASUREMENT cdcy "" UBYTE dez 1 100 0.00 255.0 FORMAT "%5.1" ECU_ADDRESS 0xAFE8017F /end MEASUREMENT
/begin MEASUREMENT cntbmdarv "" UBYTE dez 1 100 0.00 255.0 FORMAT "%5.1" ECU_ADDRESS 0xAFE80180 /end MEASUREMENT
/begin MEASUREMENT ctmrw_w "" UWORD temp_uw_q0p0029_o48 1 100 -48.00000 143.9971 FORMAT "%8.4" ECU_ADDRESS 0xD00006AC /end MEASUREMENT
/begin MEASUREMENT ctrsynaftrstp "" UBYTE dez 1 100 0.00 255.0 FORMAT "%5.1" ECU_ADDRESS 0xD0000C67 /end MEASUREMENT
/begin MEASUREMENT dfrmf_w "" UWORD fak_uw_b2 1 100 0.00 1.999969 FORMAT "%8.6" ECU_ADDRESS 0xD000051E /end MEASUREMENT
/begin MEASUREMENT dfsofmedi_w "" UWORD kw_q1p5259eEm4_om5 1 100 -5.000000 4.999847 FORMAT "%8.6" ARRAY_SIZE 2 ECU_ADDRESS 0xD00005A8 /end MEASUREMENT
/begin MEASUREMENT dlurs_w "" SWORD lu_MEx 1 100 -149.0116 149.0071 FORMAT "%8.4" ECU_ADDRESS 0xD00005A6 /end MEASUREMENT
/begin MEASUREMENT dlutsflut_w "" SWORD lu_MEx 1 100 -149.0116 149.0071 FORMAT "%8.4" ECU_ADDRESS 0xD000057E /end MEASUREMENT
/begin MEASUREMENT dlutsk_w "" SWORD lu_MEx 1 100 -149.0116 149.0071 FORMAT "%8.4" ECU_ADDRESS 0xD0000580 /end MEASUREMENT
/begin MEASUREMENT dmdsegl_w "" UWORD kw_tooth_sy 1 100 0.00 655350.0 FORMAT "%8.1" ECU_ADDRESS 0xD0000688 /end MEASUREMENT
/begin MEASUREMENT Dme_ctDataSetVariant "" UBYTE OneToOne 1 100 0.00 255.0 FORMAT "%5.1" ECU_ADDRESS 0xD0003E09 /end MEASUREMENT
/begin MEASUREMENT Dme_numBytesAvailable "" ULONG OneToOne 1 100 0.00 4294967295.00 FORMAT "%13.2" ECU_ADDRESS 0xD000299C /end MEASUREMENT
/begin MEASUREMENT Dme_numBytesAvailableOvl "" ULONG OneToOne 1 100 0.00 4294967295.00 FORMAT "%13.2" ECU_ADDRESS 0xD00029A0 /end MEASUREMENT
/begin MEASUREMENT dmxrlu_w "" SWORD lu_MEx 1 100 -149.0116 149.0071 FORMAT "%8.4" ECU_ADDRESS 0xD0000612 /end MEASUREMENT
/begin MEASUREMENT dotmcs_dst "" UBYTE dez 1 100 0.00 255.0 FORMAT "%5.1" ECU_ADDRESS 0xD0000CB0 /end MEASUREMENT
/begin MEASUREMENT dps_error "" UWORD dez 1 100 0.00 65535.00 FORMAT "%8.2" ECU_ADDRESS 0xD00006B2 /end MEASUREMENT
/begin MEASUREMENT dps_errStat "" UWORD dez 1 100 0.00 65535.00 FORMAT "%8.2" ECU_ADDRESS 0xD00006B4 /end MEASUREMENT
/begin MEASUREMENT dps_errStat_sum_rec "" UWORD dez 1 100 0.00 65535.00 FORMAT "%8.2" ECU_ADDRESS 0xD00006B6 /end MEASUREMENT
/begin MEASUREMENT dps_errStat_sum_ver "" UWORD dez 1 100 0.00 65535.00 FORMAT "%8.2" ECU_ADDRESS 0xD00006B8 /end MEASUREMENT
/begin MEASUREMENT dps_index "" UBYTE dez 1 100 0.00 255.0 FORMAT "%5.1" ECU_ADDRESS 0xD0000CC5 /end MEASUREMENT
/begin MEASUREMENT dps_recoveryTime "" UBYTE t_q0p1 1 100 0.00 25.50 FORMAT "%5.2" ECU_ADDRESS 0xD0000CC6 /end MEASUREMENT
/begin MEASUREMENT dps_state "" UBYTE dez 1 100 0.00 255.0 FORMAT "%5.1" ECU_ADDRESS 0xD0000CC7 /end MEASUREMENT
/begin MEASUREMENT dps_verifyTime "" UBYTE t_q0p1 1 100 0.00 25.50 FORMAT "%5.2" ECU_ADDRESS 0xD0000CC8 /end MEASUREMENT
/begin MEASUREMENT DSCHED_DynPrio.FId_Unused "" SWORD DFC_OneToOne 1 100 -32768.00 32767.00 FORMAT "%8.2" ECU_ADDRESS 0xD00037AA /end MEASUREMENT
/begin MEASUREMENT DSCHED_DynPrio.FID_AFRA "" SWORD DFC_OneToOne 1 100 -32768.00 32767.00 FORMAT "%8.2" ECU_ADDRESS 0xD00037AC /end MEASUREMENT
/begin MEASUREMENT DSCHED_DynPrio.FID_AORA "" SWORD DFC_OneToOne 1 100 -32768.00 32767.00 FORMAT "%8.2" ECU_ADDRESS 0xD00037AE /end MEASUREMENT
/begin MEASUREMENT DSCHED_DynPrio.FID_ATEH "" SWORD DFC_OneToOne 1 100 -32768.00 32767.00 FORMAT "%8.2" ECU_ADDRESS 0xD00037B0 /end MEASUREMENT
/begin MEASUREMENT DSCHED_DynPrio.FID_ATEL "" SWORD DFC_OneToOne 1 100 -32768.00 32767.00 FORMAT "%8.2" ECU_ADDRESS 0xD00037B2 /end MEASUREMENT
/begin MEASUREMENT DSCHED_DynPrio.FID_ATEN "" SWORD DFC_OneToOne 1 100 -32768.00 32767.00 FORMAT "%8.2" ECU_ADDRESS 0xD00037B4 /end MEASUREMENT
/begin MEASUREMENT DSCHED_DynPrio.FId_InhibitAlways "" SWORD DFC_OneToOne 1 100 -32768.00 32767.00 FORMAT "%8.2" ECU_ADDRESS 0xD00037B6 /end MEASUREMENT
/begin MEASUREMENT DSCHED_DynPrio.FID_BLLRH "" SWORD DFC_OneToOne 1 100 -32768.00 32767.00 FORMAT "%8.2" ECU_ADDRESS 0xD00037B8 /end MEASUREMENT
/begin MEASUREMENT DSCHED_DynPrio.FID_BLLRKH "" SWORD DFC_OneToOne 1 100 -32768.00 32767.00 FORMAT "%8.2" ECU_ADDRESS 0xD00037BA /end MEASUREMENT
/begin MEASUREMENT DSCHED_DynPrio.FID_BMDFON "" SWORD DFC_OneToOne 1 100 -32768.00 32767.00 FORMAT "%8.2" ECU_ADDRESS 0xD00037BC /end MEASUREMENT
/begin MEASUREMENT DSCHED_DynPrio.FId_TWCCTrimB1 "" SWORD DFC_OneToOne 1 100 -32768.00 32767.00 FORMAT "%8.2" ECU_ADDRESS 0xD00037BE /end MEASUREMENT
/begin MEASUREMENT DSCHED_DynPrio.FId_TWCDPriCatB1 "" SWORD DFC_OneToOne 1 100 -32768.00 32767.00 FORMAT "%8.2" ECU_ADDRESS 0xD00037C0 /end MEASUREMENT
/begin MEASUREMENT DSCHED_idxWTTAct "" UWORD DINH_OneToOne 1 100 0.00 65535.00 FORMAT "%8.2" ECU_ADDRESS 0xD0003ADE /end MEASUREMENT
/begin MEASUREMENT DSCHED_PhysPrio.FId_Unused "" UBYTE DFC_OneToOne 1 100 0.00 255.0 FORMAT "%5.1" ECU_ADDRESS 0xD0003DFD /end MEASUREMENT
/begin MEASUREMENT DSCHED_PhysPrio.FID_AFRA "" UBYTE DFC_OneToOne 1 100 0.00 255.0 FORMAT "%5.1" ECU_ADDRESS 0xD0003DFE /end MEASUREMENT
/begin MEASUREMENT DSCHED_PhysPrio.FID_AORA "" UBYTE DFC_OneToOne 1 100 0.00 255.0 FORMAT "%5.1" ECU_ADDRESS 0xD0003DFF /end MEASUREMENT
/begin MEASUREMENT DSCHED_PhysPrio.FID_ATEH "" UBYTE DFC_OneToOne 1 100 0.00 255.0 FORMAT "%5.1" ECU_ADDRESS 0xD0003E00 /end MEASUREMENT
/begin MEASUREMENT DSCHED_PhysPrio.FID_ATEL "" UBYTE DFC_OneToOne 1 100 0.00 255.0 FORMAT "%5.1" ECU_ADDRESS 0xD0003E01 /end MEASUREMENT
/begin MEASUREMENT DSCHED_PhysPrio.FID_ATEN "" UBYTE DFC_OneToOne 1 100 0.00 255.0 FORMAT "%5.1" ECU_ADDRESS 0xD0003E02 /end MEASUREMENT
/begin MEASUREMENT DSCHED_PhysPrio.FId_InhibitAlways "" UBYTE DFC_OneToOne 1 100 0.00 255.0 FORMAT "%5.1" ECU_ADDRESS 0xD0003E03 /end MEASUREMENT
/begin MEASUREMENT DSCHED_PhysPrio.FID_BLLRH "" UBYTE DFC_OneToOne 1 100 0.00 255.0 FORMAT "%5.1" ECU_ADDRESS 0xD0003E04 /end MEASUREMENT
/begin MEASUREMENT DSCHED_PhysPrio.FID_BLLRKH "" UBYTE DFC_OneToOne 1 100 0.00 255.0 FORMAT "%5.1" ECU_ADDRESS 0xD0003E05 /end MEASUREMENT
/begin MEASUREMENT DSCHED_PhysPrio.FID_BMDFON "" UBYTE DFC_OneToOne 1 100 0.00 255.0 FORMAT "%5.1" ECU_ADDRESS 0xD0003E06 /end MEASUREMENT
/begin MEASUREMENT DSCHED_PhysPrio.FId_TWCCTrimB1 "" UBYTE DFC_OneToOne 1 100 0.00 255.0 FORMAT "%5.1" ECU_ADDRESS 0xD0003E07 /end MEASUREMENT
/begin MEASUREMENT DSCHED_PhysPrio.FId_TWCDPriCatB1 "" UBYTE DFC_OneToOne 1 100 0.00 255.0 FORMAT "%5.1" ECU_ADDRESS 0xD0003E08 /end MEASUREMENT
/begin MEASUREMENT DSCHED_St.FId_Unused "" UBYTE DSCHED_StVerb 1 100 0.00 238.000000000 FORMAT "%13.9" ECU_ADDRESS 0xD0003DF1 /end MEASUREMENT
/begin MEASUREMENT DSCHED_St.FID_AFRA "" UBYTE DSCHED_StVerb 1 100 0.00 238.000000000 FORMAT "%13.9" ECU_ADDRESS 0xD0003DF2 /end MEASUREMENT
/begin MEASUREMENT DSCHED_St.FID_AORA "" UBYTE DSCHED_StVerb 1 100 0.00 238.000000000 FORMAT "%13.9" ECU_ADDRESS 0xD0003DF3 /end MEASUREMENT
/begin MEASUREMENT DSCHED_St.FID_ATEH "" UBYTE DSCHED_StVerb 1 100 0.00 238.000000000 FORMAT "%13.9" ECU_ADDRESS 0xD0003DF4 /end MEASUREMENT
/begin MEASUREMENT DSCHED_St.FID_ATEL "" UBYTE DSCHED_StVerb 1 100 0.00 238.000000000 FORMAT "%13.9" ECU_ADDRESS 0xD0003DF5 /end MEASUREMENT
/begin MEASUREMENT DSCHED_St.FID_ATEN "" UBYTE DSCHED_StVerb 1 100 0.00 238.000000000 FORMAT "%13.9" ECU_ADDRESS 0xD0003DF6 /end MEASUREMENT
/begin MEASUREMENT DSCHED_St.FId_InhibitAlways "" UBYTE DSCHED_StVerb 1 100 0.00 238.000000000 FORMAT "%13.9" ECU_ADDRESS 0xD0003DF7 /end MEASUREMENT
/begin MEASUREMENT DSCHED_St.FID_BLLRH "" UBYTE DSCHED_StVerb 1 100 0.00 238.000000000 FORMAT "%13.9" ECU_ADDRESS 0xD0003DF8 /end MEASUREMENT
/begin MEASUREMENT DSCHED_St.FID_BLLRKH "" UBYTE DSCHED_StVerb 1 100 0.00 238.000000000 FORMAT "%13.9" ECU_ADDRESS 0xD0003DF9 /end MEASUREMENT
/begin MEASUREMENT DSCHED_St.FID_BMDFON "" UBYTE DSCHED_StVerb 1 100 0.00 238.000000000 FORMAT "%13.9" ECU_ADDRESS 0xD0003DFA /end MEASUREMENT
/begin MEASUREMENT DSCHED_St.FId_TWCCTrimB1 "" UBYTE DSCHED_StVerb 1 100 0.00 238.000000000 FORMAT "%13.9" ECU_ADDRESS 0xD0003DFB /end MEASUREMENT
/begin MEASUREMENT DSCHED_St.FId_TWCDPriCatB1 "" UBYTE DSCHED_StVerb 1 100 0.00 238.000000000 FORMAT "%13.9" ECU_ADDRESS 0xD0003DFC /end MEASUREMENT
/begin MEASUREMENT DSCHED_TiActv.FId_Unused "" UWORD DFC_OneToOne 1 100 0.00 65535.00 FORMAT "%8.2" ECU_ADDRESS 0xD000377A /end MEASUREMENT
/begin MEASUREMENT DSCHED_TiActv.FID_AFRA "" UWORD DSCHED_Time200ms 1 100 0.00 13107.00 FORMAT "%8.2" ECU_ADDRESS 0xD000377C /end MEASUREMENT
/begin MEASUREMENT DSCHED_TiActv.FID_AORA "" UWORD DSCHED_Time200ms 1 100 0.00 13107.00 FORMAT "%8.2" ECU_ADDRESS 0xD000377E /end MEASUREMENT
/begin MEASUREMENT DSCHED_TiActv.FID_ATEH "" UWORD DSCHED_Time200ms 1 100 0.00 13107.00 FORMAT "%8.2" ECU_ADDRESS 0xD0003780 /end MEASUREMENT
/begin MEASUREMENT DSCHED_TiActv.FID_ATEL "" UWORD DSCHED_Time200ms 1 100 0.00 13107.00 FORMAT "%8.2" ECU_ADDRESS 0xD0003782 /end MEASUREMENT
/begin MEASUREMENT DSCHED_TiActv.FID_ATEN "" UWORD DSCHED_Time200ms 1 100 0.00 13107.00 FORMAT "%8.2" ECU_ADDRESS 0xD0003784 /end MEASUREMENT
/begin MEASUREMENT DSCHED_TiActv.FId_InhibitAlways "" UWORD DSCHED_Time200ms 1 100 0.00 13107.00 FORMAT "%8.2" ECU_ADDRESS 0xD0003786 /end MEASUREMENT
/begin MEASUREMENT DSCHED_TiActv.FID_BLLRH "" UWORD DSCHED_Time200ms 1 100 0.00 13107.00 FORMAT "%8.2" ECU_ADDRESS 0xD0003788 /end MEASUREMENT
/begin MEASUREMENT DSCHED_TiActv.FID_BLLRKH "" UWORD DSCHED_Time200ms 1 100 0.00 13107.00 FORMAT "%8.2" ECU_ADDRESS 0xD000378A /end MEASUREMENT
/begin MEASUREMENT DSCHED_TiActv.FID_BMDFON "" UWORD DSCHED_Time200ms 1 100 0.00 13107.00 FORMAT "%8.2" ECU_ADDRESS 0xD000378C /end MEASUREMENT
/begin MEASUREMENT DSCHED_TiActv.FId_TWCCTrimB1 "" UWORD DSCHED_Time200ms 1 100 0.00 13107.00 FORMAT "%8.2" ECU_ADDRESS 0xD000378E /end MEASUREMENT
/begin MEASUREMENT DSCHED_TiActv.FId_TWCDPriCatB1 "" UWORD DSCHED_Time200ms 1 100 0.00 13107.00 FORMAT "%8.2" ECU_ADDRESS 0xD0003790 /end MEASUREMENT
/begin MEASUREMENT DSCHED_TiPas.FId_Unused "" UWORD DFC_OneToOne 1 100 0.00 65535.00 FORMAT "%8.2" ECU_ADDRESS 0xD0003792 /end MEASUREMENT
/begin MEASUREMENT DSCHED_TiPas.FID_AFRA "" UWORD DSCHED_Time200ms 1 100 0.00 13107.00 FORMAT "%8.2" ECU_ADDRESS 0xD0003794 /end MEASUREMENT
/begin MEASUREMENT DSCHED_TiPas.FID_AORA "" UWORD DSCHED_Time200ms 1 100 0.00 13107.00 FORMAT "%8.2" ECU_ADDRESS 0xD0003796 /end MEASUREMENT
/begin MEASUREMENT DSCHED_TiPas.FID_ATEH "" UWORD DSCHED_Time200ms 1 100 0.00 13107.00 FORMAT "%8.2" ECU_ADDRESS 0xD0003798 /end MEASUREMENT
/begin MEASUREMENT DSCHED_TiPas.FID_ATEL "" UWORD DSCHED_Time200ms 1 100 0.00 13107.00 FORMAT "%8.2" ECU_ADDRESS 0xD000379A /end MEASUREMENT
/begin MEASUREMENT DSCHED_TiPas.FID_ATEN "" UWORD DSCHED_Time200ms 1 100 0.00 13107.00 FORMAT "%8.2" ECU_ADDRESS 0xD000379C /end MEASUREMENT
/begin MEASUREMENT DSCHED_TiPas.FId_InhibitAlways "" UWORD DSCHED_Time200ms 1 100 0.00 13107.00 FORMAT "%8.2" ECU_ADDRESS 0xD000379E /end MEASUREMENT
/begin MEASUREMENT DSCHED_TiPas.FID_BLLRH "" UWORD DSCHED_Time200ms 1 100 0.00 13107.00 FORMAT "%8.2" ECU_ADDRESS 0xD00037A0 /end MEASUREMENT
/begin MEASUREMENT DSCHED_TiPas.FID_BLLRKH "" UWORD DSCHED_Time200ms 1 100 0.00 13107.00 FORMAT "%8.2" ECU_ADDRESS 0xD00037A2 /end MEASUREMENT
/begin MEASUREMENT DSCHED_TiPas.FID_BMDFON "" UWORD DSCHED_Time200ms 1 100 0.00 13107.00 FORMAT "%8.2" ECU_ADDRESS 0xD00037A4 /end MEASUREMENT
/begin MEASUREMENT DSCHED_TiPas.FId_TWCCTrimB1 "" UWORD DSCHED_Time200ms 1 100 0.00 13107.00 FORMAT "%8.2" ECU_ADDRESS 0xD00037A6 /end MEASUREMENT
/begin MEASUREMENT DSCHED_TiPas.FId_TWCDPriCatB1 "" UWORD DSCHED_Time200ms 1 100 0.00 13107.00 FORMAT "%8.2" ECU_ADDRESS 0xD00037A8 /end MEASUREMENT
/begin MEASUREMENT DSCHED_tiWTT "" UWORD DSCHED_Time100ms 1 100 0.00 6553.500 FORMAT "%8.3" ECU_ADDRESS 0xD0003778 /end MEASUREMENT
/begin MEASUREMENT DSCHED_WhyExcl.FId_Unused "" UWORD DSCHED_FIdExcCauseVerb 1 100 0.00 255. FORMAT "%2.0" ECU_ADDRESS 0xD00037C2 /end MEASUREMENT
/begin MEASUREMENT DSCHED_WhyExcl.FID_AFRA "" UWORD DSCHED_FIdExcCauseVerb 1 100 0.00 255. FORMAT "%2.0" ECU_ADDRESS 0xD00037C4 /end MEASUREMENT
/begin MEASUREMENT DSCHED_WhyExcl.FID_AORA "" UWORD DSCHED_FIdExcCauseVerb 1 100 0.00 255. FORMAT "%2.0" ECU_ADDRESS 0xD00037C6 /end MEASUREMENT
/begin MEASUREMENT DSCHED_WhyExcl.FID_ATEH "" UWORD DSCHED_FIdExcCauseVerb 1 100 0.00 255. FORMAT "%2.0" ECU_ADDRESS 0xD00037C8 /end MEASUREMENT
/begin MEASUREMENT DSCHED_WhyExcl.FID_ATEL "" UWORD DSCHED_FIdExcCauseVerb 1 100 0.00 255. FORMAT "%2.0" ECU_ADDRESS 0xD00037CA /end MEASUREMENT
/begin MEASUREMENT DSCHED_WhyExcl.FID_ATEN "" UWORD DSCHED_FIdExcCauseVerb 1 100 0.00 255. FORMAT "%2.0" ECU_ADDRESS 0xD00037CC /end MEASUREMENT
/begin MEASUREMENT DSCHED_WhyExcl.FId_InhibitAlways "" UWORD DSCHED_FIdExcCauseVerb 1 100 0.00 255. FORMAT "%2.0" ECU_ADDRESS 0xD00037CE /end MEASUREMENT
/begin MEASUREMENT DSCHED_WhyExcl.FID_BLLRH "" UWORD DSCHED_FIdExcCauseVerb 1 100 0.00 255. FORMAT "%2.0" ECU_ADDRESS 0xD00037D0 /end MEASUREMENT
/begin MEASUREMENT DSCHED_WhyExcl.FID_BLLRKH "" UWORD DSCHED_FIdExcCauseVerb 1 100 0.00 255. FORMAT "%2.0" ECU_ADDRESS 0xD00037D2 /end MEASUREMENT
/begin MEASUREMENT DSCHED_WhyExcl.FID_BMDFON "" UWORD DSCHED_FIdExcCauseVerb 1 100 0.00 255. FORMAT "%2.0" ECU_ADDRESS 0xD00037D4 /end MEASUREMENT
/begin MEASUREMENT DSCHED_WhyExcl.FId_TWCCTrimB1 "" UWORD DSCHED_FIdExcCauseVerb 1 100 0.00 255. FORMAT "%2.0" ECU_ADDRESS 0xD00037D6 /end MEASUREMENT
/begin MEASUREMENT DSCHED_WhyExcl.FId_TWCDPriCatB1 "" UWORD DSCHED_FIdExcCauseVerb 1 100 0.00 255. FORMAT "%2.0" ECU_ADDRESS 0xD00037D8 /end MEASUREMENT
/begin MEASUREMENT dtmrwtumg "" UBYTE temp_ub_q0p75_o48 1 100 -48.00 143.3 FORMAT "%5.1" ECU_ADDRESS 0xD0000CBA /end MEASUREMENT
/begin MEASUREMENT esst_smi04aduw "" ULONG dez 1 100 0.00 4294967295.00 FORMAT "%13.2" ECU_ADDRESS 0xD0001ED4 /end MEASUREMENT
/begin MEASUREMENT esst_snm12aduw "" ULONG dez 1 100 0.00 4294967295.00 FORMAT "%13.2" ECU_ADDRESS 0xD0001ED8 /end MEASUREMENT
/begin MEASUREMENT famal "" UBYTE fak_ub_b2 1 100 0.00 1.992188 FORMAT "%8.6" ECU_ADDRESS 0xD0000C83 /end MEASUREMENT
/begin MEASUREMENT famalwk "" UBYTE fak_ub_b2 1 100 0.00 1.992188 FORMAT "%8.6" ECU_ADDRESS 0xD0000C84 /end MEASUREMENT
/begin MEASUREMENT fanalun "" UBYTE dez 1 100 0.00 255.0 FORMAT "%5.1" ECU_ADDRESS 0xD0000C7E /end MEASUREMENT
/begin MEASUREMENT favralu "" UBYTE dez 1 100 0.00 255.0 FORMAT "%5.1" ECU_ADDRESS 0xD0000CA0 /end MEASUREMENT
/begin MEASUREMENT fdpsrm_w "" UWORD fak_uw_b2 1 100 0.00 1.999969 FORMAT "%8.6" ECU_ADDRESS 0xD00006A2 /end MEASUREMENT
/begin MEASUREMENT fivzabg "" UBYTE dez 1 100 0.00 255.0 FORMAT "%5.1" ECU_ADDRESS 0xD0000C8D /end MEASUREMENT
/begin MEASUREMENT flgabfz "" UBYTE dez 1 100 0.00 255.0 FORMAT "%5.1" ECU_ADDRESS 0xD0000C90 /end MEASUREMENT
/begin MEASUREMENT flgaintzyl_w "" UWORD dez 1 100 0.00 65535.00 FORMAT "%8.2" ECU_ADDRESS 0xD0000658 /end MEASUREMENT
/begin MEASUREMENT flgevok "" UBYTE dez 1 100 0.00 255.0 FORMAT "%5.1" ECU_ADDRESS 0xD0000C8E /end MEASUREMENT
/begin MEASUREMENT flgkaterr_w "" UWORD dez 1 100 0.00 65535.00 FORMAT "%8.2" ECU_ADDRESS 0xD000065A /end MEASUREMENT
/begin MEASUREMENT flgmdetyp "" UBYTE dez 1 100 0.00 255.0 FORMAT "%5.1" ECU_ADDRESS 0xD0000C91 /end MEASUREMENT
/begin MEASUREMENT flgmdetypCyl "" UBYTE dez 1 100 0.00 255.0 FORMAT "%5.1" ARRAY_SIZE 3 ECU_ADDRESS 0xD0000C92 /end MEASUREMENT
/begin MEASUREMENT flgmdkatbnk "" UBYTE dez 1 100 0.00 255.0 FORMAT "%5.1" ECU_ADDRESS 0xD0000C95 /end MEASUREMENT
/begin MEASUREMENT flgstign_w "" UWORD dez 1 100 0.00 65535.00 FORMAT "%8.2" ECU_ADDRESS 0xD000069A /end MEASUREMENT
/begin MEASUREMENT flgstinj_w "" UWORD dez 1 100 0.00 65535.00 FORMAT "%8.2" ECU_ADDRESS 0xD000069C /end MEASUREMENT
/begin MEASUREMENT flgst_w "" UWORD dez 1 100 0.00 65535.00 FORMAT "%8.2" ECU_ADDRESS 0xD000069E /end MEASUREMENT
/begin MEASUREMENT flgtiab "" UBYTE dez 1 100 0.00 255.0 FORMAT "%5.1" ECU_ADDRESS 0xD0000C96 /end MEASUREMENT
/begin MEASUREMENT flgtiabmd_w "" UWORD dez 1 100 0.00 65535.00 FORMAT "%8.2" ECU_ADDRESS 0xD0000660 /end MEASUREMENT
/begin MEASUREMENT flmxofkh_w "" UWORD kw_q1p5259eEm4_om5 1 100 -5.000000 4.999847 FORMAT "%8.6" ECU_ADDRESS 0xD00005F8 /end MEASUREMENT
/begin MEASUREMENT flurb_w "" SWORD lu_MEx 1 100 -149.0116 149.0071 FORMAT "%8.4" ECU_ADDRESS 0xD0000614 /end MEASUREMENT
/begin MEASUREMENT flurktm_w "" SWORD lu_MEx 1 100 -149.0116 149.0071 FORMAT "%8.4" ECU_ADDRESS 0xD000061E /end MEASUREMENT
/begin MEASUREMENT flurmin1_w "" SWORD lu_MEx 1 100 -149.0116 149.0071 FORMAT "%8.4" ECU_ADDRESS 0xD0000616 /end MEASUREMENT
/begin MEASUREMENT flurmin2_w "" SWORD lu_MEx 1 100 -149.0116 149.0071 FORMAT "%8.4" ECU_ADDRESS 0xD0000618 /end MEASUREMENT
/begin MEASUREMENT flurmin3_w "" SWORD lu_MEx 1 100 -149.0116 149.0071 FORMAT "%8.4" ECU_ADDRESS 0xD0000620 /end MEASUREMENT
/begin MEASUREMENT flurmin_w "" SWORD lu_MEx 1 100 -149.0116 149.0071 FORMAT "%8.4" ECU_ADDRESS 0xD0000622 /end MEASUREMENT
/begin MEASUREMENT flurstmp_w "" SWORD lu_MEx 1 100 -149.0116 149.0071 FORMAT "%8.4" ECU_ADDRESS 0xD000061A /end MEASUREMENT
/begin MEASUREMENT flurst_w "" UWORD fak_uw_b2 1 100 0.00 1.999969 FORMAT "%8.6" ECU_ADDRESS 0xD000061C /end MEASUREMENT
/begin MEASUREMENT flutskzy_w "" SWORD lu_MEx 1 100 -149.0116 149.0071 FORMAT "%8.4" ARRAY_SIZE 3 ECU_ADDRESS 0xD0000582 /end MEASUREMENT
/begin MEASUREMENT flutsk_w "" SWORD lu_MEx 1 100 -149.0116 149.0071 FORMAT "%8.4" ECU_ADDRESS 0xD0000588 /end MEASUREMENT
/begin MEASUREMENT fofresz "" UBYTE dez 1 100 0.00 255.0 FORMAT "%5.1" ECU_ADDRESS 0xAFE8017A /end MEASUREMENT
/begin MEASUREMENT fofreszkh "" UBYTE dez 1 100 0.00 255.0 FORMAT "%5.1" ECU_ADDRESS 0xAFE8017B /end MEASUREMENT
/begin MEASUREMENT fofsampidx "" UBYTE dez 1 100 0.00 255.0 FORMAT "%5.1" ECU_ADDRESS 0xD0000C79 /end MEASUREMENT
/begin MEASUREMENT fofstat "" UBYTE dez 1 100 0.00 255.0 FORMAT "%5.1" ECU_ADDRESS 0xD0000C7B /end MEASUREMENT
/begin MEASUREMENT fonstat "" UBYTE dez 1 100 0.00 255.0 FORMAT "%5.1" ECU_ADDRESS 0xD0000C68 /end MEASUREMENT
/begin MEASUREMENT fraiov_w "" UWORD fak_uw_b2 1 100 0.00 1.999969 FORMAT "%8.6" ECU_ADDRESS 0xAFE80066 /end MEASUREMENT
/begin MEASUREMENT frairef_w "" UWORD fak_uw_b2 1 100 0.00 1.999969 FORMAT "%8.6" ECU_ADDRESS 0xD0000520 /end MEASUREMENT
/begin MEASUREMENT FRASTTIMER.time "" UBYTE t200msxs_ub_b51 1 100 0.00 51.00 FORMAT "%5.2" ECU_ADDRESS 0xD00011ED /end MEASUREMENT
/begin MEASUREMENT fs1fof_w "" UWORD fak_uw_b1 1 100 0.00 0.9999847 FORMAT "%9.7" ECU_ADDRESS 0xD00005B0 /end MEASUREMENT
/begin MEASUREMENT fseof1 "" UWORD kw_q1p5259eEm4_om5 1 100 -5.000000 4.999847 FORMAT "%8.6" ARRAY_SIZE 2 ECU_ADDRESS 0xAFE800FA /end MEASUREMENT
/begin MEASUREMENT fseof1kh "" UWORD kw_q1p5259eEm4_om5 1 100 -5.000000 4.999847 FORMAT "%8.6" ARRAY_SIZE 2 ECU_ADDRESS 0xAFE800FE /end MEASUREMENT
/begin MEASUREMENT fseof_w "" UWORD kw_q1p5259eEm4_om5 1 100 -5.000000 4.999847 FORMAT "%8.6" ECU_ADDRESS 0xD00005B2 /end MEASUREMENT
/begin MEASUREMENT fsmaxplaus_w "" SWORD lu_MEx 1 100 -149.0116 149.0071 FORMAT "%8.4" ECU_ADDRESS 0xD0000568 /end MEASUREMENT
/begin MEASUREMENT fsmaxplslurs_w "" SWORD lu_MEx 1 100 -149.0116 149.0071 FORMAT "%8.4" ECU_ADDRESS 0xD000056A /end MEASUREMENT
/begin MEASUREMENT fsmxplscnt "" UBYTE dez 1 100 0.00 255.0 FORMAT "%5.1" ECU_ADDRESS 0xD0000C69 /end MEASUREMENT
/begin MEASUREMENT fsof1 "" ULONG kw_q2p328eEm9_om5 1 100 -5.00000000000 4.99999999767 FORMAT "%13.11" ARRAY_SIZE 2 ECU_ADDRESS 0xD0001F84 /end MEASUREMENT
/begin MEASUREMENT fsof1kh "" ULONG kw_q2p328eEm9_om5 1 100 -5.00000000000 4.99999999767 FORMAT "%13.11" ARRAY_SIZE 2 ECU_ADDRESS 0xD0001F98 /end MEASUREMENT
/begin MEASUREMENT fsofmedi_w "" UWORD kw_q1p5259eEm4_om5 1 100 -5.000000 4.999847 FORMAT "%8.6" ARRAY_SIZE 2 ECU_ADDRESS 0xD00005B4 /end MEASUREMENT
/begin MEASUREMENT fsofsamp_w "" UWORD kw_q1p5259eEm4_om5 1 100 -5.000000 4.999847 FORMAT "%8.6" ARRAY_SIZE 22 ECU_ADDRESS 0xD00005B8 /end MEASUREMENT
/begin MEASUREMENT fsrmx_w "" SWORD lu_MEx 1 100 -149.0116 149.0071 FORMAT "%8.4" ECU_ADDRESS 0xD000056C /end MEASUREMENT
/begin MEASUREMENT fsrnpcnt "" UBYTE dez 1 100 0.00 255.0 FORMAT "%5.1" ECU_ADDRESS 0xAFE80173 /end MEASUREMENT
/begin MEASUREMENT fsrst0_w "" SWORD lu_MEx 1 100 -149.0116 149.0071 FORMAT "%8.4" ARRAY_SIZE 24 ECU_ADDRESS 0xAFE8006A /end MEASUREMENT
/begin MEASUREMENT fsrst1_w "" SWORD lu_MEx 1 100 -149.0116 149.0071 FORMAT "%8.4" ARRAY_SIZE 24 ECU_ADDRESS 0xAFE8009A /end MEASUREMENT
/begin MEASUREMENT fsrst2_w "" SWORD lu_MEx 1 100 -149.0116 149.0071 FORMAT "%8.4" ARRAY_SIZE 24 ECU_ADDRESS 0xAFE800CA /end MEASUREMENT
/begin MEASUREMENT fsrstmxsumc "" UBYTE dez 1 100 0.00 255.0 FORMAT "%5.1" ECU_ADDRESS 0xAFE80174 /end MEASUREMENT
/begin MEASUREMENT fsrstmxsumidx "" UBYTE dez 1 100 0.00 255.0 FORMAT "%5.1" ECU_ADDRESS 0xAFE80175 /end MEASUREMENT
/begin MEASUREMENT fsrstmxsum_w "" SWORD lu_MEx 1 100 -149.0116 149.0071 FORMAT "%8.4" ECU_ADDRESS 0xD000056E /end MEASUREMENT
/begin MEASUREMENT fsrstmx_w "" SWORD lu_MEx 1 100 -149.0116 149.0071 FORMAT "%8.4" ECU_ADDRESS 0xD0000570 /end MEASUREMENT
/begin MEASUREMENT fsrstnpcnt "" UBYTE dez 1 100 0.00 255.0 FORMAT "%5.1" ECU_ADDRESS 0xAFE80176 /end MEASUREMENT
/begin MEASUREMENT fsrstnplvl_w "" SWORD lu_MEx 1 100 -149.0116 149.0071 FORMAT "%8.4" ECU_ADDRESS 0xD0000572 /end MEASUREMENT
/begin MEASUREMENT fsrst_w "" SWORD lu_MEx 1 100 -149.0116 149.0071 FORMAT "%8.4" ARRAY_SIZE 3 ECU_ADDRESS 0xD0000574 /end MEASUREMENT
/begin MEASUREMENT fsr_w "" SWORD lu_MEx 1 100 -149.0116 149.0071 FORMAT "%8.4" ARRAY_SIZE 3 ECU_ADDRESS 0xD000058A /end MEASUREMENT
/begin MEASUREMENT fzabgs_w "" UWORD dez 1 100 0.00 65535.00 FORMAT "%8.2" ECU_ADDRESS 0xD0000662 /end MEASUREMENT
/begin MEASUREMENT fzabgzyl_w "" UWORD dez 1 100 0.00 65535.00 FORMAT "%8.2" ARRAY_SIZE 3 ECU_ADDRESS 0xD0000664 /end MEASUREMENT
/begin MEASUREMENT fzarv_w "" UWORD dez 1 100 0.00 65535.00 FORMAT "%8.2" ECU_ADDRESS 0xD000065C /end MEASUREMENT
/begin MEASUREMENT fzkatsb_w "" UWORD dez 1 100 0.00 65535.00 FORMAT "%8.2" ARRAY_SIZE 1 ECU_ADDRESS 0xD000066A /end MEASUREMENT
/begin MEASUREMENT fzkatzyl_w "" UWORD dez 1 100 0.00 65535.00 FORMAT "%8.2" ARRAY_SIZE 3 ECU_ADDRESS 0xD000066C /end MEASUREMENT
/begin MEASUREMENT fzmdzyl_w "" UWORD dez 1 100 0.00 65535.00 FORMAT "%8.2" ARRAY_SIZE 3 ECU_ADDRESS 0xAFE80102 /end MEASUREMENT
/begin MEASUREMENT idxfob "" UBYTE dez 1 100 0.00 255.0 FORMAT "%5.1" ECU_ADDRESS 0xD0000C6A /end MEASUREMENT
/begin MEASUREMENT ivzabg_w "" UWORD dez 1 100 0.00 65535.00 FORMAT "%8.2" ECU_ADDRESS 0xD0000672 /end MEASUREMENT
/begin MEASUREMENT ivzarv_w "" UWORD dez 1 100 0.00 65535.00 FORMAT "%8.2" ECU_ADDRESS 0xD000065E /end MEASUREMENT
/begin MEASUREMENT ivzkat_w "" UWORD dez 1 100 0.00 65535.00 FORMAT "%8.2" ECU_ADDRESS 0xD0000674 /end MEASUREMENT
/begin MEASUREMENT kamfz_w "" UWORD kw_tooth_sy 1 100 0.00 655350.0 FORMAT "%8.1" ECU_ADDRESS 0xD0000686 /end MEASUREMENT
/begin MEASUREMENT kdllrcnt_b "" UBYTE dez 1 100 0.00 255.0 FORMAT "%5.1" ECU_ADDRESS 0xD0000C5C /end MEASUREMENT
/begin MEASUREMENT kfluarmn_w "" SWORD lu_MEx 1 100 -149.0116 149.0071 FORMAT "%8.4" ECU_ADDRESS 0xD000064E /end MEASUREMENT
/begin MEASUREMENT kswf "" UBYTE dez 1 100 0.00 255.0 FORMAT "%5.1" ECU_ADDRESS 0xD0000C8F /end MEASUREMENT
/begin MEASUREMENT luarmn_w "" SWORD lu_MEx 1 100 -149.0116 149.0071 FORMAT "%8.4" ECU_ADDRESS 0xD0000650 /end MEASUREMENT
/begin MEASUREMENT luaroff_w "" SWORD lu_MEx 1 100 -149.0116 149.0071 FORMAT "%8.4" ECU_ADDRESS 0xD0000652 /end MEASUREMENT
/begin MEASUREMENT luar_w "" SWORD lu_MEx 1 100 -149.0116 149.0071 FORMAT "%8.4" ECU_ADDRESS 0xD0000654 /end MEASUREMENT
/begin MEASUREMENT lums_w "" SWORD lu_MEx 1 100 -149.0116 149.0071 FORMAT "%8.4" ECU_ADDRESS 0xD0000624 /end MEASUREMENT
/begin MEASUREMENT lunw_w "" UWORD lu_MEx 1 100 0.00 298.0187 FORMAT "%8.4" ECU_ADDRESS 0xD0000590 /end MEASUREMENT
/begin MEASUREMENT lurms_w "" SWORD lu_MEx 1 100 -149.0116 149.0071 FORMAT "%8.4" ECU_ADDRESS 0xD0000626 /end MEASUREMENT
/begin MEASUREMENT lursbas_w "" SWORD lu_MEx 1 100 -149.0116 149.0071 FORMAT "%8.4" ECU_ADDRESS 0xD0000628 /end MEASUREMENT
/begin MEASUREMENT lurs_w "" SWORD lu_MEx 1 100 -149.0116 149.0071 FORMAT "%8.4" ECU_ADDRESS 0xD000062A /end MEASUREMENT
/begin MEASUREMENT lutsinvala "" UWORD dez 1 100 0.00 65535.00 FORMAT "%8.2" ECU_ADDRESS 0xD000067A /end MEASUREMENT
/begin MEASUREMENT lutskzyl_w "" SWORD lu_MEx 1 100 -149.0116 149.0071 FORMAT "%8.4" ARRAY_SIZE 3 ECU_ADDRESS 0xD0000592 /end MEASUREMENT
/begin MEASUREMENT lutsk_w "" SWORD lu_MEx 1 100 -149.0116 149.0071 FORMAT "%8.4" ECU_ADDRESS 0xD0000598 /end MEASUREMENT
/begin MEASUREMENT luts_w "" SWORD lu_MEx 1 100 -149.0116 149.0071 FORMAT "%8.4" ECU_ADDRESS 0xD000059A /end MEASUREMENT
/begin MEASUREMENT mfmodus_w "" SWORD dez 1 100 -32768.00 32767.00 FORMAT "%8.2" ECU_ADDRESS 0xD0000690 /end MEASUREMENT
/begin MEASUREMENT mfpattidx "" UBYTE dez 1 100 0.00 255.0 FORMAT "%5.1" ECU_ADDRESS 0xD0000CAC /end MEASUREMENT
/begin MEASUREMENT midmddelay_w "" UWORD rel_uw_b100 1 100 0.00 99.99847 FORMAT "%8.5" ECU_ADDRESS 0xD000059C /end MEASUREMENT
/begin MEASUREMENT midmdrel_w "" UWORD rel_uw_b100 1 100 0.00 99.99847 FORMAT "%8.5" ECU_ADDRESS 0xD000057A /end MEASUREMENT
/begin MEASUREMENT misa "" UBYTE rel_ub_b99p6 1 100 0.00 99.61 FORMAT "%5.2" ECU_ADDRESS 0xD0000CA1 /end MEASUREMENT
/begin MEASUREMENT misafon "" UBYTE rel_ub_b99p6 1 100 0.00 99.61 FORMAT "%5.2" ECU_ADDRESS 0xD0000CA2 /end MEASUREMENT
/begin MEASUREMENT misalfho "" SBYTE rel_sb_q0p39 1 100 -50.00 49.61 FORMAT "%5.2" ECU_ADDRESS 0xD0000C9D /end MEASUREMENT
/begin MEASUREMENT misaltmt "" SBYTE rel_sb_q0p39 1 100 -50.00 49.61 FORMAT "%5.2" ECU_ADDRESS 0xD0000C9E /end MEASUREMENT
/begin MEASUREMENT misamap "" UBYTE rel_ub_b99p6 1 100 0.00 99.61 FORMAT "%5.2" ECU_ADDRESS 0xD0000C9F /end MEASUREMENT
/begin MEASUREMENT misfcnt_w "" UWORD dez 1 100 0.00 65535.00 FORMAT "%8.2" ECU_ADDRESS 0xD0000692 /end MEASUREMENT
/begin MEASUREMENT mwdotmcs_w "" SWORD temp_q0p75 1 100 -24576.00 24575.25 FORMAT "%8.2" ECU_ADDRESS 0xD00006A0 /end MEASUREMENT
/begin MEASUREMENT nmotdelay_w "" UWORD nmot_uw_q0p25 1 100 0.00 16383.75 FORMAT "%8.2" ECU_ADDRESS 0xD000059E /end MEASUREMENT
/begin MEASUREMENT nmotgneg "" UWORD nmot_sw_q0p25 1 100 0.00 16383.75 FORMAT "%8.2" ECU_ADDRESS 0xD0000528 /end MEASUREMENT
/begin MEASUREMENT nmotgpos "" UWORD nmot_sw_q0p25 1 100 0.00 16383.75 FORMAT "%8.2" ECU_ADDRESS 0xD000052A /end MEASUREMENT
/begin MEASUREMENT oraiov_w "" SWORD rel_sw_b1536 1 100 -1536.000 1535.953 FORMAT "%8.3" ECU_ADDRESS 0xAFE80068 /end MEASUREMENT
/begin MEASUREMENT orairef_w "" SWORD rel_sw_b1536 1 100 -1536.000 1535.953 FORMAT "%8.3" ECU_ADDRESS 0xD0000522 /end MEASUREMENT
/begin MEASUREMENT ORASTTIMER.time "" UBYTE t200msxs_ub_b51 1 100 0.00 51.00 FORMAT "%5.2" ECU_ADDRESS 0xD00011F1 /end MEASUREMENT
/begin MEASUREMENT pausecnt_w "" UWORD dez 1 100 0.00 65535.00 FORMAT "%8.2" ECU_ADDRESS 0xD0000694 /end MEASUREMENT
/begin MEASUREMENT psrmn_w "" UWORD p_uw_q0p078 1 100 0.00 5119.922 FORMAT "%8.3" ECU_ADDRESS 0xD00006A4 /end MEASUREMENT
/begin MEASUREMENT psrmx_w "" UWORD p_uw_q0p078 1 100 0.00 5119.922 FORMAT "%8.3" ECU_ADDRESS 0xD00006A6 /end MEASUREMENT
/begin MEASUREMENT psrrtn_w "" UWORD p_q0p078 1 100 0.00 5119.922 FORMAT "%8.3" ECU_ADDRESS 0xD00006A8 /end MEASUREMENT
/begin MEASUREMENT psrrtx_w "" UWORD p_q0p078 1 100 0.00 5119.922 FORMAT "%8.3" ECU_ADDRESS 0xD00006AA /end MEASUREMENT
/begin MEASUREMENT seglcnvf_f "" FLOAT32_IEEE fak_r32_1 1 100 0.00 10.000000000000000 FORMAT "%27.24" ECU_ADDRESS 0xD0002030 /end MEASUREMENT
/begin MEASUREMENT spacecnt_w "" UWORD dez 1 100 0.00 65535.00 FORMAT "%8.2" ECU_ADDRESS 0xD0000696 /end MEASUREMENT
/begin MEASUREMENT spanxsfof "" UWORD kw_q1p5259eEm4_om5 1 100 -5.000000 4.999847 FORMAT "%8.6" ECU_ADDRESS 0xD00005E4 /end MEASUREMENT
/begin MEASUREMENT t6mvc "" UWORD dez 1 100 0.00 65535.00 FORMAT "%8.2" ARRAY_SIZE 3 ECU_ADDRESS 0xAFE80114 /end MEASUREMENT
/begin MEASUREMENT test_bri1 "" ULONG tsquant_l 1 100 0.00 214748364.750 FORMAT "%13.3" ECU_ADDRESS 0xD0001F8C /end MEASUREMENT
/begin MEASUREMENT test_bri2 "" ULONG tsquant_l 1 100 0.00 214748364.750 FORMAT "%13.3" ECU_ADDRESS 0xD0001F90 /end MEASUREMENT
/begin MEASUREMENT tfa1linfcs "" UBYTE temp_ub_q0p75_o48 1 100 -48.00 143.3 FORMAT "%5.1" ECU_ADDRESS 0xD0000CB1 /end MEASUREMENT
/begin MEASUREMENT tfrastmn "" UBYTE t200msxs_ub_b51 1 100 0.00 51.00 FORMAT "%5.2" ECU_ADDRESS 0xD0000C59 /end MEASUREMENT
/begin MEASUREMENT tmotlfmax "" UBYTE temp_ub_q0p75_o48 1 100 -48.00 143.3 FORMAT "%5.1" ECU_ADDRESS 0xD0000CBB /end MEASUREMENT
/begin MEASUREMENT tmotlfmin "" UBYTE temp_ub_q0p75_o48 1 100 -48.00 143.3 FORMAT "%5.1" ECU_ADDRESS 0xD0000CBC /end MEASUREMENT
/begin MEASUREMENT tmrw "" UBYTE temp_ub_q0p75_o48 1 100 -48.00 143.3 FORMAT "%5.1" ECU_ADDRESS 0xD0000CC3 /end MEASUREMENT
/begin MEASUREMENT tmrwend "" UBYTE temp_ub_q0p75_o48 1 100 -48.00 143.3 FORMAT "%5.1" ECU_ADDRESS 0xD0000CC4 /end MEASUREMENT
/begin MEASUREMENT tmrwgrad_w "" UWORD temp_uw_q0p0029_o48 1 100 -48.00000 143.9971 FORMAT "%8.4" ECU_ADDRESS 0xD00006AE /end MEASUREMENT
/begin MEASUREMENT tmrwop_w "" UWORD temp_uw_q0p0029_o48 1 100 -48.00000 143.9971 FORMAT "%8.4" ECU_ADDRESS 0xD00006B0 /end MEASUREMENT
/begin MEASUREMENT transmActTime "" UWORD t_q0p5 1 100 0.00 32767.50 FORMAT "%8.2" ECU_ADDRESS 0xD000057C /end MEASUREMENT
/begin MEASUREMENT tsbsyctr "" UBYTE dez 1 100 0.00 255.0 FORMAT "%5.1" ECU_ADDRESS 0xD0000CA9 /end MEASUREMENT
/begin MEASUREMENT tskdelay "" UBYTE dez 1 100 0.00 255.0 FORMAT "%5.1" ECU_ADDRESS 0xD0000C6B /end MEASUREMENT
/begin MEASUREMENT tsk_l "" ULONG tsquant_l 1 100 0.00 214748364.750 FORMAT "%13.3" ECU_ADDRESS 0xD0001FA0 /end MEASUREMENT
/begin MEASUREMENT tsmodif_l "" ULONG tsquant_l 1 100 0.00 214748364.750 FORMAT "%13.3" ECU_ADDRESS 0xD0001F94 /end MEASUREMENT
/begin MEASUREMENT tsroh_l "" ULONG tsquant_l 1 100 0.00 214748364.750 FORMAT "%13.3" ECU_ADDRESS 0xD0002034 /end MEASUREMENT
/begin MEASUREMENT tumlok "" UBYTE temp_ub_q0p75_o48 1 100 -48.00 143.3 FORMAT "%5.1" ECU_ADDRESS 0xD0000CBD /end MEASUREMENT
/begin MEASUREMENT twklhoff "" UBYTE t_q1 1 100 0.00 255.0 FORMAT "%5.1" ECU_ADDRESS 0xD0000CBE /end MEASUREMENT
/begin MEASUREMENT twklhon "" UBYTE t_q1 1 100 0.00 255.0 FORMAT "%5.1" ECU_ADDRESS 0xD0000CBF /end MEASUREMENT
/begin MEASUREMENT twklnoff "" UBYTE t_q1 1 100 0.00 255.0 FORMAT "%5.1" ECU_ADDRESS 0xD0000CC0 /end MEASUREMENT
/begin MEASUREMENT twklnon "" UBYTE t_q1 1 100 0.00 255.0 FORMAT "%5.1" ECU_ADDRESS 0xD0000CC1 /end MEASUREMENT
/begin MEASUREMENT xs "" UWORD kw_q1p5259eEm4_om5 1 100 -5.000000 4.999847 FORMAT "%8.6" ARRAY_SIZE 3 ECU_ADDRESS 0xD00005E6 /end MEASUREMENT
/begin MEASUREMENT xsmax "" UWORD kw_q1p5259eEm4_om5 1 100 -5.000000 4.999847 FORMAT "%8.6" ARRAY_SIZE 3 ECU_ADDRESS 0xD00005EC /end MEASUREMENT
/begin MEASUREMENT xsmin "" UWORD kw_q1p5259eEm4_om5 1 100 -5.000000 4.999847 FORMAT "%8.6" ARRAY_SIZE 3 ECU_ADDRESS 0xD00005F2 /end MEASUREMENT
/begin MEASUREMENT zdkrsam "" UBYTE dez 1 100 0.00 255.0 FORMAT "%5.1" ECU_ADDRESS 0xD0000C55 /end MEASUREMENT
/begin MEASUREMENT zdkrsas_w "" UWORD dez 1 100 0.00 65535.00 FORMAT "%8.2" ECU_ADDRESS 0xD000051A /end MEASUREMENT
/begin MEASUREMENT zkrdisam "" UBYTE dez 1 100 0.00 255.0 FORMAT "%5.1" ECU_ADDRESS 0xD0000C56 /end MEASUREMENT
/begin MEASUREMENT zkrdisas_w "" UWORD dez 1 100 0.00 65535.00 FORMAT "%8.2" ECU_ADDRESS 0xD000051C /end MEASUREMENT
/begin MEASUREMENT zkrzsam "" UBYTE dez 1 100 0.00 255.0 FORMAT "%5.1" ECU_ADDRESS 0xD0000C57 /end MEASUREMENT
/begin MEASUREMENT zkrzsas "" UBYTE dez 1 100 0.00 255.0 FORMAT "%5.1" ECU_ADDRESS 0xD0000C58 /end MEASUREMENT
/begin MEASUREMENT zwavg "" SBYTE zw_sb_q0p75 1 100 -96.00 95.25 FORMAT "%5.2" ECU_ADDRESS 0xD0000CA7 /end MEASUREMENT
/begin MEASUREMENT zwavglp "" SBYTE zw_sb_q0p75 1 100 -96.00 95.25 FORMAT "%5.2" ECU_ADDRESS 0xD0000CAA /end MEASUREMENT
/begin MEASUREMENT zwavgret "" SWORD zw_sw_q0p75 1 100 -24576.00 24575.25 FORMAT "%8.2" ECU_ADDRESS 0xD000062C /end MEASUREMENT
/begin MEASUREMENT zwkrmax "" SBYTE zw_sb_q0p75 1 100 -96.00 95.25 FORMAT "%5.2" ECU_ADDRESS 0xD0000C7A /end MEASUREMENT
/begin MEASUREMENT zwmedi "" SBYTE zw_sb_q0p75 1 100 -96.00 95.25 FORMAT "%5.2" ECU_ADDRESS 0xD0000CA8 /end MEASUREMENT
/begin MEASUREMENT zzuend_l "" ULONG dez 1 100 0.00 4294967295.00 FORMAT "%13.2" ECU_ADDRESS 0xAFE80010 /end MEASUREMENT
/begin MEASUREMENT zzyldmd "" UBYTE dez 1 100 0.00 255.0 FORMAT "%5.1" ECU_ADDRESS 0xD0000CAB /end MEASUREMENT
/begin MEASUREMENT zzyllfb "" UBYTE dez 1 100 0.00 255.0 FORMAT "%5.1" ECU_ADDRESS 0xD0000C6C /end MEASUREMENT
/begin MEASUREMENT zzyl_temp "" UBYTE dez 1 100 0.00 255.0 FORMAT "%5.1" ECU_ADDRESS 0xD0000698 /end MEASUREMENT
/begin FUNCTION DKRSA "1.2.0" /begin DEF_CHARACTERISTIC CWDKRSA DKRSAM DKRSAS /end DEF_CHARACTERISTIC
 /begin IN_MEASUREMENT KnDet_bStMeasWin KnDet_RlsChkMeasWin KnDet_stSigEvalCurrCmb /end IN_MEASUREMENT
 /begin LOC_MEASUREMENT B_hlpkrsme B_hlpkrsmz B_hlpkrsse B_hlpkrssz B_krensam B_krensas zdkrsam zdkrsas_w zkrdisam zkrdisas_w zkrzsam zkrzsas /end LOC_MEASUREMENT
 FUNCTION_VERSION "1.2.0" /end FUNCTION
/begin FUNCTION DKVS "1.19.0"
 /begin DEF_CHARACTERISTIC DFRAESTAB DFRASTAB DFRMSTAB DORAESTAB DORASTAB FRADN FRADNFA FRADX FRADXFA ORADN ORADNFA ORADX ORADXFA SDFRA SDORA TEFRA TEORA TFRA TLRASTMN TORA ZKDFRM /end DEF_CHARACTERISTIC
 /begin IN_MEASUREMENT B_falra B_fvlra B_lrafra B_lraora B_nofra B_noora B_refrast B_reorast dfrm_w frai_w orai_w /end IN_MEASUREMENT
 /begin OUT_MEASUREMENT B_edkvs B_efra B_eframax B_eframin B_eora B_eoramax B_eoramin B_fdgser B_frastab B_fstabzs B_gae B_gaefra B_gaeing B_odgser B_orastab B_ostabzs B_zfra B_zora /end OUT_MEASUREMENT
 /begin LOC_MEASUREMENT B_frast B_inidkvs B_orast dfrmf_w fraiov_w frairef_w FRASTTIMER.time oraiov_w orairef_w ORASTTIMER.time tfrastmn /end LOC_MEASUREMENT
 FUNCTION_VERSION "1.19.0" /end FUNCTION
/begin FUNCTION DKVSDFC "1.6.1" /begin DEF_CHARACTERISTIC TOFEORAFFR /end DEF_CHARACTERISTIC
 /begin IN_MEASUREMENT B_cdkvs B_eframax B_eframin B_eoramax B_eoramin B_fdgser B_fstabzs B_lrare B_orastab B_zfra B_zora /end IN_MEASUREMENT
 FUNCTION_VERSION "1.6.1" /end FUNCTION
/begin FUNCTION DLLR "4.0.0"
 /begin DEF_CHARACTERISTIC CWDLLR DASA DNDLLRO DNDLLROKH DNDLLRU DNDLLRUKH DNMOTG FHDLLR NMOTGNP RLMDVERL RLMDVERLKH TADLLR TDLLFG1 TDLLR TDLLRMN TDLLRMNKH TDLLRMX TDLLRMXKH TDLLRNF TDLLRNFKH TMDLLR TNSTDLLR /end DEF_CHARACTERISTIC
 /begin IN_MEASUREMENT B_cdllr B_cdllrkh B_dknolu B_dkpu B_khakt B_ll B_llrilimn B_nldg B_nmot B_nswo1 B_sa B_stend dmllri_w dns fho limax_w limin_w mdverl_w nllkh nmot_w nstat rl tans tmot tnst_w vfzg /end IN_MEASUREMENT
 /begin OUT_MEASUREMENT B_dllr B_dllrfg B_dllrh B_dllrkh B_dllrkha /end OUT_MEASUREMENT
 /begin LOC_MEASUREMENT B_dllrebd B_emnrkh B_emxrkh B_esmnllr B_esmxllr B_esnpllr nmotgneg nmotgpos /end LOC_MEASUREMENT
 FUNCTION_VERSION "4.0.0" /end FUNCTION
/begin FUNCTION DLLRIR "4.0.0" /begin DEF_CHARACTERISTIC IMG_BLLRH IMG_BLLRKH TDLKHNUM TDLLRNUM /end DEF_CHARACTERISTIC /begin IN_MEASUREMENT B_cdllr B_dllrh B_dllrkh B_dllrkha B_ll B_nmot vfzg_w /end IN_MEASUREMENT /begin LOC_MEASUREMENT B_dllractv B_dllrtdly B_dllrton kdllrcnt_b /end LOC_MEASUREMENT FUNCTION_VERSION "4.0.0" /end FUNCTION
/begin FUNCTION Dma "1.7.0" FUNCTION_VERSION "1.7.0" /end FUNCTION
/begin FUNCTION DMDADAP "1.210.1"
 /begin DEF_CHARACTERISTIC ANZFSRSAMP AZSTPFSRST CWADAPAPPL CWDMDADAP FLUTSRTIOF FSMXPLCNT FSRFIL FSRPLSLVL FSRPLSLVLOFFSKH FSRSTMXSUM KLADAPSMPLMN KLDMDSTPADP KLLURSFAKPLS LURSFAKMAXLU LURSFAKPLSKH LURSFAKPLSLL NMFSRMX SMI04ADUW SNM02ADUW SNM12ADUW STPADPST TRANSMACTTIMEMN TRANSMACTTRQ /end DEF_CHARACTERISTIC
 /begin REF_CHARACTERISTIC TSBSEGINI /end REF_CHARACTERISTIC
 /begin IN_MEASUREMENT B_dfonrst B_fa B_folunw B_fonresd B_fonstp B_gsch B_kh B_ll B_lustop B_mderk B_mdzag dmdsegl_w fanalun fofstat lursbas_w midmd midmd_w misa misafon nmot nmot_w tsk_l vfzg zzyl zzyldmd /end IN_MEASUREMENT
 /begin OUT_MEASUREMENT bitsadapr B_adapfsrst B_adpstpmf B_fonr B_fonresf B_fonrset B_fsmxplsc B_fsrnp B_fsrst B_fsrstnp B_mdstim B_misafon B_stpadpst ctrsynaftrstp dlutsflut_w dlutsk_w esst_smi04aduw esst_snm12aduw flutskzy_w flutsk_w fonstat fsmxplscnt fsr_w idxfob lunw_w lutskzyl_w lutsk_w luts_w midmddelay_w nmotdelay_w tskdelay zzyllfb /end OUT_MEASUREMENT
 /begin LOC_MEASUREMENT adapidx B_adapfsr B_fonr1st B_fsmaxplaus B_fsrstmxsum B_fsrstused fsmaxplaus_w fsmaxplslurs_w fsrmx_w fsrnpcnt fsrst0_w fsrst1_w fsrst2_w fsrstmxsumc fsrstmxsumidx fsrstmxsum_w fsrstmx_w fsrstnpcnt fsrstnplvl_w fsrst_w midmdrel_w transmActTime /end LOC_MEASUREMENT
 FUNCTION_VERSION "1.210.1" /end FUNCTION
/begin FUNCTION DMDDLU "1.90.0"
 /begin DEF_CHARACTERISTIC DLURKHE DLURMIN DMXRDL KFDLUR KFDLUR1 KFDLUR2 KFDLURMI NMIDLU /end DEF_CHARACTERISTIC
 /begin REF_CHARACTERISTIC SMI08DMUB SNM08DMUB /end REF_CHARACTERISTIC
 /begin IN_MEASUREMENT B_analu B_ll B_lurkhe_corr B_lustop B_mdstop B_wk B_wkr dlutsk_w esst_smi08dmub esst_snm08dmub flurktm_w flurmin3_w fofstat fonstat midmd midmd_w nmot nmot_w vfzg zwavgret /end IN_MEASUREMENT
 /begin OUT_MEASUREMENT B_dluerk B_dlutsk dlurs_w /end OUT_MEASUREMENT
 FUNCTION_VERSION "1.90.0" /end FUNCTION
/begin FUNCTION DMDFOF "3.90.1"
 /begin DEF_CHARACTERISTIC ANWFOFST ANWFOST CDFO DFSOFMEDMX FLMXOFMXKH FOFAKT FOFPLAUS FOFPLAUSKH FOFSMPEOL FS1FOFDEC FS1FOFKH FS1FOFO FS1FOFU FSEOFPLAUSKH KLMIOFOF1 KLMIOFOF2 LURFOST MIUFOF1 MIUFOF2 NOFOF1 NOFOF2 NOFOFSA1 NOFOFSA2 NUFOF1 NUFOF2 NUFOFSA1 NUFOFSA2 SPANXSMAX SPANXSMXKH TSROHDEV TSROHDEVKH ZWKRMAXOF /end DEF_CHARACTERISTIC
 /begin REF_CHARACTERISTIC CWKAMFZKH /end REF_CHARACTERISTIC
 /begin IN_MEASUREMENT B_autget B_clradfof B_dlutsk B_efra B_eora B_fafonrm B_fofstp B_fonresf B_fonstp B_fvlra B_gaeing B_gsch B_kamfzkh B_kh B_ll B_lutsk B_mderk B_mdzgstp B_pwf dwkrz lunw_w mdverf_w midmd_w nmot tsroh_l vfzg zzyldmd /end IN_MEASUREMENT
 /begin OUT_MEASUREMENT B_fofadpen B_fofr B_fofrkh B_fofrset B_fofrun B_folunw B_fonresd flmxofkh_w fofresz fofreszkh fofstat fseof1 fseof1kh fsof1kh tsk_l /end OUT_MEASUREMENT
 /begin LOC_MEASUREMENT anwfofs anzfofsamp B_dfsofmed B_fofcalc B_fofreskh B_fofsamp B_gemadapr B_idxfof1 dfsofmedi_w fofsampidx fs1fof_w fseof_w fsof1 fsofmedi_w fsofsamp_w spanxsfof test_bri1 test_bri2 tsmodif_l xs xsmax xsmin zwkrmax /end LOC_MEASUREMENT
 FUNCTION_VERSION "3.90.1" /end FUNCTION
/begin FUNCTION DMDLAD "1.30.0" /begin DEF_CHARACTERISTIC ANALUN ANALUST TNALU /end DEF_CHARACTERISTIC /begin REF_CHARACTERISTIC SNM08DMUB /end REF_CHARACTERISTIC
 /begin IN_MEASUREMENT B_dluerk B_dopzue B_luaerk B_luerk B_lustop B_mdstop B_optpherk B_stpon esst_snm08dmub nmot /end IN_MEASUREMENT
 /begin OUT_MEASUREMENT B_analu B_mderk B_tnalu fanalun /end OUT_MEASUREMENT
 FUNCTION_VERSION "1.30.0" /end FUNCTION
/begin FUNCTION DMDLU "1.140.0"
 /begin DEF_CHARACTERISTIC CWLURKH FIAMALU FIMALU KFAMAL KFAMAL1 KFAMAL2 KFLURB KFLURB1 KFLURB2 KFLURM KFLURM1 KLDMXRLU LURBMI LURBMIKH LURBMIKO LURKHE LURKTM LURMIN1 LURMIN2 LURMIN3 LURMIN3KH LURMINKHE LURST TNSDMXRLU /end DEF_CHARACTERISTIC
 /begin REF_CHARACTERISTIC SMI08DMUB SNM08DMUB /end REF_CHARACTERISTIC
 /begin IN_MEASUREMENT B_analu B_fokstp B_ivzabg1 B_kamfzkh B_kh B_khakt B_koe B_ll B_lustop B_mdstop B_misaLI B_wk B_wkr esst_smi08dmub esst_snm08dmub fofstat fonstat lutskzyl_w lutsk_w midmd midmd_w nmot nmot_w tengdmd tnst_w tskdelay zwavglp zwopt zzyllfb /end IN_MEASUREMENT
 /begin OUT_MEASUREMENT B_luerk B_lurkhe_corr B_lutsk flurktm_w flurmin3_w flurmin_w lums_w lurms_w lursbas_w lurs_w zwavgret /end OUT_MEASUREMENT
 /begin LOC_MEASUREMENT B_dmxrl dmxrlu_w famal famalwk flurb_w flurmin1_w flurmin2_w flurstmp_w flurst_w /end LOC_MEASUREMENT
 FUNCTION_VERSION "1.140.0" /end FUNCTION
/begin FUNCTION DMDLUA "1.90.0"
 /begin DEF_CHARACTERISTIC DMXRFL KFLUAR KFLUAR1 KFLUAR2 KFLUARMN LUARKHE LUARMI NMAXFLUTS /end DEF_CHARACTERISTIC
 /begin REF_CHARACTERISTIC SMI08DMUB SNM08DMUB /end REF_CHARACTERISTIC
 /begin IN_MEASUREMENT B_ll B_lurkhe_corr B_lustop B_mdstop B_wk B_wkr esst_smi08dmub esst_snm08dmub flurmin_w flutskzy_w flutsk_w fofstat midmd midmd_w nmot nmot_w tskdelay vfzg zwavgret zzyllfb /end IN_MEASUREMENT
 /begin OUT_MEASUREMENT B_luaerk luar_w /end OUT_MEASUREMENT
 /begin LOC_MEASUREMENT B_luarmn kfluarmn_w luarmn_w luaroff_w /end LOC_MEASUREMENT
 FUNCTION_VERSION "1.90.0" /end FUNCTION
/begin FUNCTION DMDMIL "1.110.1"
 /begin DEF_CHARACTERISTIC ADCY AHEAGW AHEAGWS AHEAGWSK AHEARV AHEKABB AHEKS1A AHEKSA AINTKAN AZYTIABB CWDALA CWDMDE CWDMDFCER FAINTEN FASKIV1 KFKSWF KSWFEVE MISFRATE TMASKIV1 /end DEF_CHARACTERISTIC
 /begin REF_CHARACTERISTIC SNM08DMUB /end REF_CHARACTERISTIC
 /begin IN_MEASUREMENT B_cdmd B_kh B_mderk B_milstp B_synph esst_snm08dmub midmd nmot tengstdmd zzyllfb /end IN_MEASUREMENT
 /begin OUT_MEASUREMENT B_cntmde B_ivzabg1 B_kh1i B_mdarv B_mdarvdmd B_mdkat flgabfz flgmdetyp flgmdetypCyl flgmdkatbnk flgtiab flgtiabmd_w fzabgs_w fzabgzyl_w fzkatsb_w fzkatzyl_w fzmdzyl_w ivzabg_w ivzkat_w /end OUT_MEASUREMENT
 /begin LOC_MEASUREMENT abgivctr ahearv_w aintkamin aintzyl anzainten azycntb B_abfzdc B_DmdmilComplete B_ffrset B_ivzkat1 B_katerr cdcy cntbmdarv fivzabg flgaintzyl_w flgevok flgkaterr_w fzarv_w ivzarv_w kswf zzuend_l /end LOC_MEASUREMENT
 FUNCTION_VERSION "1.110.1" /end FUNCTION
/begin FUNCTION DMDSTP "1.200.0"
 /begin DEF_CHARACTERISTIC AVRALU AZSTLU AZSTMIL AZSTPON CWMISALI CWSTDMD CWSTPCNF CWSTPCNF2 CWSTPNOT CWSTPNOT2 DRLSOLA DRLSOLST INJ2TSDEL KFMISALFHO KFMISALTMT KLDMWDK KLMISAFON1 KLMISAFON2 KLMISALULL KLTALUST KLTLUSTEOL KWBNMXALU MIFLDWN MISAGANGSISTDEL MISALUN MISANLIOFS NGALUN NGALUST NMIALU NSTDMD SFOFTM SFONTM TAMIALU TMOTDMD TMSTDMD /end DEF_CHARACTERISTIC
 /begin REF_CHARACTERISTIC SMI08DMUB SNM08DMUB SNM09DM1UB SNM09DM2UB /end REF_CHARACTERISTIC
 /begin IN_MEASUREMENT B_autget B_brems B_cdmd B_dknolu B_dkpu B_dksbeg B_dmdsteol B_edkvs B_eev B_evasel B_fa B_fbm B_fofrset B_fonrset B_gsch B_kamfzkh B_koe B_kuppl B_ll B_mdarv B_mderk B_nldg B_phsnl B_pug B_sa B_st B_synph B_tsbready B_tsroov B_wk B_wkauf B_wkr B_zesync B_zwget esst_smi08dmub esst_snm08dmub esst_snm09dm1ub esst_snm09dm2ub fho flgabfz gangsist LIGov_nDiff midmd ngfil_w nmot nmot_w rlgas_w tans tengdmd tengstdmd tnsezmot_w tskdelay vfzg wdkba /end IN_MEASUREMENT
 /begin OUT_MEASUREMENT B_com1 B_fofstp B_fokstp B_fonstp B_lustop B_lutsval B_mddrla B_mdmi B_mdng B_mdnmn B_mdnmx B_mdstop B_mdtnst B_mdzgstp B_milstp B_misaLI B_stpon B_swe favralu lutsinvala misa misafon /end OUT_MEASUREMENT
 /begin LOC_MEASUREMENT B_com2 B_com3 B_FFcom1 B_fontm B_lustops B_milstps B_misaZero B_stdmd B_tmstdmd misalfho misaltmt misamap /end LOC_MEASUREMENT
 FUNCTION_VERSION "1.200.0" /end FUNCTION
/begin FUNCTION DMDSV "1.31.0" /begin IN_MEASUREMENT B_cdmd B_mderk B_mdstop B_milstp zzyllfb /end IN_MEASUREMENT /begin OUT_MEASUREMENT B_dmdsvclr /end OUT_MEASUREMENT /begin LOC_MEASUREMENT B_ctrvalid t6mvc /end LOC_MEASUREMENT FUNCTION_VERSION "1.31.0" /end FUNCTION
/begin FUNCTION DMDTSB "1.80.0"
 /begin DEF_CHARACTERISTIC CWKAMFZKH DMDSEGL DMDSEGLKH FFZWKH KAMFZ KAMFZKH LLVFZGZCTR MIKHMXSWOOFF MIKHMXSWOON NMKAMFZKH TSBINVALID TSBSEGINI ZWDIFFLATE ZWLATEDEL ZYLKOR ZYLKORKH /end DEF_CHARACTERISTIC
 /begin REF_CHARACTERISTIC EpmSeq_phiInt_CA /end REF_CHARACTERISTIC
 /begin IN_MEASUREMENT B_fofkhseg B_fofrun0 B_kh B_kuppl B_ll B_stend EpmSyn_phiInt midmd nmot_w vfzg zwopt zwout zzyl /end IN_MEASUREMENT
 /begin OUT_MEASUREMENT B_kamfzkh B_llvfzgz B_tsbready B_tsroov dmdsegl_w seglcnvf_f tsbsyctr tsroh_l zwavglp zzyldmd /end OUT_MEASUREMENT
 /begin LOC_MEASUREMENT B_stHys B_zwlate kamfz_w zwavg zwmedi /end LOC_MEASUREMENT
 FUNCTION_VERSION "1.80.0" /end FUNCTION
/begin FUNCTION DMDZAG "4.1.0" /begin DEF_CHARACTERISTIC CWDMDZAG MISFPATTRN ZAGRUN /end DEF_CHARACTERISTIC /begin IN_MEASUREMENT B_milstp zzyl /end IN_MEASUREMENT /begin OUT_MEASUREMENT B_mdzag flgstign_w flgstinj_w flgst_w /end OUT_MEASUREMENT
 /begin LOC_MEASUREMENT B_modactiv B_zagena B_zagrun mfmodus_w mfpattidx misfcnt_w pausecnt_w spacecnt_w zzyl_temp /end LOC_MEASUREMENT
 FUNCTION_VERSION "4.1.0" /end FUNCTION
/begin FUNCTION Dme "1.15.0" /begin DEF_CHARACTERISTIC Dme_stOverlayMethodOnly_C /end DEF_CHARACTERISTIC
 /begin OUT_MEASUREMENT Dme_ctDataSetVariant Dme_numBytesAvailable Dme_numBytesAvailableOvl /end OUT_MEASUREMENT
 FUNCTION_VERSION "1.15.0" /end FUNCTION
/begin FUNCTION DOTMCS "3.1.0"
 /begin DEF_CHARACTERISTIC CWDOTMCS DTDOTMCSMN DTDOTMCSMX DTTOTMCS KLTMOTAB TDBLKHTRC TDOTMCS TDOTMCSESD TDTSTMST2 /end DEF_CHARACTERISTIC
 /begin IN_MEASUREMENT B_nmot B_stend B_tmmn tengslst tengs_w tfa1linf tmotab tmotlin /end IN_MEASUREMENT
 /begin OUT_MEASUREMENT B_emntcwcs B_emxtcwcs B_htcwcs B_irtcwcs B_nirtcwcs B_nltcw /end OUT_MEASUREMENT
 /begin LOC_MEASUREMENT B_blckhtrc B_dedotmcs B_dotmcse1 B_engsfld B_otmcsesd B_otmcsfst B_pemntcw B_pemxtcw B_phtcwcs dotmcs_dst mwdotmcs_w tfa1linfcs /end LOC_MEASUREMENT
 FUNCTION_VERSION "3.1.0" /end FUNCTION
/begin FUNCTION DPLPSR "2.5.0"
 /begin DEF_CHARACTERISTIC DDPSRPSINI DPSRM DPSRMFA DPSRSVMN DPTPSRMX DPUPSINIMX NMOTMNDDSS NPSRSVMN NPSRSVMX PSRMN PSRMX PUPLPSRMN SF_PSR SF_PSR1 TDEPSRB TDEPSRP TDPSRRG TMOTPSSVMN TMOTPSSVMX TNMNPSR TPSINIG TPSRSVMN TPSRSVN WDKPSRSVMN WDKPSRSVMX /end DEF_CHARACTERISTIC
 /begin IN_MEASUREMENT B_dkpu B_edks B_eepwf B_fadss B_nmin B_psinirg B_psrmnxg B_psrmw B_psrrg B_pug B_pwf nmot_w ofpu_w psini_w psrmmn_w psrmmx_w psrr_w pu_w tmot tmst tnse_w wdkba_w /end IN_MEASUREMENT
 /begin OUT_MEASUREMENT B_dpsrsvmn B_epsrplmn B_epsrplmx B_fdpsrp B_psini B_psrpl B_psrrgmn B_psrrgmx psrrtn_w psrrtx_w /end OUT_MEASUREMENT
 /begin LOC_MEASUREMENT B_eplpsr B_epsrsv B_fdpsrb B_fps2plsv B_fpsrplsv B_hepsrmn B_hepsrmx B_hepsrsv B_nmnpsr B_psrrgtd B_psrsvmn B_psrsvmni B_psrsvmx B_psrsvmxi B_sppsrr B_thigh B_zpsrsv fdpsrm_w psrmn_w psrmx_w /end LOC_MEASUREMENT
 FUNCTION_VERSION "2.5.0" /end FUNCTION
/begin FUNCTION DPLTCW "1.6.0"
 /begin DEF_CHARACTERISTIC AFZBKLH AFZBKLN CFETIME CWPLTCWLSC CWPLTCWSTC DTMDMA DTMDNPO KFDTMRO KFDTMRS KFDTMRVFZ KFDTMTR KFDTMTU KLDTMFXTM KLDTMRSUM KLTMRWEND MLOBKLHV MLOBKLNV MLUBKLHV MLUBKLNV TDDLSC TDTGC TMESSCMN TMSSSCO TMSSSCU TWBKLHOFF TWBKLHON TWBKLNOFF TWBKLNON VBKLHO VBKLHU VBKLNO VBKLNU /end DEF_CHARACTERISTIC
 /begin IN_MEASUREMENT B_nmot B_sa B_stend B_tmotrg B_tmsrt mll1 tmew tmmodkorrf tmotlinf tmotlinstz tum vfzg /end IN_MEASUREMENT
 /begin OUT_MEASUREMENT B_erhsctcw B_erlsctcw B_erstctcw B_hlhsctcw B_hllsctcw B_hlstctcw tmrw tmrwend /end OUT_MEASUREMENT
 /begin LOC_MEASUREMENT afzklh afzkln B_enlsc B_enstc B_irhsc B_klh B_kln B_lscdis B_nirhsc B_perlsc B_perstc B_phllsc B_phlstc B_stccold B_stcdis B_stchot B_tmrwfvr B_tmrwset B_tmrwstrt ctmrw_w dtmrwtumg tmotlfmax tmotlfmin tmrwgrad_w tmrwop_w tumlok twklhoff twklhon twklnoff twklnon /end LOC_MEASUREMENT
 FUNCTION_VERSION "1.6.0" /end FUNCTION
/begin FUNCTION DPS_Tmp "2.20.0" /begin DEF_CHARACTERISTIC DPSWATCHINDEX THP TVP /end DEF_CHARACTERISTIC
 /begin OUT_MEASUREMENT dps_error dps_errStat dps_errStat_sum_rec dps_errStat_sum_ver dps_index dps_recoveryTime dps_state dps_verifyTime /end OUT_MEASUREMENT
 FUNCTION_VERSION "2.20.0" /end FUNCTION
/begin FUNCTION DSCHED_Cal "1.1.0"
 /begin DEF_CHARACTERISTIC DSCHED_AsgnCheck.FID_AFRA_C DSCHED_AsgnCheck.FID_AORA_C DSCHED_AsgnCheck.FID_ATEH_C DSCHED_AsgnCheck.FID_ATEL_C DSCHED_AsgnCheck.FID_ATEN_C DSCHED_AsgnCheck.FId_InhibitAlways_C DSCHED_AsgnCheck.FID_BLLRH_C DSCHED_AsgnCheck.FID_BLLRKH_C DSCHED_AsgnCheck.FID_BMDFON_C DSCHED_AsgnCheck.FId_TWCCTrimB1_C DSCHED_AsgnCheck.FId_TWCDPriCatB1_C DSCHED_BsPrio.FID_AFRA_C DSCHED_BsPrio.FID_AORA_C DSCHED_BsPrio.FID_ATEH_C DSCHED_BsPrio.FID_ATEL_C DSCHED_BsPrio.FID_ATEN_C DSCHED_BsPrio.FId_InhibitAlways_C DSCHED_BsPrio.FID_BLLRH_C DSCHED_BsPrio.FID_BLLRKH_C DSCHED_BsPrio.FID_BMDFON_C DSCHED_BsPrio.FId_TWCCTrimB1_C DSCHED_BsPrio.FId_TWCDPriCatB1_C DSCHED_FacPhys.FID_AFRA_C DSCHED_FacPhys.FID_AORA_C DSCHED_FacPhys.FID_ATEH_C DSCHED_FacPhys.FID_ATEL_C DSCHED_FacPhys.FID_ATEN_C DSCHED_FacPhys.FId_InhibitAlways_C DSCHED_FacPhys.FID_BLLRH_C DSCHED_FacPhys.FID_BLLRKH_C DSCHED_FacPhys.FID_BMDFON_C DSCHED_FacPhys.FId_TWCCTrimB1_C DSCHED_FacPhys.FId_TWCDPriCatB1_C DSCHED_idxWTTEnd_C DSCHED_idxWTTStrt_C DSCHED_JmpActvPrio.FID_AFRA_C DSCHED_JmpActvPrio.FID_AORA_C DSCHED_JmpActvPrio.FID_ATEH_C DSCHED_JmpActvPrio.FID_ATEL_C DSCHED_JmpActvPrio.FID_ATEN_C DSCHED_JmpActvPrio.FId_InhibitAlways_C DSCHED_JmpActvPrio.FID_BLLRH_C DSCHED_JmpActvPrio.FID_BLLRKH_C DSCHED_JmpActvPrio.FID_BMDFON_C DSCHED_JmpActvPrio.FId_TWCCTrimB1_C DSCHED_JmpActvPrio.FId_TWCDPriCatB1_C DSCHED_SetPointRateActv.FID_AFRA_C DSCHED_SetPointRateActv.FID_AORA_C DSCHED_SetPointRateActv.FID_ATEH_C DSCHED_SetPointRateActv.FID_ATEL_C DSCHED_SetPointRateActv.FID_ATEN_C DSCHED_SetPointRateActv.FId_InhibitAlways_C DSCHED_SetPointRateActv.FID_BLLRH_C DSCHED_SetPointRateActv.FID_BLLRKH_C DSCHED_SetPointRateActv.FID_BMDFON_C DSCHED_SetPointRateActv.FId_TWCCTrimB1_C DSCHED_SetPointRateActv.FId_TWCDPriCatB1_C DSCHED_SetPointRatePas.FID_AFRA_C DSCHED_SetPointRatePas.FID_AORA_C DSCHED_SetPointRatePas.FID_ATEH_C DSCHED_SetPointRatePas.FID_ATEL_C DSCHED_SetPointRatePas.FID_ATEN_C DSCHED_SetPointRatePas.FId_InhibitAlways_C DSCHED_SetPointRatePas.FID_BLLRH_C DSCHED_SetPointRatePas.FID_BLLRKH_C DSCHED_SetPointRatePas.FID_BMDFON_C DSCHED_SetPointRatePas.FId_TWCCTrimB1_C DSCHED_SetPointRatePas.FId_TWCDPriCatB1_C DSCHED_tiWTT_CA DSCHED_UpLimRateLow.FID_AFRA_C DSCHED_UpLimRateLow.FID_AORA_C DSCHED_UpLimRateLow.FID_ATEH_C DSCHED_UpLimRateLow.FID_ATEL_C DSCHED_UpLimRateLow.FID_ATEN_C DSCHED_UpLimRateLow.FId_InhibitAlways_C DSCHED_UpLimRateLow.FID_BLLRH_C DSCHED_UpLimRateLow.FID_BLLRKH_C DSCHED_UpLimRateLow.FID_BMDFON_C DSCHED_UpLimRateLow.FId_TWCCTrimB1_C DSCHED_UpLimRateLow.FId_TWCDPriCatB1_C DSCHED_UpLimRateOk.FID_AFRA_C DSCHED_UpLimRateOk.FID_AORA_C DSCHED_UpLimRateOk.FID_ATEH_C DSCHED_UpLimRateOk.FID_ATEL_C DSCHED_UpLimRateOk.FID_ATEN_C DSCHED_UpLimRateOk.FId_InhibitAlways_C DSCHED_UpLimRateOk.FID_BLLRH_C DSCHED_UpLimRateOk.FID_BLLRKH_C DSCHED_UpLimRateOk.FID_BMDFON_C DSCHED_UpLimRateOk.FId_TWCCTrimB1_C DSCHED_UpLimRateOk.FId_TWCDPriCatB1_C DSCHED_valOfsPrioOpMode_C DSCHED_valOfsPrioTst_C DSCHED_xFctTstFId_CA DSCHED_xWTTFId_CA /end DEF_CHARACTERISTIC
 /begin OUT_MEASUREMENT DSCHED_DynPrio.FId_Unused DSCHED_DynPrio.FID_AFRA DSCHED_DynPrio.FID_AORA DSCHED_DynPrio.FID_ATEH DSCHED_DynPrio.FID_ATEL DSCHED_DynPrio.FID_ATEN DSCHED_DynPrio.FId_InhibitAlways DSCHED_DynPrio.FID_BLLRH DSCHED_DynPrio.FID_BLLRKH DSCHED_DynPrio.FID_BMDFON DSCHED_DynPrio.FId_TWCCTrimB1 DSCHED_DynPrio.FId_TWCDPriCatB1 DSCHED_PhysPrio.FId_Unused DSCHED_PhysPrio.FID_AFRA DSCHED_PhysPrio.FID_AORA DSCHED_PhysPrio.FID_ATEH DSCHED_PhysPrio.FID_ATEL DSCHED_PhysPrio.FID_ATEN DSCHED_PhysPrio.FId_InhibitAlways DSCHED_PhysPrio.FID_BLLRH DSCHED_PhysPrio.FID_BLLRKH DSCHED_PhysPrio.FID_BMDFON DSCHED_PhysPrio.FId_TWCCTrimB1 DSCHED_PhysPrio.FId_TWCDPriCatB1 DSCHED_TiActv.FId_Unused DSCHED_TiActv.FID_AFRA DSCHED_TiActv.FID_AORA DSCHED_TiActv.FID_ATEH DSCHED_TiActv.FID_ATEL DSCHED_TiActv.FID_ATEN DSCHED_TiActv.FId_InhibitAlways DSCHED_TiActv.FID_BLLRH DSCHED_TiActv.FID_BLLRKH DSCHED_TiActv.FID_BMDFON DSCHED_TiActv.FId_TWCCTrimB1 DSCHED_TiActv.FId_TWCDPriCatB1 DSCHED_TiPas.FId_Unused DSCHED_TiPas.FID_AFRA DSCHED_TiPas.FID_AORA DSCHED_TiPas.FID_ATEH DSCHED_TiPas.FID_ATEL DSCHED_TiPas.FID_ATEN DSCHED_TiPas.FId_InhibitAlways DSCHED_TiPas.FID_BLLRH DSCHED_TiPas.FID_BLLRKH DSCHED_TiPas.FID_BMDFON DSCHED_TiPas.FId_TWCCTrimB1 DSCHED_TiPas.FId_TWCDPriCatB1 /end OUT_MEASUREMENT
 /begin LOC_MEASUREMENT DSCHED_idxWTTAct DSCHED_tiWTT /end LOC_MEASUREMENT
 FUNCTION_VERSION "1.1.0" /end FUNCTION
/begin FUNCTION DSCHED_Eval "1.3.0"
 /begin DEF_CHARACTERISTIC DSCHED_Excl.AFRA_AORA_C DSCHED_Excl.AFRA_ATEH_C DSCHED_Excl.AFRA_ATEL_C DSCHED_Excl.AFRA_ATEN_C DSCHED_Excl.AFRA_InhibitAlways_C DSCHED_Excl.AFRA_BLLRH_C DSCHED_Excl.AFRA_BLLRKH_C DSCHED_Excl.AFRA_BMDFON_C DSCHED_Excl.AFRA_TWCCTrimB1_C DSCHED_Excl.AFRA_TWCDPriCatB1_C DSCHED_Excl.AORA_ATEH_C DSCHED_Excl.AORA_ATEL_C DSCHED_Excl.AORA_ATEN_C DSCHED_Excl.AORA_InhibitAlways_C DSCHED_Excl.AORA_BLLRH_C DSCHED_Excl.AORA_BLLRKH_C DSCHED_Excl.AORA_BMDFON_C DSCHED_Excl.AORA_TWCCTrimB1_C DSCHED_Excl.AORA_TWCDPriCatB1_C DSCHED_Excl.ATEH_ATEL_C DSCHED_Excl.ATEH_ATEN_C DSCHED_Excl.ATEH_InhibitAlways_C DSCHED_Excl.ATEH_BLLRH_C DSCHED_Excl.ATEH_BLLRKH_C DSCHED_Excl.ATEH_BMDFON_C DSCHED_Excl.ATEH_TWCCTrimB1_C DSCHED_Excl.ATEH_TWCDPriCatB1_C DSCHED_Excl.ATEL_ATEN_C DSCHED_Excl.ATEL_InhibitAlways_C DSCHED_Excl.ATEL_BLLRH_C DSCHED_Excl.ATEL_BLLRKH_C DSCHED_Excl.ATEL_BMDFON_C DSCHED_Excl.ATEL_TWCCTrimB1_C DSCHED_Excl.ATEL_TWCDPriCatB1_C DSCHED_Excl.ATEN_InhibitAlways_C DSCHED_Excl.ATEN_BLLRH_C DSCHED_Excl.ATEN_BLLRKH_C DSCHED_Excl.ATEN_BMDFON_C DSCHED_Excl.ATEN_TWCCTrimB1_C DSCHED_Excl.ATEN_TWCDPriCatB1_C DSCHED_Excl.InhibitAlways_BLLRH_C DSCHED_Excl.InhibitAlways_BLLRKH_C DSCHED_Excl.InhibitAlways_BMDFON_C DSCHED_Excl.InhibitAlways_TWCCTrimB1_C DSCHED_Excl.InhibitAlways_TWCDPriCatB1_C DSCHED_Excl.BLLRH_BLLRKH_C DSCHED_Excl.BLLRH_BMDFON_C DSCHED_Excl.BLLRH_TWCCTrimB1_C DSCHED_Excl.BLLRH_TWCDPriCatB1_C DSCHED_Excl.BLLRKH_BMDFON_C DSCHED_Excl.BLLRKH_TWCCTrimB1_C DSCHED_Excl.BLLRKH_TWCDPriCatB1_C DSCHED_Excl.BMDFON_TWCCTrimB1_C DSCHED_Excl.BMDFON_TWCDPriCatB1_C DSCHED_Excl.TWCCTrimB1_TWCDPriCatB1_C DSCHED_stMode_C DSCHED_valDflOpMode_C /end DEF_CHARACTERISTIC
 /begin OUT_MEASUREMENT DSCHED_St.FId_Unused DSCHED_St.FID_AFRA DSCHED_St.FID_AORA DSCHED_St.FID_ATEH DSCHED_St.FID_ATEL DSCHED_St.FID_ATEN DSCHED_St.FId_InhibitAlways DSCHED_St.FID_BLLRH DSCHED_St.FID_BLLRKH DSCHED_St.FID_BMDFON DSCHED_St.FId_TWCCTrimB1 DSCHED_St.FId_TWCDPriCatB1 DSCHED_WhyExcl.FId_Unused DSCHED_WhyExcl.FID_AFRA DSCHED_WhyExcl.FID_AORA DSCHED_WhyExcl.FID_ATEH DSCHED_WhyExcl.FID_ATEL DSCHED_WhyExcl.FID_ATEN DSCHED_WhyExcl.FId_InhibitAlways DSCHED_WhyExcl.FID_BLLRH DSCHED_WhyExcl.FID_BLLRKH DSCHED_WhyExcl.FID_BMDFON DSCHED_WhyExcl.FId_TWCCTrimB1 DSCHED_WhyExcl.FId_TWCDPriCatB1 /end OUT_MEASUREMENT
 FUNCTION_VERSION "1.3.0" /end FUNCTION
/begin COMPU_METHOD B_TRUE "" TAB_VERB "%6.3" "" COMPU_TAB_REF B_TRUE /end COMPU_METHOD
/begin COMPU_VTAB B_TRUE "" TAB_VERB 2 0 "----" 1 "TRUE" /end COMPU_VTAB
/begin COMPU_METHOD dez "" RAT_FUNC "%6.2" "" COEFFS 0 1 0 0 0 1 /end COMPU_METHOD
/begin COMPU_METHOD DFC_OneToOne "" RAT_FUNC "%6.2" "-" COEFFS 0 1 0 0 0 1 /end COMPU_METHOD
/begin COMPU_METHOD DFC_Verb "" TAB_VERB "%2.1" "-" COMPU_TAB_REF DFC_Verb /end COMPU_METHOD
/begin COMPU_VTAB DFC_Verb "" TAB_VERB 212 0 "DFC_Unused" 60 "DFC_AirCClntPAnaSRCMax" 61 "DFC_AirCClntPAnaSRCMin" 41 "DFC_AirCCmprOL" 42 "DFC_AirCCmprOvrTemp" 43 "DFC_AirCCmprSCB" 44 "DFC_AirCCmprSCG" 62 "DFC_AirCSwtNpl" 63 "DFC_AirCSwtSig" 64 "DFC_AltIOLdSRCMax" 45 "DFC_AltIOLdSRCMin" 46 "DFC_AltIOOL" 47 "DFC_AltIOOvrTemp" 48 "DFC_AltIOSCB" 49 "DFC_AltIOSCG" 1 "DFC_AltMaxPwr" 2 "DFC_BrkNpl" 65 "DFC_BrkSig" 81 "DFC_BusDiagBusOffNodeA" 3 "DFC_Cj930SSp1Mon" 4 "DFC_Cj930SSp2Mon" 5 "DFC_Cj930SSp3Mon" 66 "DFC_ClthEPBNpl" 67 "DFC_ClthEPBSensErr" 68 "DFC_ClthErr" 24 "DFC_ClthNplClsd" 25 "DFC_ClthNplOpn" 69 "DFC_ClthSig" 82 "DFC_ComACSensTO" 83 "DFC_ComAWD1TO" 84 "DFC_ComBRK10TO" 85 "DFC_ComGW11TO" 86 "DFC_ComLVL1TO" 87 "DFC_ComPRKA01TO" 88 "DFC_ComPRKH01TO" 89 "DFC_ComPRKH1TO" 90 "DFC_ComTRBCH1TO" 91 "DFC_ComTRBCH2TO" 50 "DFC_DevLibBattUHi" 51 "DFC_DevLibBattULo" 92 "DFC_DK" 95 "DFC_DKmax" 96 "DFC_DKmin" 93 "DFC_DKRSA" 94 "DFC_DKVSmax" 97 "DFC_DSSmax" 98 "DFC_EEPEraseErr" 99 "DFC_EEPRdErr" 100 "DFC_EEPWrErr" 110 "DFC_EpmCaSI1ErrSig" 111 "DFC_EpmCaSI1NoSig" 112 "DFC_EpmCaSI1NoSigMax" 113 "DFC_EpmCaSI1NoSigMin" 114 "DFC_EpmCaSI1OfsErr" 115 "DFC_EpmCrSErrSig" 116 "DFC_EpmCrSNoSig" 101 "DFC_EV1max" 102 "DFC_EV1min" 103 "DFC_EV1sig" 104 "DFC_EV2max" 105 "DFC_EV2min" 106 "DFC_EV2sig" 107 "DFC_EV3max" 108 "DFC_EV3min" 109 "DFC_EV3sig" 52 "DFC_FanDIOOL" 53 "DFC_FanDIOOvrTemp" 54 "DFC_FanDIOSCB" 55 "DFC_FanDIOSCG" 56 "DFC_FanPWMOL" 57 "DFC_FanPWMOvrTemp" 58 "DFC_FanPWMSCB" 59 "DFC_FanPWMSCG" 117 "DFC_FRAmax" 118 "DFC_FRAmin" 119 "DFC_HEGOS1B1ElecMax" 120 "DFC_HEGOS1B1ElecMin" 121 "DFC_HEGOS1B1ElecNpl" 122 "DFC_HEGOS1B1ElecSig" 123 "DFC_HEGOS1B1HtgNpl" 124 "DFC_HEGOS1B1HtrPsMax" 125 "DFC_HEGOS1B1HtrPsMin" 126 "DFC_HEGOS1B1HtrPsSig" 127 "DFC_HEGOS1B1StkMax" 128 "DFC_HEGOS1B1StkMin" 129 "DFC_HEGOS2B1RstrcnLean" 130 "DFC_HEGOS2B1RstrcnRich" 6 "DFC_IdleChrgActrAMax" 7 "DFC_IdleChrgActrAMin" 8 "DFC_IdleChrgActrASig" 9 "DFC_IdleChrgActrBMax" 10 "DFC_IdleChrgActrBMin" 11 "DFC_IdleChrgActrBSig" 12 "DFC_IdleChrgActrGovDeCold" 13 "DFC_IdleChrgActrGovDeMax" 14 "DFC_IdleChrgActrGovDeMin" 131 "DFC_IdleChrgActrJamVlvClsd" 132 "DFC_IdleChrgActrJamVlvOpn" 15 "DFC_IdleChrgActrNAMax" 16 "DFC_IdleChrgActrNAMin" 17 "DFC_IdleChrgActrNASig" 18 "DFC_IdleChrgActrNBMax" 19 "DFC_IdleChrgActrNBMin" 20 "DFC_IdleChrgActrNBSig" 21 "DFC_IdleChrgActrOverTmp" 26 "DFC_IgnClPsDevComErr1" 133 "DFC_IgnClPsDevOscErr1" 27 "DFC_IgnClPsOpenLoad0" 28 "DFC_IgnClPsOpenLoad1" 29 "DFC_IgnClPsOpenLoad2" 30 "DFC_IgnClPsShCirBatt0" 31 "DFC_IgnClPsShCirBatt1" 32 "DFC_IgnClPsShCirBatt2" 33 "DFC_IgnClPsShCirGnd0" 34 "DFC_IgnClPsShCirGnd1" 35 "DFC_IgnClPsShCirGnd2" 36 "DFC_KnDetSens1PortAMax" 37 "DFC_KnDetSens1PortAMin" 38 "DFC_KnDetSens1PortBMax" 39 "DFC_KnDetSens1PortBMin" 134 "DFC_KPEmax" 135 "DFC_KPEmin" 136 "DFC_KPEsig" 137 "DFC_KS1max" 138 "DFC_KS1min" 139 "DFC_LLRKHmax" 140 "DFC_LLRKHmin" 141 "DFC_LLRKHnpl" 142 "DFC_LLRmax" 143 "DFC_LLRmin" 144 "DFC_LLRnpl" 145 "DFC_LMmax" 146 "DFC_LZSRnpl" 147 "DFC_MD" 148 "DFC_MD00min" 149 "DFC_MD00npl" 150 "DFC_MD01min" 151 "DFC_MD01npl" 152 "DFC_MD02min" 153 "DFC_MD02npl" 154 "DFC_MD03min" 155 "DFC_MD03npl" 156 "DFC_MD04min" 157 "DFC_MD04npl" 158 "DFC_MDCyl_0" 159 "DFC_MDCyl_1" 160 "DFC_MDCyl_2" 161 "DFC_MDFC" 162 "DFC_MDmin" 163 "DFC_MDnpl" 70 "DFC_MILLmpOL" 71 "DFC_MILLmpSCB" 72 "DFC_MILLmpSCG" 164 "DFC_MoCADCNTP" 165 "DFC_MoCADCTst" 166 "DFC_MoCComctErrMM" 22 "DFC_MonUMaxSupply1" 23 "DFC_MonUMinSupply1" 167 "DFC_OCWDAActv" 168 "DFC_OCWDACom" 169 "DFC_ORAmax" 170 "DFC_ORAmin" 171 "DFC_PSR1max" 172 "DFC_PSRBmax" 173 "DFC_PSRBmin" 174 "DFC_PSREmax" 175 "DFC_PSREmin" 179 "DFC_PSRmax" 176 "DFC_PSRPmax" 177 "DFC_PSRPmin" 178 "DFC_PSRPsig" 73 "DFC_SRCHighAPP1" 74 "DFC_SRCHighAPP2" 75 "DFC_SRCLowAPP1" 76 "DFC_SRCLowAPP2" 180 "DFC_SSpMon1" 181 "DFC_SSpMon2" 182 "DFC_SSpMon3" 183 "DFC_SWReset_0" 184 "DFC_SWReset_1" 185 "DFC_SWReset_2" 77 "DFC_SyncAPP" 190 "DFC_TAmax" 186 "DFC_TASREmax" 187 "DFC_TASREmin" 188 "DFC_TASREnpl" 189 "DFC_TASRmax" 191 "DFC_TEVEmax" 192 "DFC_TEVEmin" 193 "DFC_TEVEsig" 194 "DFC_TMCSmax" 195 "DFC_TMCSmin" 196 "DFC_TMEmax" 197 "DFC_TMEmin" 198 "DFC_TMEnpl" 199 "DFC_TMEsig" 203 "DFC_TMmax" 200 "DFC_TMPmax" 201 "DFC_TMPmin" 202 "DFC_TMPnpl" 204 "DFC_TUMmax" 205 "DFC_TWCCTrimMaxB1" 206 "DFC_TWCCTrimMinB1" 207 "DFC_TWCDPriCatB1" 209 "DFC_UBmax" 210 "DFC_UBmin" 211 "DFC_UBnpl" 208 "DFC_UBRmax" 78 "DFC_VehVMax" 79 "DFC_VehVPlaus" 80 "DFC_VehVSig" 40 "DFC_VehVWhlErr" DEFAULT_VALUE "---" /end COMPU_VTAB
/begin COMPU_METHOD dfp_verbal "" TAB_VERB "%2.1" "-" COMPU_TAB_REF dfp_verbal /end COMPU_METHOD
/begin COMPU_VTAB dfp_verbal "" TAB_VERB 87 0 "DFP_AAA" 1 "DFP_BM" 2 "DFP_DK" 3 "DFP_DKVS" 4 "DFP_DSS" 5 "DFP_DVEV" 6 "DFP_DYLSU" 7 "DFP_DZKU0" 8 "DFP_DZKU1" 9 "DFP_DZKU2" 10 "DFP_EGFE" 11 "DFP_ENWS" 12 "DFP_ENWSE" 13 "DFP_EV1" 14 "DFP_EV2" 15 "DFP_EV3" 16 "DFP_FMAS" 17 "DFP_FP1P" 18 "DFP_FP2P" 19 "DFP_FRA" 20 "DFP_FRAU" 21 "DFP_FTDLA" 22 "DFP_HELSU" 23 "DFP_HRE" 24 "DFP_HSH" 25 "DFP_HSHE" 26 "DFP_HSV" 27 "DFP_HSVE" 28 "DFP_HSVSA" 29 "DFP_ICLSU" 30 "DFP_KAT" 31 "DFP_KATF" 32 "DFP_KPE" 33 "DFP_KRNT" 34 "DFP_KROF" 35 "DFP_KRTP" 36 "DFP_KUPPL" 37 "DFP_LASH" 38 "DFP_LLR" 39 "DFP_LLRKH" 40 "DFP_LM" 41 "DFP_LSH" 42 "DFP_LSUKS" 43 "DFP_LSUUN" 44 "DFP_LSV" 45 "DFP_LUES1E" 46 "DFP_LZSR" 47 "DFP_MD" 48 "DFP_N" 49 "DFP_NWKW" 50 "DFP_NWKWE" 51 "DFP_ORA" 52 "DFP_PH" 53 "DFP_PHE" 54 "DFP_PLLSU" 55 "DFP_PS1E" 56 "DFP_PS2E" 57 "DFP_PS3E" 58 "DFP_PSR" 59 "DFP_PSR1" 60 "DFP_PSRB" 61 "DFP_PSRE" 62 "DFP_PSRP" 63 "DFP_PVD" 64 "DFP_RKAT" 65 "DFP_RKAZ" 66 "DFP_STKLSV" 67 "DFP_TA" 68 "DFP_TACS" 69 "DFP_TAR" 70 "DFP_TASR" 71 "DFP_TASRE" 72 "DFP_TES" 73 "DFP_TEVE" 74 "DFP_THM" 75 "DFP_TM" 76 "DFP_TMCS" 77 "DFP_TME" 78 "DFP_TMKI" 79 "DFP_TMP" 80 "DFP_TUM" 81 "DFP_UB" 82 "DFP_UBR" 83 "DFP_ULSU" 84 "DFP_VFZ" 85 "DFP_VFZG" 86 "DFP_ZZZ" DEFAULT_VALUE "---" /end COMPU_VTAB
/begin COMPU_METHOD DINH_OneToOne "" RAT_FUNC "%6.2" "-" COEFFS 0 1 0 0 0 1 /end COMPU_METHOD
/begin COMPU_METHOD DSCHED_FIdExcCauseVerb "" TAB_VERB "%2.1" "-" COMPU_TAB_REF DSCHED_FIdExcCauseVerb /end COMPU_METHOD
/begin COMPU_VTAB DSCHED_FIdExcCauseVerb "" TAB_VERB 15 0 "No_exclusion" 1 "FID_AFRA" 2 "FID_AORA" 3 "FID_ATEH" 4 "FID_ATEL" 5 "FID_ATEN" 6 "FId_InhibitAlways" 7 "FID_BLLRH" 8 "FID_BLLRKH" 9 "FID_BMDFON" 10 "FId_TWCCTrimB1" 11 "FId_TWCDPriCatB1" 253 "NO_PRIO" 254 "MODE_IMPOSSIBLE" 255 "NO_RUN" DEFAULT_VALUE "---" /end COMPU_VTAB
/begin COMPU_METHOD DSCHED_FIdVerb "" TAB_VERB "%2.1" "-" COMPU_TAB_REF DSCHED_FIdVerb /end COMPU_METHOD
/begin COMPU_VTAB DSCHED_FIdVerb "" TAB_VERB 12 0 "FId_Unused" 1 "FID_AFRA" 2 "FID_AORA" 3 "FID_ATEH" 4 "FID_ATEL" 5 "FID_ATEN" 6 "FId_InhibitAlways" 7 "FID_BLLRH" 8 "FID_BLLRKH" 9 "FID_BMDFON" 10 "FId_TWCCTrimB1" 11 "FId_TWCDPriCatB1" DEFAULT_VALUE "---" /end COMPU_VTAB
/begin COMPU_METHOD DSCHED_FIdWTTVerb "" TAB_VERB "%2.1" "-" COMPU_TAB_REF DSCHED_FIdWTTVerb /end COMPU_METHOD
/begin COMPU_VTAB DSCHED_FIdWTTVerb "" TAB_VERB 23 0 "FId_Unused" 1 "FID_AFRA_Reset" 2 "FID_AORA_Reset" 3 "FID_ATEH_Reset" 4 "FID_ATEL_Reset" 5 "FID_ATEN_Reset" 6 "FId_InhibitAlways_Reset" 7 "FID_BLLRH_Reset" 8 "FID_BLLRKH_Reset" 9 "FID_BMDFON_Reset" 10 "FId_TWCCTrimB1_Reset" 11 "FId_TWCDPriCatB1_Reset" 32769 "FID_AFRA_Activate" 32770 "FID_AORA_Activate" 32771 "FID_ATEH_Activate" 32772 "FID_ATEL_Activate" 32773 "FID_ATEN_Activate" 32774 "FId_InhibitAlways_Activate" 32775 "FID_BLLRH_Activate" 32776 "FID_BLLRKH_Activate" 32777 "FID_BMDFON_Activate" 32778 "FId_TWCCTrimB1_Activate" 32779 "FId_TWCDPriCatB1_Activate" DEFAULT_VALUE "---" /end COMPU_VTAB
/begin COMPU_METHOD DSCHED_StVerb "" TAB_VERB "%6.3" "-" COMPU_TAB_REF DSCHED_StVerb /end COMPU_METHOD
/begin COMPU_VTAB DSCHED_StVerb "" TAB_VERB 64 0 "____________________________" 2 "_____________________RawPerm" 4 "_________________Act________" 6 "_________________Act_RawPerm" 8 "_____________Lck____________" 10 "_____________Lck_____RawPerm" 12 "_____________Lck_Act________" 14 "_____________Lck_Act_RawPerm" 32 "_________Val________________" 34 "_________Val_________RawPerm" 36 "_________Val_____Act________" 38 "_________Val_____Act_RawPerm" 40 "_________Val_Lck____________" 42 "_________Val_Lck_____RawPerm" 44 "_________Val_Lck_Act________" 46 "_________Val_Lck_Act_RawPerm" 64 "____Perm____________________" 66 "____Perm_____________RawPerm" 68 "____Perm_________Act________" 70 "____Perm_________Act_RawPerm" 72 "____Perm_____Lck____________" 74 "____Perm_____Lck_____RawPerm" 76 "____Perm_____Lck_Act________" 78 "____Perm_____Lck_Act_RawPerm" 96 "____Perm_Val________________" 98 "____Perm_Val_________RawPerm" 100 "____Perm_Val_____Act________" 102 "____Perm_Val_____Act_RawPerm" 104 "____Perm_Val_Lck____________" 106 "____Perm_Val_Lck_____RawPerm" 108 "____Perm_Val_Lck_Act________" 110 "____Perm_Val_Lck_Act_RawPerm" 128 "Rdy_________________________" 130 "Rdy__________________RawPerm" 132 "Rdy______________Act________" 134 "Rdy______________Act_RawPerm" 136 "Rdy__________Lck____________" 138 "Rdy__________Lck_____RawPerm" 140 "Rdy__________Lck_Act________" 142 "Rdy__________Lck_Act_RawPerm" 160 "Rdy______Val________________" 162 "Rdy______Val_________RawPerm" 164 "Rdy______Val_____Act________" 166 "Rdy______Val_____Act_RawPerm" 168 "Rdy______Val_Lck____________" 170 "Rdy______Val_Lck_____RawPerm" 172 "Rdy______Val_Lck_Act________" 174 "Rdy______Val_Lck_Act_RawPerm" 192 "Rdy_Perm____________________" 194 "Rdy_Perm_____________RawPerm" 196 "Rdy_Perm_________Act________" 198 "Rdy_Perm_________Act_RawPerm" 200 "Rdy_Perm_____Lck____________" 202 "Rdy_Perm_____Lck_____RawPerm" 204 "Rdy_Perm_____Lck_Act________" 206 "Rdy_Perm_____Lck_Act_RawPerm" 224 "Rdy_Perm_Val________________" 226 "Rdy_Perm_Val_________RawPerm" 228 "Rdy_Perm_Val_____Act________" 230 "Rdy_Perm_Val_____Act_RawPerm" 232 "Rdy_Perm_Val_Lck____________" 234 "Rdy_Perm_Val_Lck_____RawPerm" 236 "Rdy_Perm_Val_Lck_Act________" 238 "Rdy_Perm_Val_Lck_Act_RawPerm" /end COMPU_VTAB
/begin COMPU_METHOD DSCHED_Time100ms "" RAT_FUNC "%6.3" "s" COEFFS 0 10 0 0 0 1 /end COMPU_METHOD
/begin COMPU_METHOD DSCHED_Time200ms "" RAT_FUNC "%6.3" "s" COEFFS 0 5 0 0 0 1 /end COMPU_METHOD
/begin COMPU_METHOD fak_r32_1 "" RAT_FUNC "%27.13" "-" COEFFS 0 1 0 0 0 1 /end COMPU_METHOD
/begin COMPU_METHOD fak_ub_b1 "" RAT_FUNC "%6.4" "-" COEFFS 0 256 0 0 0 1 /end COMPU_METHOD
/begin COMPU_METHOD fak_ub_b2 "" RAT_FUNC "%8.5" "-" COEFFS 0 256 0 0 0 2 /end COMPU_METHOD
/begin COMPU_METHOD fak_ub_b4 "" RAT_FUNC "%6.4" "-" COEFFS 0 256 0 0 0 4 /end COMPU_METHOD
/begin COMPU_METHOD fak_uw_b1 "" RAT_FUNC "%7.6" "-" COEFFS 0 65536 0 0 0 1 /end COMPU_METHOD
/begin COMPU_METHOD fak_uw_b2 "" RAT_FUNC "%7.6" "-" COEFFS 0 65536 0 0 0 2 /end COMPU_METHOD
/begin COMPU_METHOD iumpr_img_verbal "" TAB_VERB "%6.3" "" COMPU_TAB_REF iumpr_img_verbal /end COMPU_METHOD
/begin COMPU_VTAB iumpr_img_verbal "" TAB_VERB 8 0 "NONE" 1 "CAT1" 2 "CAT2" 4 "OXS1" 8 "OXS2" 16 "EVAP" 32 "EGR" 64 "SAIR" /end COMPU_VTAB
/begin COMPU_METHOD kw_q1p5259eEm4_om5 "" RAT_FUNC "%6.3" "deg KW" COEFFS 0 32768 163840 0 0 5 /end COMPU_METHOD
/begin COMPU_METHOD kw_q2p328eEm9_om5 "" RAT_FUNC "%6.3" "deg KW" COEFFS 0 2147483648 10737418240 0 0 5 /end COMPU_METHOD
/begin COMPU_METHOD kw_tooth_sy "" RAT_FUNC "%6.1" "deg KW" COEFFS 0 0.1 0 0 0 1 /end COMPU_METHOD
/begin COMPU_METHOD lu_MEx "" RAT_FUNC "%6.4" "(Umdr./sec)^2" COEFFS 0 219.9023255552 0 0 0 1 /end COMPU_METHOD
/begin COMPU_METHOD m_ub_b1020 "" RAT_FUNC "%6.2" "kg/h" COEFFS 0 1 0 0 0 4 /end COMPU_METHOD
/begin COMPU_METHOD nmotd_sb_q10 "" RAT_FUNC "%6.1" "1/min" COEFFS 0 1 0 0 0 10 /end COMPU_METHOD
/begin COMPU_METHOD nmotg_sw_q0p39 "" RAT_FUNC "%6.3" "1/(min*s)" COEFFS 0 1 0 0 0 0.39063 /end COMPU_METHOD
/begin COMPU_METHOD nmot_q0p25 "" RAT_FUNC "%6.3" "1/min" COEFFS 0 4 0 0 0 1 /end COMPU_METHOD
/begin COMPU_METHOD nmot_q0p5 "" RAT_FUNC "%6.3" "1/min" COEFFS 0 2 0 0 0 1 /end COMPU_METHOD
/begin COMPU_METHOD nmot_q40 "" RAT_FUNC "%6.1" "1/min" COEFFS 0 1 0 0 0 40 /end COMPU_METHOD
/begin COMPU_METHOD nmot_sw_q0p25 "" RAT_FUNC "%6.3" "1/min" COEFFS 0 1 0 0 0 0.25 /end COMPU_METHOD
/begin COMPU_METHOD nmot_ub_q40 "" RAT_FUNC "%6.1" "1/min" COEFFS 0 1 0 0 0 40 /end COMPU_METHOD
/begin COMPU_METHOD nmot_uw_q0p25 "" RAT_FUNC "%6.3" "1/min" COEFFS 0 1 0 0 0 0.25 /end COMPU_METHOD
/begin COMPU_METHOD OneToOne "" RAT_FUNC "%6.2" "-" COEFFS 0 1 0 0 0 1 /end COMPU_METHOD
/begin COMPU_METHOD PCA8565_SY_Compu "" TAB_VERB "%6.3" "" COMPU_TAB_REF PCA8565_SY_Compu /end COMPU_METHOD
/begin COMPU_VTAB PCA8565_SY_Compu "" TAB_VERB 2 0 "no PCA8565" 1 "one PCA8565" /end COMPU_VTAB
/begin COMPU_METHOD PCP_SY_Compu "" TAB_VERB "%6.3" "" COMPU_TAB_REF PCP_SY_Compu /end COMPU_METHOD
/begin COMPU_VTAB PCP_SY_Compu "" TAB_VERB 2 0 "no PCP" 1 "PCP present" /end COMPU_VTAB
/begin COMPU_METHOD PCSI_SY_Compu "" TAB_VERB "%6.3" "" COMPU_TAB_REF PCSI_SY_Compu /end COMPU_METHOD
/begin COMPU_VTAB PCSI_SY_Compu "" TAB_VERB 2 1 "PCSI used" 0 "no PCSI" /end COMPU_VTAB
/begin COMPU_METHOD PDIFFEGRSENS_SY_Compu "" TAB_VERB "%6.3" "" COMPU_TAB_REF PDIFFEGRSENS_SY_Compu /end COMPU_METHOD
/begin COMPU_VTAB PDIFFEGRSENS_SY_Compu "" TAB_VERB 2 0 "False" 1 "True" /end COMPU_VTAB
/begin COMPU_METHOD Period "" RAT_FUNC "%6.3" "ms" COEFFS 0 10 0 0 0 1 /end COMPU_METHOD
/begin COMPU_METHOD PERMSPLYSYS_SY_Compu "" TAB_VERB "%6.3" "" COMPU_TAB_REF PERMSPLYSYS_SY_Compu /end COMPU_METHOD
/begin COMPU_VTAB PERMSPLYSYS_SY_Compu "" TAB_VERB 2 0 "non-permanently supplied system" 1 "permanently supplied system" /end COMPU_VTAB
/begin COMPU_METHOD PHASE_DETECT_SY_Compu "" TAB_VERB "%6.3" "" COMPU_TAB_REF PHASE_DETECT_SY_Compu /end COMPU_METHOD
/begin COMPU_VTAB PHASE_DETECT_SY_Compu "" TAB_VERB 3 0 "CAS" 1 "COMB_PRESSURE" 2 "SPEED" /end COMPU_VTAB
/begin COMPU_METHOD PINTKVUS_INHOUSE_SY_Compu "" TAB_VERB "%6.3" "" COMPU_TAB_REF PINTKVUS_INHOUSE_SY_Compu /end COMPU_METHOD
/begin COMPU_VTAB PINTKVUS_INHOUSE_SY_Compu "" TAB_VERB 2 0 "False" 1 "True" /end COMPU_VTAB
/begin COMPU_METHOD PINTVUS_SY_Compu "" TAB_VERB "%6.3" "" COMPU_TAB_REF PINTVUS_SY_Compu /end COMPU_METHOD
/begin COMPU_VTAB PINTVUS_SY_Compu "" TAB_VERB 2 1 "AirDvP provides neutral value for PIntkVUs" 0 "AirMod provides neutral value for PIntkVUs" /end COMPU_VTAB
/begin COMPU_METHOD POSTDRV_SOFTRST_SY_Compu "" TAB_VERB "%6.3" "" COMPU_TAB_REF POSTDRV_SOFTRST_SY_Compu /end COMPU_METHOD
/begin COMPU_VTAB POSTDRV_SOFTRST_SY_Compu "" TAB_VERB 2 0 "false" 1 "true" /end COMPU_VTAB
/begin COMPU_METHOD PrcHigh "" RAT_FUNC "%6.5" "%" COEFFS 0 1000 0 0 0 1 /end COMPU_METHOD
/begin COMPU_METHOD PrcPerTime "" RAT_FUNC "%7.6" "%/s" COEFFS 0 10000 0 0 0 1 /end COMPU_METHOD
/begin COMPU_METHOD Prc_q0p1_COMPU "" RAT_FUNC "%6.3" "%" COEFFS 0 10 0 0 0 1 /end COMPU_METHOD
/begin COMPU_METHOD Pres "" RAT_FUNC "%6.3" "kPa" COEFFS 0 10 0 0 0 1 /end COMPU_METHOD
/begin COMPU_METHOD Pres_hPaPT "" RAT_FUNC "%6.3" "hPa/s" COEFFS 0 10 0 0 0 1 /end COMPU_METHOD
/begin COMPU_METHOD Pres_SI "" RAT_FUNC "%6.0" "Pa" COEFFS 0 0.01 0 0 0 1 /end COMPU_METHOD
/begin COMPU_METHOD PRODMODE_SY_Compu "" TAB_VERB "%6.3" "" COMPU_TAB_REF PRODMODE_SY_Compu /end COMPU_METHOD
/begin COMPU_VTAB PRODMODE_SY_Compu "" TAB_VERB 2 0 "False" 1 "True" /end COMPU_VTAB
/begin COMPU_METHOD PRTSHFTUPREQ_SY_Compu "" TAB_VERB "%6.3" "" COMPU_TAB_REF PRTSHFTUPREQ_SY_Compu /end COMPU_METHOD
/begin COMPU_VTAB PRTSHFTUPREQ_SY_Compu "" TAB_VERB 2 0 "False" 1 "True" /end COMPU_VTAB
/begin COMPU_METHOD PTHRESCUS_SY_Compu "" RAT_FUNC "%6.2" "" COEFFS 0 1 0 0 0 1 /end COMPU_METHOD
/begin COMPU_METHOD PTLHC_SY_Compu "" TAB_VERB "%6.3" "" COMPU_TAB_REF PTLHC_SY_Compu /end COMPU_METHOD
/begin COMPU_VTAB PTLHC_SY_Compu "" TAB_VERB 2 1 "TRUE" 0 "FALSE" /end COMPU_VTAB
/begin COMPU_METHOD PTO_SY_Compu "" TAB_VERB "%6.3" "" COMPU_TAB_REF PTO_SY_Compu /end COMPU_METHOD
/begin COMPU_VTAB PTO_SY_Compu "" TAB_VERB 2 0 "False" 1 "True" /end COMPU_VTAB
/begin COMPU_METHOD PTPRTOVRDSSPDGOV_SY_Compu "" TAB_VERB "%6.3" "" COMPU_TAB_REF PTPRTOVRDSSPDGOV_SY_Compu /end COMPU_METHOD
/begin COMPU_VTAB PTPRTOVRDSSPDGOV_SY_Compu "" TAB_VERB 2 1 "TRUE" 0 "FALSE" /end COMPU_VTAB
/begin COMPU_METHOD PT_SWGRIP_SY_Compu "" TAB_VERB "%6.3" "" COMPU_TAB_REF PT_SWGRIP_SY_Compu /end COMPU_METHOD
/begin COMPU_VTAB PT_SWGRIP_SY_Compu "" TAB_VERB 2 0 "0" 1 "1" /end COMPU_VTAB
/begin COMPU_METHOD Pwr2 "" RAT_FUNC "%6.1" "W" COEFFS 0 0.0530516476972949 0 0 0 1 /end COMPU_METHOD
/begin COMPU_METHOD PWRINTENGNLIM_SY_Compu "" TAB_VERB "%6.3" "" COMPU_TAB_REF PWRINTENGNLIM_SY_Compu /end COMPU_METHOD
/begin COMPU_VTAB PWRINTENGNLIM_SY_Compu "" TAB_VERB 2 0 "False" 1 "True" /end COMPU_VTAB
/begin COMPU_METHOD Pwr_W_q4p0_COMPU "" RAT_FUNC "%6.2" "W" COEFFS 0 1 0 0 0 4 /end COMPU_METHOD
/begin COMPU_METHOD p_q0p039 "" RAT_FUNC "%6.4" "hPa" COEFFS 0 256 0 0 0 10 /end COMPU_METHOD
/begin COMPU_METHOD p_q0p078 "" RAT_FUNC "%6.4" "hPa" COEFFS 0 64 0 0 0 5 /end COMPU_METHOD
/begin COMPU_METHOD p_uw_q0p078 "" RAT_FUNC "%6.4" "hPa" COEFFS 0 256 0 0 0 20 /end COMPU_METHOD
/begin COMPU_METHOD QntR "" RAT_FUNC "%6.5" "-" COEFFS 0 1024 0 0 0 1 /end COMPU_METHOD
/begin COMPU_METHOD QNTSTMOT_SY_Compu "" TAB_VERB "%6.3" "" COMPU_TAB_REF QNTSTMOT_SY_Compu /end COMPU_METHOD
/begin COMPU_VTAB QNTSTMOT_SY_Compu "" TAB_VERB 2 0 "QNTSTMOT_SY == 0" 1 "QNTSTMOT_SY == 1" /end COMPU_VTAB
/begin COMPU_METHOD R2S2_SY_Compu "" TAB_VERB "%6.3" "" COMPU_TAB_REF R2S2_SY_Compu /end COMPU_METHOD
/begin COMPU_VTAB R2S2_SY_Compu "" TAB_VERB 5 0 "NO_R2S2" 1 "1_R2S2" 2 "2_R2S2" 3 "3_R2S2" 4 "4_R2S2" /end COMPU_VTAB
/begin COMPU_METHOD RADSHT_SY_Compu "" TAB_VERB "%6.3" "" COMPU_TAB_REF RADSHT_SY_Compu /end COMPU_METHOD
/begin COMPU_VTAB RADSHT_SY_Compu "" TAB_VERB 3 0 "OFF" 1 "HW" 2 "LIN" /end COMPU_VTAB
/begin COMPU_METHOD RatAirMass "" RAT_FUNC "%6.4" "-" COEFFS 0 100 0 0 0 1 /end COMPU_METHOD
/begin COMPU_METHOD RCSSTRT_SY_Compu "" TAB_VERB "%6.3" "" COMPU_TAB_REF RCSSTRT_SY_Compu /end COMPU_METHOD
/begin COMPU_VTAB RCSSTRT_SY_Compu "" TAB_VERB 2 0 "False" 1 "True" /end COMPU_VTAB
/begin COMPU_METHOD relDK_q0p02441 "" RAT_FUNC "%6.4" "%DK" COEFFS 0 65536 0 0 0 1600 /end COMPU_METHOD
/begin COMPU_METHOD relDK_ub_b100 "" RAT_FUNC "%6.3" "%DK" COEFFS 0 255 0 0 0 100 /end COMPU_METHOD
/begin COMPU_METHOD relNWU_q0p0234 "" RAT_FUNC "%6.4" "%/NWU" COEFFS 0 32 0 0 0 0.75 /end COMPU_METHOD
/begin COMPU_METHOD rel_q0p5 "" RAT_FUNC "%6.3" "%" COEFFS 0 1 0 0 0 0.5 /end COMPU_METHOD
/begin COMPU_METHOD rel_sb_q0p39 "" RAT_FUNC "%6.3" "%" COEFFS 0 1 0 0 0 0.3906 /end COMPU_METHOD
/begin COMPU_METHOD rel_sw_b1536 "" RAT_FUNC "%6.4" "%" COEFFS 0 65536 0 0 0 3072 /end COMPU_METHOD
/begin COMPU_METHOD rel_ub_b100 "" RAT_FUNC "%6.3" "%" COEFFS 0 256 0 0 0 100 /end COMPU_METHOD
/begin COMPU_METHOD rel_ub_b99p6 "" RAT_FUNC "%6.3" "%" COEFFS 0 256 0 0 0 100 /end COMPU_METHOD
/begin COMPU_METHOD rel_ub_q0p75 "" RAT_FUNC "%6.3" "%" COEFFS 0 1 0 0 0 0.75 /end COMPU_METHOD
/begin COMPU_METHOD rel_uw_b100 "" RAT_FUNC "%6.4" "%" COEFFS 0 65536 0 0 0 100 /end COMPU_METHOD
/begin COMPU_METHOD Resist "" RAT_FUNC "%6.3" "Ohm" COEFFS 0 10 0 0 0 1 /end COMPU_METHOD
/begin COMPU_METHOD RLXBF_SC_Compu "" TAB_VERB "%6.3" "" COMPU_TAB_REF RLXBF_SC_Compu /end COMPU_METHOD
/begin COMPU_VTAB RLXBF_SC_Compu "" TAB_VERB 2 0 "False" 1 "True" /end COMPU_VTAB
/begin COMPU_METHOD Rmp "" RAT_FUNC "%6.4" "1/s" COEFFS 0 65.536 0 0 0 1 /end COMPU_METHOD
/begin COMPU_METHOD ROOFOPN_SY_Compu "" TAB_VERB "%6.3" "" COMPU_TAB_REF ROOFOPN_SY_Compu /end COMPU_METHOD
/begin COMPU_VTAB ROOFOPN_SY_Compu "" TAB_VERB 2 0 "deactivated" 1 "activated" /end COMPU_VTAB
/begin COMPU_METHOD rTrqCAN "" RAT_FUNC "%6.3" "%" COEFFS 0 2.54999910750031 0 0 0 1 /end COMPU_METHOD
/begin COMPU_METHOD rTrqCANLow "" RAT_FUNC "%6.2" "%" COEFFS 0 1.25 0 0 0 1 /end COMPU_METHOD
/begin COMPU_METHOD SAIL_SY_Compu "" TAB_VERB "%6.3" "" COMPU_TAB_REF SAIL_SY_Compu /end COMPU_METHOD
/begin COMPU_VTAB SAIL_SY_Compu "" TAB_VERB 2 0 "False" 1 "True" /end COMPU_VTAB
/begin COMPU_METHOD SCAV_INHOUSE_SY_Compu "" TAB_VERB "%6.3" "" COMPU_TAB_REF SCAV_INHOUSE_SY_Compu /end COMPU_METHOD
/begin COMPU_VTAB SCAV_INHOUSE_SY_Compu "" TAB_VERB 2 0 "False" 1 "True" /end COMPU_VTAB
/begin COMPU_METHOD SG_INTVENG_SY_Compu "" TAB_VERB "%6.3" "" COMPU_TAB_REF SG_INTVENG_SY_Compu /end COMPU_METHOD
/begin COMPU_VTAB SG_INTVENG_SY_Compu "" TAB_VERB 2 0 "False" 1 "True" /end COMPU_VTAB
/begin COMPU_METHOD SHFTR_SY_Compu "" TAB_VERB "%6.3" "" COMPU_TAB_REF SHFTR_SY_Compu /end COMPU_METHOD
/begin COMPU_VTAB SHFTR_SY_Compu "" TAB_VERB 2 1 "one shift register" 0 "no shift register" /end COMPU_VTAB
/begin COMPU_METHOD SHTRP_MAPSIZE_SY_Compu "" RAT_FUNC "%6.2" "" COEFFS 0 1 0 0 0 1 /end COMPU_METHOD
/begin COMPU_METHOD SIA_CY150MEM_SY_Compu "" TAB_VERB "%6.3" "" COMPU_TAB_REF SIA_CY150MEM_SY_Compu /end COMPU_METHOD
/begin COMPU_VTAB SIA_CY150MEM_SY_Compu "" TAB_VERB 2 0 "CY150 not used by SIA" 1 "CY150 used by SIA" /end COMPU_VTAB
/begin COMPU_METHOD SIA_GENR_SY_Compu "" RAT_FUNC "%6.2" "" COEFFS 0 1 0 0 0 1 /end COMPU_METHOD
/begin COMPU_METHOD Signals_OneToOne "" RAT_FUNC "%6.2" "" COEFFS 0 1 0 0 0 1 /end COMPU_METHOD
/begin COMPU_METHOD Sig_I15031_LeanAppl_SY_Compu "" RAT_FUNC "%6.2" "" COEFFS 0 1 0 0 0 1 /end COMPU_METHOD
/begin COMPU_METHOD SPAF_SY_Compu "" TAB_VERB "%6.3" "" COMPU_TAB_REF SPAF_SY_Compu /end COMPU_METHOD
/begin COMPU_VTAB SPAF_SY_Compu "" TAB_VERB 2 0 "False" 1 "True" /end COMPU_VTAB
/begin COMPU_METHOD SPC_SY_Compu "" TAB_VERB "%6.3" "" COMPU_TAB_REF SPC_SY_Compu /end COMPU_METHOD
/begin COMPU_VTAB SPC_SY_Compu "" TAB_VERB 2 0 "no SPC available" 1 "SPC available" /end COMPU_VTAB
/begin COMPU_METHOD SPDLIM_SY_Compu "" TAB_VERB "%6.3" "" COMPU_TAB_REF SPDLIM_SY_Compu /end COMPU_METHOD
/begin COMPU_VTAB SPDLIM_SY_Compu "" TAB_VERB 2 1 "True" 0 "False" /end COMPU_VTAB
/begin COMPU_METHOD SPRTEXTD_SY_Compu "" TAB_VERB "%6.3" "" COMPU_TAB_REF SPRTEXTD_SY_Compu /end COMPU_METHOD
/begin COMPU_VTAB SPRTEXTD_SY_Compu "" TAB_VERB 2 0 "inactive" 1 "active" /end COMPU_VTAB
/begin COMPU_METHOD SPRTTYP_SY_Compu "" TAB_VERB "%6.3" "" COMPU_TAB_REF SPRTTYP_SY_Compu /end COMPU_METHOD
/begin COMPU_VTAB SPRTTYP_SY_Compu "" TAB_VERB 2 0 "SPRTTYP_CHRSM" 1 "SPRTTYP_SPRTSWT" /end COMPU_VTAB
/begin COMPU_METHOD SPRT_SY_Compu "" TAB_VERB "%6.3" "" COMPU_TAB_REF SPRT_SY_Compu /end COMPU_METHOD
/begin COMPU_VTAB SPRT_SY_Compu "" TAB_VERB 2 0 "no sport driving mode available" 1 "sport driving mode available" /end COMPU_VTAB
/begin COMPU_METHOD SSPRITNUM_SY_Compu "" TAB_VERB "%6.3" "" COMPU_TAB_REF SSPRITNUM_SY_Compu /end COMPU_METHOD
/begin COMPU_VTAB SSPRITNUM_SY_Compu "" TAB_VERB 2 0 "False" 1 "True" /end COMPU_VTAB
/begin COMPU_METHOD STAACTVDET_SY_Compu "" TAB_VERB "%6.3" "" COMPU_TAB_REF STAACTVDET_SY_Compu /end COMPU_METHOD
/begin COMPU_VTAB STAACTVDET_SY_Compu "" TAB_VERB 4 0 "STAACTDET_MDL" 1 "STAACTDET_PS" 2 "STAACTDET_T50" 3 "STAACTDET_MD or STAACTVDET_T50" /end COMPU_VTAB
/begin COMPU_METHOD STADAP_INHCUST_SY_Compu "" TAB_VERB "%6.3" "" COMPU_TAB_REF STADAP_INHCUST_SY_Compu /end COMPU_METHOD
/begin COMPU_VTAB STADAP_INHCUST_SY_Compu "" TAB_VERB 2 0 "False" 1 "True" /end COMPU_VTAB
/begin COMPU_METHOD STAPMP_SY_Compu "" TAB_VERB "%6.3" "" COMPU_TAB_REF STAPMP_SY_Compu /end COMPU_METHOD
/begin COMPU_VTAB STAPMP_SY_Compu "" TAB_VERB 2 0 "FALSE" 1 "TRUE" /end COMPU_VTAB
/begin COMPU_METHOD STEUSMNCAT_SY_Compu "" TAB_VERB "%6.3" "" COMPU_TAB_REF STEUSMNCAT_SY_Compu /end COMPU_METHOD
/begin COMPU_VTAB STEUSMNCAT_SY_Compu "" TAB_VERB 2 0 "mono lambda regulation upstream main catalyst" 1 "stereo lambda regulation upstream main catalyst" /end COMPU_VTAB
/begin COMPU_METHOD STF_SY_Compu "" TAB_VERB "%6.3" "" COMPU_TAB_REF STF_SY_Compu /end COMPU_METHOD
/begin COMPU_VTAB STF_SY_Compu "" TAB_VERB 2 1 "True" 0 "False" /end COMPU_VTAB
/begin COMPU_METHOD STM_SY_Compu "" TAB_VERB "%6.3" "" COMPU_TAB_REF STM_SY_Compu /end COMPU_METHOD
/begin COMPU_VTAB STM_SY_Compu "" TAB_VERB 2 0 "STM not used" 1 "STM used" /end COMPU_VTAB
/begin COMPU_METHOD STNETH_SY_Compu "" TAB_VERB "%6.3" "" COMPU_TAB_REF STNETH_SY_Compu /end COMPU_METHOD
/begin COMPU_VTAB STNETH_SY_Compu "" TAB_VERB 2 0 "ZERO" 1 "ONE" /end COMPU_VTAB
/begin COMPU_METHOD STRGTYP_SY_Compu "" TAB_VERB "%6.3" "" COMPU_TAB_REF STRGTYP_SY_Compu /end COMPU_METHOD
/begin COMPU_VTAB STRGTYP_SY_Compu "" TAB_VERB 4 0 "STRGTYP_NOSTRG" 1 "STRGTYP_MECH" 2 "STRGTYP_LVELEC" 3 "STRGTYP_HVELEC" /end COMPU_VTAB
/begin COMPU_METHOD StrgWhlAg "" RAT_FUNC "%6.4" "deg StWhl" COEFFS 0 22.8571428571429 0 0 0 1 /end COMPU_METHOD
/begin COMPU_METHOD StrgWhlAgAcc "" RAT_FUNC "%6.3" "deg StWhl/s" COEFFS 0 1.9047619047619 0 0 0 1 /end COMPU_METHOD
/begin COMPU_METHOD StrgWhlAgVel "" RAT_FUNC "%6.4" "deg StWhl/s" COEFFS 0 22.8571428571429 0 0 0 1 /end COMPU_METHOD
/begin COMPU_METHOD StrgWhlAngle "" RAT_FUNC "%6.3" "deg StWhl" COEFFS 0 4 0 0 0 1 /end COMPU_METHOD
/begin COMPU_METHOD StrgWhlAngleAcc "" RAT_FUNC "%6.2" "deg StWhl/s^2" COEFFS 0 1 0 0 0 1 /end COMPU_METHOD
/begin COMPU_METHOD StrgWhlAngleVel "" RAT_FUNC "%6.3" "deg StWhl/s" COEFFS 0 2 0 0 0 1 /end COMPU_METHOD
/begin COMPU_METHOD t100msxs_uw_b6553p5 "" RAT_FUNC "%6.3" "s" COEFFS 0 1 0 0 0 0.1 /end COMPU_METHOD
/begin COMPU_METHOD t10msxs_uw_b655p35 "" RAT_FUNC "%6.4" "s" COEFFS 0 1 0 0 0 0.01 /end COMPU_METHOD
/begin COMPU_METHOD t1msxs_b65p535 "" RAT_FUNC "%6.5" "s" COEFFS 0 65535 0 0 0 65.535 /end COMPU_METHOD
/begin COMPU_METHOD t1sxs_q1 "" RAT_FUNC "%6.2" "s" COEFFS 0 1 0 0 0 1 /end COMPU_METHOD
/begin COMPU_METHOD t200msxs_ub_b51 "" RAT_FUNC "%6.3" "s" COEFFS 0 1 0 0 0 0.2 /end COMPU_METHOD
/begin COMPU_METHOD temp_q0p75 "" RAT_FUNC "%6.3" "GradC" COEFFS 0 4 0 0 0 3 /end COMPU_METHOD
/begin COMPU_METHOD temp_ub_b191p25 "" RAT_FUNC "%6.3" "Grad C" COEFFS 0 1 0 0 0 0.75 /end COMPU_METHOD
/begin COMPU_METHOD temp_ub_q0p75_o48 "" RAT_FUNC "%6.2" "Grad C" COEFFS 0 1 48 0 0 0.75 /end COMPU_METHOD
/begin COMPU_METHOD temp_uw_q0p0029_o48 "" RAT_FUNC "%6.2" "Grad C" COEFFS 0 256 12288 0 0 0.75 /end COMPU_METHOD
/begin COMPU_METHOD tsquant_l "" RAT_FUNC "%6.4" "us" COEFFS 0 20 0 0 0 1 /end COMPU_METHOD
/begin COMPU_METHOD t_q0p02 "" RAT_FUNC "%6.4" "s" COEFFS 0 100 0 0 0 2 /end COMPU_METHOD
/begin COMPU_METHOD t_q0p05 "" RAT_FUNC "%6.4" "s" COEFFS 0 100 0 0 0 5 /end COMPU_METHOD
/begin COMPU_METHOD t_q0p1 "" RAT_FUNC "%6.3" "s" COEFFS 0 10 0 0 0 1 /end COMPU_METHOD
/begin COMPU_METHOD t_q0p2 "" RAT_FUNC "%6.3" "s" COEFFS 0 10 0 0 0 2 /end COMPU_METHOD
/begin COMPU_METHOD t_q0p5 "" RAT_FUNC "%6.3" "s" COEFFS 0 1 0 0 0 0.5 /end COMPU_METHOD
/begin COMPU_METHOD t_q1 "" RAT_FUNC "%6.2" "s" COEFFS 0 1 0 0 0 1 /end COMPU_METHOD
/begin COMPU_METHOD t_q4_s "" RAT_FUNC "%6.2" "s" COEFFS 0 1 0 0 0 4 /end COMPU_METHOD
/begin COMPU_METHOD vfzg_ub_q1p25 "" RAT_FUNC "%6.2" "km/h" COEFFS 0 1 0 0 0 1.25 /end COMPU_METHOD
/begin COMPU_METHOD zk200msxs_uw_b13107p2 "" RAT_FUNC "%6.0" "s" COEFFS 0 0 65536 0 5 0 /end COMPU_METHOD
/begin COMPU_METHOD zw_sb_q0p75 "" RAT_FUNC "%6.3" "Grad KW" COEFFS 0 255 0 0 0 191.25 /end COMPU_METHOD
/begin COMPU_METHOD zw_sw_q0p75 "" RAT_FUNC "%6.3" "Grad KW" COEFFS 0 65536 0 0 0 49152 /end COMPU_METHOD
/begin RECORD_LAYOUT FkfNoShNoOffWSw FNC_VALUES 1 SWORD COLUMN_DIR DIRECT /end RECORD_LAYOUT
/begin RECORD_LAYOUT GkfWSw FNC_VALUES 1 SWORD COLUMN_DIR DIRECT /end RECORD_LAYOUT
/begin RECORD_LAYOUT GkfWUb FNC_VALUES 1 UBYTE COLUMN_DIR DIRECT /end RECORD_LAYOUT
/begin RECORD_LAYOUT GklWSw FNC_VALUES 1 SWORD COLUMN_DIR DIRECT /end RECORD_LAYOUT
/begin RECORD_LAYOUT GklWUb FNC_VALUES 1 UBYTE COLUMN_DIR DIRECT /end RECORD_LAYOUT
/begin RECORD_LAYOUT GklWUw FNC_VALUES 1 UWORD COLUMN_DIR DIRECT /end RECORD_LAYOUT
/begin RECORD_LAYOUT KfAxU8AyU8SstxU16SstyU16WS16 NO_AXIS_PTS_X 1 UWORD NO_AXIS_PTS_Y 2 UWORD AXIS_PTS_X 3 UWORD INDEX_INCR DIRECT AXIS_PTS_Y 4 UWORD INDEX_INCR DIRECT FNC_VALUES 5 SWORD COLUMN_DIR DIRECT /end RECORD_LAYOUT
/begin RECORD_LAYOUT KfAxU8AyU8SstxU16SstyU16WU16 NO_AXIS_PTS_X 1 UWORD NO_AXIS_PTS_Y 2 UWORD AXIS_PTS_X 3 UWORD INDEX_INCR DIRECT AXIS_PTS_Y 4 UWORD INDEX_INCR DIRECT FNC_VALUES 5 UWORD COLUMN_DIR DIRECT /end RECORD_LAYOUT
/begin RECORD_LAYOUT KfAxUbAyUbSstxUbSstyUbWSb NO_AXIS_PTS_X 1 UBYTE NO_AXIS_PTS_Y 2 UBYTE AXIS_PTS_X 3 UBYTE INDEX_INCR DIRECT AXIS_PTS_Y 4 UBYTE INDEX_INCR DIRECT FNC_VALUES 5 SBYTE COLUMN_DIR DIRECT /end RECORD_LAYOUT
/begin RECORD_LAYOUT KfAxUbAyUbSstxUbSstyUbWUb NO_AXIS_PTS_X 1 UBYTE NO_AXIS_PTS_Y 2 UBYTE AXIS_PTS_X 3 UBYTE INDEX_INCR DIRECT AXIS_PTS_Y 4 UBYTE INDEX_INCR DIRECT FNC_VALUES 5 UBYTE COLUMN_DIR DIRECT /end RECORD_LAYOUT
/begin RECORD_LAYOUT KlAUbSstUbWUb NO_AXIS_PTS_X 1 UBYTE AXIS_PTS_X 2 UBYTE INDEX_INCR DIRECT FNC_VALUES 3 UBYTE COLUMN_DIR DIRECT /end RECORD_LAYOUT
/begin RECORD_LAYOUT KlAUbSstUbWUw NO_AXIS_PTS_X 1 UBYTE AXIS_PTS_X 2 UBYTE INDEX_INCR DIRECT FNC_VALUES 3 UWORD COLUMN_DIR DIRECT /end RECORD_LAYOUT
/begin RECORD_LAYOUT KlAUwSstSwWUw NO_AXIS_PTS_X 1 UWORD AXIS_PTS_X 2 SWORD INDEX_INCR DIRECT FNC_VALUES 3 UWORD COLUMN_DIR DIRECT /end RECORD_LAYOUT
/begin RECORD_LAYOUT KlAUwSstUwWSw NO_AXIS_PTS_X 1 UWORD AXIS_PTS_X 2 UWORD INDEX_INCR DIRECT FNC_VALUES 3 SWORD COLUMN_DIR DIRECT /end RECORD_LAYOUT
/begin RECORD_LAYOUT KlAUwSstUwWUw NO_AXIS_PTS_X 1 UWORD AXIS_PTS_X 2 UWORD INDEX_INCR DIRECT FNC_VALUES 3 UWORD COLUMN_DIR DIRECT /end RECORD_LAYOUT
/begin RECORD_LAYOUT KlAxU8SstxU16WU8 NO_AXIS_PTS_X 1 UWORD AXIS_PTS_X 2 UWORD INDEX_INCR DIRECT FNC_VALUES 3 UBYTE COLUMN_DIR DIRECT /end RECORD_LAYOUT
/begin RECORD_LAYOUT KlAxU8SstxU8WU16 NO_AXIS_PTS_X 1 UBYTE AXIS_PTS_X 2 UBYTE INDEX_INCR DIRECT FNC_VALUES 3 UWORD COLUMN_DIR DIRECT /end RECORD_LAYOUT
/begin RECORD_LAYOUT KlAxU8SstxU8WU8 NO_AXIS_PTS_X 1 UBYTE AXIS_PTS_X 2 UBYTE INDEX_INCR DIRECT FNC_VALUES 3 UBYTE COLUMN_DIR DIRECT /end RECORD_LAYOUT
/begin RECORD_LAYOUT KwbUb FNC_VALUES 1 UBYTE COLUMN_DIR DIRECT /end RECORD_LAYOUT
/begin RECORD_LAYOUT KwbUw FNC_VALUES 1 UWORD COLUMN_DIR DIRECT /end RECORD_LAYOUT
/begin RECORD_LAYOUT KwbWU16 FNC_VALUES 1 UWORD COLUMN_DIR DIRECT /end RECORD_LAYOUT
/begin RECORD_LAYOUT KwSb FNC_VALUES 1 SBYTE COLUMN_DIR DIRECT /end RECORD_LAYOUT
/begin RECORD_LAYOUT KwSw FNC_VALUES 1 SWORD COLUMN_DIR DIRECT /end RECORD_LAYOUT
/begin RECORD_LAYOUT KwUb FNC_VALUES 1 UBYTE COLUMN_DIR DIRECT /end RECORD_LAYOUT
/begin RECORD_LAYOUT KwUw FNC_VALUES 1 UWORD COLUMN_DIR DIRECT /end RECORD_LAYOUT
/begin RECORD_LAYOUT KwWS16 FNC_VALUES 1 SWORD COLUMN_DIR DIRECT /end RECORD_LAYOUT
/begin RECORD_LAYOUT KwWS8 FNC_VALUES 1 SBYTE COLUMN_DIR DIRECT /end RECORD_LAYOUT
/begin RECORD_LAYOUT KwWU16 FNC_VALUES 1 UWORD COLUMN_DIR DIRECT /end RECORD_LAYOUT
/begin RECORD_LAYOUT KwWU8 FNC_VALUES 1 UBYTE COLUMN_DIR DIRECT /end RECORD_LAYOUT
/begin RECORD_LAYOUT SstAUbSstUb NO_AXIS_PTS_X 1 UBYTE AXIS_PTS_X 2 UBYTE INDEX_INCR DIRECT /end RECORD_LAYOUT
/begin RECORD_LAYOUT SstAUwSstUw NO_AXIS_PTS_X 1 UWORD AXIS_PTS_X 2 UWORD INDEX_INCR DIRECT /end RECORD_LAYOUT
/begin RECORD_LAYOUT ValA_Wu16 FNC_VALUES 1 UWORD COLUMN_DIR DIRECT /end RECORD_LAYOUT
/begin RECORD_LAYOUT ValA_Wu8 FNC_VALUES 1 UBYTE COLUMN_DIR DIRECT /end RECORD_LAYOUT
/begin RECORD_LAYOUT Val_Wu16 FNC_VALUES 1 UWORD COLUMN_DIR DIRECT /end RECORD_LAYOUT
/begin RECORD_LAYOUT Val_Wu8 FNC_VALUES 1 UBYTE COLUMN_DIR DIRECT /end RECORD_LAYOUT
/end MODULE
/end PROJECT
