ASAP2_VERSION 1 4
/begin PROJECT M17955S3CC411_110Y0320 "M17955S3CC411_110Y0320"
/begin HEADER "" VERSION "M17955S3CC411_110Y0320" PROJECT_NO M17955S3CC411_110Y0320 /end HEADER
/begin MODULE DIM ""
/begin MOD_COMMON "" BYTE_ORDER MSB_LAST ALIGNMENT_BYTE 1 ALIGNMENT_WORD 2 ALIGNMENT_LONG 4 ALIGNMENT_FLOAT32_IEEE 4 /end MOD_COMMON
/begin CHARACTERISTIC ATISLATX "" CURVE 0x8004712E KlAxU8SstxU8WU16 65535.00 dez 0.00 65535.00 FORMAT "%8.2"
 /begin AXIS_DESCR STD_AXIS tmstlanswl temp_ub_q0p75_o48 12 -48.00 143.3 FORMAT "%5.1" DEPOSIT ABSOLUTE /end AXIS_DESCR
/end CHARACTERISTIC
/begin CHARACTERISTIC ATIWKSTX "" CURVE 0x80047154 KlAxU8SstxU8WU16 65535.00 dez 0.00 65535.00 FORMAT "%8.2"
 /begin AXIS_DESCR STD_AXIS tmstlanswl temp_ub_q0p75_o48 12 -48.00 143.3 FORMAT "%5.1" DEPOSIT ABSOLUTE /end AXIS_DESCR
/end CHARACTERISTIC
/begin CHARACTERISTIC CDAAV "" VALUE 0x800464EA KwUb 255.0 dez 0.00 255.0 FORMAT "%5.1" /end CHARACTERISTIC
/begin CHARACTERISTIC CDAGR "" VALUE 0x800464EB KwUb 255.0 dez 0.00 255.0 FORMAT "%5.1" /end CHARACTERISTIC
/begin CHARACTERISTIC CDAGRE "" VALUE 0x800464EC KwUb 255.0 dez 0.00 255.0 FORMAT "%5.1" /end CHARACTERISTIC
/begin CHARACTERISTIC CDAGRL "" VALUE 0x800464ED KwUb 255.0 dez 0.00 255.0 FORMAT "%5.1" /end CHARACTERISTIC
/begin CHARACTERISTIC CDAGRS "" VALUE 0x800464EE KwUb 255.0 dez 0.00 255.0 FORMAT "%5.1" /end CHARACTERISTIC
/begin CHARACTERISTIC CDAGRV "" VALUE 0x800464EF KwUb 255.0 dez 0.00 255.0 FORMAT "%5.1" /end CHARACTERISTIC
/begin CHARACTERISTIC CDALLR "" VALUE 0x800464F0 KwUb 255.0 dez 0.00 255.0 FORMAT "%5.1" /end CHARACTERISTIC
/begin CHARACTERISTIC CDATNV "" VALUE 0x800464F1 KwUb 255.0 dez 0.00 255.0 FORMAT "%5.1" /end CHARACTERISTIC
/begin CHARACTERISTIC CDATVH "" VALUE 0x800464F2 KwUb 255.0 dez 0.00 255.0 FORMAT "%5.1" /end CHARACTERISTIC
/begin CHARACTERISTIC CDATVV "" VALUE 0x800464F3 KwUb 255.0 dez 0.00 255.0 FORMAT "%5.1" /end CHARACTERISTIC
/begin CHARACTERISTIC CDDMTL "" VALUE 0x800464F4 KwUb 255.0 dez 0.00 255.0 FORMAT "%5.1" /end CHARACTERISTIC
/begin CHARACTERISTIC CDDPL "" VALUE 0x800464F5 KwUb 255.0 dez 0.00 255.0 FORMAT "%5.1" /end CHARACTERISTIC
/begin CHARACTERISTIC CDDSBKV "" VALUE 0x800464F6 KwUb 255.0 dez 0.00 255.0 FORMAT "%5.1" /end CHARACTERISTIC
/begin CHARACTERISTIC CDDST "" VALUE 0x800464F7 KwUb 255.0 dez 0.00 255.0 FORMAT "%5.1" /end CHARACTERISTIC
/begin CHARACTERISTIC CDDTESK "" VALUE 0x800464F8 KwUb 255.0 dez 0.00 255.0 FORMAT "%5.1" /end CHARACTERISTIC
/begin CHARACTERISTIC CDDTKA "" VALUE 0x800464F9 KwUb 255.0 dez 0.00 255.0 FORMAT "%5.1" /end CHARACTERISTIC
/begin CHARACTERISTIC CDDYLSF "" VALUE 0x800464FA KwUb 255.0 dez 0.00 255.0 FORMAT "%5.1" /end CHARACTERISTIC
/begin CHARACTERISTIC CDDYLSH "" VALUE 0x800464FB KwUb 255.0 dez 0.00 255.0 FORMAT "%5.1" /end CHARACTERISTIC
/begin CHARACTERISTIC CDDYLSU "" VALUE 0x800464FC KwUb 255.0 dez 0.00 255.0 FORMAT "%5.1" /end CHARACTERISTIC
/begin CHARACTERISTIC CDEDSS "" VALUE 0x800464FD KwUb 255.0 dez 0.00 255.0 FORMAT "%5.1" /end CHARACTERISTIC
/begin CHARACTERISTIC CDEGFE "" VALUE 0x800464FE KwUb 255.0 dez 0.00 255.0 FORMAT "%5.1" /end CHARACTERISTIC
/begin CHARACTERISTIC CDEHFM "" VALUE 0x800464FF KwUb 255.0 dez 0.00 255.0 FORMAT "%5.1" /end CHARACTERISTIC
/begin CHARACTERISTIC CDEONV "" VALUE 0x80046500 KwUb 255.0 dez 0.00 255.0 FORMAT "%5.1" /end CHARACTERISTIC
/begin CHARACTERISTIC CDFTDLA "" VALUE 0x80046501 KwUb 255.0 dez 0.00 255.0 FORMAT "%5.1" /end CHARACTERISTIC
/begin CHARACTERISTIC CDGGGTS "" VALUE 0x80046502 KwUb 255.0 dez 0.00 255.0 FORMAT "%5.1" /end CHARACTERISTIC
/begin CHARACTERISTIC CDHELSU "" VALUE 0x80046503 KwUb 255.0 dez 0.00 255.0 FORMAT "%5.1" /end CHARACTERISTIC
/begin CHARACTERISTIC CDHNOHK "" VALUE 0x80046504 KwUb 255.0 dez 0.00 255.0 FORMAT "%5.1" /end CHARACTERISTIC
/begin CHARACTERISTIC CDHNOHKE "" VALUE 0x80046505 KwUb 255.0 dez 0.00 255.0 FORMAT "%5.1" /end CHARACTERISTIC
/begin CHARACTERISTIC CDHSF "" VALUE 0x80046506 KwUb 255.0 dez 0.00 255.0 FORMAT "%5.1" /end CHARACTERISTIC
/begin CHARACTERISTIC CDHSFE "" VALUE 0x80046507 KwUb 255.0 dez 0.00 255.0 FORMAT "%5.1" /end CHARACTERISTIC
/begin CHARACTERISTIC CDHSH "" VALUE 0x80046508 KwUb 255.0 dez 0.00 255.0 FORMAT "%5.1" /end CHARACTERISTIC
/begin CHARACTERISTIC CDHSHE "" VALUE 0x80046509 KwUb 255.0 dez 0.00 255.0 FORMAT "%5.1" /end CHARACTERISTIC
/begin CHARACTERISTIC CDHSV "" VALUE 0x8004650A KwUb 255.0 dez 0.00 255.0 FORMAT "%5.1" /end CHARACTERISTIC
/begin CHARACTERISTIC CDHSVSA "" VALUE 0x8004650B KwUb 255.0 dez 0.00 255.0 FORMAT "%5.1" /end CHARACTERISTIC
/begin CHARACTERISTIC CDICLSU "" VALUE 0x8004650C KwUb 255.0 dez 0.00 255.0 FORMAT "%5.1" /end CHARACTERISTIC
/begin CHARACTERISTIC CDKAT "" VALUE 0x8004650D KwUb 255.0 dez 0.00 255.0 FORMAT "%5.1" /end CHARACTERISTIC
/begin CHARACTERISTIC CDKATSP "" VALUE 0x8004650E KwUb 255.0 dez 0.00 255.0 FORMAT "%5.1" /end CHARACTERISTIC
/begin CHARACTERISTIC CDKVS "" VALUE 0x8004650F KwUb 255.0 dez 0.00 255.0 FORMAT "%5.1" /end CHARACTERISTIC
/begin CHARACTERISTIC CDKVSCMB "" VALUE 0x80046510 KwUb 255.0 dez 0.00 255.0 FORMAT "%5.1" /end CHARACTERISTIC
/begin CHARACTERISTIC CDLASF "" VALUE 0x80046511 KwUb 255.0 dez 0.00 255.0 FORMAT "%5.1" /end CHARACTERISTIC
/begin CHARACTERISTIC CDLASH "" VALUE 0x80046512 KwUb 255.0 dez 0.00 255.0 FORMAT "%5.1" /end CHARACTERISTIC
/begin CHARACTERISTIC CDLATP "" VALUE 0x80046513 KwUb 255.0 dez 0.00 255.0 FORMAT "%5.1" /end CHARACTERISTIC
/begin CHARACTERISTIC CDLATV "" VALUE 0x80046514 KwUb 255.0 dez 0.00 255.0 FORMAT "%5.1" /end CHARACTERISTIC
/begin CHARACTERISTIC CDLBK "" VALUE 0x80046515 KwUb 255.0 dez 0.00 255.0 FORMAT "%5.1" /end CHARACTERISTIC
/begin CHARACTERISTIC CDLDP "" VALUE 0x80046516 KwUb 255.0 dez 0.00 255.0 FORMAT "%5.1" /end CHARACTERISTIC
/begin CHARACTERISTIC CDLLR "" VALUE 0x80046517 KwUb 255.0 dez 0.00 255.0 FORMAT "%5.1" /end CHARACTERISTIC
/begin CHARACTERISTIC CDLSF "" VALUE 0x80046518 KwUb 255.0 dez 0.00 255.0 FORMAT "%5.1" /end CHARACTERISTIC
/begin CHARACTERISTIC CDLSH "" VALUE 0x80046519 KwUb 255.0 dez 0.00 255.0 FORMAT "%5.1" /end CHARACTERISTIC
/begin CHARACTERISTIC CDLSV "" VALUE 0x8004651A KwUb 255.0 dez 0.00 255.0 FORMAT "%5.1" /end CHARACTERISTIC
/begin CHARACTERISTIC CDLSVE "" VALUE 0x8004651B KwUb 255.0 dez 0.00 255.0 FORMAT "%5.1" /end CHARACTERISTIC
/begin CHARACTERISTIC CDLSVST "" VALUE 0x8004651C KwUb 255.0 dez 0.00 255.0 FORMAT "%5.1" /end CHARACTERISTIC
/begin CHARACTERISTIC CDMD "" VALUE 0x8004651D KwUb 255.0 dez 0.00 255.0 FORMAT "%5.1" /end CHARACTERISTIC
/begin CHARACTERISTIC CDMKATS "" VALUE 0x8004651E KwUb 255.0 dez 0.00 255.0 FORMAT "%5.1" /end CHARACTERISTIC
/begin CHARACTERISTIC CDNOHK "" VALUE 0x8004651F KwUb 255.0 dez 0.00 255.0 FORMAT "%5.1" /end CHARACTERISTIC
/begin CHARACTERISTIC CDNOHKP "" VALUE 0x80046520 KwUb 255.0 dez 0.00 255.0 FORMAT "%5.1" /end CHARACTERISTIC
/begin CHARACTERISTIC CDNOLSU "" VALUE 0x80046521 KwUb 255.0 dez 0.00 255.0 FORMAT "%5.1" /end CHARACTERISTIC
/begin CHARACTERISTIC CDNWS "" VALUE 0x80046522 KwUb 255.0 dez 0.00 255.0 FORMAT "%5.1" /end CHARACTERISTIC
/begin CHARACTERISTIC CDPLLSU "" VALUE 0x80046523 KwUb 255.0 dez 0.00 255.0 FORMAT "%5.1" /end CHARACTERISTIC
/begin CHARACTERISTIC CDRHLSH "" VALUE 0x80046524 KwUb 255.0 dez 0.00 255.0 FORMAT "%5.1" /end CHARACTERISTIC
/begin CHARACTERISTIC CDSALSU "" VALUE 0x80046525 KwUb 255.0 dez 0.00 255.0 FORMAT "%5.1" /end CHARACTERISTIC
/begin CHARACTERISTIC CDSKNO "" VALUE 0x80046526 KwUb 255.0 dez 0.00 255.0 FORMAT "%5.1" /end CHARACTERISTIC
/begin CHARACTERISTIC CDSLS "" VALUE 0x80046527 KwUb 255.0 dez 0.00 255.0 FORMAT "%5.1" /end CHARACTERISTIC
/begin CHARACTERISTIC CDSLSE "" VALUE 0x80046528 KwUb 255.0 dez 0.00 255.0 FORMAT "%5.1" /end CHARACTERISTIC
/begin CHARACTERISTIC CDSWE "" VALUE 0x80046529 KwUb 255.0 dez 0.00 255.0 FORMAT "%5.1" /end CHARACTERISTIC
/begin CHARACTERISTIC CDTABKOM "" VALUE 0x8004652A KwUb 255.0 dez 0.00 255.0 FORMAT "%5.1" /end CHARACTERISTIC
/begin CHARACTERISTIC CDTANKL "" VALUE 0x8004652B KwUb 255.0 dez 0.00 255.0 FORMAT "%5.1" /end CHARACTERISTIC
/begin CHARACTERISTIC CDTES "" VALUE 0x8004652C KwUb 255.0 dez 0.00 255.0 FORMAT "%5.1" /end CHARACTERISTIC
/begin CHARACTERISTIC CDULSU "" VALUE 0x8004652D KwUb 255.0 dez 0.00 255.0 FORMAT "%5.1" /end CHARACTERISTIC
/begin CHARACTERISTIC CDVKT "" VALUE 0x8004652E KwUb 255.0 dez 0.00 255.0 FORMAT "%5.1" /end CHARACTERISTIC
/begin CHARACTERISTIC CDWVERAD "" VALUE 0x8004652F KwUb 255.0 dez 0.00 255.0 FORMAT "%5.1" /end CHARACTERISTIC
/begin CHARACTERISTIC CNFKUPPL "" VALUE 0x80047388 KwWU8 255.0 dez 0.00 255.0 FORMAT "%5.1" /end CHARACTERISTIC
/begin CHARACTERISTIC CNFLLRNS "" VALUE 0x80047474 KwWU8 255.0 dez 0.00 255.0 FORMAT "%5.1" /end CHARACTERISTIC
/begin CHARACTERISTIC CWADRES "" VALUE 0x80046530 KwUb 255.0 dez 0.00 255.0 FORMAT "%5.1" /end CHARACTERISTIC
/begin CHARACTERISTIC CWAGR "" VALUE 0x80046531 KwUb 255.0 dez 0.00 255.0 FORMAT "%5.1" /end CHARACTERISTIC
/begin CHARACTERISTIC CWAGREO "" VALUE 0x80046532 KwUb 255.0 dez 0.00 255.0 FORMAT "%5.1" /end CHARACTERISTIC
/begin CHARACTERISTIC CWAGREO2 "" VALUE 0x80046533 KwUb 255.0 dez 0.00 255.0 FORMAT "%5.1" /end CHARACTERISTIC
/begin CHARACTERISTIC CWAGRVBP "" VALUE 0x80046534 KwUb 255.0 dez 0.00 255.0 FORMAT "%5.1" /end CHARACTERISTIC
/begin CHARACTERISTIC CWALE "" VALUE 0x80046535 KwUb 255.0 dez 0.00 255.0 FORMAT "%5.1" /end CHARACTERISTIC
/begin CHARACTERISTIC CWBDE1 "" VALUE 0x80046536 KwUw 65535.00 dez 0.00 65535.00 FORMAT "%8.2" /end CHARACTERISTIC
/begin CHARACTERISTIC CWBDEMD "" VALUE 0x80046538 KwUw 65535.00 dez 0.00 65535.00 FORMAT "%8.2" /end CHARACTERISTIC
/begin CHARACTERISTIC CWBRCFG "" VALUE 0x8004653A KwUb 255.0 dez 0.00 255.0 FORMAT "%5.1" /end CHARACTERISTIC
/begin CHARACTERISTIC CWCANCONF "" VALUE 0x8004653B KwUb 255.0 dez 0.00 255.0 FORMAT "%5.1" /end CHARACTERISTIC
/begin CHARACTERISTIC CWCHT2KTTD "" VALUE 0x80046280 KwUb 1.000 dez 0.00 1.000 FORMAT "%5.3" /end CHARACTERISTIC
/begin CHARACTERISTIC CWDKATNO "" VALUE 0x8004653C KwUb 255.0 dez 0.00 255.0 FORMAT "%5.1" /end CHARACTERISTIC
/begin CHARACTERISTIC CWDLSU "" VALUE 0x8004653D KwWU8 255.0 dez 0.00 255.0 FORMAT "%5.1" /end CHARACTERISTIC
/begin CHARACTERISTIC CWERFIL "" VALUE 0x8004653E KwUb 255.0 dez 0.00 255.0 FORMAT "%5.1" /end CHARACTERISTIC
/begin CHARACTERISTIC CWFHO "" VALUE 0x80047475 KwWU8 255.0 dez 0.00 255.0 FORMAT "%5.1" /end CHARACTERISTIC
/begin CHARACTERISTIC CWFRST "" VALUE 0x8004653F KwUb 255.0 dez 0.00 255.0 FORMAT "%5.1" /end CHARACTERISTIC
/begin CHARACTERISTIC CWGRABH "" VALUE 0x80046540 KwUb 255.0 dez 0.00 255.0 FORMAT "%5.1" /end CHARACTERISTIC
/begin CHARACTERISTIC CWKLIMA "" VALUE 0x80046541 KwUb 255.0 dez 0.00 255.0 FORMAT "%5.1" /end CHARACTERISTIC
/begin CHARACTERISTIC CWKMMILSCT "" VALUE 0x80046542 KwUb 255.0 dez 0.00 255.0 FORMAT "%5.1" /end CHARACTERISTIC
/begin CHARACTERISTIC CWKONABG "" VALUE 0x80046543 KwUb 255.0 dez 0.00 255.0 FORMAT "%5.1" /end CHARACTERISTIC
/begin CHARACTERISTIC CWKONFGR "" VALUE 0x80046544 KwUb 255.0 dez 0.00 255.0 FORMAT "%5.1" /end CHARACTERISTIC
/begin CHARACTERISTIC CWKONFLS "" VALUE 0x80046545 KwWU8 255.0 dez 0.00 255.0 FORMAT "%5.1" /end CHARACTERISTIC
/begin CHARACTERISTIC CWKONFZ1 "" VALUE 0x80046546 KwUb 255.0 dez 0.00 255.0 FORMAT "%5.1" /end CHARACTERISTIC
/begin CHARACTERISTIC CWKONLS "" VALUE 0x80046547 KwUb 255.0 dez 0.00 255.0 FORMAT "%5.1" /end CHARACTERISTIC
/begin CHARACTERISTIC CWKRNLR "" VALUE 0x80046676 KwWU8 255.0 dez 0.00 255.0 FORMAT "%5.1" /end CHARACTERISTIC
/begin CHARACTERISTIC CWKROFFGZ "" VALUE 0x8004668A KwWU8 255.0 dez 0.00 255.0 FORMAT "%5.1" /end CHARACTERISTIC
/begin CHARACTERISTIC CWKTAGRA "" VALUE 0x80046548 KwUb 255.0 dez 0.00 255.0 FORMAT "%5.1" /end CHARACTERISTIC
/begin CHARACTERISTIC CWLAMBTS "" VALUE 0x80046A20 KwWU16 65535.00 dez 0.00 65535.00 FORMAT "%8.2" /end CHARACTERISTIC
/begin CHARACTERISTIC CWLAMKO "" VALUE 0x8004710C KwWU8 255.0 dez 0.00 255.0 FORMAT "%5.1" /end CHARACTERISTIC
/begin CHARACTERISTIC CWLAMKOAP "" VALUE 0x8004710D KwWU8 255.0 dez 0.00 255.0 FORMAT "%5.1" /end CHARACTERISTIC
/begin CHARACTERISTIC CWLLRBBSV "" VALUE 0x80047389 KwWU8 255.0 dez 0.00 255.0 FORMAT "%5.1" /end CHARACTERISTIC
/begin CHARACTERISTIC CWLLRNS "" VALUE 0x80047476 KwWU8 255.0 dez 0.00 255.0 FORMAT "%5.1" /end CHARACTERISTIC
/begin CHARACTERISTIC CWLSFA "" VALUE 0x80046549 KwUb 255.0 dez 0.00 255.0 FORMAT "%5.1" /end CHARACTERISTIC
/begin CHARACTERISTIC CWLSHA "" VALUE 0x8004654A KwUb 255.0 dez 0.00 255.0 FORMAT "%5.1" /end CHARACTERISTIC
/begin CHARACTERISTIC CWMDAPP "" VALUE 0x8004654B KwUb 255.0 dez 0.00 255.0 FORMAT "%5.1" /end CHARACTERISTIC
/begin CHARACTERISTIC CWNSABG "" VALUE 0x8004654C KwUb 255.0 dez 0.00 255.0 FORMAT "%5.1" /end CHARACTERISTIC
/begin CHARACTERISTIC CWNSTAT "" VALUE 0x80047477 KwWU8 255.0 dez 0.00 255.0 FORMAT "%5.1" /end CHARACTERISTIC
/begin CHARACTERISTIC CWOBD "" VALUE 0x8004654D KwUb 255.0 dez 0.00 255.0 FORMAT "%5.1" /end CHARACTERISTIC
/begin CHARACTERISTIC CWPWF "" VALUE 0x8004654E KwUb 255.0 dez 0.00 255.0 FORMAT "%5.1" /end CHARACTERISTIC
/begin CHARACTERISTIC CWRR "" VALUE 0x8004654F KwUb 255.0 dez 0.00 255.0 FORMAT "%5.1" /end CHARACTERISTIC
/begin CHARACTERISTIC CWSCTMDE "" VALUE 0x80046550 KwUb 255.0 dez 0.00 255.0 FORMAT "%5.1" /end CHARACTERISTIC
/begin CHARACTERISTIC CWSLS "" VALUE 0x80046551 KwUb 255.0 dez 0.00 255.0 FORMAT "%5.1" /end CHARACTERISTIC
/begin CHARACTERISTIC CWSYN2APM "" VALUE 0x80046552 KwUb 255.0 dez 0.00 255.0 FORMAT "%5.1" /end CHARACTERISTIC
/begin CHARACTERISTIC CWTATETEV "" VALUE 0x80046281 KwWU8 255.0 dez 0.00 255.0 FORMAT "%5.1" /end CHARACTERISTIC
/begin CHARACTERISTIC CWTF "" VALUE 0x80046553 KwUb 255.0 dez 0.00 255.0 FORMAT "%5.1" /end CHARACTERISTIC
/begin CHARACTERISTIC CWUHR "" VALUE 0x80046554 KwUb 255.0 dez 0.00 255.0 FORMAT "%5.1" /end CHARACTERISTIC
/begin CHARACTERISTIC CWWAKSH "" VALUE 0x80046555 KwUb 255.0 dez 0.00 255.0 FORMAT "%5.1" /end CHARACTERISTIC
/begin CHARACTERISTIC CWWL "" VALUE 0x8004717A KwWU8 255.0 dez 0.00 255.0 FORMAT "%5.1" /end CHARACTERISTIC
/begin CHARACTERISTIC CWZGST "" VALUE 0x80046556 KwUb 255.0 dez 0.00 255.0 FORMAT "%5.1" /end CHARACTERISTIC
/begin CHARACTERISTIC CWZUEAB "" VALUE 0x800462A8 KwUb 255.0 dez 0.00 255.0 FORMAT "%5.1" /end CHARACTERISTIC
/begin CHARACTERISTIC CW_HWVAR "" VALUE 0x80046557 KwUb 255.0 dez 0.00 255.0 FORMAT "%5.1" /end CHARACTERISTIC
/begin CHARACTERISTIC DFRLBTSN "" VALUE 0x80046A22 KwWS16 1.000000 fak_sw_b1 -1.000000 0.00 FORMAT "%8.6" /end CHARACTERISTIC
/begin CHARACTERISTIC DFRLBTSNN "" VALUE 0x80046A24 KwWS16 1.000000 fak_sw_b1 -1.000000 0.00 FORMAT "%8.6" /end CHARACTERISTIC
/begin CHARACTERISTIC DFRLBTSP "" VALUE 0x80046A26 KwWS16 0.2000122 fak_sw_b1 0.00 0.2000122 FORMAT "%9.7" /end CHARACTERISTIC
/begin CHARACTERISTIC DLABTSELSV "" VALUE 0x80046A28 KwWS16 0.2001953 fak_sw_b8 -0.1000977 0.1000977 FORMAT "%9.7" /end CHARACTERISTIC
/begin CHARACTERISTIC DLAMNSWL "" VALUE 0x8004717B KwWU8 0.9961 fak_ub_b1 0.00 0.9961 /end CHARACTERISTIC
/begin CHARACTERISTIC DLBTS "" CURVE 0x80046A2A GklWS16 0.5000000 fak_sw_b8 -0.5000000 0.00 FORMAT "%9.7"
 /begin AXIS_DESCR COM_AXIS detazwbs_w fak_uw_b2 8 0.00 1.999969 FORMAT "%8.6" AXIS_PTS_REF SDETA08UW /end AXIS_DESCR
/end CHARACTERISTIC
/begin CHARACTERISTIC DLBTSGANG "" CURVE 0x80046A3A KlAxU8SstxS16WS16 0.6250000 fak_sw_b8 -0.5000000 0.1250000 FORMAT "%9.7"
 /begin AXIS_DESCR STD_AXIS gangist dez 8 0.00 255.0000 FORMAT "%8.4" DEPOSIT ABSOLUTE /end AXIS_DESCR
/end CHARACTERISTIC
/begin CHARACTERISTIC DLBTSVFZG "" CURVE 0x80046A5C KlAxU8SstxU16WS16 0.6250000 fak_sw_b8 -0.5000000 0.1250000 FORMAT "%9.7"
 /begin AXIS_DESCR STD_AXIS vfzg_w vfzg_uw_b512 6 0.00 511.9922 FORMAT "%8.4" DEPOSIT ABSOLUTE /end AXIS_DESCR
/end CHARACTERISTIC
/begin CHARACTERISTIC DNLLR "" VALUE 0x8004738A KwWU8 2550. nmot_ub_q10 0.00 2550. FORMAT "%5.0" /end CHARACTERISTIC
/begin CHARACTERISTIC DNLLRLR "" VALUE 0x8004738B KwWU8 2550. nmot_ub_q10 0.00 2550. FORMAT "%5.0" /end CHARACTERISTIC
/begin CHARACTERISTIC DNSNFST "" VALUE 0x800473EC KwWU8 2550. nmot_ub_q10 0.00 2550. FORMAT "%5.0" /end CHARACTERISTIC
/begin CHARACTERISTIC DNSNFX "" VALUE 0x800473ED KwWU8 2550. nmot_ub_q10 0.00 2550. FORMAT "%5.0" /end CHARACTERISTIC
/begin CHARACTERISTIC DNSOLST "" VALUE 0x800473EE KwWU8 2550. nmot_ub_q10 0.00 2550. FORMAT "%5.0" /end CHARACTERISTIC
/begin CHARACTERISTIC DNSTATMST "" CURVE 0x800473EF KlAxU8SstxU8WU8 2550. nmot_ub_q10 0.00 2550. FORMAT "%5.0"
 /begin AXIS_DESCR STD_AXIS tmst temp_ub_q0p75_o48 6 -48.00 143.3 FORMAT "%5.1" DEPOSIT ABSOLUTE /end AXIS_DESCR
/end CHARACTERISTIC
/begin CHARACTERISTIC DNSTLST "" VALUE 0x800473FC KwWS8 2550. nmotd_sb_q10 -1280. 1270. FORMAT "%5.0" /end CHARACTERISTIC
/begin CHARACTERISTIC DRLMXBTS "" VALUE 0x80046A76 KwWU16 1535.977 rel_sw_q0p0234 0.00 1535.977 FORMAT "%8.3" /end CHARACTERISTIC
/begin CHARACTERISTIC DTBTSGAS "" VALUE 0x80046A78 KwWS16 500.0156 temp_q0p0468_K 0.00 500.0156 FORMAT "%8.4" /end CHARACTERISTIC
/begin CHARACTERISTIC DTBTSKAT "" VALUE 0x80046A7A KwWS16 500.0156 temp_q0p0468_K 0.00 500.0156 FORMAT "%8.4" /end CHARACTERISTIC
/begin CHARACTERISTIC DTBTSNL "" VALUE 0x80046A7C KwWS16 500.0156 temp_q0p0468_K 0.00 500.0156 FORMAT "%8.4" /end CHARACTERISTIC
/begin CHARACTERISTIC DTBTSNLLSV "" VALUE 0x80046A7E KwWS16 500.0156 temp_q0p0468_K 0.00 500.0156 FORMAT "%8.4" /end CHARACTERISTIC
/begin CHARACTERISTIC DTBTSOFF "" VALUE 0x80046A80 KwWS16 500.0156 temp_q0p0468_K 0.00 500.0156 FORMAT "%8.4" /end CHARACTERISTIC
/begin CHARACTERISTIC DWKRMSN "" CURVE 0x8004668B GklWS8 20.25 kw_q0p75 0.00 20.25 FORMAT "%5.2"
 /begin AXIS_DESCR COM_AXIS nmot nmot_ub_q40 8 0.00 10200. FORMAT "%5.0" AXIS_PTS_REF SNMKRB /end AXIS_DESCR
/end CHARACTERISTIC
/begin CHARACTERISTIC DYADS "" VALUE 0x80046560 KwWS8 24.00 kw_q0p75 -24.00 0.00 FORMAT "%5.2" /end CHARACTERISTIC
/begin CHARACTERISTIC DZWTIN "" CURVE 0x80046561 GklWS8 191.3 kw_q0p75 -96.00 95.25 FORMAT "%5.2"
 /begin AXIS_DESCR COM_AXIS nmot nmot_ub_q40 8 0.00 10200. FORMAT "%5.0" AXIS_PTS_REF SNMKRB /end AXIS_DESCR
/end CHARACTERISTIC
/begin CHARACTERISTIC FKEDY "" VALUE 0x80046596 KwWU8 1.938 fak_ub_b16 0.06250 2.000 FORMAT "%5.3" /end CHARACTERISTIC
/begin CHARACTERISTIC FKEFMC "" VALUE 0x80046597 KwWU8 1.938 fak_ub_b16 0.06250 2.000 FORMAT "%5.3" /end CHARACTERISTIC
/begin CHARACTERISTIC FKELDYA "" VALUE 0x80046569 KwWU8 15.94 fak_ub_b16 0.00 15.94 FORMAT "%5.2" /end CHARACTERISTIC
/begin CHARACTERISTIC FKRVFS "" VALUE 0x80046693 KwWU8 0.9375 fak_ub_b16 0.06250 1.000 FORMAT "%5.3" /end CHARACTERISTIC
/begin CHARACTERISTIC FNSNF "" VALUE 0x800473FD KwWU8 0.9961 fak_ub_b1 0.00 0.9961 /end CHARACTERISTIC
/begin CHARACTERISTIC FNSSTKM "" CURVE 0x800473FE KlAxU8SstxU8WU8 1.992188 fak_ub_b2 0.00 1.992188 FORMAT "%8.6"
 /begin AXIS_DESCR STD_AXIS tmot temp_ub_q0p75_o48 6 -48.00 143.3 FORMAT "%5.1" DEPOSIT ABSOLUTE /end AXIS_DESCR
/end CHARACTERISTIC
/begin CHARACTERISTIC FNSSTM "" CURVE 0x8004740B KlAxU8SstxU8WU8 1.992188 fak_ub_b2 0.00 1.992188 FORMAT "%8.6"
 /begin AXIS_DESCR STD_AXIS tmot temp_ub_q0p75_o48 6 -48.00 143.3 FORMAT "%5.1" DEPOSIT ABSOLUTE /end AXIS_DESCR
/end CHARACTERISTIC
/begin CHARACTERISTIC FRLBTSMN "" VALUE 0x80046A82 KwWU16 0.3999634 fak_uw_b2 0.6000061 0.9999695 FORMAT "%9.7" /end CHARACTERISTIC
/begin CHARACTERISTIC FZKLLSTAB "" CURVE 0x80047418 GklWU8 3.00000 rfak_q0p5 1.00000 4.00000 FORMAT "%7.5"
 /begin AXIS_DESCR COM_AXIS tmst temp_ub_q0p75_o48 6 -48.00 143.3 FORMAT "%5.1" AXIS_PTS_REF STMS06LLUB /end AXIS_DESCR
/end CHARACTERISTIC
/begin CHARACTERISTIC HEGO_ctRiCalc_C "" VALUE 0x80046265 KwWU8 255.0 dez 0.00 255.0 FORMAT "%5.1" /end CHARACTERISTIC
/begin CHARACTERISTIC HEGO_duRiAftFrz_C "" VALUE 0x80046266 KwWU16 4.995117 spg_q0p00488 0.00 4.995117 FORMAT "%8.6" /end CHARACTERISTIC
/begin CHARACTERISTIC HEGO_SensS1B1_I.tiDebEnaRiVltg_C "" VALUE 0x80046278 KwWU8 2.550 t_q0p01 0.00 2.550 FORMAT "%5.3" /end CHARACTERISTIC
/begin CHARACTERISTIC HEGO_SensS1B1_I.uRiLoLim_C "" VALUE 0x8004627A KwWU16 4.995117 spg_q0p00488 0.00 4.995117 FORMAT "%8.6" /end CHARACTERISTIC
/begin CHARACTERISTIC HEGO_SensS1B1_I.uRiUpLim_C "" VALUE 0x8004627C KwWU16 4.995117 spg_q0p00488 0.00 4.995117 FORMAT "%8.6" /end CHARACTERISTIC
/begin CHARACTERISTIC HEGO_stSensHw_CW "" VALUE 0x80046268 KwWU8 255.0 dez 0.00 255.0 FORMAT "%5.1" /end CHARACTERISTIC
/begin CHARACTERISTIC HEGO_stSens_CW "" VALUE 0x80046264 KwWU8 255.0 dez 0.00 255.0 FORMAT "%5.1" /end CHARACTERISTIC
/begin CHARACTERISTIC HEGO_tiDelLdPls_C "" VALUE 0x8004626A KwWU16 6553.500 t_q0p1 0.00 6553.500 FORMAT "%8.3" /end CHARACTERISTIC
/begin CHARACTERISTIC HEGO_tiDelOpRdnRiPls_C "" VALUE 0x8004626C KwWU8 25.50 t_q0p1 0.00 25.50 FORMAT "%5.2" /end CHARACTERISTIC
/begin CHARACTERISTIC HEGO_tiDelRiPls_C "" VALUE 0x80046270 KwWU8 2.550 t_q0p01 0.00 2.550 FORMAT "%5.3" /end CHARACTERISTIC
/begin CHARACTERISTIC HEGO_tiPolarRedPls_C "" VALUE 0x8004626E KwWU16 65.53500 t_q0p001 0.00 65.53500 FORMAT "%8.5" /end CHARACTERISTIC
/begin CHARACTERISTIC HEGO_tiS1FrzRi_C "" VALUE 0x80046271 KwWU8 2.540 t_q0p01 0.01000 2.550 FORMAT "%5.3" /end CHARACTERISTIC
/begin CHARACTERISTIC I15031_nMaxSrv4_C "" VALUE 0x8004BE14 Val_Ws16 10000.00 EngN 0.00 10000.00 FORMAT "%8.2" /end CHARACTERISTIC
/begin CHARACTERISTIC I15031_PID1C_C "" VALUE 0x8004BE16 Val_Wu8 28.0000000000 I15031_PID1CVerb 1.00000000000 29.0000000000 FORMAT "%13.10" /end CHARACTERISTIC
/begin CHARACTERISTIC I15031_PID4FA_C "" VALUE 0x8004BE17 Val_Wu8 255.0 OneToOne 0.00 255.0 FORMAT "%5.1" /end CHARACTERISTIC
/begin CHARACTERISTIC I15031_PID4FB_C "" VALUE 0x8004BE18 Val_Wu8 255.0 OneToOne 0.00 255.0 FORMAT "%5.1" /end CHARACTERISTIC
/begin CHARACTERISTIC I15031_PID4FC_C "" VALUE 0x8004BE19 Val_Wu8 255.0 OneToOne 0.00 255.0 FORMAT "%5.1" /end CHARACTERISTIC
/begin CHARACTERISTIC I15031_PID4FD_C "" VALUE 0x8004BE1A Val_Wu8 2550. OneToTenCarb 0.00 2550. FORMAT "%5.0" /end CHARACTERISTIC
/begin CHARACTERISTIC I15031_PID50A_C "" VALUE 0x8004BE1B Val_Wu8 2550. OneToTenCarb 0.00 2550. FORMAT "%5.0" /end CHARACTERISTIC
/begin CHARACTERISTIC I15031_PID5F_C "" VALUE 0x8004BE1C Val_Wu8 2.00000000000 I15031_PID5FVerb 14.0000000000 16.0000000000 FORMAT "%13.10" /end CHARACTERISTIC
/begin CHARACTERISTIC I15031_srv9PIDTable.PID0_C "" VALUE 0x8004BE1E Val_Wu8 255.0 OneToOne 0.00 255.0 FORMAT "%5.1" /end CHARACTERISTIC
/begin CHARACTERISTIC I15031_srv9PIDTable.PID1_C "" VALUE 0x8004BE1F Val_Wu8 255.0 OneToOne 0.00 255.0 FORMAT "%5.1" /end CHARACTERISTIC
/begin CHARACTERISTIC I15031_srv9PIDTable.PID2_C "" VALUE 0x8004BE20 Val_Wu8 255.0 OneToOne 0.00 255.0 FORMAT "%5.1" /end CHARACTERISTIC
/begin CHARACTERISTIC I15031_srv9PIDTable.PID3_C "" VALUE 0x8004BE21 Val_Wu8 255.0 OneToOne 0.00 255.0 FORMAT "%5.1" /end CHARACTERISTIC
/begin CHARACTERISTIC I15031_srv9PIDTable.PID4_C "" VALUE 0x8004BE22 Val_Wu8 255.0 OneToOne 0.00 255.0 FORMAT "%5.1" /end CHARACTERISTIC
/begin CHARACTERISTIC I15031_srv9PIDTable.PID5_C "" VALUE 0x8004BE23 Val_Wu8 255.0 OneToOne 0.00 255.0 FORMAT "%5.1" /end CHARACTERISTIC
/begin CHARACTERISTIC I15031_srv9PIDTable.PID6_C "" VALUE 0x8004BE24 Val_Wu8 255.0 OneToOne 0.00 255.0 FORMAT "%5.1" /end CHARACTERISTIC
/begin CHARACTERISTIC I15031_srv9PIDTable.PID7_C "" VALUE 0x8004BE25 Val_Wu8 255.0 OneToOne 0.00 255.0 FORMAT "%5.1" /end CHARACTERISTIC
/begin CHARACTERISTIC I15031_srv9PIDTable.PID8_C "" VALUE 0x8004BE26 Val_Wu8 255.0 OneToOne 0.00 255.0 FORMAT "%5.1" /end CHARACTERISTIC
/begin CHARACTERISTIC I15031_srv9PIDTable.PID9_C "" VALUE 0x8004BE27 Val_Wu8 255.0 OneToOne 0.00 255.0 FORMAT "%5.1" /end CHARACTERISTIC
/begin CHARACTERISTIC I15031_srv9PIDTable.PIDA_C "" VALUE 0x8004BE28 Val_Wu8 255.0 OneToOne 0.00 255.0 FORMAT "%5.1" /end CHARACTERISTIC
/begin CHARACTERISTIC I15031_srv9PIDTable.PIDB_C "" VALUE 0x8004BE29 Val_Wu8 255.0 OneToOne 0.00 255.0 FORMAT "%5.1" /end CHARACTERISTIC
/begin CHARACTERISTIC IgnClPs_Count "" VALUE 0x800462A4 KwWU8 255.0 dez 0.00 255.0 FORMAT "%5.1" /end CHARACTERISTIC
/begin CHARACTERISTIC IgnClPs_uBattMax_C "" VALUE 0x800462A5 KwWU8 25.50 spg_q0p1 0.00 25.50 FORMAT "%5.2" /end CHARACTERISTIC
/begin CHARACTERISTIC IgnClPs_uBattMin_C "" VALUE 0x800462A6 KwWU8 25.50 spg_q0p1 0.00 25.50 FORMAT "%5.2" /end CHARACTERISTIC
/begin CHARACTERISTIC KFDYMNTVS "" MAP 0x8004656A KfAxU8AyU8SstxU8SstyU8WS8 191.3 kw_q0p75 -96.00 95.25 FORMAT "%5.2"
 /begin AXIS_DESCR STD_AXIS nmot nmot_ub_q40 6 0.00 10200. FORMAT "%5.0" DEPOSIT ABSOLUTE /end AXIS_DESCR
 /begin AXIS_DESCR STD_AXIS taevkr temp_ub_q0p75_o48 5 -48.00 143.3 FORMAT "%5.1" DEPOSIT ABSOLUTE /end AXIS_DESCR
/end CHARACTERISTIC
/begin CHARACTERISTIC KFETAKHKTL "" MAP 0x800462AA GkfWU16 1.999969 fak_uw_b2 0.00 1.999969 FORMAT "%8.6"
 /begin AXIS_DESCR COM_AXIS mifal_w rel_uw_b100 8 0.00 99.99847 FORMAT "%8.5" AXIS_PTS_REF SMG08KHUW /end AXIS_DESCR
 /begin AXIS_DESCR COM_AXIS nmot_w nmot_uw_q0p25 8 0.00 16383.75 FORMAT "%8.2" AXIS_PTS_REF SNM08KHUW /end AXIS_DESCR
/end CHARACTERISTIC
/begin CHARACTERISTIC KFETAKHKTT "" MAP 0x8004632A GkfWU16 1.999969 fak_uw_b2 0.00 1.999969 FORMAT "%8.6"
 /begin AXIS_DESCR COM_AXIS mifal_w rel_uw_b100 8 0.00 99.99847 FORMAT "%8.5" AXIS_PTS_REF SMG08KHUW /end AXIS_DESCR
 /begin AXIS_DESCR COM_AXIS nmot_w nmot_uw_q0p25 8 0.00 16383.75 FORMAT "%8.2" AXIS_PTS_REF SNM08KHUW /end AXIS_DESCR
/end CHARACTERISTIC
/begin CHARACTERISTIC KFETAKHKW "" MAP 0x800463AA GkfWU16 1.999969 fak_uw_b2 0.00 1.999969 FORMAT "%8.6"
 /begin AXIS_DESCR COM_AXIS mifal_w rel_uw_b100 8 0.00 99.99847 FORMAT "%8.5" AXIS_PTS_REF SMG08KHUW /end AXIS_DESCR
 /begin AXIS_DESCR COM_AXIS nmot_w nmot_uw_q0p25 8 0.00 16383.75 FORMAT "%8.2" AXIS_PTS_REF SNM08KHUW /end AXIS_DESCR
/end CHARACTERISTIC
/begin CHARACTERISTIC KFFDLBTS "" MAP 0x80046A84 GkfWU16 1.999969 fak_uw_b2 0.00 1.999969 FORMAT "%8.6"
 /begin AXIS_DESCR COM_AXIS nmot_w nmot_uw_q0p25 16 0.00 16383.75 FORMAT "%8.2" AXIS_PTS_REF SNM16GKUW /end AXIS_DESCR
 /begin AXIS_DESCR COM_AXIS rl_w rel_uw_q0p0234 12 0.00 1535.977 FORMAT "%8.3" AXIS_PTS_REF SRL12GKUW /end AXIS_DESCR
/end CHARACTERISTIC
/begin CHARACTERISTIC KFFTPKR "" MAP 0x80046598 KfAxU8AyU8SstxS8SstyU8WU8 28.00 dez 4.000 32.00 FORMAT "%5.2"
 /begin AXIS_DESCR STD_AXIS krngfil nmotg_sb_q100 6 -12800. 12700. FORMAT "%5.0" DEPOSIT ABSOLUTE /end AXIS_DESCR
 /begin AXIS_DESCR STD_AXIS nmot nmot_ub_q40 4 0.00 10200. FORMAT "%5.0" DEPOSIT ABSOLUTE /end AXIS_DESCR
/end CHARACTERISTIC
/begin CHARACTERISTIC KFKE0 "" MAP 0x800465BC GkfWU8 3.438 fak_ub_b16 0.06250 3.500 FORMAT "%5.3"
 /begin AXIS_DESCR COM_AXIS nmot nmot_ub_q40 13 0.00 10200. FORMAT "%5.0" AXIS_PTS_REF SNMKRA /end AXIS_DESCR
 /begin AXIS_DESCR COM_AXIS rl rel_ub_q0p75 4 0.00 191.3 FORMAT "%5.1" AXIS_PTS_REF SRL04KRUB /end AXIS_DESCR
/end CHARACTERISTIC
/begin CHARACTERISTIC KFKE1 "" MAP 0x800465F0 GkfWU8 3.438 fak_ub_b16 0.06250 3.500 FORMAT "%5.3"
 /begin AXIS_DESCR COM_AXIS nmot nmot_ub_q40 13 0.00 10200. FORMAT "%5.0" AXIS_PTS_REF SNMKRA /end AXIS_DESCR
 /begin AXIS_DESCR COM_AXIS rl rel_ub_q0p75 4 0.00 191.3 FORMAT "%5.1" AXIS_PTS_REF SRL04KRUB /end AXIS_DESCR
/end CHARACTERISTIC
/begin CHARACTERISTIC KFKE2 "" MAP 0x80046624 GkfWU8 3.438 fak_ub_b16 0.06250 3.500 FORMAT "%5.3"
 /begin AXIS_DESCR COM_AXIS nmot nmot_ub_q40 13 0.00 10200. FORMAT "%5.0" AXIS_PTS_REF SNMKRA /end AXIS_DESCR
 /begin AXIS_DESCR COM_AXIS rl rel_ub_q0p75 4 0.00 191.3 FORMAT "%5.1" AXIS_PTS_REF SRL04KRUB /end AXIS_DESCR
/end CHARACTERISTIC
/begin CHARACTERISTIC KFKRFKN "" MAP 0x80046694 KfAxU8AyU8SstxU8SstyU8WS8 6.000 kw_q0p75 -6.000 0.00 FORMAT "%5.3"
 /begin AXIS_DESCR STD_AXIS nmot nmot_ub_q40 8 0.00 10200. FORMAT "%5.0" DEPOSIT ABSOLUTE /end AXIS_DESCR
 /begin AXIS_DESCR STD_AXIS virkr fak_ub_b16 4 0.00 15.94 FORMAT "%5.2" DEPOSIT ABSOLUTE /end AXIS_DESCR
/end CHARACTERISTIC
/begin CHARACTERISTIC KFKRMXNT "" MAP 0x800466C2 KfAxU8AyU8SstxU8SstyU8WS8 20.25 kw_q0p75 -20.25 0.00 FORMAT "%5.2"
 /begin AXIS_DESCR STD_AXIS nmot nmot_ub_q40 8 0.00 10200. FORMAT "%5.0" DEPOSIT ABSOLUTE /end AXIS_DESCR
 /begin AXIS_DESCR STD_AXIS tmot temp_uw_q0p75_o48 8 -48.00 143.3 FORMAT "%5.1" DEPOSIT ABSOLUTE /end AXIS_DESCR
/end CHARACTERISTIC
/begin CHARACTERISTIC KFLANS "" MAP 0x8004717C KfAxU8AyU8SstxU8SstyU16WU16 15.99976 fak_uw_b16 0.00 15.99976 FORMAT "%8.5"
 /begin AXIS_DESCR STD_AXIS tmstlanswl temp_ub_q0p75_o48 12 -48.00 143.3 FORMAT "%5.1" DEPOSIT ABSOLUTE /end AXIS_DESCR
 /begin AXIS_DESCR STD_AXIS anztib1_w dez 12 0.00 65535.00 FORMAT "%8.2" DEPOSIT ABSOLUTE /end AXIS_DESCR
/end CHARACTERISTIC
/begin CHARACTERISTIC KFLANSKH "" MAP 0x800468B0 KfAxU8AyU8SstxU8SstyU16WU16 15.99976 fak_q0p000244 0.00 15.99976 FORMAT "%8.5"
 /begin AXIS_DESCR STD_AXIS tmst temp_ub_q0p75_o48 6 -48.00 143.3 FORMAT "%5.1" DEPOSIT ABSOLUTE /end AXIS_DESCR
 /begin AXIS_DESCR STD_AXIS anztib_w dez 12 0.00 65535.00 FORMAT "%8.2" DEPOSIT ABSOLUTE /end AXIS_DESCR
/end CHARACTERISTIC
/begin CHARACTERISTIC KFLASWLRTX "" MAP 0x800472C2 KfAxU8AyU8SstxU8SstyU8WU8 1.992188 fak_ub_b2 0.00 1.992188 FORMAT "%8.6"
 /begin AXIS_DESCR STD_AXIS tmotlanswl temp_ub_q0p75_o48 12 -48.00 143.3 FORMAT "%5.1" DEPOSIT ABSOLUTE /end AXIS_DESCR
 /begin AXIS_DESCR STD_AXIS tmstlanswl temp_ub_q0p75_o48 12 -48.00 143.3 FORMAT "%5.1" DEPOSIT ABSOLUTE /end AXIS_DESCR
/end CHARACTERISTIC
/begin CHARACTERISTIC KFLBTS "" MAP 0x80046C04 GkfWU16 0.7500000 fak_uw_b16 0.5000000 1.250000 FORMAT "%8.6"
 /begin AXIS_DESCR COM_AXIS nmot_w nmot_uw_q0p25 16 0.00 16383.75 FORMAT "%8.2" AXIS_PTS_REF SNM16GKUW /end AXIS_DESCR
 /begin AXIS_DESCR COM_AXIS rl_w rel_uw_q0p0234 12 0.00 1535.977 FORMAT "%8.3" AXIS_PTS_REF SRL12GKUW /end AXIS_DESCR
/end CHARACTERISTIC
/begin CHARACTERISTIC KFLBTSBG "" MAP 0x80046D84 GkfWU16 15.99976 fak_uw_b16 0.00 15.99976 FORMAT "%8.5"
 /begin AXIS_DESCR COM_AXIS nmot_w nmot_uw_q0p25 16 0.00 16383.75 FORMAT "%8.2" AXIS_PTS_REF SNM16GKUW /end AXIS_DESCR
 /begin AXIS_DESCR COM_AXIS rl_w rel_uw_q0p0234 12 0.00 1535.977 FORMAT "%8.3" AXIS_PTS_REF SRL12GKUW /end AXIS_DESCR
/end CHARACTERISTIC
/begin CHARACTERISTIC KFLBTSL "" MAP 0x80046F04 GkfWU16 0.7500000 fak_uw_b16 0.5000000 1.250000 FORMAT "%8.6"
 /begin AXIS_DESCR COM_AXIS nmot_w nmot_uw_q0p25 16 0.00 16383.75 FORMAT "%8.2" AXIS_PTS_REF SNM16GKUW /end AXIS_DESCR
 /begin AXIS_DESCR COM_AXIS rl_w rel_uw_q0p0234 12 0.00 1535.977 FORMAT "%8.3" AXIS_PTS_REF SRL12GKUW /end AXIS_DESCR
/end CHARACTERISTIC
/begin CHARACTERISTIC KFLMSKH "" MAP 0x80046960 KfAxU8AyU8SstxU16SstyU16WU16 8.000000 fak_q0p000244 0.00 8.000000 FORMAT "%8.6"
 /begin AXIS_DESCR STD_AXIS nmot_w nmot_uw_q0p25 8 0.00 16383.75 FORMAT "%8.2" DEPOSIT ABSOLUTE /end AXIS_DESCR
 /begin AXIS_DESCR STD_AXIS rl_w rel_q0p0234 8 0.00 1535.977 FORMAT "%8.3" DEPOSIT ABSOLUTE /end AXIS_DESCR
/end CHARACTERISTIC
/begin CHARACTERISTIC KFTKRVFN "" MAP 0x80046714 KfAxU8AyU8SstxS16SstyS16WS16 25.50000 t_q0p1 0.00 25.50000 FORMAT "%8.5"
 /begin AXIS_DESCR STD_AXIS nmot nmot_ub_q40 8 0.00 10200.00 FORMAT "%8.2" DEPOSIT ABSOLUTE /end AXIS_DESCR
 /begin AXIS_DESCR STD_AXIS krfkwz_out kw_q0p75 4 -96.00000 95.25000 FORMAT "%8.5" DEPOSIT ABSOLUTE /end AXIS_DESCR
/end CHARACTERISTIC
/begin CHARACTERISTIC KFZNSM "" MAP 0x8004741E GkfWU8 5.08000 zk20msxs_ub_b5p1 0.0200000 5.10000 FORMAT "%7.5"
 /begin AXIS_DESCR COM_AXIS tmot temp_ub_q0p75_o48 6 -48.00 143.3 FORMAT "%5.1" AXIS_PTS_REF STM06LLUB /end AXIS_DESCR
 /begin AXIS_DESCR COM_AXIS dns nmotd_sb_q10 6 -1280. 1270. FORMAT "%5.0" AXIS_PTS_REF SNS06LLSB /end AXIS_DESCR
/end CHARACTERISTIC
/begin CHARACTERISTIC KLDETAKH "" CURVE 0x8004642A KlAxU8SstxU16WU16 1.999969 fak_uw_b2 0.00 1.999969 FORMAT "%8.6"
 /begin AXIS_DESCR STD_AXIS etazwmn_w fak_uw_b2 6 0.00 1.999969 FORMAT "%8.6" DEPOSIT ABSOLUTE /end AXIS_DESCR
/end CHARACTERISTIC
/begin CHARACTERISTIC KLDLUWSKH "" CURVE 0x80046444 KlAxU8SstxS16WU16 1.999969 fak_uw_b2 0.00 1.999969 FORMAT "%8.6"
 /begin AXIS_DESCR STD_AXIS dsdluts_w lu_MEx 4 -149.0116 149.0071 FORMAT "%8.4" DEPOSIT ABSOLUTE /end AXIS_DESCR
/end CHARACTERISTIC
/begin CHARACTERISTIC KLFSTIMLPR "" CURVE 0x80046456 KlAxU8SstxU16WU8 1.992188 fak_ub_b2 0.00 1.992188 FORMAT "%8.6"
 /begin AXIS_DESCR STD_AXIS imlpr_w fak_uw_b1 8 0.00 0.9999847 FORMAT "%9.7" DEPOSIT ABSOLUTE /end AXIS_DESCR
/end CHARACTERISTIC
/begin CHARACTERISTIC KLFSTKTAGE "" CURVE 0x80046470 KlAxU8SstxU16WU8 1.992188 fak_ub_b2 0.00 1.992188 FORMAT "%8.6"
 /begin AXIS_DESCR STD_AXIS fcoscaw_w fak_uw_b2 4 0.00 1.999969 FORMAT "%8.6" DEPOSIT ABSOLUTE /end AXIS_DESCR
/end CHARACTERISTIC
/begin CHARACTERISTIC KLFSTKTFHO "" CURVE 0x8004647E KlAxU8SstxU16WU8 0.9961 fak_ub_b1 0.00 0.9961
 /begin AXIS_DESCR STD_AXIS fho_w fak_uw_b4 4 0.00 3.999939 FORMAT "%8.6" DEPOSIT ABSOLUTE /end AXIS_DESCR
/end CHARACTERISTIC
/begin CHARACTERISTIC KLFSTKTMST "" CURVE 0x8004648C KlAxU8SstxU8WU16 1.999969 fak_uw_b2 0.00 1.999969 FORMAT "%8.6"
 /begin AXIS_DESCR STD_AXIS tmst temp_ub_q0p75_o48 8 -48.00 143.3 FORMAT "%5.1" DEPOSIT ABSOLUTE /end AXIS_DESCR
/end CHARACTERISTIC
/begin CHARACTERISTIC KLFSTKTTNS "" CURVE 0x800464A6 KlAxU8SstxU16WU8 1.992188 fak_ub_b2 0.00 1.992188 FORMAT "%8.6"
 /begin AXIS_DESCR STD_AXIS tnse_w t100msxs_uw_b6553p5 8 0.00 6553.500 FORMAT "%8.3" DEPOSIT ABSOLUTE /end AXIS_DESCR
/end CHARACTERISTIC
/begin CHARACTERISTIC KLLAKHFH "" CURVE 0x80046A04 KlAxU8SstxU16WU16 1.999969 fak_uw_b2 0.00 1.999969 FORMAT "%8.6"
 /begin AXIS_DESCR STD_AXIS fho_w fak_uw_b4 4 0.00 3.999939 FORMAT "%8.6" DEPOSIT ABSOLUTE /end AXIS_DESCR
/end CHARACTERISTIC
/begin CHARACTERISTIC KLLLRNFHO "" CURVE 0x80047478 KlAxU8SstxU8WU8 2550. nmot_ub_q10 0.00 2550. FORMAT "%5.0"
 /begin AXIS_DESCR STD_AXIS fho fak_ub_b4 6 0.00 3.984 FORMAT "%5.3" DEPOSIT ABSOLUTE /end AXIS_DESCR
/end CHARACTERISTIC
/begin CHARACTERISTIC KLTIKBTSMT "" CURVE 0x80047084 KlAxU8SstxU16WU16 1535.977 temp_q0p0234_o273 -273.1500 1262.827 FORMAT "%8.3"
 /begin AXIS_DESCR STD_AXIS tmatbts_w temp_q0p0234_o273 4 -273.1500 1262.827 FORMAT "%8.3" DEPOSIT ABSOLUTE /end AXIS_DESCR
/end CHARACTERISTIC
/begin CHARACTERISTIC KLZDLBTS "" CURVE 0x80047096 KlAxU8SstxU16WU16 6553.500 t_q0p1 0.00 6553.500 FORMAT "%8.3"
 /begin AXIS_DESCR STD_AXIS ml_w m_uw_b6553p5 4 0.00 6553.500 FORMAT "%8.3" DEPOSIT ABSOLUTE /end AXIS_DESCR
/end CHARACTERISTIC
/begin CHARACTERISTIC KnDet_CoefFlt_CA "" VAL_BLK 0x80046788 KwbUw 65535.00 dez 0.00 65535.00 FORMAT "%8.2" NUMBER 147 /end CHARACTERISTIC
/begin CHARACTERISTIC KnDet_SensMaxErr_C "" VALUE 0x80046782 KwSw 6.599899 spg_sw_q0p0001 -3.300000 3.299899 FORMAT "%8.6" /end CHARACTERISTIC
/begin CHARACTERISTIC KnDet_SensMinErr_C "" VALUE 0x80046784 KwSw 6.599899 spg_sw_q0p0001 -3.300000 3.299899 FORMAT "%8.6" /end CHARACTERISTIC
/begin CHARACTERISTIC KnDet_ThresNGradMeasWin_C "" VALUE 0x8004677C KwSw 10000.00 EngNGrd 0.00 10000.00 FORMAT "%8.2" /end CHARACTERISTIC
/begin CHARACTERISTIC KnDet_ThresNMeasWin_C "" VALUE 0x8004677E KwSw 10000.00 nmot_q0p5 0.00 10000.00 FORMAT "%8.2" /end CHARACTERISTIC
/begin CHARACTERISTIC KnDet_ThresNumMeasWin_C "" VALUE 0x80046780 KwSw 50.00000 dez 0.00 50.00000 FORMAT "%8.5" /end CHARACTERISTIC
/begin CHARACTERISTIC KNSNF "" VALUE 0x80047442 KwWU8 2550. nmot_ub_q10 0.00 2550. FORMAT "%5.0" /end CHARACTERISTIC
/begin CHARACTERISTIC KRDWA "" VALUE 0x8004655C KwWS8 8.250 kw_q0p75 0.00 8.250 FORMAT "%5.3" /end CHARACTERISTIC
/begin CHARACTERISTIC KRDWKLA "" VALUE 0x8004655D KwWS8 6.000 kw_q0p75 -6.000 0.00 FORMAT "%5.3" /end CHARACTERISTIC
/begin CHARACTERISTIC KRDWSA "" VALUE 0x8004655E KwWS8 6.000 kw_q0p75 0.00 6.000 FORMAT "%5.3" /end CHARACTERISTIC
/begin CHARACTERISTIC KRDWSN "" CURVE 0x80046770 GklWS8 20.25 kw_q0p75 -20.25 0.00 FORMAT "%5.2"
 /begin AXIS_DESCR COM_AXIS nmot nmot_ub_q40 8 0.00 10200. FORMAT "%5.0" AXIS_PTS_REF SNMKRB /end AXIS_DESCR
/end CHARACTERISTIC
/begin CHARACTERISTIC KRLLZA "" VAL_BLK 0x80046677 KwbWU8 191.3 rel_ub_q0p75 0.00 191.3 FORMAT "%5.1" NUMBER 3 /end CHARACTERISTIC
/begin CHARACTERISTIC KRNGFILO "" VALUE 0x80046658 KwWS8 25500. nmotg_sb_q100 -12800. 12700. FORMAT "%5.0" /end CHARACTERISTIC
/begin CHARACTERISTIC KRNGFILU "" VALUE 0x80046659 KwWS8 25500. nmotg_sb_q100 -12800. 12700. FORMAT "%5.0" /end CHARACTERISTIC
/begin CHARACTERISTIC KRNLZOB "" VAL_BLK 0x8004667A KwbWU8 10200. nmot_ub_q40 0.00 10200. FORMAT "%5.0" NUMBER 3 /end CHARACTERISTIC
/begin CHARACTERISTIC KRNLZUN "" VAL_BLK 0x8004667D KwbWU8 10200. nmot_ub_q40 0.00 10200. FORMAT "%5.0" NUMBER 3 /end CHARACTERISTIC
/begin CHARACTERISTIC LAMHAP "" VALUE 0x8004710E KwWU16 15.99976 fak_uw_b16 0.00 15.99976 FORMAT "%8.5" /end CHARACTERISTIC
/begin CHARACTERISTIC LAMLGFKT "" VALUE 0x80047110 KwWU8 1.992188 fak_ub_b2 0.00 1.992188 FORMAT "%8.6" /end CHARACTERISTIC
/begin CHARACTERISTIC LAMLGFTM "" CURVE 0x80047111 GklWU8 1.992188 fak_ub_b2 0.00 1.992188 FORMAT "%8.6"
 /begin AXIS_DESCR COM_AXIS tmot temp_ub_q0p75_o48 12 -48.00 143.3 FORMAT "%5.1" AXIS_PTS_REF STM12ESUB /end AXIS_DESCR
/end CHARACTERISTIC
/begin CHARACTERISTIC LAMLGMKT "" VALUE 0x8004711D KwWU8 1.992188 fak_ub_b2 0.00 1.992188 FORMAT "%8.6" /end CHARACTERISTIC
/begin CHARACTERISTIC LAMLGMTM "" CURVE 0x8004711E GklWU8 1.992188 fak_ub_b2 0.00 1.992188 FORMAT "%8.6"
 /begin AXIS_DESCR COM_AXIS tmot temp_ub_q0p75_o48 12 -48.00 143.3 FORMAT "%5.1" AXIS_PTS_REF STM12ESUB /end AXIS_DESCR
/end CHARACTERISTIC
/begin CHARACTERISTIC LASOAB "" VALUE 0x8004712A KwWU8 1.992188 fak_ub_b2 0.00 1.992188 FORMAT "%8.6" /end CHARACTERISTIC
/begin CHARACTERISTIC LASOABDMD "" VALUE 0x8004712B KwWU8 1.992188 fak_ub_b2 0.00 1.992188 FORMAT "%8.6" /end CHARACTERISTIC
/begin CHARACTERISTIC LASOABDQ "" VALUE 0x8004712C KwWU8 1.992188 fak_ub_b2 0.00 1.992188 FORMAT "%8.6" /end CHARACTERISTIC
/begin CHARACTERISTIC LASWLTX "" CURVE 0x8004736C KlAxU8SstxU8WS8 1.992 fak_sb_b1 -1.000 0.9922 FORMAT "%5.3"
 /begin AXIS_DESCR STD_AXIS tmotlanswl temp_ub_q0p75_o48 12 -48.00 143.3 FORMAT "%5.1" DEPOSIT ABSOLUTE /end AXIS_DESCR
/end CHARACTERISTIC
/begin CHARACTERISTIC LBTSSTART "" VALUE 0x800470A8 KwWU16 0.1000977 fak_uw_b16 0.8999023 1.000000 FORMAT "%8.6" /end CHARACTERISTIC
/begin CHARACTERISTIC LLRBBTMOTO "" CURVE 0x8004738C KlAxU8SstxS16WS16 16383.75 nmot_sw_q0p25 -8192.000 8191.750 FORMAT "%8.3"
 /begin AXIS_DESCR STD_AXIS tmot temp_ub_q0p75_o48 8 -48.00000 143.2500 FORMAT "%8.4" DEPOSIT ABSOLUTE /end AXIS_DESCR
/end CHARACTERISTIC
/begin CHARACTERISTIC LLRBBTMOTU "" CURVE 0x800473AE KlAxU8SstxS16WS16 16383.75 nmot_sw_q0p25 -8192.000 8191.750 FORMAT "%8.3"
 /begin AXIS_DESCR STD_AXIS tmot temp_ub_q0p75_o48 8 -48.00000 143.2500 FORMAT "%8.4" DEPOSIT ABSOLUTE /end AXIS_DESCR
/end CHARACTERISTIC
/begin CHARACTERISTIC LMSTMOT "" CURVE 0x80046A16 KlAxU8SstxU8WU8 1.992188 fak_ub_b2 0.00 1.992188 FORMAT "%8.6"
 /begin AXIS_DESCR STD_AXIS tmot temp_ub_q0p75_o48 4 -48.00 143.3 FORMAT "%5.1" DEPOSIT ABSOLUTE /end AXIS_DESCR
/end CHARACTERISTIC
/begin CHARACTERISTIC LZFUERV "" VAL_BLK 0x80046680 KwbWU8 255.0 dez 0.00 255.0 FORMAT "%5.1" NUMBER 3 /end CHARACTERISTIC
/begin CHARACTERISTIC MINAKRLZ "" VALUE 0x80046683 KwWU8 7.000 dez 1.000 8.000 FORMAT "%5.3" /end CHARACTERISTIC
/begin CHARACTERISTIC NFSMIN "" VALUE 0x80047485 KwWU8 2550. nmot_ub_q10 0.00 2550. FORMAT "%5.0" /end CHARACTERISTIC
/begin CHARACTERISTIC NGNSNF "" VALUE 0x80047443 KwWU8 25500. nmotg_ub_q100 0.00 25500. FORMAT "%5.0" /end CHARACTERISTIC
/begin CHARACTERISTIC NLLMG "" MAP 0x80047486 GkfWU8 2550. nmot_ub_q10 0.00 2550. FORMAT "%5.0"
 /begin AXIS_DESCR COM_AXIS tmot temp_ub_q0p75_o48 10 -48.00 143.3 FORMAT "%5.1" AXIS_PTS_REF STM10LLUB /end AXIS_DESCR
 /begin AXIS_DESCR COM_AXIS gangllr dez 8 0.00 255.0 FORMAT "%5.1" AXIS_PTS_REF SGA08LLUB /end AXIS_DESCR
/end CHARACTERISTIC
/begin CHARACTERISTIC NLLMGAC "" MAP 0x800474D6 GkfWU8 2550. nmot_ub_q10 0.00 2550. FORMAT "%5.0"
 /begin AXIS_DESCR COM_AXIS tmot temp_ub_q0p75_o48 10 -48.00 143.3 FORMAT "%5.1" AXIS_PTS_REF STM10LLUB /end AXIS_DESCR
 /begin AXIS_DESCR COM_AXIS gangllr dez 8 0.00 255.0 FORMAT "%5.1" AXIS_PTS_REF SGA08LLUB /end AXIS_DESCR
/end CHARACTERISTIC
/begin CHARACTERISTIC NLLMGFS "" MAP 0x80047526 GkfWU8 2550. nmot_ub_q10 0.00 2550. FORMAT "%5.0"
 /begin AXIS_DESCR COM_AXIS tmot temp_ub_q0p75_o48 10 -48.00 143.3 FORMAT "%5.1" AXIS_PTS_REF STM10LLUB /end AXIS_DESCR
 /begin AXIS_DESCR COM_AXIS gangllr dez 8 0.00 255.0 FORMAT "%5.1" AXIS_PTS_REF SGA08LLUB /end AXIS_DESCR
/end CHARACTERISTIC
/begin CHARACTERISTIC NLLMGFSAC "" MAP 0x80047576 GkfWU8 2550. nmot_ub_q10 0.00 2550. FORMAT "%5.0"
 /begin AXIS_DESCR COM_AXIS tmot temp_ub_q0p75_o48 10 -48.00 143.3 FORMAT "%5.1" AXIS_PTS_REF STM10LLUB /end AXIS_DESCR
 /begin AXIS_DESCR COM_AXIS gangllr dez 8 0.00 255.0 FORMAT "%5.1" AXIS_PTS_REF SGA08LLUB /end AXIS_DESCR
/end CHARACTERISTIC
/begin CHARACTERISTIC NLLMIN "" VALUE 0x800475C6 KwWU8 2550. nmot_ub_q10 0.00 2550. FORMAT "%5.0" /end CHARACTERISTIC
/begin CHARACTERISTIC NSOLMX "" VALUE 0x80047444 KwWU8 2550. nmot_ub_q10 0.00 2550. FORMAT "%5.0" /end CHARACTERISTIC
/begin CHARACTERISTIC NSOLMXTCU "" VALUE 0x80047445 KwWU8 2550. nmot_ub_q10 0.00 2550. FORMAT "%5.0" /end CHARACTERISTIC
/begin CHARACTERISTIC NSWO1 "" VALUE 0x80046558 KwUb 10200. nmot_ub_q40 0.00 10200. FORMAT "%5.0" /end CHARACTERISTIC
/begin CHARACTERISTIC NSWO2 "" VALUE 0x80046559 KwUb 10200. nmot_ub_q40 0.00 10200. FORMAT "%5.0" /end CHARACTERISTIC
/begin CHARACTERISTIC NTIPLL "" VALUE 0x800475C7 KwWU8 10200. nmot_ub_q40 0.00 10200. FORMAT "%5.0" /end CHARACTERISTIC
/begin CHARACTERISTIC RKRMX1V6N "" CURVE 0x8004665A GklWU16 319.9951 spg_q0p00488 0.00 319.9951 FORMAT "%8.4"
 /begin AXIS_DESCR COM_AXIS nmot nmot_ub_q40 13 0.00 10200. FORMAT "%5.0" AXIS_PTS_REF SNMKRA /end AXIS_DESCR
/end CHARACTERISTIC
/begin AXIS_PTS SDETA08UW "" 0x800470AA detazwbs_w SstAU8SstU16 1.999969 fak_uw_b2 8 0.00 1.999969 FORMAT "%8.6" DEPOSIT ABSOLUTE /end AXIS_PTS
/begin AXIS_PTS SGA08LLUB "" 0x800475C8 gangllr SstAU8SstU8 255.0 dez 8 0.00 255.0 FORMAT "%5.1" DEPOSIT ABSOLUTE /end AXIS_PTS
/begin AXIS_PTS SMG08KHUW "" 0x800464C0 mifal_w SstAU8SstU16 99.99847 rel_uw_b100 8 0.00 99.99847 FORMAT "%8.5" DEPOSIT ABSOLUTE /end AXIS_PTS
/begin AXIS_PTS SNM08KHUW "" 0x800464D2 nmot_w SstAU8SstU16 16383.75 nmot_uw_q0p25 8 0.00 16383.75 FORMAT "%8.2" DEPOSIT ABSOLUTE /end AXIS_PTS
/begin AXIS_PTS SNM16GKUW "" 0x800470BC nmot_w SstAU8SstU16 16383.75 nmot_uw_q0p25 16 0.00 16383.75 FORMAT "%8.2" DEPOSIT ABSOLUTE /end AXIS_PTS
/begin AXIS_PTS SNMKRA "" 0x80046282 nmot SstAU8SstU8 10200. nmot_ub_q40 13 0.00 10200. FORMAT "%5.0" DEPOSIT ABSOLUTE /end AXIS_PTS
/begin AXIS_PTS SNMKRB "" 0x80046290 nmot SstAU8SstU8 10200. nmot_ub_q40 8 0.00 10200. FORMAT "%5.0" DEPOSIT ABSOLUTE /end AXIS_PTS
/begin AXIS_PTS SNS06LLSB "" 0x80047446 dns SstAU8SstS8 2550. nmotd_sb_q10 6 -1280. 1270. FORMAT "%5.0" DEPOSIT ABSOLUTE /end AXIS_PTS
/begin AXIS_PTS SRL04DYUB "" 0x80046299 rl SstAU8SstU8 191.3 rel_ub_q0p75 4 0.00 191.3 FORMAT "%5.1" DEPOSIT ABSOLUTE /end AXIS_PTS
/begin AXIS_PTS SRL04KRUB "" 0x8004629E rl SstAU8SstU8 191.3 rel_ub_q0p75 4 0.00 191.3 FORMAT "%5.1" DEPOSIT ABSOLUTE /end AXIS_PTS
/begin AXIS_PTS SRL12GKUW "" 0x800470DE rl_w SstAU8SstU16 1535.977 rel_uw_q0p0234 12 0.00 1535.977 FORMAT "%8.3" DEPOSIT ABSOLUTE /end AXIS_PTS
/begin AXIS_PTS STM06LLUB "" 0x80049F89 tmot SstAU8SstU8 191.3 temp_ub_q0p75_o48 6 -48.00 143.3 FORMAT "%5.1" DEPOSIT ABSOLUTE /end AXIS_PTS
/begin AXIS_PTS STM06MDUB "" 0x800473D0 tmot SstAU8SstU8 191.3 temp_ub_q0p75_o48 6 -48.00 143.3 FORMAT "%5.1" DEPOSIT ABSOLUTE /end AXIS_PTS
/begin AXIS_PTS STM10LLUB "" 0x800475D1 tmot SstAU8SstU8 191.3 temp_ub_q0p75_o48 10 -48.00 143.3 FORMAT "%5.1" DEPOSIT ABSOLUTE /end AXIS_PTS
/begin AXIS_PTS STM12ESUB "" 0x80049FAE tmot SstAUbSstUb 191.3 temp_ub_q0p75_o48 12 -48.00 143.3 FORMAT "%5.1" DEPOSIT ABSOLUTE /end AXIS_PTS
/begin AXIS_PTS STMS06LLUB "" 0x80049FBB tmst SstAUbSstUb 191.3 temp_ub_q0p75_o48 6 -48.00 143.3 FORMAT "%5.1" DEPOSIT ABSOLUTE /end AXIS_PTS
/begin CHARACTERISTIC TANAVMBTS "" VALUE 0x800470F8 KwWU16 1535.977 temp_q0p0234_o273 -273.1500 1262.827 FORMAT "%8.3" /end CHARACTERISTIC
/begin CHARACTERISTIC TANVKBTS "" VALUE 0x800470FA KwWU16 1535.977 temp_q0p0234_o273 -273.1500 1262.827 FORMAT "%8.3" /end CHARACTERISTIC
/begin CHARACTERISTIC TAVHKBTS "" VALUE 0x800470FC KwWU16 1535.977 temp_q0p0234_o273 -273.1500 1262.827 FORMAT "%8.3" /end CHARACTERISTIC
/begin CHARACTERISTIC TAVROBTS "" VALUE 0x800470FE KwWU16 1535.977 temp_q0p0234_o273 -273.1500 1262.827 FORMAT "%8.3" /end CHARACTERISTIC
/begin CHARACTERISTIC TAVVKBTS "" VALUE 0x80047100 KwWU16 1535.977 temp_q0p0234_o273 -273.1500 1262.827 FORMAT "%8.3" /end CHARACTERISTIC
/begin CHARACTERISTIC TETAKHKT "" VALUE 0x800464E4 KwWU16 6553.4999985 zk100msxs_uw_b6553p6 0.10000152590 6553.6000000 FORMAT "%12.7" /end CHARACTERISTIC
/begin CHARACTERISTIC TKIHKBTS "" VALUE 0x80047102 KwWU16 1535.977 temp_q0p0234_o273 -273.1500 1262.827 FORMAT "%8.3" /end CHARACTERISTIC
/begin CHARACTERISTIC TKIVKBTS "" VALUE 0x80047104 KwWU16 1535.977 temp_q0p0234_o273 -273.1500 1262.827 FORMAT "%8.3" /end CHARACTERISTIC
/begin CHARACTERISTIC TKRLZAMN "" VALUE 0x80046684 KwWU8 25.50 t_q0p1 0.00 25.50 FORMAT "%5.2" /end CHARACTERISTIC
/begin CHARACTERISTIC TLASOABDQ "" VALUE 0x8004712D KwWU8 2.550 t_q0p01 0.00 2.550 FORMAT "%5.3" /end CHARACTERISTIC
/begin CHARACTERISTIC TLLRPDOFF "" VALUE 0x800473D8 KwWU16 655.3500 t10msxs_uw_b655p35 0.00 655.3500 FORMAT "%8.4" /end CHARACTERISTIC
/begin CHARACTERISTIC TVDK "" VALUE 0x800473DA KwWU8 5.100 t20msxs_ub_b5p1 0.00 5.100 FORMAT "%5.3" /end CHARACTERISTIC
/begin CHARACTERISTIC TVFUABTS "" VALUE 0x80047106 KwWU8 25.50 t_q0p1 0.00 25.50 FORMAT "%5.2" /end CHARACTERISTIC
/begin CHARACTERISTIC TVKUPPL "" VALUE 0x800473DB KwWU8 5.100 t20msxs_ub_b5p1 0.00 5.100 FORMAT "%5.3" /end CHARACTERISTIC
/begin CHARACTERISTIC TVLBTSGAS "" VALUE 0x80047107 KwWU8 25.50 t100msxs_ub_b25p5 0.00 25.50 FORMAT "%5.2" /end CHARACTERISTIC
/begin CHARACTERISTIC TVLBTSKAT "" VALUE 0x80047108 KwWU8 25.50 t100msxs_ub_b25p5 0.00 25.50 FORMAT "%5.2" /end CHARACTERISTIC
/begin CHARACTERISTIC TVLLR "" VALUE 0x800473DC KwWU8 5.100 t20msxs_ub_b5p1 0.00 5.100 FORMAT "%5.3" /end CHARACTERISTIC
/begin CHARACTERISTIC TVLLRI "" CURVE 0x800473DD GklWU8 5.100 t20msxs_ub_b5p1 0.00 5.100 FORMAT "%5.3"
 /begin AXIS_DESCR COM_AXIS tmot temp_ub_q0p75_o48 6 -48.00 143.3 FORMAT "%5.1" AXIS_PTS_REF STM06MDUB /end AXIS_DESCR
/end CHARACTERISTIC
/begin CHARACTERISTIC TVLLRPD "" CURVE 0x800473E3 GklWU8 5.100 t20msxs_ub_b5p1 0.00 5.100 FORMAT "%5.3"
 /begin AXIS_DESCR COM_AXIS tmot temp_ub_q0p75_o48 6 -48.00 143.3 FORMAT "%5.1" AXIS_PTS_REF STM06MDUB /end AXIS_DESCR
/end CHARACTERISTIC
/begin CHARACTERISTIC VFZGKHKT "" VALUE 0x800464E6 KwWU16 511.9922 vfzg_uw_q0p00781 0.00 511.9922 FORMAT "%8.4" /end CHARACTERISTIC
/begin CHARACTERISTIC VLLR2 "" VALUE 0x800473EA KwWU16 511.9922 vfzg_uw_q0p00781 0.00 511.9922 FORMAT "%8.4" /end CHARACTERISTIC
/begin CHARACTERISTIC VZWKR "" VAL_BLK 0x80046778 KwbWS8 40.50 kw_q0p75 -20.25 20.25 FORMAT "%5.2" NUMBER 3 /end CHARACTERISTIC
/begin CHARACTERISTIC WESBM "" VALUE 0x8004655A KwUb 717.2 kw_q2p8125 0.00 717.2 FORMAT "%5.1" /end CHARACTERISTIC
/begin CHARACTERISTIC WKRLZOFEKS "" VALUE 0x80046685 KwWS8 12.00 kw_q0p75 -12.00 0.00 FORMAT "%5.2" /end CHARACTERISTIC
/begin CHARACTERISTIC WKRLZOFS "" VAL_BLK 0x80046686 KwbWS8 12.00 kw_q0p75 -12.00 0.00 FORMAT "%5.2" NUMBER 3 /end CHARACTERISTIC
/begin CHARACTERISTIC ZKKHKTL "" VALUE 0x800464E8 KwWU8 25.4996 zk100msxs_ub_b25p5 0.100392 25.6000 FORMAT "%7.4" /end CHARACTERISTIC
/begin CHARACTERISTIC ZKKHKTT "" VALUE 0x800464E9 KwWU8 25.4996 zk100msxs_ub_b25p5 0.100392 25.6000 FORMAT "%7.4" /end CHARACTERISTIC
/begin CHARACTERISTIC ZKLANSWL "" VALUE 0x80047386 KwWU16 655.34999985 zk10msxs_uw_b655 0.010000152590 655.36000000 FORMAT "%12.8" /end CHARACTERISTIC
/begin CHARACTERISTIC ZKLLLST "" CURVE 0x8004744D KlAxU8SstxU8WU8 5.08000 zk20msxs_ub_b5p1 0.0200000 5.10000 FORMAT "%7.5"
 /begin AXIS_DESCR STD_AXIS tmst temp_ub_q0p75_o48 6 -48.00 143.3 FORMAT "%5.1" DEPOSIT ABSOLUTE /end AXIS_DESCR
/end CHARACTERISTIC
/begin CHARACTERISTIC ZKLLSTAB "" CURVE 0x8004745A KlAxU8SstxU8WU8 5.08000 zk20msxs_ub_b5p1 0.0200000 5.10000 FORMAT "%7.5"
 /begin AXIS_DESCR STD_AXIS dnsolzkst nmotd_sb_q10 12 0.00 2550. FORMAT "%5.0" DEPOSIT ABSOLUTE /end AXIS_DESCR
/end CHARACTERISTIC
/begin CHARACTERISTIC ZKNS "" VALUE 0x800475DC KwWU8 5.08000 zk20msxs_ub_b5p1 0.0200000 5.10000 FORMAT "%7.5" /end CHARACTERISTIC
/begin CHARACTERISTIC ZKNSU "" VALUE 0x800475DD KwWU8 5.08000 zk20msxs_ub_b5p1 0.0200000 5.10000 FORMAT "%7.5" /end CHARACTERISTIC
/begin CHARACTERISTIC ZKRNGFIL "" VALUE 0x80046674 KwWU8 0.9922 fak_ub_b1 0.003906 0.9961 /end CHARACTERISTIC
/begin CHARACTERISTIC ZLBTS "" VALUE 0x8004710A KwWU16 6553.4999985 zk100msxs_uw_b6553p6 0.10000152590 6553.6000000 FORMAT "%12.7" /end CHARACTERISTIC
/begin MEASUREMENT akrgz "" UBYTE dez 1 100 0.00 254.0 FORMAT "%5.1" ECU_ADDRESS 0xD0000D79 /end MEASUREMENT
/begin MEASUREMENT akrlz "" UBYTE dez 1 100 0.00 254.0 FORMAT "%5.1" ECU_ADDRESS 0xD0000D7A /end MEASUREMENT
/begin MEASUREMENT AngZotTicks "" ULONG AngleCrS 1 100 0.00 94371839.9781 FORMAT "%13.4" ARRAY_SIZE 3 ECU_ADDRESS 0xD0002244 /end MEASUREMENT
/begin MEASUREMENT anzesab_w "" UWORD dez 1 100 0.00 65535.00 FORMAT "%8.2" ECU_ADDRESS 0xD00007D4 /end MEASUREMENT
/begin MEASUREMENT anzti "" UBYTE dez 1 100 0.00 255.0 FORMAT "%5.1" ECU_ADDRESS 0xD0000D3C /end MEASUREMENT
/begin MEASUREMENT anztib "" UBYTE dez 1 100 0.00 255.0 FORMAT "%5.1" ECU_ADDRESS 0xD0000D3D /end MEASUREMENT
/begin MEASUREMENT anztib0_w "" UWORD dez 1 100 0.00 65535.00 FORMAT "%8.2" ECU_ADDRESS 0xD000087A /end MEASUREMENT
/begin MEASUREMENT anztib1_w "" UWORD dez 1 100 0.00 65535.00 FORMAT "%8.2" ECU_ADDRESS 0xD0000882 /end MEASUREMENT
/begin MEASUREMENT anztib_w "" UWORD dez 1 100 0.00 65535.00 FORMAT "%8.2" ECU_ADDRESS 0xD00007D6 /end MEASUREMENT
/begin MEASUREMENT anzti_w "" UWORD dez 1 100 0.00 65535.00 FORMAT "%8.2" ECU_ADDRESS 0xD00007D8 /end MEASUREMENT
/begin MEASUREMENT azoffmsk_w "" UWORD dez 1 100 0.00 65535.00 FORMAT "%8.2" ECU_ADDRESS 0xD0000B6E /end MEASUREMENT
/begin MEASUREMENT B_4wd "" UBYTE B_TRUE 1 100 0.00 1.00000000000 BIT_MASK 0x80 FORMAT "%13.11" ECU_ADDRESS 0xD0000F23 /end MEASUREMENT
/begin MEASUREMENT B_abstnl "" UBYTE B_TRUE 1 100 0.00 1.00000000000 BIT_MASK 0x8 FORMAT "%13.11" ECU_ADDRESS 0xD0000F24 /end MEASUREMENT
/begin MEASUREMENT B_adrkra "" UBYTE B_TRUE 1 100 0.00 1.00000000000 BIT_MASK 0x1 FORMAT "%13.11" ECU_ADDRESS 0xD0000F36 /end MEASUREMENT
/begin MEASUREMENT B_adrldra "" UBYTE B_TRUE 1 100 0.00 1.00000000000 BIT_MASK 0x80 FORMAT "%13.11" ECU_ADDRESS 0xD0000F35 /end MEASUREMENT
/begin MEASUREMENT B_adrlra "" UBYTE B_TRUE 1 100 0.00 1.00000000000 BIT_MASK 0x2 FORMAT "%13.11" ECU_ADDRESS 0xD0000F36 /end MEASUREMENT
/begin MEASUREMENT B_adrmdver "" UBYTE B_TRUE 1 100 0.00 1.00000000000 BIT_MASK 0x4 FORMAT "%13.11" ECU_ADDRESS 0xD0000F36 /end MEASUREMENT
/begin MEASUREMENT B_adrmsdk "" UBYTE B_TRUE 1 100 0.00 1.00000000000 BIT_MASK 0x8 FORMAT "%13.11" ECU_ADDRESS 0xD0000F36 /end MEASUREMENT
/begin MEASUREMENT B_adrsta "" UBYTE B_TRUE 1 100 0.00 1.00000000000 BIT_MASK 0x40 FORMAT "%13.11" ECU_ADDRESS 0xD0000F35 /end MEASUREMENT
/begin MEASUREMENT B_ainfgr "" UBYTE B_TRUE 1 100 0.00 1.00000000000 BIT_MASK 0x8 FORMAT "%13.11" ECU_ADDRESS 0xD0000F2D /end MEASUREMENT
/begin MEASUREMENT B_asm "" UBYTE B_TRUE 1 100 0.00 1.00000000000 BIT_MASK 0x8 FORMAT "%13.11" ECU_ADDRESS 0xD0000F23 /end MEASUREMENT
/begin MEASUREMENT B_asrfz "" UBYTE B_TRUE 1 100 0.00 1.00000000000 BIT_MASK 0x40 FORMAT "%13.11" ECU_ADDRESS 0xD0000F23 /end MEASUREMENT
/begin MEASUREMENT B_autget "" UBYTE B_TRUE 1 100 0.00 1.00000000000 BIT_MASK 0x1 FORMAT "%13.11" ECU_ADDRESS 0xD0000F23 /end MEASUREMENT
/begin MEASUREMENT B_brport "" UBYTE B_TRUE 1 100 0.00 1.00000000000 BIT_MASK 0x4 FORMAT "%13.11" ECU_ADDRESS 0xD0000F2E /end MEASUREMENT
/begin MEASUREMENT B_brufs "" UBYTE B_TRUE 1 100 0.00 1.00000000000 BIT_MASK 0x1 FORMAT "%13.11" ECU_ADDRESS 0xD0000DB7 /end MEASUREMENT
/begin MEASUREMENT B_btsnl "" UBYTE B_TRUE 1 100 0.00 1.00000000000 BIT_MASK 0x4 FORMAT "%13.11" ECU_ADDRESS 0xD0000041 /end MEASUREMENT
/begin MEASUREMENT B_canfgr "" UBYTE B_TRUE 1 100 0.00 1.00000000000 BIT_MASK 0x4 FORMAT "%13.11" ECU_ADDRESS 0xD0000F2D /end MEASUREMENT
/begin MEASUREMENT B_ccpappli "" UBYTE B_TRUE 1 100 0.00 1.00000000000 BIT_MASK 0x10 FORMAT "%13.11" ECU_ADDRESS 0xD0000070 /end MEASUREMENT
/begin MEASUREMENT B_cdaav "" UBYTE B_TRUE 1 100 0.00 1.00000000000 BIT_MASK 0x8 FORMAT "%13.11" ECU_ADDRESS 0xD0000F2B /end MEASUREMENT
/begin MEASUREMENT B_cdagr "" UBYTE B_TRUE 1 100 0.00 1.00000000000 BIT_MASK 0x20 FORMAT "%13.11" ECU_ADDRESS 0xD0000F26 /end MEASUREMENT
/begin MEASUREMENT B_cdagre "" UBYTE B_TRUE 1 100 0.00 1.00000000000 BIT_MASK 0x4 FORMAT "%13.11" ECU_ADDRESS 0xD0000F29 /end MEASUREMENT
/begin MEASUREMENT B_cdagrl "" UBYTE B_TRUE 1 100 0.00 1.00000000000 BIT_MASK 0x80 FORMAT "%13.11" ECU_ADDRESS 0xD0000F28 /end MEASUREMENT
/begin MEASUREMENT B_cdagrs "" UBYTE B_TRUE 1 100 0.00 1.00000000000 BIT_MASK 0x2 FORMAT "%13.11" ECU_ADDRESS 0xD0000F29 /end MEASUREMENT
/begin MEASUREMENT B_cdagrv "" UBYTE B_TRUE 1 100 0.00 1.00000000000 BIT_MASK 0x80 FORMAT "%13.11" ECU_ADDRESS 0xD0000F27 /end MEASUREMENT
/begin MEASUREMENT B_cdanws "" UBYTE B_TRUE 1 100 0.00 1.00000000000 BIT_MASK 0x2 FORMAT "%13.11" ECU_ADDRESS 0xD0000F28 /end MEASUREMENT
/begin MEASUREMENT B_cdatnv "" UBYTE B_TRUE 1 100 0.00 1.00000000000 BIT_MASK 0x20 FORMAT "%13.11" ECU_ADDRESS 0xD0000F27 /end MEASUREMENT
/begin MEASUREMENT B_cdatvh "" UBYTE B_TRUE 1 100 0.00 1.00000000000 BIT_MASK 0x1 FORMAT "%13.11" ECU_ADDRESS 0xD0000F27 /end MEASUREMENT
/begin MEASUREMENT B_cdatvv "" UBYTE B_TRUE 1 100 0.00 1.00000000000 BIT_MASK 0x80 FORMAT "%13.11" ECU_ADDRESS 0xD0000F2D /end MEASUREMENT
/begin MEASUREMENT B_cddmtl "" UBYTE B_TRUE 1 100 0.00 1.00000000000 BIT_MASK 0x80 FORMAT "%13.11" ECU_ADDRESS 0xD0000F2C /end MEASUREMENT
/begin MEASUREMENT B_cddpl "" UBYTE B_TRUE 1 100 0.00 1.00000000000 BIT_MASK 0x2 FORMAT "%13.11" ECU_ADDRESS 0xD0000F31 /end MEASUREMENT
/begin MEASUREMENT B_cddsbkv "" UBYTE B_TRUE 1 100 0.00 1.00000000000 BIT_MASK 0x80 FORMAT "%13.11" ECU_ADDRESS 0xD0000F25 /end MEASUREMENT
/begin MEASUREMENT B_cddst "" UBYTE B_TRUE 1 100 0.00 1.00000000000 BIT_MASK 0x4 FORMAT "%13.11" ECU_ADDRESS 0xD0000F26 /end MEASUREMENT
/begin MEASUREMENT B_cddtesk "" UBYTE B_TRUE 1 100 0.00 1.00000000000 BIT_MASK 0x40 FORMAT "%13.11" ECU_ADDRESS 0xD0000F2E /end MEASUREMENT
/begin MEASUREMENT B_cddylsf "" UBYTE B_TRUE 1 100 0.00 1.00000000000 BIT_MASK 0x10 FORMAT "%13.11" ECU_ADDRESS 0xD0000F31 /end MEASUREMENT
/begin MEASUREMENT B_cddylsh "" UBYTE B_TRUE 1 100 0.00 1.00000000000 BIT_MASK 0x1 FORMAT "%13.11" ECU_ADDRESS 0xD0000F31 /end MEASUREMENT
/begin MEASUREMENT B_cddylsu "" UBYTE B_TRUE 1 100 0.00 1.00000000000 BIT_MASK 0x1 FORMAT "%13.11" ECU_ADDRESS 0xD0000F2C /end MEASUREMENT
/begin MEASUREMENT B_cdedss "" UBYTE B_TRUE 1 100 0.00 1.00000000000 BIT_MASK 0x80 FORMAT "%13.11" ECU_ADDRESS 0xD0000F29 /end MEASUREMENT
/begin MEASUREMENT B_cdegfe "" UBYTE B_TRUE 1 100 0.00 1.00000000000 BIT_MASK 0x20 FORMAT "%13.11" ECU_ADDRESS 0xD0000F2C /end MEASUREMENT
/begin MEASUREMENT B_cdehfm "" UBYTE B_TRUE 1 100 0.00 1.00000000000 BIT_MASK 0x1 FORMAT "%13.11" ECU_ADDRESS 0xD0000F2A /end MEASUREMENT
/begin MEASUREMENT B_cdenws "" UBYTE B_TRUE 1 100 0.00 1.00000000000 BIT_MASK 0x1 FORMAT "%13.11" ECU_ADDRESS 0xD0000F28 /end MEASUREMENT
/begin MEASUREMENT B_cdeonv "" UBYTE B_TRUE 1 100 0.00 1.00000000000 BIT_MASK 0x10 FORMAT "%13.11" ECU_ADDRESS 0xD0000F2E /end MEASUREMENT
/begin MEASUREMENT B_cdfrst "" UBYTE B_TRUE 1 100 0.00 1.00000000000 BIT_MASK 0x20 FORMAT "%13.11" ECU_ADDRESS 0xD0000F35 /end MEASUREMENT
/begin MEASUREMENT B_cdftdla "" UBYTE B_TRUE 1 100 0.00 1.00000000000 BIT_MASK 0x40 FORMAT "%13.11" ECU_ADDRESS 0xD0000F2C /end MEASUREMENT
/begin MEASUREMENT B_cdgts "" UBYTE B_TRUE 1 100 0.00 1.00000000000 BIT_MASK 0x40 FORMAT "%13.11" ECU_ADDRESS 0xD0000F2A /end MEASUREMENT
/begin MEASUREMENT B_cdhelsu "" UBYTE B_TRUE 1 100 0.00 1.00000000000 BIT_MASK 0x2 FORMAT "%13.11" ECU_ADDRESS 0xD0000F2C /end MEASUREMENT
/begin MEASUREMENT B_cdhnohk "" UBYTE B_TRUE 1 100 0.00 1.00000000000 BIT_MASK 0x8 FORMAT "%13.11" ECU_ADDRESS 0xD0000F29 /end MEASUREMENT
/begin MEASUREMENT B_cdhnohke "" UBYTE B_TRUE 1 100 0.00 1.00000000000 BIT_MASK 0x10 FORMAT "%13.11" ECU_ADDRESS 0xD0000F29 /end MEASUREMENT
/begin MEASUREMENT B_cdhsf "" UBYTE B_TRUE 1 100 0.00 1.00000000000 BIT_MASK 0x20 FORMAT "%13.11" ECU_ADDRESS 0xD0000F2B /end MEASUREMENT
/begin MEASUREMENT B_cdhsfe "" UBYTE B_TRUE 1 100 0.00 1.00000000000 BIT_MASK 0x40 FORMAT "%13.11" ECU_ADDRESS 0xD0000F2B /end MEASUREMENT
/begin MEASUREMENT B_cdhsh "" UBYTE B_TRUE 1 100 0.00 1.00000000000 BIT_MASK 0x4 FORMAT "%13.11" ECU_ADDRESS 0xD0000F27 /end MEASUREMENT
/begin MEASUREMENT B_cdhshe "" UBYTE B_TRUE 1 100 0.00 1.00000000000 BIT_MASK 0x1 FORMAT "%13.11" ECU_ADDRESS 0xD0000F29 /end MEASUREMENT
/begin MEASUREMENT B_cdhsv "" UBYTE B_TRUE 1 100 0.00 1.00000000000 BIT_MASK 0x40 FORMAT "%13.11" ECU_ADDRESS 0xD0000F38 /end MEASUREMENT
/begin MEASUREMENT B_cdhsvsa "" UBYTE B_TRUE 1 100 0.00 1.00000000000 BIT_MASK 0x20 FORMAT "%13.11" ECU_ADDRESS 0xD0000F25 /end MEASUREMENT
/begin MEASUREMENT B_cdiclsu "" UBYTE B_TRUE 1 100 0.00 1.00000000000 BIT_MASK 0x4 FORMAT "%13.11" ECU_ADDRESS 0xD0000F2C /end MEASUREMENT
/begin MEASUREMENT B_cdkat "" UBYTE B_TRUE 1 100 0.00 1.00000000000 BIT_MASK 0x8 FORMAT "%13.11" ECU_ADDRESS 0xD0000F27 /end MEASUREMENT
/begin MEASUREMENT B_cdkatno "" UBYTE B_TRUE 1 100 0.00 1.00000000000 BIT_MASK 0x40 FORMAT "%13.11" ECU_ADDRESS 0xD0000F2F /end MEASUREMENT
/begin MEASUREMENT B_cdkatsp "" UBYTE B_TRUE 1 100 0.00 1.00000000000 BIT_MASK 0x8 FORMAT "%13.11" ECU_ADDRESS 0xD0000F2A /end MEASUREMENT
/begin MEASUREMENT B_cdkatspf "" UBYTE B_TRUE 1 100 0.00 1.00000000000 BIT_MASK 0x20 FORMAT "%13.11" ECU_ADDRESS 0xD0000F2A /end MEASUREMENT
/begin MEASUREMENT B_cdkatspt "" UBYTE B_TRUE 1 100 0.00 1.00000000000 BIT_MASK 0x10 FORMAT "%13.11" ECU_ADDRESS 0xD0000F2A /end MEASUREMENT
/begin MEASUREMENT B_cdkvs "" UBYTE B_TRUE 1 100 0.00 1.00000000000 BIT_MASK 0x40 FORMAT "%13.11" ECU_ADDRESS 0xD0000F25 /end MEASUREMENT
/begin MEASUREMENT B_cdkvscmb "" UBYTE B_TRUE 1 100 0.00 1.00000000000 BIT_MASK 0x10 FORMAT "%13.11" ECU_ADDRESS 0xD0000F30 /end MEASUREMENT
/begin MEASUREMENT B_cdlasf "" UBYTE B_TRUE 1 100 0.00 1.00000000000 BIT_MASK 0x1 FORMAT "%13.11" ECU_ADDRESS 0xD0000F26 /end MEASUREMENT
/begin MEASUREMENT B_cdlash "" UBYTE B_TRUE 1 100 0.00 1.00000000000 BIT_MASK 0x4 FORMAT "%13.11" ECU_ADDRESS 0xD0000F25 /end MEASUREMENT
/begin MEASUREMENT B_cdlatp "" UBYTE B_TRUE 1 100 0.00 1.00000000000 BIT_MASK 0x10 FORMAT "%13.11" ECU_ADDRESS 0xD0000F25 /end MEASUREMENT
/begin MEASUREMENT B_cdlatv "" UBYTE B_TRUE 1 100 0.00 1.00000000000 BIT_MASK 0x8 FORMAT "%13.11" ECU_ADDRESS 0xD0000F25 /end MEASUREMENT
/begin MEASUREMENT B_cdlbk "" UBYTE B_TRUE 1 100 0.00 1.00000000000 BIT_MASK 0x10 FORMAT "%13.11" ECU_ADDRESS 0xD0000F28 /end MEASUREMENT
/begin MEASUREMENT B_cdlbkf "" UBYTE B_TRUE 1 100 0.00 1.00000000000 BIT_MASK 0x2 FORMAT "%13.11" ECU_ADDRESS 0xD0000F27 /end MEASUREMENT
/begin MEASUREMENT B_cdlbko "" UBYTE B_TRUE 1 100 0.00 1.00000000000 BIT_MASK 0x20 FORMAT "%13.11" ECU_ADDRESS 0xD0000F28 /end MEASUREMENT
/begin MEASUREMENT B_cdlbkp "" UBYTE B_TRUE 1 100 0.00 1.00000000000 BIT_MASK 0x40 FORMAT "%13.11" ECU_ADDRESS 0xD0000F28 /end MEASUREMENT
/begin MEASUREMENT B_cdldp "" UBYTE B_TRUE 1 100 0.00 1.00000000000 BIT_MASK 0x10 FORMAT "%13.11" ECU_ADDRESS 0xD0000F26 /end MEASUREMENT
/begin MEASUREMENT B_cdllr "" UBYTE B_TRUE 1 100 0.00 1.00000000000 BIT_MASK 0x8 FORMAT "%13.11" ECU_ADDRESS 0xD0000F28 /end MEASUREMENT
/begin MEASUREMENT B_cdllrkh "" UBYTE B_TRUE 1 100 0.00 1.00000000000 BIT_MASK 0x4 FORMAT "%13.11" ECU_ADDRESS 0xD0000F28 /end MEASUREMENT
/begin MEASUREMENT B_cdlsf "" UBYTE B_TRUE 1 100 0.00 1.00000000000 BIT_MASK 0x10 FORMAT "%13.11" ECU_ADDRESS 0xD0000F2B /end MEASUREMENT
/begin MEASUREMENT B_cdlsh "" UBYTE B_TRUE 1 100 0.00 1.00000000000 BIT_MASK 0x20 FORMAT "%13.11" ECU_ADDRESS 0xD0000F38 /end MEASUREMENT
/begin MEASUREMENT B_cdlsv "" UBYTE B_TRUE 1 100 0.00 1.00000000000 BIT_MASK 0x10 FORMAT "%13.11" ECU_ADDRESS 0xD0000F38 /end MEASUREMENT
/begin MEASUREMENT B_cdlsve "" UBYTE B_TRUE 1 100 0.00 1.00000000000 BIT_MASK 0x20 FORMAT "%13.11" ECU_ADDRESS 0xD0000F30 /end MEASUREMENT
/begin MEASUREMENT B_cdlsvst "" UBYTE B_TRUE 1 100 0.00 1.00000000000 BIT_MASK 0x80 FORMAT "%13.11" ECU_ADDRESS 0xD0000F38 /end MEASUREMENT
/begin MEASUREMENT B_cdmd "" UBYTE B_TRUE 1 100 0.00 1.00000000000 BIT_MASK 0x4 FORMAT "%13.11" ECU_ADDRESS 0xD0000F38 /end MEASUREMENT
/begin MEASUREMENT B_cdmkats "" UBYTE B_TRUE 1 100 0.00 1.00000000000 BIT_MASK 0x8 FORMAT "%13.11" ECU_ADDRESS 0xD0000F31 /end MEASUREMENT
/begin MEASUREMENT B_cdnohk "" UBYTE B_TRUE 1 100 0.00 1.00000000000 BIT_MASK 0x20 FORMAT "%13.11" ECU_ADDRESS 0xD0000F29 /end MEASUREMENT
/begin MEASUREMENT B_cdnohkp "" UBYTE B_TRUE 1 100 0.00 1.00000000000 BIT_MASK 0x4 FORMAT "%13.11" ECU_ADDRESS 0xD0000F2B /end MEASUREMENT
/begin MEASUREMENT B_cdnolsu "" UBYTE B_TRUE 1 100 0.00 1.00000000000 BIT_MASK 0x4 FORMAT "%13.11" ECU_ADDRESS 0xD0000F30 /end MEASUREMENT
/begin MEASUREMENT B_cdnws "" UBYTE B_TRUE 1 100 0.00 1.00000000000 BIT_MASK 0x10 FORMAT "%13.11" ECU_ADDRESS 0xD0000F27 /end MEASUREMENT
/begin MEASUREMENT B_cdpllsu "" UBYTE B_TRUE 1 100 0.00 1.00000000000 BIT_MASK 0x8 FORMAT "%13.11" ECU_ADDRESS 0xD0000F2C /end MEASUREMENT
/begin MEASUREMENT B_cdrhsh "" UBYTE B_TRUE 1 100 0.00 1.00000000000 BIT_MASK 0x80 FORMAT "%13.11" ECU_ADDRESS 0xD0000F30 /end MEASUREMENT
/begin MEASUREMENT B_cdsalsu "" UBYTE B_TRUE 1 100 0.00 1.00000000000 BIT_MASK 0x80 FORMAT "%13.11" ECU_ADDRESS 0xD0000F2B /end MEASUREMENT
/begin MEASUREMENT B_cdskno "" UBYTE B_TRUE 1 100 0.00 1.00000000000 BIT_MASK 0x40 FORMAT "%13.11" ECU_ADDRESS 0xD0000F29 /end MEASUREMENT
/begin MEASUREMENT B_cdsls "" UBYTE B_TRUE 1 100 0.00 1.00000000000 BIT_MASK 0x40 FORMAT "%13.11" ECU_ADDRESS 0xD0000F26 /end MEASUREMENT
/begin MEASUREMENT B_cdslse "" UBYTE B_TRUE 1 100 0.00 1.00000000000 BIT_MASK 0x80 FORMAT "%13.11" ECU_ADDRESS 0xD0000F26 /end MEASUREMENT
/begin MEASUREMENT B_cdswe "" UBYTE B_TRUE 1 100 0.00 1.00000000000 BIT_MASK 0x8 FORMAT "%13.11" ECU_ADDRESS 0xD0000F38 /end MEASUREMENT
/begin MEASUREMENT B_cdtabkom "" UBYTE B_TRUE 1 100 0.00 1.00000000000 BIT_MASK 0x4 FORMAT "%13.11" ECU_ADDRESS 0xD0000F31 /end MEASUREMENT
/begin MEASUREMENT B_cdtankl "" UBYTE B_TRUE 1 100 0.00 1.00000000000 BIT_MASK 0x1 FORMAT "%13.11" ECU_ADDRESS 0xD0000F25 /end MEASUREMENT
/begin MEASUREMENT B_cdtes "" UBYTE B_TRUE 1 100 0.00 1.00000000000 BIT_MASK 0x8 FORMAT "%13.11" ECU_ADDRESS 0xD0000F26 /end MEASUREMENT
/begin MEASUREMENT B_cdtka "" UBYTE B_TRUE 1 100 0.00 1.00000000000 BIT_MASK 0x20 FORMAT "%13.11" ECU_ADDRESS 0xD0000F2E /end MEASUREMENT
/begin MEASUREMENT B_cdulsu "" UBYTE B_TRUE 1 100 0.00 1.00000000000 BIT_MASK 0x10 FORMAT "%13.11" ECU_ADDRESS 0xD0000F2C /end MEASUREMENT
/begin MEASUREMENT B_cdvkt "" UBYTE B_TRUE 1 100 0.00 1.00000000000 BIT_MASK 0x40 FORMAT "%13.11" ECU_ADDRESS 0xD0000F27 /end MEASUREMENT
/begin MEASUREMENT B_cvt "" UBYTE B_TRUE 1 100 0.00 1.00000000000 BIT_MASK 0x4 FORMAT "%13.11" ECU_ADDRESS 0xD0000F23 /end MEASUREMENT
/begin MEASUREMENT B_cwagrap "" UBYTE B_TRUE 1 100 0.00 1.00000000000 BIT_MASK 0x80 FORMAT "%13.11" ECU_ADDRESS 0xD0000F36 /end MEASUREMENT
/begin MEASUREMENT B_cwagrh "" UBYTE B_TRUE 1 100 0.00 1.00000000000 BIT_MASK 0x10 FORMAT "%13.11" ECU_ADDRESS 0xD0000F36 /end MEASUREMENT
/begin MEASUREMENT B_cwagrhap "" UBYTE B_TRUE 1 100 0.00 1.00000000000 BIT_MASK 0x1 FORMAT "%13.11" ECU_ADDRESS 0xD0000F37 /end MEASUREMENT
/begin MEASUREMENT B_cwagrlsr "" UBYTE B_TRUE 1 100 0.00 1.00000000000 BIT_MASK 0x40 FORMAT "%13.11" ECU_ADDRESS 0xD0000F36 /end MEASUREMENT
/begin MEASUREMENT B_cwagrs "" UBYTE B_TRUE 1 100 0.00 1.00000000000 BIT_MASK 0x20 FORMAT "%13.11" ECU_ADDRESS 0xD0000F36 /end MEASUREMENT
/begin MEASUREMENT B_cwlsfdyn "" UBYTE B_TRUE 1 100 0.00 1.00000000000 BIT_MASK 0x2 FORMAT "%13.11" ECU_ADDRESS 0xD0000F33 /end MEASUREMENT
/begin MEASUREMENT B_cwlsfoff "" UBYTE B_TRUE 1 100 0.00 1.00000000000 BIT_MASK 0x20 FORMAT "%13.11" ECU_ADDRESS 0xD0000F33 /end MEASUREMENT
/begin MEASUREMENT B_cwlsfsch "" UBYTE B_TRUE 1 100 0.00 1.00000000000 BIT_MASK 0x1 FORMAT "%13.11" ECU_ADDRESS 0xD0000F33 /end MEASUREMENT
/begin MEASUREMENT B_cwlsfvl "" UBYTE B_TRUE 1 100 0.00 1.00000000000 BIT_MASK 0x10 FORMAT "%13.11" ECU_ADDRESS 0xD0000F33 /end MEASUREMENT
/begin MEASUREMENT B_cwlshdyn "" UBYTE B_TRUE 1 100 0.00 1.00000000000 BIT_MASK 0x2 FORMAT "%13.11" ECU_ADDRESS 0xD0000F32 /end MEASUREMENT
/begin MEASUREMENT B_cwlshsch "" UBYTE B_TRUE 1 100 0.00 1.00000000000 BIT_MASK 0x1 FORMAT "%13.11" ECU_ADDRESS 0xD0000F32 /end MEASUREMENT
/begin MEASUREMENT B_cwlshvl "" UBYTE B_TRUE 1 100 0.00 1.00000000000 BIT_MASK 0x10 FORMAT "%13.11" ECU_ADDRESS 0xD0000F32 /end MEASUREMENT
/begin MEASUREMENT B_cwsfndyn "" UBYTE B_TRUE 1 100 0.00 1.00000000000 BIT_MASK 0x8 FORMAT "%13.11" ECU_ADDRESS 0xD0000F33 /end MEASUREMENT
/begin MEASUREMENT B_cwsfnsch "" UBYTE B_TRUE 1 100 0.00 1.00000000000 BIT_MASK 0x4 FORMAT "%13.11" ECU_ADDRESS 0xD0000F33 /end MEASUREMENT
/begin MEASUREMENT B_cwslow "" UBYTE B_TRUE 1 100 0.00 1.00000000000 BIT_MASK 0x40 FORMAT "%13.11" ECU_ADDRESS 0xD0000F32 /end MEASUREMENT
/begin MEASUREMENT B_cwsnodyn "" UBYTE B_TRUE 1 100 0.00 1.00000000000 BIT_MASK 0x8 FORMAT "%13.11" ECU_ADDRESS 0xD0000F32 /end MEASUREMENT
/begin MEASUREMENT B_cwsnosch "" UBYTE B_TRUE 1 100 0.00 1.00000000000 BIT_MASK 0x4 FORMAT "%13.11" ECU_ADDRESS 0xD0000F32 /end MEASUREMENT
/begin MEASUREMENT B_cwsnslow "" UBYTE B_TRUE 1 100 0.00 1.00000000000 BIT_MASK 0x20 FORMAT "%13.11" ECU_ADDRESS 0xD0000F32 /end MEASUREMENT
/begin MEASUREMENT B_cwzgst "" UBYTE B_TRUE 1 100 0.00 1.00000000000 BIT_MASK 0x2 FORMAT "%13.11" ECU_ADDRESS 0xD0000F2E /end MEASUREMENT
/begin MEASUREMENT B_dinfgr "" UBYTE B_TRUE 1 100 0.00 1.00000000000 BIT_MASK 0x10 FORMAT "%13.11" ECU_ADDRESS 0xD0000F2D /end MEASUREMENT
/begin MEASUREMENT B_dkg "" UBYTE B_TRUE 1 100 0.00 1.00000000000 BIT_MASK 0x10 FORMAT "%13.11" ECU_ADDRESS 0xD0000F23 /end MEASUREMENT
/begin MEASUREMENT B_dslafa "" UBYTE B_TRUE 1 100 0.00 1.00000000000 BIT_MASK 0x2 FORMAT "%13.11" ECU_ADDRESS 0xD0000041 /end MEASUREMENT
/begin MEASUREMENT B_dslvh "" UBYTE B_TRUE 1 100 0.00 1.00000000000 BIT_MASK 0x1 FORMAT "%13.11" ECU_ADDRESS 0xD0000F34 /end MEASUREMENT
/begin MEASUREMENT B_dssv "" UBYTE B_TRUE 1 100 0.00 1.00000000000 BIT_MASK 0x80 FORMAT "%13.11" ECU_ADDRESS 0xD0000F33 /end MEASUREMENT
/begin MEASUREMENT B_dsuv "" UBYTE B_TRUE 1 100 0.00 1.00000000000 BIT_MASK 0x2 FORMAT "%13.11" ECU_ADDRESS 0xD0000F34 /end MEASUREMENT
/begin MEASUREMENT B_dsvap "" UWORD B_TRUE 1 100 0.00 1.00000000000 BIT_MASK 0x1000 FORMAT "%13.11" ECU_ADDRESS 0xD0000B5A /end MEASUREMENT
/begin MEASUREMENT B_elzmn "" UBYTE B_TRUE 1 100 0.00 1.00000000000 BIT_MASK 0x1 FORMAT "%13.11" ECU_ADDRESS 0xD0000041 /end MEASUREMENT
/begin MEASUREMENT B_enllri "" UBYTE B_TRUE 1 100 0.00 1.00000000000 BIT_MASK 0x1 FORMAT "%13.11" ECU_ADDRESS 0xD0000079 /end MEASUREMENT
/begin MEASUREMENT B_esbhap "" UWORD B_TRUE 1 100 0.00 1.00000000000 BIT_MASK 0x400 FORMAT "%13.11" ECU_ADDRESS 0xD0000B5A /end MEASUREMENT
/begin MEASUREMENT B_esbkhap "" UWORD B_TRUE 1 100 0.00 1.00000000000 BIT_MASK 0x100 FORMAT "%13.11" ECU_ADDRESS 0xD0000B5A /end MEASUREMENT
/begin MEASUREMENT B_esbsap "" UWORD B_TRUE 1 100 0.00 1.00000000000 BIT_MASK 0x200 FORMAT "%13.11" ECU_ADDRESS 0xD0000B5A /end MEASUREMENT
/begin MEASUREMENT B_esesap "" UWORD B_TRUE 1 100 0.00 1.00000000000 BIT_MASK 0x4000 FORMAT "%13.11" ECU_ADDRESS 0xD0000B5A /end MEASUREMENT
/begin MEASUREMENT B_etsport "" UBYTE B_TRUE 1 100 0.00 1.00000000000 BIT_MASK 0x8 FORMAT "%13.11" ECU_ADDRESS 0xD0000F2E /end MEASUREMENT
/begin MEASUREMENT B_fglahmm "" UBYTE B_TRUE 1 100 0.00 1.00000000000 BIT_MASK 0x4 FORMAT "%13.11" ECU_ADDRESS 0xD0000F35 /end MEASUREMENT
/begin MEASUREMENT B_fgzwhmmc "" UBYTE B_TRUE 1 100 0.00 1.00000000000 BIT_MASK 0x1 FORMAT "%13.11" ECU_ADDRESS 0xD0000F35 /end MEASUREMENT
/begin MEASUREMENT B_firstSyn "" UBYTE B_TRUE 1 100 0.00 1.00000000000 BIT_MASK 0x1 FORMAT "%13.11" ECU_ADDRESS 0xD0000065 /end MEASUREMENT
/begin MEASUREMENT B_fpwdkap "" UBYTE B_TRUE 1 100 0.00 1.00000000000 BIT_MASK 0x8 FORMAT "%13.11" ECU_ADDRESS 0xD0000F34 /end MEASUREMENT
/begin MEASUREMENT B_fuabts "" UBYTE B_TRUE 1 100 0.00 1.00000000000 BIT_MASK 0x80 FORMAT "%13.11" ECU_ADDRESS 0xD000005D /end MEASUREMENT
/begin MEASUREMENT B_gra6p "" UBYTE B_TRUE 1 100 0.00 1.00000000000 BIT_MASK 0x10 FORMAT "%13.11" ECU_ADDRESS 0xD0000F37 /end MEASUREMENT
/begin MEASUREMENT B_gracan "" UBYTE B_TRUE 1 100 0.00 1.00000000000 BIT_MASK 0x8 FORMAT "%13.11" ECU_ADDRESS 0xD0000F37 /end MEASUREMENT
/begin MEASUREMENT B_hfmv "" UBYTE B_TRUE 1 100 0.00 1.00000000000 BIT_MASK 0x40 FORMAT "%13.11" ECU_ADDRESS 0xD0000F33 /end MEASUREMENT
/begin MEASUREMENT B_hmmlb "" UBYTE B_TRUE 1 100 0.00 1.00000000000 BIT_MASK 0x2 FORMAT "%13.11" ECU_ADDRESS 0xD0000F35 /end MEASUREMENT
/begin MEASUREMENT B_hspmd "" UBYTE B_TRUE 1 100 0.00 1.00000000000 BIT_MASK 0x10 FORMAT "%13.11" ECU_ADDRESS 0xD0000F35 /end MEASUREMENT
/begin MEASUREMENT B_ignpsol "" UBYTE B_TRUE 1 100 0.00 1.00000000000 BIT_MASK 0x4 FORMAT "%13.11" ECU_ADDRESS 0xD0000D3B /end MEASUREMENT
/begin MEASUREMENT B_ignpsscb "" UBYTE B_TRUE 1 100 0.00 1.00000000000 BIT_MASK 0x1 FORMAT "%13.11" ECU_ADDRESS 0xD0000D3B /end MEASUREMENT
/begin MEASUREMENT B_ignpsscg "" UBYTE B_TRUE 1 100 0.00 1.00000000000 BIT_MASK 0x2 FORMAT "%13.11" ECU_ADDRESS 0xD0000D3B /end MEASUREMENT
/begin MEASUREMENT B_katfz "" UBYTE B_TRUE 1 100 0.00 1.00000000000 BIT_MASK 0x4 FORMAT "%13.11" ECU_ADDRESS 0xD0000F2F /end MEASUREMENT
/begin MEASUREMENT B_kath "" UBYTE B_TRUE 1 100 0.00 1.00000000000 BIT_MASK 0x8 FORMAT "%13.11" ECU_ADDRESS 0xD0000F2F /end MEASUREMENT
/begin MEASUREMENT B_kl "" UBYTE B_TRUE 1 100 0.00 1.00000000000 BIT_MASK 0x1 FORMAT "%13.11" ECU_ADDRESS 0xD0000086 /end MEASUREMENT
/begin MEASUREMENT B_kldynrm "" UBYTE B_TRUE 1 100 0.00 1.00000000000 BIT_MASK 0x8 FORMAT "%13.11" ECU_ADDRESS 0xD0000040 /end MEASUREMENT
/begin MEASUREMENT B_kldystk "" UBYTE B_TRUE 1 100 0.00 1.00000000000 BIT_MASK 0x4 FORMAT "%13.11" ECU_ADDRESS 0xD0000040 /end MEASUREMENT
/begin MEASUREMENT B_klima "" UBYTE B_TRUE 1 100 0.00 1.00000000000 BIT_MASK 0x20 FORMAT "%13.11" ECU_ADDRESS 0xD0000F2F /end MEASUREMENT
/begin MEASUREMENT B_kmmilsct "" UBYTE B_TRUE 1 100 0.00 1.00000000000 BIT_MASK 0x80 FORMAT "%13.11" ECU_ADDRESS 0xD0000F37 /end MEASUREMENT
/begin MEASUREMENT B_koevab "" UBYTE B_TRUE 1 100 0.00 1.00000000000 BIT_MASK 0x10 FORMAT "%13.11" ECU_ADDRESS 0xD000008C /end MEASUREMENT
/begin MEASUREMENT B_krdwslz "" UBYTE B_TRUE 1 100 0.00 1.00000000000 BIT_MASK 0x10 FORMAT "%13.11" ECU_ADDRESS 0xD0000091 /end MEASUREMENT
/begin MEASUREMENT B_krlz "" UBYTE B_TRUE 1 100 0.00 1.00000000000 BIT_MASK 0x10 FORMAT "%13.11" ECU_ADDRESS 0xD0000040 /end MEASUREMENT
/begin MEASUREMENT B_krvf "" UBYTE B_TRUE 1 100 0.00 1.00000000000 BIT_MASK 0x1 FORMAT "%13.11" ECU_ADDRESS 0xD000005B /end MEASUREMENT
/begin MEASUREMENT B_lalgf "" UBYTE B_TRUE 1 100 0.00 1.00000000000 BIT_MASK 0x1 FORMAT "%13.11" ECU_ADDRESS 0xD0000061 /end MEASUREMENT
/begin MEASUREMENT B_lambts "" UBYTE B_TRUE 1 100 0.00 1.00000000000 BIT_MASK 0x10 FORMAT "%13.11" ECU_ADDRESS 0xD000007B /end MEASUREMENT
/begin MEASUREMENT B_lamdiag "" UBYTE B_TRUE 1 100 0.00 1.00000000000 BIT_MASK 0x40 FORMAT "%13.11" ECU_ADDRESS 0xD000007B /end MEASUREMENT
/begin MEASUREMENT B_lamhap "" UWORD B_TRUE 1 100 0.00 1.00000000000 BIT_MASK 0x2000 FORMAT "%13.11" ECU_ADDRESS 0xD0000B5A /end MEASUREMENT
/begin MEASUREMENT B_lamkh "" UBYTE B_TRUE 1 100 0.00 1.00000000000 BIT_MASK 0x2 FORMAT "%13.11" ECU_ADDRESS 0xD000008E /end MEASUREMENT
/begin MEASUREMENT B_lamkhe "" UBYTE B_TRUE 1 100 0.00 1.00000000000 BIT_MASK 0x4 FORMAT "%13.11" ECU_ADDRESS 0xD000008F /end MEASUREMENT
/begin MEASUREMENT B_lamnswl "" UBYTE B_TRUE 1 100 0.00 1.00000000000 BIT_MASK 0x20 FORMAT "%13.11" ECU_ADDRESS 0xD000006F /end MEASUREMENT
/begin MEASUREMENT B_lamsdef "" UBYTE B_TRUE 1 100 0.00 1.00000000000 BIT_MASK 0x40 FORMAT "%13.11" ECU_ADDRESS 0xD000008B /end MEASUREMENT
/begin MEASUREMENT B_lawlon "" UBYTE B_TRUE 1 100 0.00 1.00000000000 BIT_MASK 0x1 FORMAT "%13.11" ECU_ADDRESS 0xD0000042 /end MEASUREMENT
/begin MEASUREMENT B_lbtsatm "" UBYTE B_TRUE 1 100 0.00 1.00000000000 BIT_MASK 0x8 FORMAT "%13.11" ECU_ADDRESS 0xD0000041 /end MEASUREMENT
/begin MEASUREMENT B_lbtsbg "" UBYTE B_TRUE 1 100 0.00 1.00000000000 BIT_MASK 0x20 FORMAT "%13.11" ECU_ADDRESS 0xD0000041 /end MEASUREMENT
/begin MEASUREMENT B_ldef "" UBYTE B_TRUE 1 100 0.00 1.00000000000 BIT_MASK 0x40 FORMAT "%13.11" ECU_ADDRESS 0xD0000041 /end MEASUREMENT
/begin MEASUREMENT B_ldsafw "" UBYTE B_TRUE 1 100 0.00 1.00000000000 BIT_MASK 0x40 FORMAT "%13.11" ECU_ADDRESS 0xD0000F34 /end MEASUREMENT
/begin MEASUREMENT B_ldsapp "" UBYTE B_TRUE 1 100 0.00 1.00000000000 BIT_MASK 0x20 FORMAT "%13.11" ECU_ADDRESS 0xD0000F34 /end MEASUREMENT
/begin MEASUREMENT B_llr "" UBYTE B_TRUE 1 100 0.00 1.00000000000 BIT_MASK 0x2 FORMAT "%13.11" ECU_ADDRESS 0xD000006D /end MEASUREMENT
/begin MEASUREMENT B_llrein "" UBYTE B_TRUE 1 100 0.00 1.00000000000 BIT_MASK 0x2 FORMAT "%13.11" ECU_ADDRESS 0xD0000070 /end MEASUREMENT
/begin MEASUREMENT B_llri "" UBYTE B_TRUE 1 100 0.00 1.00000000000 BIT_MASK 0x4 FORMAT "%13.11" ECU_ADDRESS 0xD0000085 /end MEASUREMENT
/begin MEASUREMENT B_llrpd "" UBYTE B_TRUE 1 100 0.00 1.00000000000 BIT_MASK 0x10 FORMAT "%13.11" ECU_ADDRESS 0xD000006C /end MEASUREMENT
/begin MEASUREMENT B_lsf "" UBYTE B_TRUE 1 100 0.00 1.00000000000 BIT_MASK 0x40 FORMAT "%13.11" ECU_ADDRESS 0xD0000F24 /end MEASUREMENT
/begin MEASUREMENT B_lsf2 "" UBYTE B_TRUE 1 100 0.00 1.00000000000 BIT_MASK 0x2 FORMAT "%13.11" ECU_ADDRESS 0xD0000F2F /end MEASUREMENT
/begin MEASUREMENT B_lsh "" UBYTE B_TRUE 1 100 0.00 1.00000000000 BIT_MASK 0x20 FORMAT "%13.11" ECU_ADDRESS 0xD0000F24 /end MEASUREMENT
/begin MEASUREMENT B_lsh2 "" UBYTE B_TRUE 1 100 0.00 1.00000000000 BIT_MASK 0x1 FORMAT "%13.11" ECU_ADDRESS 0xD0000F2F /end MEASUREMENT
/begin MEASUREMENT B_lsv "" UBYTE B_TRUE 1 100 0.00 1.00000000000 BIT_MASK 0x10 FORMAT "%13.11" ECU_ADDRESS 0xD0000F24 /end MEASUREMENT
/begin MEASUREMENT B_lsv2 "" UBYTE B_TRUE 1 100 0.00 1.00000000000 BIT_MASK 0x80 FORMAT "%13.11" ECU_ADDRESS 0xD0000F24 /end MEASUREMENT
/begin MEASUREMENT B_lzup "" UBYTE B_TRUE 1 100 0.00 1.00000000000 BIT_MASK 0x80 FORMAT "%13.11" ECU_ADDRESS 0xD0000040 /end MEASUREMENT
/begin MEASUREMENT B_mde8e "" UBYTE B_TRUE 1 100 0.00 1.00000000000 BIT_MASK 0x20 FORMAT "%13.11" ECU_ADDRESS 0xD0000F37 /end MEASUREMENT
/begin MEASUREMENT B_mde9e "" UBYTE B_TRUE 1 100 0.00 1.00000000000 BIT_MASK 0x40 FORMAT "%13.11" ECU_ADDRESS 0xD0000F37 /end MEASUREMENT
/begin MEASUREMENT B_mdvur "" UBYTE B_TRUE 1 100 0.00 1.00000000000 BIT_MASK 0x8 FORMAT "%13.11" ECU_ADDRESS 0xD0000F35 /end MEASUREMENT
/begin MEASUREMENT B_mt "" UBYTE B_TRUE 1 100 0.00 1.00000000000 BIT_MASK 0x2 FORMAT "%13.11" ECU_ADDRESS 0xD0000F23 /end MEASUREMENT
/begin MEASUREMENT B_ndsav "" UBYTE B_TRUE 1 100 0.00 1.00000000000 BIT_MASK 0x2 FORMAT "%13.11" ECU_ADDRESS 0xD0000F2D /end MEASUREMENT
/begin MEASUREMENT B_niveau "" UBYTE B_TRUE 1 100 0.00 1.00000000000 BIT_MASK 0x20 FORMAT "%13.11" ECU_ADDRESS 0xD0000F23 /end MEASUREMENT
/begin MEASUREMENT B_nllstab "" UBYTE B_TRUE 1 100 0.00 1.00000000000 BIT_MASK 0x40 FORMAT "%13.11" ECU_ADDRESS 0xD0000055 /end MEASUREMENT
/begin MEASUREMENT B_nsolst "" UBYTE B_TRUE 1 100 0.00 1.00000000000 BIT_MASK 0x40 FORMAT "%13.11" ECU_ADDRESS 0xD0000057 /end MEASUREMENT
/begin MEASUREMENT B_nstu "" UBYTE B_TRUE 1 100 0.00 1.00000000000 BIT_MASK 0x8 FORMAT "%13.11" ECU_ADDRESS 0xD000007F /end MEASUREMENT
/begin MEASUREMENT B_nswo1 "" UBYTE B_TRUE 1 100 0.00 1.00000000000 BIT_MASK 0x1 FORMAT "%13.11" ECU_ADDRESS 0xD0000F38 /end MEASUREMENT
/begin MEASUREMENT B_nswo2 "" UBYTE B_TRUE 1 100 0.00 1.00000000000 BIT_MASK 0x2 FORMAT "%13.11" ECU_ADDRESS 0xD0000F38 /end MEASUREMENT
/begin MEASUREMENT B_plsolap "" UBYTE B_TRUE 1 100 0.00 1.00000000000 BIT_MASK 0x80 FORMAT "%13.11" ECU_ADDRESS 0xD0000F34 /end MEASUREMENT
/begin MEASUREMENT B_png "" UBYTE B_TRUE 1 100 0.00 1.00000000000 BIT_MASK 0x40 FORMAT "%13.11" ECU_ADDRESS 0xD0000F30 /end MEASUREMENT
/begin MEASUREMENT B_prsolap "" UWORD B_TRUE 1 100 0.00 1.00000000000 BIT_MASK 0x800 FORMAT "%13.11" ECU_ADDRESS 0xD0000B5A /end MEASUREMENT
/begin MEASUREMENT B_psmxrkap "" UWORD B_TRUE 1 100 0.00 1.00000000000 BIT_MASK 0x80 FORMAT "%13.11" ECU_ADDRESS 0xD0000B5A /end MEASUREMENT
/begin MEASUREMENT B_rkapp "" UWORD B_TRUE 1 100 0.00 1.00000000000 BIT_MASK 0x4 FORMAT "%13.11" ECU_ADDRESS 0xD0000B5A /end MEASUREMENT
/begin MEASUREMENT B_rlsschap "" UWORD B_TRUE 1 100 0.00 1.00000000000 BIT_MASK 0x8 FORMAT "%13.11" ECU_ADDRESS 0xD0000B5A /end MEASUREMENT
/begin MEASUREMENT B_rriesap "" UBYTE B_TRUE 1 100 0.00 1.00000000000 BIT_MASK 0x4 FORMAT "%13.11" ECU_ADDRESS 0xD0000F37 /end MEASUREMENT
/begin MEASUREMENT B_rrisolap "" UBYTE B_TRUE 1 100 0.00 1.00000000000 BIT_MASK 0x2 FORMAT "%13.11" ECU_ADDRESS 0xD0000F37 /end MEASUREMENT
/begin MEASUREMENT B_slsfz "" UBYTE B_TRUE 1 100 0.00 1.00000000000 BIT_MASK 0x10 FORMAT "%13.11" ECU_ADDRESS 0xD0000F2F /end MEASUREMENT
/begin MEASUREMENT B_tdactive "" UBYTE B_TRUE 1 100 0.00 1.00000000000 BIT_MASK 0x10 FORMAT "%13.11" ECU_ADDRESS 0xD0000066 /end MEASUREMENT
/begin MEASUREMENT B_tevtini "" UBYTE B_TRUE 1 100 0.00 1.00000000000 BIT_MASK 0x40 FORMAT "%13.11" ECU_ADDRESS 0xD0000074 /end MEASUREMENT
/begin MEASUREMENT B_tfu "" UBYTE B_TRUE 1 100 0.00 1.00000000000 BIT_MASK 0x1 FORMAT "%13.11" ECU_ADDRESS 0xD0000F24 /end MEASUREMENT
/begin MEASUREMENT B_tpn "" UBYTE B_TRUE 1 100 0.00 1.00000000000 BIT_MASK 0x2 FORMAT "%13.11" ECU_ADDRESS 0xD0000DB7 /end MEASUREMENT
/begin MEASUREMENT B_uhrrmin "" UBYTE B_TRUE 1 100 0.00 1.00000000000 BIT_MASK 0x2 FORMAT "%13.11" ECU_ADDRESS 0xD0000F24 /end MEASUREMENT
/begin MEASUREMENT B_uhrrsec "" UBYTE B_TRUE 1 100 0.00 1.00000000000 BIT_MASK 0x4 FORMAT "%13.11" ECU_ADDRESS 0xD0000F24 /end MEASUREMENT
/begin MEASUREMENT B_varfgr "" UBYTE B_TRUE 1 100 0.00 1.00000000000 BIT_MASK 0x20 FORMAT "%13.11" ECU_ADDRESS 0xD0000F2D /end MEASUREMENT
/begin MEASUREMENT B_vllr "" UBYTE B_TRUE 1 100 0.00 1.00000000000 BIT_MASK 0x20 FORMAT "%13.11" ECU_ADDRESS 0xD000005E /end MEASUREMENT
/begin MEASUREMENT B_waksh "" UBYTE B_TRUE 1 100 0.00 1.00000000000 BIT_MASK 0x40 FORMAT "%13.11" ECU_ADDRESS 0xD0000F2D /end MEASUREMENT
/begin MEASUREMENT B_wdkhomap "" UWORD B_TRUE 1 100 0.00 1.00000000000 BIT_MASK 0x20 FORMAT "%13.11" ECU_ADDRESS 0xD0000B5A /end MEASUREMENT
/begin MEASUREMENT B_wdksap "" UBYTE B_TRUE 1 100 0.00 1.00000000000 BIT_MASK 0x10 FORMAT "%13.11" ECU_ADDRESS 0xD0000F34 /end MEASUREMENT
/begin MEASUREMENT B_wdkschap "" UWORD B_TRUE 1 100 0.00 1.00000000000 BIT_MASK 0x10 FORMAT "%13.11" ECU_ADDRESS 0xD0000B5A /end MEASUREMENT
/begin MEASUREMENT B_wkralcpy "" UBYTE B_TRUE 1 100 0.00 1.00000000000 BIT_MASK 0x40 FORMAT "%13.11" ECU_ADDRESS 0xD0000065 /end MEASUREMENT
/begin MEASUREMENT B_zesync "" UBYTE B_TRUE 1 100 0.00 1.00000000000 BIT_MASK 0x4 FORMAT "%13.11" ECU_ADDRESS 0xD000007F /end MEASUREMENT
/begin MEASUREMENT B_zwappl "" UBYTE B_TRUE 1 100 0.00 1.00000000000 BIT_MASK 0x4 FORMAT "%13.11" ECU_ADDRESS 0xD0000F34 /end MEASUREMENT
/begin MEASUREMENT B_zwetakh "" UBYTE B_TRUE 1 100 0.00 1.00000000000 BIT_MASK 0x2 FORMAT "%13.11" ECU_ADDRESS 0xD0000D47 /end MEASUREMENT
/begin MEASUREMENT B_zwschap "" UWORD B_TRUE 1 100 0.00 1.00000000000 BIT_MASK 0x40 FORMAT "%13.11" ECU_ADDRESS 0xD0000B5A /end MEASUREMENT
/begin MEASUREMENT cw_erfil "" UBYTE dez 1 100 0.00 255.0 FORMAT "%5.1" ECU_ADDRESS 0xD0000F1F /end MEASUREMENT
/begin MEASUREMENT cw_obd "" UBYTE dez 1 100 0.00 255.0 FORMAT "%5.1" ECU_ADDRESS 0xD0000F20 /end MEASUREMENT
/begin MEASUREMENT detazwbs_w "" UWORD fak_uw_b2 1 100 0.00 1.999969 FORMAT "%8.6" ECU_ADDRESS 0xD000083C /end MEASUREMENT
/begin MEASUREMENT dlbtszwr_w "" SWORD fak_sw_b8 1 100 -0.5000000 0.00 FORMAT "%9.7" ECU_ADDRESS 0xD000083E /end MEASUREMENT
/begin MEASUREMENT dlbtszw_w "" SWORD fak_sw_b8 1 100 -8.000000 7.999756 FORMAT "%8.6" ECU_ADDRESS 0xD0000840 /end MEASUREMENT
/begin MEASUREMENT dns "" SBYTE nmotd_sb_q10 1 100 -1280. 1270. FORMAT "%5.0" ECU_ADDRESS 0xD0000DAF /end MEASUREMENT
/begin MEASUREMENT dnsolzkst "" UBYTE nmotd_sb_q10 1 100 0.00 2550. FORMAT "%5.0" ECU_ADDRESS 0xD0000DAA /end MEASUREMENT
/begin MEASUREMENT dtbtsgs_w "" SWORD temp_q0p0468_K 1 100 -1536.000 1535.953 FORMAT "%8.3" ECU_ADDRESS 0xD0000842 /end MEASUREMENT
/begin MEASUREMENT dtbtska_w "" SWORD temp_q0p0468_K 1 100 -1536.000 1535.953 FORMAT "%8.3" ECU_ADDRESS 0xD0000844 /end MEASUREMENT
/begin MEASUREMENT dtlabts_w "" SWORD temp_q0p0468_K 1 100 -1536.000 1535.953 FORMAT "%8.3" ECU_ADDRESS 0xD000085E /end MEASUREMENT
/begin MEASUREMENT dwkr "" SBYTE kw_q0p75 1 100 -96.00 95.25 FORMAT "%5.2" ECU_ADDRESS 0xD0000D99 /end MEASUREMENT
/begin MEASUREMENT dwkrms "" SBYTE kw_q0p75 1 100 -96.00 95.25 FORMAT "%5.2" ECU_ADDRESS 0xD0000D89 /end MEASUREMENT
/begin MEASUREMENT dwkrz "" SBYTE kw_q0p75 1 100 -96.00 95.25 FORMAT "%5.2" ARRAY_SIZE 3 ECU_ADDRESS 0xD0000D9A /end MEASUREMENT
/begin MEASUREMENT dymntvs "" SBYTE kw_q0p75 1 100 -96.00 95.25 FORMAT "%5.2" ECU_ADDRESS 0xD0000D59 /end MEASUREMENT
/begin MEASUREMENT etaaktsl_w "" UWORD fak_uw_b2 1 100 0.00 1.999969 FORMAT "%8.6" ECU_ADDRESS 0xD00007EE /end MEASUREMENT
/begin MEASUREMENT etakhaw_w "" UWORD fak_uw_b2 1 100 0.00 1.999969 FORMAT "%8.6" ECU_ADDRESS 0xD00007DA /end MEASUREMENT
/begin MEASUREMENT etakhbg_w "" UWORD fak_uw_b2 1 100 0.00 1.999969 FORMAT "%8.6" ECU_ADDRESS 0xD00007DC /end MEASUREMENT
/begin MEASUREMENT etakhktl_w "" UWORD fak_uw_b2 1 100 0.00 1.999969 FORMAT "%8.6" ECU_ADDRESS 0xD00007F0 /end MEASUREMENT
/begin MEASUREMENT etakhktn_w "" UWORD fak_uw_b2 1 100 0.00 1.999969 FORMAT "%8.6" ECU_ADDRESS 0xD00007DE /end MEASUREMENT
/begin MEASUREMENT etakhktt_w "" UWORD fak_uw_b2 1 100 0.00 1.999969 FORMAT "%8.6" ECU_ADDRESS 0xD00007F2 /end MEASUREMENT
/begin MEASUREMENT etakhkt_w "" UWORD fak_uw_b2 1 100 0.00 1.999969 FORMAT "%8.6" ECU_ADDRESS 0xD00007E0 /end MEASUREMENT
/begin MEASUREMENT etakhkwn_w "" UWORD fak_uw_b2 1 100 0.00 1.999969 FORMAT "%8.6" ECU_ADDRESS 0xD00007E2 /end MEASUREMENT
/begin MEASUREMENT etakhkw_w "" UWORD fak_uw_b2 1 100 0.00 1.999969 FORMAT "%8.6" ECU_ADDRESS 0xD00007E4 /end MEASUREMENT
/begin MEASUREMENT etakhsu_w "" UWORD fak_uw_b2 1 100 0.00 1.999969 FORMAT "%8.6" ECU_ADDRESS 0xD00007E6 /end MEASUREMENT
/begin MEASUREMENT etakhtrp_w "" UWORD fak_uw_b2 1 100 0.00 1.999969 FORMAT "%8.6" ECU_ADDRESS 0xD00007E8 /end MEASUREMENT
/begin MEASUREMENT etakh_w "" UWORD fak_uw_b2 1 100 0.00 1.999969 FORMAT "%8.6" ECU_ADDRESS 0xD00007F4 /end MEASUREMENT
/begin MEASUREMENT etazwg_w "" UWORD fak_uw_b2 1 100 0.00 1.999969 FORMAT "%8.6" ECU_ADDRESS 0xD0000846 /end MEASUREMENT
/begin MEASUREMENT etazwmnk_w "" UWORD fak_uw_b2 1 100 0.00 1.999969 FORMAT "%8.6" ECU_ADDRESS 0xD00007EA /end MEASUREMENT
/begin MEASUREMENT fcoscaw_w "" UWORD fak_uw_b2 1 100 0.00 1.999969 FORMAT "%8.6" ECU_ADDRESS 0xD00007EC /end MEASUREMENT
/begin MEASUREMENT flbtatm_w "" UWORD fak_uw_b2 1 100 0.00 1.999969 FORMAT "%8.6" ECU_ADDRESS 0xD0000848 /end MEASUREMENT
/begin MEASUREMENT fmfkrako_w "" SWORD dez 1 100 0.00 32767.00 FORMAT "%8.2" ARRAY_SIZE 3 ECU_ADDRESS 0xD0000810 /end MEASUREMENT
/begin MEASUREMENT fmfkrc "" UBYTE dez 1 100 0.00 255.0 FORMAT "%5.1" ECU_ADDRESS 0xD0000D6D /end MEASUREMENT
/begin MEASUREMENT frlmxbts_w "" UWORD fak_uw_b2 1 100 0.00 1.999969 FORMAT "%8.6" ECU_ADDRESS 0xD0000860 /end MEASUREMENT
/begin MEASUREMENT frlmxdzw_w "" UWORD fak_uw_b2 1 100 0.00 1.000000 FORMAT "%8.6" ECU_ADDRESS 0xD000082E /end MEASUREMENT
/begin MEASUREMENT frstinjcyl "" UBYTE dez 1 100 0.00 255.0 FORMAT "%5.1" ECU_ADDRESS 0xD0000D3E /end MEASUREMENT
/begin MEASUREMENT fstetakhkt "" UBYTE fak_ub_b2 1 100 0.00 1.992188 FORMAT "%8.6" ECU_ADDRESS 0xD0000D43 /end MEASUREMENT
/begin MEASUREMENT fstetakhkw "" UBYTE fak_ub_b2 1 100 0.00 1.992188 FORMAT "%8.6" ECU_ADDRESS 0xD0000D44 /end MEASUREMENT
/begin MEASUREMENT fstkttmsfh "" UBYTE fak_ub_b2 1 100 0.00 1.992188 FORMAT "%8.6" ECU_ADDRESS 0xD0000D45 /end MEASUREMENT
/begin MEASUREMENT fwetakhkt "" UBYTE fak_ub_b1 1 100 0.00 0.9961 ECU_ADDRESS 0xD0000D46 /end MEASUREMENT
/begin MEASUREMENT fwsanfdlut "" UBYTE fak_ub_b2 1 100 0.00 1.992188 FORMAT "%8.6" ECU_ADDRESS 0xD0000D48 /end MEASUREMENT
/begin MEASUREMENT gangllr "" UBYTE dez 1 100 0.00 255.0 FORMAT "%5.1" ECU_ADDRESS 0xD0000DB2 /end MEASUREMENT
/begin MEASUREMENT grdwof "" UBYTE kw_q1 1 100 0.00 255.0 FORMAT "%5.1" ECU_ADDRESS 0xD0000F21 /end MEASUREMENT
/begin MEASUREMENT grundwert "" UBYTE kw_q1 1 100 0.00 255.0 FORMAT "%5.1" ECU_ADDRESS 0xD0000F22 /end MEASUREMENT
/begin MEASUREMENT HEGO_bRiPlsReq "" UBYTE B_TRUE 1 100 0.00 1.00000000000 BIT_MASK 0x80 FORMAT "%13.11" ECU_ADDRESS 0xD000003F /end MEASUREMENT
/begin MEASUREMENT HEGO_bS1B1FrzRi "" UBYTE B_TRUE 1 100 0.00 1.00000000000 BIT_MASK 0x10 FORMAT "%13.11" ECU_ADDRESS 0xD0000053 /end MEASUREMENT
/begin MEASUREMENT HEGO_bS1B1LdPlsRslt "" UBYTE B_TRUE 1 100 0.00 1.00000000000 BIT_MASK 0x8 FORMAT "%13.11" ECU_ADDRESS 0xD0000094 /end MEASUREMENT
/begin MEASUREMENT HEGO_bS1B1RiPlsReq "" UBYTE B_TRUE 1 100 0.00 1.00000000000 BIT_MASK 0x1 FORMAT "%13.11" ECU_ADDRESS 0xD0000040 /end MEASUREMENT
/begin MEASUREMENT HEGO_bS1B1VldRi "" UBYTE B_TRUE 1 100 0.00 1.00000000000 BIT_MASK 0x8 FORMAT "%13.11" ECU_ADDRESS 0xD000008D /end MEASUREMENT
/begin MEASUREMENT HEGO_idxSensRiPls "" UBYTE dez 1 100 0.00 255.0 FORMAT "%5.1" ECU_ADDRESS 0xD0000D3A /end MEASUREMENT
/begin MEASUREMENT HEGO_resS1B1Ri "" UWORD r_uw_q2 1 100 0.00 131070.0 FORMAT "%8.1" ECU_ADDRESS 0xD00035EA /end MEASUREMENT
/begin MEASUREMENT HEGO_resS1B1RiNoFlt "" UWORD r_uw_q2 1 100 0.00 131070.0 FORMAT "%8.1" ECU_ADDRESS 0xD00035EC /end MEASUREMENT
/begin MEASUREMENT HEGO_SensS1B1_I.bCalcRi "" UBYTE B_TRUE 1 100 0.00 1.00000000000 BIT_MASK 0x1 FORMAT "%13.11" ECU_ADDRESS 0xD00013ED /end MEASUREMENT
/begin MEASUREMENT HEGO_SensS1B1_I.bDelOpRdnRiPls "" UBYTE B_TRUE 1 100 0.00 1.00000000000 BIT_MASK 0x1 FORMAT "%13.11" ECU_ADDRESS 0xD00013EE /end MEASUREMENT
/begin MEASUREMENT HEGO_SensS1B1_I.bEnaLdPls "" UBYTE B_TRUE 1 100 0.00 1.00000000000 BIT_MASK 0x2 FORMAT "%13.11" ECU_ADDRESS 0xD00013EC /end MEASUREMENT
/begin MEASUREMENT HEGO_SensS1B1_I.bEnaOpRdnRiPls "" UBYTE B_TRUE 1 100 0.00 1.00000000000 BIT_MASK 0x1 FORMAT "%13.11" ECU_ADDRESS 0xD00013EF /end MEASUREMENT
/begin MEASUREMENT HEGO_SensS1B1_I.bEnaRi "" UBYTE B_TRUE 1 100 0.00 1.00000000000 BIT_MASK 0x1 FORMAT "%13.11" ECU_ADDRESS 0xD00013F0 /end MEASUREMENT
/begin MEASUREMENT HEGO_SensS1B1_I.bEnaRiFlt "" UBYTE B_TRUE 1 100 0.00 1.00000000000 BIT_MASK 0x1 FORMAT "%13.11" ECU_ADDRESS 0xD00013EC /end MEASUREMENT
/begin MEASUREMENT HEGO_SensS1B1_I.bFrzRi "" UBYTE B_TRUE 1 100 0.00 1.00000000000 BIT_MASK 0x1 FORMAT "%13.11" ECU_ADDRESS 0xD00013F1 /end MEASUREMENT
/begin MEASUREMENT HEGO_SensS1B1_I.bLdPlsEval "" UBYTE B_TRUE 1 100 0.00 1.00000000000 BIT_MASK 0x1 FORMAT "%13.11" ECU_ADDRESS 0xD00013F2 /end MEASUREMENT
/begin MEASUREMENT HEGO_SensS1B1_I.bLdPlsFin "" UBYTE B_TRUE 1 100 0.00 1.00000000000 BIT_MASK 0x4 FORMAT "%13.11" ECU_ADDRESS 0xD00013EC /end MEASUREMENT
/begin MEASUREMENT HEGO_SensS1B1_I.bLdPlsRslt "" UBYTE B_TRUE 1 100 0.00 1.00000000000 BIT_MASK 0x1 FORMAT "%13.11" ECU_ADDRESS 0xD00013F3 /end MEASUREMENT
/begin MEASUREMENT HEGO_SensS1B1_I.bPlausRi "" UBYTE B_TRUE 1 100 0.00 1.00000000000 BIT_MASK 0x8 FORMAT "%13.11" ECU_ADDRESS 0xD00013EC /end MEASUREMENT
/begin MEASUREMENT HEGO_SensS1B1_I.bPolarRedPls "" UBYTE B_TRUE 1 100 0.00 1.00000000000 BIT_MASK 0x1 FORMAT "%13.11" ECU_ADDRESS 0xD00013F4 /end MEASUREMENT
/begin MEASUREMENT HEGO_SensS1B1_I.bRiPls "" UBYTE B_TRUE 1 100 0.00 1.00000000000 BIT_MASK 0x1 FORMAT "%13.11" ECU_ADDRESS 0xD00013F5 /end MEASUREMENT
/begin MEASUREMENT HEGO_SensS1B1_I.bRiTrg "" UBYTE B_TRUE 1 100 0.00 1.00000000000 BIT_MASK 0x1 FORMAT "%13.11" ECU_ADDRESS 0xD00013F6 /end MEASUREMENT
/begin MEASUREMENT HEGO_SensS1B1_I.bVldRi "" UBYTE B_TRUE 1 100 0.00 1.00000000000 BIT_MASK 0x1 FORMAT "%13.11" ECU_ADDRESS 0xD00013F7 /end MEASUREMENT
/begin MEASUREMENT HEGO_SensS1B1_I.ctLdPls "" UBYTE dez 1 100 0.00 255.0 FORMAT "%5.1" ECU_ADDRESS 0xD00013F8 /end MEASUREMENT
/begin MEASUREMENT HEGO_SensS1B1_I.numLdPlsMax "" UBYTE dez 1 100 0.00 255.0 FORMAT "%5.1" ECU_ADDRESS 0xD00013F9 /end MEASUREMENT
/begin MEASUREMENT HEGO_SensS1B1_I.resRi "" UWORD r_uw_q2 1 100 0.00 131070.0 FORMAT "%8.1" ECU_ADDRESS 0xD00013FA /end MEASUREMENT
/begin MEASUREMENT HEGO_SensS1B1_I.resRiNoFlt "" UWORD r_uw_q2 1 100 0.00 131070.0 FORMAT "%8.1" ECU_ADDRESS 0xD00013FC /end MEASUREMENT
/begin MEASUREMENT HEGO_SensS1B1_I.resRiNoFltPrev "" UWORD r_uw_q2 1 100 0.00 131070.0 FORMAT "%8.1" ECU_ADDRESS 0xD00013FE /end MEASUREMENT
/begin MEASUREMENT HEGO_SensS1B1_I.sm "" UBYTE OneToOne 1 100 0.00 3.000 FORMAT "%5.3" ECU_ADDRESS 0xD0001402 /end MEASUREMENT
/begin MEASUREMENT HEGO_SensS1B1_I.uLdPls "" UWORD spg_q0p00488 1 100 0.00 4.995117 FORMAT "%8.6" ECU_ADDRESS 0xD0001404 /end MEASUREMENT
/begin MEASUREMENT HEGO_SensS1B1_I.uLdPlsDiff "" UWORD spg_q0p00488 1 100 0.00 319.9951 FORMAT "%8.4" ECU_ADDRESS 0xD0001406 /end MEASUREMENT
/begin MEASUREMENT HEGO_SensS1B1_I.uRiAftFrz "" UWORD spg_q0p00488 1 100 0.00 4.995117 FORMAT "%8.6" ECU_ADDRESS 0xD000140A /end MEASUREMENT
/begin MEASUREMENT HEGO_SensS1B1_I.uRiWiLd "" UWORD spg_q0p00488 1 100 0.00 4.995117 FORMAT "%8.6" ECU_ADDRESS 0xD000140C /end MEASUREMENT
/begin MEASUREMENT HEGO_SensS1B1_I.uRiWoLd "" UWORD spg_q0p00488 1 100 0.00 4.995117 FORMAT "%8.6" ECU_ADDRESS 0xD000140E /end MEASUREMENT
/begin MEASUREMENT HEGO_SensS1B1_I.uSExtd "" UWORD spg_q0p00488 1 100 0.00 4.995117 FORMAT "%8.6" ECU_ADDRESS 0xD0001410 /end MEASUREMENT
/begin MEASUREMENT HEGO_uS1B1 "" UBYTE spg_q0p00488 1 100 0.00 1.245 FORMAT "%5.3" ECU_ADDRESS 0xD0003C6F /end MEASUREMENT
/begin MEASUREMENT HEGO_uS1B1Extd "" UWORD spg_q0p00488 1 100 0.00 4.995117 FORMAT "%8.6" ECU_ADDRESS 0xD00035F2 /end MEASUREMENT
/begin MEASUREMENT HEGO_uS1B1LdPls "" UWORD spg_q0p00488 1 100 0.00 4.995117 FORMAT "%8.6" ECU_ADDRESS 0xD00035F4 /end MEASUREMENT
/begin MEASUREMENT HEGO_uS1B1Tstr "" UBYTE spg_q0p005 1 100 0.00 1.275 FORMAT "%5.3" ECU_ADDRESS 0xD0003C70 /end MEASUREMENT
/begin MEASUREMENT HEGO_uS1B1WoDynSim "" UWORD spg_q0p00488 1 100 0.00 4.995117 FORMAT "%8.6" ECU_ADDRESS 0xD00035F8 /end MEASUREMENT
/begin MEASUREMENT I15031_FILLSIG1 "" UBYTE OneToOne 1 100 0.00 255.0 FORMAT "%5.1" ECU_ADDRESS 0xD0003C73 /end MEASUREMENT
/begin MEASUREMENT I15031_FILLSIG2 "" UWORD OneToOne 1 100 0.00 65535.00 FORMAT "%8.2" ECU_ADDRESS 0xD00035FC /end MEASUREMENT
/begin MEASUREMENT I15031_FILLSIG4 "" ULONG OneToOne 1 100 0.00 4294967295.00 FORMAT "%13.2" ECU_ADDRESS 0xD0002338 /end MEASUREMENT
/begin MEASUREMENT I15031_PID1C "" UBYTE OneToOne 1 100 0.00 255.0 FORMAT "%5.1" ECU_ADDRESS 0xD0003C74 /end MEASUREMENT
/begin MEASUREMENT I15031_PID4FA "" UBYTE OneToOne 1 100 0.00 255.0 FORMAT "%5.1" ECU_ADDRESS 0xD0003C75 /end MEASUREMENT
/begin MEASUREMENT I15031_PID4FB "" UBYTE OneToOne 1 100 0.00 255.0 FORMAT "%5.1" ECU_ADDRESS 0xD0003C76 /end MEASUREMENT
/begin MEASUREMENT I15031_PID4FC "" UBYTE OneToOne 1 100 0.00 255.0 FORMAT "%5.1" ECU_ADDRESS 0xD0003C77 /end MEASUREMENT
/begin MEASUREMENT I15031_PID4FD "" UBYTE OneToTenCarb 1 100 0.00 2550. FORMAT "%5.0" ECU_ADDRESS 0xD0003C78 /end MEASUREMENT
/begin MEASUREMENT I15031_PID50A "" UBYTE OneToTenCarb 1 100 0.00 2550. FORMAT "%5.0" ECU_ADDRESS 0xD0003C79 /end MEASUREMENT
/begin MEASUREMENT I15031_PID50B "" UBYTE OneToOne 1 100 0.00 255.0 FORMAT "%5.1" ECU_ADDRESS 0xD0003C7A /end MEASUREMENT
/begin MEASUREMENT I15031_PID50C "" UBYTE OneToOne 1 100 0.00 255.0 FORMAT "%5.1" ECU_ADDRESS 0xD0003C7B /end MEASUREMENT
/begin MEASUREMENT I15031_PID50D "" UBYTE OneToOne 1 100 0.00 255.0 FORMAT "%5.1" ECU_ADDRESS 0xD0003C7C /end MEASUREMENT
/begin MEASUREMENT I15031_PID5F "" UBYTE OneToOne 1 100 0.00 255.0 FORMAT "%5.1" ECU_ADDRESS 0xD0003C7D /end MEASUREMENT
/begin MEASUREMENT I15031_PIDSuppSrv1 "" ULONG OneToOne 1 100 0.00 4294967295.00 FORMAT "%13.2" ARRAY_SIZE 8 ECU_ADDRESS 0xD00030D4 /end MEASUREMENT
/begin MEASUREMENT I15031_PIDSuppSrv2 "" ULONG OneToOne 1 100 0.00 4294967295.00 FORMAT "%13.2" ARRAY_SIZE 8 ECU_ADDRESS 0xD00030F4 /end MEASUREMENT
/begin MEASUREMENT ignactf_w "" UWORD dez 1 100 0.00 65535.00 FORMAT "%8.2" ECU_ADDRESS 0xD00047AE /end MEASUREMENT
/begin MEASUREMENT IgnClPs_bDiagEna "" UBYTE default 1 100 0.00 255.0 BIT_MASK 0x1 FORMAT "%5.1" ECU_ADDRESS 0xD0003C7E /end MEASUREMENT
/begin MEASUREMENT IgnClPs_cntIgnOld_u16 "" UWORD dez 1 100 0.00 65535.00 FORMAT "%8.2" ECU_ADDRESS 0xD00007D0 /end MEASUREMENT
/begin MEASUREMENT IgnClPs_cntIgn_u16 "" UWORD dez 1 100 0.00 65535.00 FORMAT "%8.2" ECU_ADDRESS 0xD00007D2 /end MEASUREMENT
/begin MEASUREMENT IgnClPs_DiaLokBitsKoop0 "" UBYTE dez 1 100 0.00 255.0 FORMAT "%5.1" ECU_ADDRESS 0xD0000D3B /end MEASUREMENT
/begin MEASUREMENT IgnClPs_numCommErr_u8 "" UBYTE dez 1 100 0.00 255.0 FORMAT "%5.1" ECU_ADDRESS 0xD0003C7F /end MEASUREMENT
/begin MEASUREMENT IgnClPs_numDiagReg_u16 "" UWORD dez 1 100 0.00 65535.00 FORMAT "%8.2" ECU_ADDRESS 0xD0000B6C /end MEASUREMENT
/begin MEASUREMENT IgnClPs_numIgnCh_a8 "" UBYTE dez 1 100 0.00 255.0 FORMAT "%5.1" ARRAY_SIZE 3 ECU_ADDRESS 0xD0003C80 /end MEASUREMENT
/begin MEASUREMENT IgnClPs_numIgnIc_a8 "" UBYTE dez 1 100 0.00 255.0 FORMAT "%5.1" ARRAY_SIZE 3 ECU_ADDRESS 0xD0003C83 /end MEASUREMENT
/begin MEASUREMENT IgnClPs_numPsErr_a16 "" UWORD dez 1 100 0.00 65535.00 FORMAT "%8.2" ARRAY_SIZE 3 ECU_ADDRESS 0xD000360E /end MEASUREMENT
/begin MEASUREMENT IgnClPs_valDiaRes_u8 "" UBYTE dez 1 100 0.00 255.0 FORMAT "%5.1" ECU_ADDRESS 0xD0003C86 /end MEASUREMENT
/begin MEASUREMENT igndd_cylFreeze "" UBYTE dez 1 100 0.00 255.0 FORMAT "%5.1" ECU_ADDRESS 0xD000479E /end MEASUREMENT
/begin MEASUREMENT igndd_fdOutPattern_u16 "" UWORD dez 1 100 0.00 65535.00 FORMAT "%8.2" ECU_ADDRESS 0xD00047A8 /end MEASUREMENT
/begin MEASUREMENT igndd_fdPatArray_u16 "" UWORD dez 1 100 0.00 65535.00 FORMAT "%8.2" ARRAY_SIZE 12 ECU_ADDRESS 0xD00047B0 /end MEASUREMENT
/begin MEASUREMENT igndd_oldIgnCntVal_u8 "" UBYTE dez 1 100 0.00 255.0 FORMAT "%5.1" ECU_ADDRESS 0xD00047AA /end MEASUREMENT
/begin MEASUREMENT igndd_ovl_u8 "" UBYTE dez 1 100 0.00 255.0 FORMAT "%5.1" ECU_ADDRESS 0xD0004796 /end MEASUREMENT
/begin MEASUREMENT igndd_state "" UBYTE dez 1 100 0.00 255.0 FORMAT "%5.1" ECU_ADDRESS 0xD0004794 /end MEASUREMENT
/begin MEASUREMENT igndd_zwFreeze "" SBYTE zw_sb_q0p75 1 100 -96.00 95.25 FORMAT "%5.2" ARRAY_SIZE 3 ECU_ADDRESS 0xD000479B /end MEASUREMENT
/begin MEASUREMENT ignFadeStatBits_w "" UWORD dez 1 100 0.00 65535.00 FORMAT "%8.2" ECU_ADDRESS 0xD00047AC /end MEASUREMENT
/begin MEASUREMENT ignswofdly "" UBYTE dez 1 100 0.00 255.0 FORMAT "%5.1" ECU_ADDRESS 0xD0004795 /end MEASUREMENT
/begin MEASUREMENT ikr_tst_w "" UWORD spg_uw_q0p000076 1 100 0.00 4.999924 FORMAT "%8.6" ECU_ADDRESS 0xD0000820 /end MEASUREMENT
/begin MEASUREMENT ikr_w "" UWORD spg_uw_q0p000076 1 100 0.00 4.999924 FORMAT "%8.6" ARRAY_SIZE 3 ECU_ADDRESS 0xD0000822 /end MEASUREMENT
/begin MEASUREMENT ke "" UBYTE fak_ub_b16 1 100 0.00 15.94 FORMAT "%5.2" ARRAY_SIZE 3 ECU_ADDRESS 0xD0000D60 /end MEASUREMENT
/begin MEASUREMENT kek "" UBYTE fak_ub_b16 1 100 0.06250 15.94 FORMAT "%5.2" ARRAY_SIZE 3 ECU_ADDRESS 0xD0000D6E /end MEASUREMENT
/begin MEASUREMENT kek_tst "" UBYTE fak_ub_b16 1 100 0.06250 15.94 FORMAT "%5.2" ECU_ADDRESS 0xD0000D63 /end MEASUREMENT
/begin MEASUREMENT klopfakt "" UBYTE dez 1 100 0.00 255.0 FORMAT "%5.1" ECU_ADDRESS 0xD0000D8A /end MEASUREMENT
/begin MEASUREMENT KnDet_bDiaDeb "" UBYTE B_TRUE 1 100 0.00 1.00000000000 BIT_MASK 0x4 FORMAT "%13.11" ECU_ADDRESS 0xD000009C /end MEASUREMENT
/begin MEASUREMENT KnDet_bEnaSigEval "" UBYTE B_TRUE 1 100 0.00 1.00000000000 BIT_MASK 0x2 FORMAT "%13.11" ECU_ADDRESS 0xD0000040 /end MEASUREMENT
/begin MEASUREMENT KnDet_bNewEval "" UBYTE B_TRUE 1 100 0.00 1.00000000000 BIT_MASK 0x8 FORMAT "%13.11" ECU_ADDRESS 0xD0000057 /end MEASUREMENT
/begin MEASUREMENT KnDet_bStMeasWin "" UBYTE B_TRUE 1 100 0.00 1.00000000000 BIT_MASK 0x20 FORMAT "%13.11" ECU_ADDRESS 0xD0000069 /end MEASUREMENT
/begin MEASUREMENT KnDet_ctCyl "" UBYTE dez 1 100 0.00 255.0 FORMAT "%5.1" ECU_ADDRESS 0xD0000D49 /end MEASUREMENT
/begin MEASUREMENT KnDet_ctDia "" UBYTE dez 1 100 0.00 255.0 FORMAT "%5.1" ECU_ADDRESS 0xD0000D4E /end MEASUREMENT
/begin MEASUREMENT KnDet_ctIntegRsltInvld "" UBYTE dez 1 100 0.00 255.0 FORMAT "%5.1" ECU_ADDRESS 0xD0000D4F /end MEASUREMENT
/begin MEASUREMENT KnDet_DebDiagVal1 "" UBYTE dez 1 100 0.00 255.0 FORMAT "%5.1" ECU_ADDRESS 0xD0000D54 /end MEASUREMENT
/begin MEASUREMENT KnDet_DebDiagVal2 "" UBYTE dez 1 100 0.00 255.0 FORMAT "%5.1" ECU_ADDRESS 0xD0000D55 /end MEASUREMENT
/begin MEASUREMENT KnDet_DiaRes "" UBYTE dez 1 100 0.00 255.0 FORMAT "%5.1" ECU_ADDRESS 0xD0000D56 /end MEASUREMENT
/begin MEASUREMENT KnDet_HwDiaMode "" UBYTE dez 1 100 0.00 255.0 FORMAT "%5.1" ECU_ADDRESS 0xD0000D4A /end MEASUREMENT
/begin MEASUREMENT KnDet_IntegWinEnd "" ULONG dez 1 100 0.00 4294967295.00 FORMAT "%13.2" ARRAY_SIZE 1 ECU_ADDRESS 0xD0002264 /end MEASUREMENT
/begin MEASUREMENT KnDet_numFltNew "" UWORD dez 1 100 0.00 65535.00 FORMAT "%8.2" ECU_ADDRESS 0xD0000804 /end MEASUREMENT
/begin MEASUREMENT KnDet_numSensDia "" UWORD dez 1 100 0.00 65535.00 FORMAT "%8.2" ECU_ADDRESS 0xD0000806 /end MEASUREMENT
/begin MEASUREMENT KnDet_numValMeasWin "" ULONG dez 1 100 0.00 4294967295.00 FORMAT "%13.2" ECU_ADDRESS 0xD000226C /end MEASUREMENT
/begin MEASUREMENT KnDet_numValMeasWinEst "" UWORD dez 1 100 0.00 65535.00 FORMAT "%8.2" ECU_ADDRESS 0xD00007FA /end MEASUREMENT
/begin MEASUREMENT KnDet_numValMeasWinTmp "" UWORD dez 1 100 0.00 65535.00 FORMAT "%8.2" ECU_ADDRESS 0xD00007FC /end MEASUREMENT
/begin MEASUREMENT KnDet_phiMeasWinBgn "" SWORD kw_sw_q0p0219 1 100 -720.0000 719.9780 FORMAT "%8.4" ECU_ADDRESS 0xD00007FE /end MEASUREMENT
/begin MEASUREMENT KnDet_phiMeasWinLngth "" SWORD kw_sw_q0p0219 1 100 -720.0000 719.9780 FORMAT "%8.4" ECU_ADDRESS 0xD0000800 /end MEASUREMENT
/begin MEASUREMENT KnDet_phiMeasWinLngthOld "" SWORD kw_sw_q0p0219 1 100 -720.0000 719.9780 FORMAT "%8.4" ECU_ADDRESS 0xD0000802 /end MEASUREMENT
/begin MEASUREMENT KnDet_ReqSigEvalMode "" UBYTE dez 1 100 0.00 255.0 FORMAT "%5.1" ECU_ADDRESS 0xD0000D50 /end MEASUREMENT
/begin MEASUREMENT KnDet_RlsChkMeasWin "" UBYTE dez 1 100 0.00 255.0 FORMAT "%5.1" ECU_ADDRESS 0xD0000D51 /end MEASUREMENT
/begin MEASUREMENT KnDet_SensMode "" UBYTE dez 1 100 0.00 255.0 FORMAT "%5.1" ECU_ADDRESS 0xD0000D52 /end MEASUREMENT
/begin MEASUREMENT KnDet_stDiaCtl "" UBYTE dez 1 100 0.00 255.0 FORMAT "%5.1" ECU_ADDRESS 0xD0000D53 /end MEASUREMENT
/begin MEASUREMENT KnDet_stGetDigRawVal "" ULONG dez 1 100 0.00 4294967295.00 FORMAT "%13.2" ECU_ADDRESS 0xD0002260 /end MEASUREMENT
/begin MEASUREMENT KnDet_stGnClb "" UBYTE dez 1 100 0.00 255.0 FORMAT "%5.1" ECU_ADDRESS 0xD0000D4B /end MEASUREMENT
/begin MEASUREMENT KnDet_stMeasWin "" UBYTE dez 1 100 0.00 255.0 FORMAT "%5.1" ECU_ADDRESS 0xD0000D4C /end MEASUREMENT
/begin MEASUREMENT KnDet_stOfsClb "" UBYTE dez 1 100 0.00 255.0 FORMAT "%5.1" ECU_ADDRESS 0xD0000D4D /end MEASUREMENT
/begin MEASUREMENT KnDet_stSigEval "" UBYTE dez 1 100 0.00 255.0 FORMAT "%5.1" ECU_ADDRESS 0xD0000D57 /end MEASUREMENT
/begin MEASUREMENT KnDet_stSigEvalCurrCmb "" ULONG dez 1 100 0.00 4294967295.00 FORMAT "%13.2" ECU_ADDRESS 0xD0002268 /end MEASUREMENT
/begin MEASUREMENT KnDet_vNewIntegDia "" SWORD spg_sw_q0p0001 1 100 -3.300000 3.299899 FORMAT "%8.6" ECU_ADDRESS 0xD000080A /end MEASUREMENT
/begin MEASUREMENT KnDet_vNewIntegWinEnd "" ULONG dez 1 100 0.00 4294967295.00 FORMAT "%13.2" ARRAY_SIZE 1 ECU_ADDRESS 0xD0002270 /end MEASUREMENT
/begin MEASUREMENT KnDet_vValDia "" SWORD spg_sw_q0p0001 1 100 -3.300000 3.299899 FORMAT "%8.6" ECU_ADDRESS 0xD0000808 /end MEASUREMENT
/begin MEASUREMENT koncwAusBitsKoop0 "" UBYTE dez 1 100 0.00 255.0 FORMAT "%5.1" ECU_ADDRESS 0xD0000F23 /end MEASUREMENT
/begin MEASUREMENT koncwAusBitsKoop1 "" UBYTE dez 1 100 0.00 255.0 FORMAT "%5.1" ECU_ADDRESS 0xD0000F24 /end MEASUREMENT
/begin MEASUREMENT koncwAusBitsKoop10 "" UBYTE dez 1 100 0.00 255.0 FORMAT "%5.1" ECU_ADDRESS 0xD0000F25 /end MEASUREMENT
/begin MEASUREMENT koncwAusBitsKoop11 "" UBYTE dez 1 100 0.00 255.0 FORMAT "%5.1" ECU_ADDRESS 0xD0000F26 /end MEASUREMENT
/begin MEASUREMENT koncwAusBitsKoop12 "" UBYTE dez 1 100 0.00 255.0 FORMAT "%5.1" ECU_ADDRESS 0xD0000F27 /end MEASUREMENT
/begin MEASUREMENT koncwAusBitsKoop13 "" UBYTE dez 1 100 0.00 255.0 FORMAT "%5.1" ECU_ADDRESS 0xD0000F28 /end MEASUREMENT
/begin MEASUREMENT koncwAusBitsKoop14 "" UBYTE dez 1 100 0.00 255.0 FORMAT "%5.1" ECU_ADDRESS 0xD0000F29 /end MEASUREMENT
/begin MEASUREMENT koncwAusBitsKoop15 "" UBYTE dez 1 100 0.00 255.0 FORMAT "%5.1" ECU_ADDRESS 0xD0000F2A /end MEASUREMENT
/begin MEASUREMENT koncwAusBitsKoop16 "" UBYTE dez 1 100 0.00 255.0 FORMAT "%5.1" ECU_ADDRESS 0xD0000F2B /end MEASUREMENT
/begin MEASUREMENT koncwAusBitsKoop17 "" UBYTE dez 1 100 0.00 255.0 FORMAT "%5.1" ECU_ADDRESS 0xD0000F2C /end MEASUREMENT
/begin MEASUREMENT koncwAusBitsKoop18 "" UBYTE dez 1 100 0.00 255.0 FORMAT "%5.1" ECU_ADDRESS 0xD0000F2D /end MEASUREMENT
/begin MEASUREMENT koncwAusBitsKoop19 "" UBYTE dez 1 100 0.00 255.0 FORMAT "%5.1" ECU_ADDRESS 0xD0000F2E /end MEASUREMENT
/begin MEASUREMENT koncwAusBitsKoop2 "" UBYTE dez 1 100 0.00 255.0 FORMAT "%5.1" ECU_ADDRESS 0xD0000F2F /end MEASUREMENT
/begin MEASUREMENT koncwAusBitsKoop20 "" UBYTE dez 1 100 0.00 255.0 FORMAT "%5.1" ECU_ADDRESS 0xD0000F30 /end MEASUREMENT
/begin MEASUREMENT koncwAusBitsKoop21 "" UBYTE dez 1 100 0.00 255.0 FORMAT "%5.1" ECU_ADDRESS 0xD0000F31 /end MEASUREMENT
/begin MEASUREMENT koncwAusBitsKoop3 "" UBYTE dez 1 100 0.00 255.0 FORMAT "%5.1" ECU_ADDRESS 0xD0000F32 /end MEASUREMENT
/begin MEASUREMENT koncwAusBitsKoop4 "" UBYTE dez 1 100 0.00 255.0 FORMAT "%5.1" ECU_ADDRESS 0xD0000F33 /end MEASUREMENT
/begin MEASUREMENT koncwAusBitsKoop5 "" UBYTE dez 1 100 0.00 255.0 FORMAT "%5.1" ECU_ADDRESS 0xD0000F34 /end MEASUREMENT
/begin MEASUREMENT koncwAusBitsKoop6 "" UBYTE dez 1 100 0.00 255.0 FORMAT "%5.1" ECU_ADDRESS 0xD0000F35 /end MEASUREMENT
/begin MEASUREMENT koncwAusBitsKoop7 "" UBYTE dez 1 100 0.00 255.0 FORMAT "%5.1" ECU_ADDRESS 0xD0000F36 /end MEASUREMENT
/begin MEASUREMENT koncwAusBitsKoop8 "" UBYTE dez 1 100 0.00 255.0 FORMAT "%5.1" ECU_ADDRESS 0xD0000F37 /end MEASUREMENT
/begin MEASUREMENT koncwAusBitsKoop9 "" UBYTE dez 1 100 0.00 255.0 FORMAT "%5.1" ECU_ADDRESS 0xD0000F38 /end MEASUREMENT
/begin MEASUREMENT krdwsw "" SBYTE kw_q0p75 1 100 -96.00 95.25 FORMAT "%5.2" ECU_ADDRESS 0xD0000D8B /end MEASUREMENT
/begin MEASUREMENT krfkwz "" SBYTE kw_q0p75 1 100 -96.00 95.25 FORMAT "%5.2" ARRAY_SIZE 3 ECU_ADDRESS 0xD0000D8C /end MEASUREMENT
/begin MEASUREMENT krfkwz_out "" SBYTE kw_q0p75 1 100 -96.00 95.25 FORMAT "%5.2" ECU_ADDRESS 0xD0000D8F /end MEASUREMENT
/begin MEASUREMENT krftpakt "" UBYTE dez 1 100 1.000 32.00 FORMAT "%5.2" ECU_ADDRESS 0xD0000D64 /end MEASUREMENT
/begin MEASUREMENT krftpst "" UBYTE dez 1 100 4.000 32.00 FORMAT "%5.2" ECU_ADDRESS 0xD0000D65 /end MEASUREMENT
/begin MEASUREMENT krlzn "" UBYTE dez 1 100 0.00 255.0 FORMAT "%5.1" ECU_ADDRESS 0xD0000D7B /end MEASUREMENT
/begin MEASUREMENT krlzsfytm "" UBYTE t_q0p1 1 100 0.00 25.50 FORMAT "%5.2" ECU_ADDRESS 0xD0000D7C /end MEASUREMENT
/begin MEASUREMENT krmxw "" SBYTE kw_q0p75 1 100 -96.00 95.25 FORMAT "%5.2" ECU_ADDRESS 0xD0000D9D /end MEASUREMENT
/begin MEASUREMENT krngfil "" SBYTE nmotg_sb_q100 1 100 -12800. 12700. FORMAT "%5.0" ECU_ADDRESS 0xD0000D71 /end MEASUREMENT
/begin MEASUREMENT krvfwz "" UBYTE t_q0p1 1 100 0.00 25.50 FORMAT "%5.2" ARRAY_SIZE 3 ECU_ADDRESS 0xD0000D90 /end MEASUREMENT
/begin MEASUREMENT labtszw_w "" UWORD fak_uw_b16 1 100 0.00 15.99976 FORMAT "%8.5" ECU_ADDRESS 0xD000084A /end MEASUREMENT
/begin MEASUREMENT lambas "" UBYTE fak_ub_b2 1 100 0.00 1.992188 FORMAT "%8.6" ECU_ADDRESS 0xD0000DA5 /end MEASUREMENT
/begin MEASUREMENT lambas_w "" UWORD fak_uw_b16 1 100 0.00 15.99976 FORMAT "%8.5" ECU_ADDRESS 0xD0000870 /end MEASUREMENT
/begin MEASUREMENT lambs_w "" UWORD fak_uw_b16 1 100 0.00 15.99976 FORMAT "%8.5" ECU_ADDRESS 0xD0000862 /end MEASUREMENT
/begin MEASUREMENT lambts_w "" UWORD fak_uw_b16 1 100 0.00 15.99976 FORMAT "%8.5" ECU_ADDRESS 0xD0000864 /end MEASUREMENT
/begin MEASUREMENT lamdiag_w "" UWORD fak_uw_b16 1 100 0.00 15.99976 FORMAT "%8.5" ECU_ADDRESS 0xD0000866 /end MEASUREMENT
/begin MEASUREMENT lamkhg_w "" UWORD fak_q0p000244 1 100 0.00 15.99976 FORMAT "%8.5" ECU_ADDRESS 0xD0000832 /end MEASUREMENT
/begin MEASUREMENT lamkhr_w "" UWORD fak_q0p000244 1 100 0.00 15.99976 FORMAT "%8.5" ECU_ADDRESS 0xD0000834 /end MEASUREMENT
/begin MEASUREMENT lamkh_w "" UWORD fak_q0p000244 1 100 0.00 15.99976 FORMAT "%8.5" ECU_ADDRESS 0xD000083A /end MEASUREMENT
/begin MEASUREMENT lamlgfmn_w "" UWORD fak_uw_b16 1 100 0.00 15.99976 FORMAT "%8.5" ECU_ADDRESS 0xD0000872 /end MEASUREMENT
/begin MEASUREMENT lamlgm_w "" UWORD fak_uw_b16 1 100 0.00 15.99976 FORMAT "%8.5" ECU_ADDRESS 0xD0000874 /end MEASUREMENT
/begin MEASUREMENT lamnswl_w "" UWORD fak_uw_b16 1 100 0.00 15.99976 FORMAT "%8.5" ECU_ADDRESS 0xD0000884 /end MEASUREMENT
/begin MEASUREMENT lamns_w "" UWORD fak_uw_b16 1 100 0.00 15.99976 FORMAT "%8.5" ECU_ADDRESS 0xD0000886 /end MEASUREMENT
/begin MEASUREMENT lamsbg_w "" UWORD fak_uw_b16 1 100 0.00 15.99976 FORMAT "%8.5" ECU_ADDRESS 0xD0000876 /end MEASUREMENT
/begin MEASUREMENT lamsfbt_w "" UWORD fak_uw_b16 1 100 0.00 15.99976 FORMAT "%8.5" ECU_ADDRESS 0xD000086A /end MEASUREMENT
/begin MEASUREMENT lamsubg_w "" UWORD fak_uw_b16 1 100 0.00 15.99976 FORMAT "%8.5" ECU_ADDRESS 0xD000086C /end MEASUREMENT
/begin MEASUREMENT lams_w "" UWORD fak_uw_b16 1 100 0.00 15.99976 FORMAT "%8.5" ECU_ADDRESS 0xD0000878 /end MEASUREMENT
/begin MEASUREMENT lamwbr_w "" UWORD fak_uw_b16 1 100 0.00 15.99976 FORMAT "%8.5" ECU_ADDRESS 0xD000086E /end MEASUREMENT
/begin MEASUREMENT lamwl_w "" UWORD fak_uw_b16 1 100 0.00 15.99976 FORMAT "%8.5" ECU_ADDRESS 0xD000087C /end MEASUREMENT
/begin MEASUREMENT lanskh_w "" UWORD fak_q0p000244 1 100 0.00 15.99976 FORMAT "%8.5" ECU_ADDRESS 0xD0000836 /end MEASUREMENT
/begin MEASUREMENT lastzyl "" UBYTE dez 1 100 0.00 255.0 FORMAT "%5.1" ECU_ADDRESS 0xD0000D3F /end MEASUREMENT
/begin MEASUREMENT lbtsaw_w "" UWORD fak_uw_b16 1 100 0.00 15.99976 FORMAT "%8.5" ECU_ADDRESS 0xD0000852 /end MEASUREMENT
/begin MEASUREMENT lbtsgs_w "" UWORD fak_uw_b16 1 100 0.00 15.99976 FORMAT "%8.5" ECU_ADDRESS 0xD0000854 /end MEASUREMENT
/begin MEASUREMENT lbtsskf_w "" UWORD fak_uw_b16 1 100 0.00 15.99976 FORMAT "%8.5" ECU_ADDRESS 0xD0000856 /end MEASUREMENT
/begin MEASUREMENT lbts_w "" UWORD fak_uw_b16 1 100 0.00 15.99976 FORMAT "%8.5" ECU_ADDRESS 0xD0000858 /end MEASUREMENT
/begin MEASUREMENT lmskh_w "" UWORD fak_q0p000244 1 100 0.00 15.99976 FORMAT "%8.5" ECU_ADDRESS 0xD0000838 /end MEASUREMENT
/begin MEASUREMENT maskeks "" UBYTE dez 1 100 0.00 255.0 FORMAT "%5.1" ECU_ADDRESS 0xD0000D80 /end MEASUREMENT
/begin MEASUREMENT maskgz "" UBYTE dez 1 100 0.00 255.0 FORMAT "%5.1" ECU_ADDRESS 0xD0000D82 /end MEASUREMENT
/begin MEASUREMENT masklz "" UBYTE dez 1 100 0.00 255.0 FORMAT "%5.1" ECU_ADDRESS 0xD0000D81 /end MEASUREMENT
/begin MEASUREMENT mkrzwsp "" UBYTE dez 1 100 0.00 255.0 FORMAT "%5.1" ECU_ADDRESS 0xD0000D93 /end MEASUREMENT
/begin MEASUREMENT nexttizyl "" UBYTE dez 1 100 0.00 255.0 FORMAT "%5.1" ARRAY_SIZE 3 ECU_ADDRESS 0xD0000D40 /end MEASUREMENT
/begin MEASUREMENT nsnf "" UBYTE nmot_ub_q10 1 100 0.00 2550. FORMAT "%5.0" ECU_ADDRESS 0xD0000DAB /end MEASUREMENT
/begin MEASUREMENT nsol "" UBYTE nmot_ub_q10 1 100 0.00 2550. FORMAT "%5.0" ECU_ADDRESS 0xD0000DB0 /end MEASUREMENT
/begin MEASUREMENT nsolbas "" UBYTE nmot_ub_q10 1 100 0.00 2550. FORMAT "%5.0" ECU_ADDRESS 0xD0000DB8 /end MEASUREMENT
/begin MEASUREMENT nsolfho "" UBYTE nmot_ub_q10 1 100 0.00 2550. FORMAT "%5.0" ECU_ADDRESS 0xD0000DB4 /end MEASUREMENT
/begin MEASUREMENT nsolmaxll "" UBYTE nmot_ub_q10 1 100 0.00 2550. FORMAT "%5.0" ECU_ADDRESS 0xD0000DAC /end MEASUREMENT
/begin MEASUREMENT nsolst "" UBYTE nmot_ub_q10 1 100 0.00 2550. FORMAT "%5.0" ECU_ADDRESS 0xD0000DAD /end MEASUREMENT
/begin MEASUREMENT nsol_w "" UWORD nmot_uw_q0p25 1 100 0.00 16383.75 FORMAT "%8.2" ECU_ADDRESS 0xD0000888 /end MEASUREMENT
/begin MEASUREMENT nsst "" UBYTE nmot_ub_q10 1 100 0.00 2550. FORMAT "%5.0" ECU_ADDRESS 0xD0000DB1 /end MEASUREMENT
/begin MEASUREMENT nstat "" UBYTE nmot_ub_q10 1 100 0.00 2550. FORMAT "%5.0" ECU_ADDRESS 0xD0000DB9 /end MEASUREMENT
/begin MEASUREMENT nstat2 "" UBYTE nmot_ub_q10 1 100 0.00 2550. FORMAT "%5.0" ECU_ADDRESS 0xD0000DB5 /end MEASUREMENT
/begin MEASUREMENT nstat3 "" UBYTE nmot_ub_q10 1 100 0.00 2550. FORMAT "%5.0" ECU_ADDRESS 0xD0000DB6 /end MEASUREMENT
/begin MEASUREMENT nstate "" UBYTE nmot_ub_q10 1 100 0.00 2550. FORMAT "%5.0" ECU_ADDRESS 0xD0000DBA /end MEASUREMENT
/begin MEASUREMENT nstatfil "" UBYTE nmot_ub_q10 1 100 0.00 2550. FORMAT "%5.0" ECU_ADDRESS 0xD0000DBB /end MEASUREMENT
/begin MEASUREMENT ovlctr "" UBYTE dez 1 100 0.00 255.0 FORMAT "%5.1" ECU_ADDRESS 0xD0000F3E /end MEASUREMENT
/begin MEASUREMENT rinv_w "" UWORD r_uw_q2 1 100 0.00 131070.0 FORMAT "%8.1" ECU_ADDRESS 0xD00007CC /end MEASUREMENT
/begin MEASUREMENT rkrmx1v6_w "" UWORD spg_q0p00488 1 100 0.00 319.9951 FORMAT "%8.4" ECU_ADDRESS 0xD0000818 /end MEASUREMENT
/begin MEASUREMENT rkrmx_w "" UWORD spg_uw_q0p000076 1 100 0.00007629395 4.999924 FORMAT "%8.6" ECU_ADDRESS 0xD000081A /end MEASUREMENT
/begin MEASUREMENT rkrtp_w "" UWORD spg_uw_q0p000076 1 100 0.00007629395 4.999924 FORMAT "%8.6" ECU_ADDRESS 0xD000081C /end MEASUREMENT
/begin MEASUREMENT rkr_tst_w "" UWORD spg_uw_q0p000076 1 100 0.00 4.999924 FORMAT "%8.6" ECU_ADDRESS 0xD000081E /end MEASUREMENT
/begin MEASUREMENT rkr_w "" UWORD spg_uw_q0p000076 1 100 0.00 4.999924 FORMAT "%8.6" ARRAY_SIZE 3 ECU_ADDRESS 0xD0000828 /end MEASUREMENT
/begin MEASUREMENT stuetz "" UBYTE dez 1 100 0.00 255.0 FORMAT "%5.1" ECU_ADDRESS 0xD0000D5A /end MEASUREMENT
/begin MEASUREMENT taevkr "" UBYTE temp_ub_q0p75_o48 1 100 -48.00 143.3 FORMAT "%5.1" ECU_ADDRESS 0xD0000D5B /end MEASUREMENT
/begin MEASUREMENT taikrsw_w "" UWORD temp_q0p0234_o273 1 100 -273.1500 1262.827 FORMAT "%8.3" ECU_ADDRESS 0xD000085A /end MEASUREMENT
/begin MEASUREMENT tmatbts_w "" UWORD temp_q0p0234_o273 1 100 -273.1500 1262.827 FORMAT "%8.3" ECU_ADDRESS 0xD000085C /end MEASUREMENT
/begin MEASUREMENT tmotlanswl "" UBYTE temp_ub_q0p75_o48 1 100 -48.00 143.3 FORMAT "%5.1" ECU_ADDRESS 0xD0000DA8 /end MEASUREMENT
/begin MEASUREMENT tmp_zknslo "" UBYTE zk20msxs_ub_b5p1 1 100 0.0200000 5.10000 FORMAT "%7.5" ECU_ADDRESS 0xD0000DAE /end MEASUREMENT
/begin MEASUREMENT tmstlanswl "" UBYTE temp_ub_q0p75_o48 1 100 -48.00 143.3 FORMAT "%5.1" ECU_ADDRESS 0xD0000DA9 /end MEASUREMENT
/begin MEASUREMENT usvk_w "" UWORD spg_uw_q0p00488_o1 1 100 -1.000000 318.9951 FORMAT "%8.4" ECU_ADDRESS 0xD00007CE /end MEASUREMENT
/begin MEASUREMENT vikrbuf "" UBYTE fak_ub_b16 1 100 0.00 15.94 FORMAT "%5.2" ARRAY_SIZE 3 ECU_ADDRESS 0xD0000D66 /end MEASUREMENT
/begin MEASUREMENT virkr "" UBYTE fak_ub_b16 1 100 0.00 15.94 FORMAT "%5.2" ECU_ADDRESS 0xD0000D72 /end MEASUREMENT
/begin MEASUREMENT virkr_mir "" UBYTE fak_ub_b16 1 100 0.00 15.94 FORMAT "%5.2" ECU_ADDRESS 0xD0000D73 /end MEASUREMENT
/begin MEASUREMENT vkr "" UBYTE dez 1 100 0.00 6.000 FORMAT "%5.3" ARRAY_SIZE 3 ECU_ADDRESS 0xD0000D74 /end MEASUREMENT
/begin MEASUREMENT vkr_tst "" UBYTE dez 1 100 0.00 255.0 FORMAT "%5.1" ECU_ADDRESS 0xD0000D77 /end MEASUREMENT
/begin MEASUREMENT vszwm "" SBYTE kw_q0p75 1 100 -96.00 95.25 FORMAT "%5.2" ECU_ADDRESS 0xD0000D94 /end MEASUREMENT
/begin MEASUREMENT wessbm "" UBYTE kw_q2p8125 1 100 0.00 717.2 FORMAT "%5.1" ECU_ADDRESS 0xD0000F39 /end MEASUREMENT
/begin MEASUREMENT wkradap "" SBYTE kw_q0p75 1 100 -96.00 95.25 FORMAT "%5.2" ARRAY_SIZE 20 ECU_ADDRESS 0xAFE8018C /end MEASUREMENT
/begin MEASUREMENT wkratst "" SBYTE kw_q0p75 1 100 -96.00 95.25 FORMAT "%5.2" ECU_ADDRESS 0xD0000D58 /end MEASUREMENT
/begin MEASUREMENT wkrdya "" SBYTE kw_q0p75 1 100 -96.00 95.25 FORMAT "%5.2" ARRAY_SIZE 5 ECU_ADDRESS 0xAFE801A0 /end MEASUREMENT
/begin MEASUREMENT wkrdyaa "" SBYTE kw_q0p75 1 100 -96.00 95.25 FORMAT "%5.2" ECU_ADDRESS 0xD0000D5C /end MEASUREMENT
/begin MEASUREMENT wkrdyti "" SBYTE kw_q0p75 1 100 -96.00 95.25 FORMAT "%5.2" ECU_ADDRESS 0xD0000D5D /end MEASUREMENT
/begin MEASUREMENT wkrdyv "" SBYTE kw_q0p75 1 100 -96.00 95.25 FORMAT "%5.2" ECU_ADDRESS 0xD0000D5F /end MEASUREMENT
/begin MEASUREMENT wkrkm "" SBYTE kw_q0p75 1 100 -96.00 95.25 FORMAT "%5.2" ECU_ADDRESS 0xD0000D9E /end MEASUREMENT
/begin MEASUREMENT wkrlzofv "" SBYTE kw_q0p75 1 100 -96.00 95.25 FORMAT "%5.2" ARRAY_SIZE 3 ECU_ADDRESS 0xD0000D83 /end MEASUREMENT
/begin MEASUREMENT wkrmav "" SBYTE kw_q0p75 1 100 -96.00 95.25 FORMAT "%5.2" ECU_ADDRESS 0xD0000D9F /end MEASUREMENT
/begin MEASUREMENT wkrmv "" SBYTE kw_q0p75 1 100 -96.00 95.25 FORMAT "%5.2" ECU_ADDRESS 0xD0000DA0 /end MEASUREMENT
/begin MEASUREMENT wkrv "" SBYTE kw_q0p75 1 100 -96.00 95.25 FORMAT "%5.2" ARRAY_SIZE 3 ECU_ADDRESS 0xD0000DA1 /end MEASUREMENT
/begin MEASUREMENT wkr_tst "" SBYTE kw_q0p75 1 100 -96.00 95.25 FORMAT "%5.2" ECU_ADDRESS 0xD0000D95 /end MEASUREMENT
/begin MEASUREMENT zkrfmu "" UBYTE dez 1 100 0.00 255.0 FORMAT "%5.1" ARRAY_SIZE 3 ECU_ADDRESS 0xD0000D69 /end MEASUREMENT
/begin MEASUREMENT zkrvf "" UBYTE t_q0p1 1 100 0.00 25.50 FORMAT "%5.2" ARRAY_SIZE 3 ECU_ADDRESS 0xD0000D96 /end MEASUREMENT
/begin MEASUREMENT zlamko "" UBYTE dez 1 100 0.00 255.0 FORMAT "%5.1" ECU_ADDRESS 0xD0000DA6 /end MEASUREMENT
/begin MEASUREMENT zlamkod "" UBYTE dez 1 100 0.00 255.0 FORMAT "%5.1" ECU_ADDRESS 0xD0000DA4 /end MEASUREMENT
/begin MEASUREMENT zwoutakt "" SBYTE zw_sb_q0p75 1 100 -96.00 95.25 FORMAT "%5.2" ECU_ADDRESS 0xD0000F3F /end MEASUREMENT
/begin MEASUREMENT zwoutaktar "" SBYTE zw_sb_q0p75 1 100 -96.00 95.25 FORMAT "%5.2" ARRAY_SIZE 3 ECU_ADDRESS 0xD0004798 /end MEASUREMENT
/begin MEASUREMENT zylmin "" UBYTE dez 1 100 0.00 255.0 FORMAT "%5.1" ECU_ADDRESS 0xD0000D6C /end MEASUREMENT
/begin MEASUREMENT zzaehl "" UBYTE dez 1 100 0.00 255.0 FORMAT "%5.1" ECU_ADDRESS 0xD0000F40 /end MEASUREMENT
/begin MEASUREMENT zzaehl_w "" UWORD dez 1 100 0.00 65535.00 FORMAT "%8.2" ECU_ADDRESS 0xD0000B70 /end MEASUREMENT
/begin MEASUREMENT zzbank "" UBYTE dez 1 100 0.00 255.0 FORMAT "%5.1" ECU_ADDRESS 0xD0000F3A /end MEASUREMENT
/begin MEASUREMENT zzprz "" UBYTE rel_q0p39 1 100 0.00 99.61 FORMAT "%5.2" ECU_ADDRESS 0xD0000D5E /end MEASUREMENT
/begin MEASUREMENT zzwdykr_w "" UWORD dez 1 100 0.00 65535.00 FORMAT "%8.2" ECU_ADDRESS 0xD000080C /end MEASUREMENT
/begin MEASUREMENT zzwdymd_w "" UWORD dez 1 100 0.00 65535.00 FORMAT "%8.2" ECU_ADDRESS 0xD000080E /end MEASUREMENT
/begin MEASUREMENT zzylkra "" UBYTE dez 1 100 0.00 255.0 FORMAT "%5.1" ARRAY_SIZE 3 ECU_ADDRESS 0xD0000D86 /end MEASUREMENT
/begin MEASUREMENT zzylkr_mir "" UBYTE dez 1 100 0.00 255.0 FORMAT "%5.1" ECU_ADDRESS 0xD0000D78 /end MEASUREMENT
/begin FUNCTION HEGO_Sens "1.10.0"
 /begin DEF_CHARACTERISTIC HEGO_stSens_CW HEGO_ctRiCalc_C HEGO_duRiAftFrz_C HEGO_stSensHw_CW HEGO_tiDelLdPls_C HEGO_tiDelOpRdnRiPls_C HEGO_tiPolarRedPls_C HEGO_SensS1B1_I.tiDebEnaRiVltg_C HEGO_SensS1B1_I.uRiLoLim_C HEGO_SensS1B1_I.uRiUpLim_C HEGO_tiDelRiPls_C HEGO_tiS1FrzRi_C /end DEF_CHARACTERISTIC
 /begin IN_MEASUREMENT HEGO_bS1B1ErrElecHtrCpl HEGO_bS1B1ErrElecSigPrev HEGO_bS1B1ExptOpRdn HEGO_bS1B1HtgRiReq HEGO_bS1B1LdPlsMinReq HEGO_bS1B1LdPlsSigCnfReq HEGO_bS1B1LdPlsSigReq HEGO_bS1B1OpRdnRiReq HEGO_uS1B1WiDynSim /end IN_MEASUREMENT
 /begin OUT_MEASUREMENT HEGO_bS1B1FrzRi HEGO_bS1B1LdPlsRslt HEGO_bS1B1VldRi HEGO_resS1B1Ri HEGO_resS1B1RiNoFlt HEGO_uS1B1 HEGO_uS1B1Extd HEGO_uS1B1LdPls HEGO_uS1B1Tstr HEGO_uS1B1WoDynSim rinv_w usvk_w /end OUT_MEASUREMENT
 /begin LOC_MEASUREMENT HEGO_bRiPlsReq HEGO_bS1B1RiPlsReq HEGO_idxSensRiPls HEGO_SensS1B1_I.bCalcRi HEGO_SensS1B1_I.bDelOpRdnRiPls HEGO_SensS1B1_I.bEnaLdPls HEGO_SensS1B1_I.bEnaOpRdnRiPls HEGO_SensS1B1_I.bEnaRi HEGO_SensS1B1_I.bEnaRiFlt HEGO_SensS1B1_I.bFrzRi HEGO_SensS1B1_I.bLdPlsEval HEGO_SensS1B1_I.bLdPlsFin HEGO_SensS1B1_I.bLdPlsRslt HEGO_SensS1B1_I.bPlausRi HEGO_SensS1B1_I.bPolarRedPls HEGO_SensS1B1_I.bRiPls HEGO_SensS1B1_I.bRiTrg HEGO_SensS1B1_I.bVldRi HEGO_SensS1B1_I.ctLdPls HEGO_SensS1B1_I.numLdPlsMax HEGO_SensS1B1_I.resRi HEGO_SensS1B1_I.resRiNoFlt HEGO_SensS1B1_I.resRiNoFltPrev HEGO_SensS1B1_I.sm HEGO_SensS1B1_I.uLdPls HEGO_SensS1B1_I.uLdPlsDiff HEGO_SensS1B1_I.uRiAftFrz HEGO_SensS1B1_I.uRiWiLd HEGO_SensS1B1_I.uRiWoLd HEGO_SensS1B1_I.uSExtd /end LOC_MEASUREMENT
 FUNCTION_VERSION "1.10.0" /end FUNCTION
/begin FUNCTION HT2KTTD "4.0.0" /begin DEF_CHARACTERISTIC CWCHT2KTTD /end DEF_CHARACTERISTIC /begin IN_MEASUREMENT B_nmot synstate /end IN_MEASUREMENT /begin LOC_MEASUREMENT B_tdactive /end LOC_MEASUREMENT FUNCTION_VERSION "4.0.0" /end FUNCTION
/begin FUNCTION HT2KTTEV "1.4.0" /begin DEF_CHARACTERISTIC CWTATETEV /end DEF_CHARACTERISTIC /begin IN_MEASUREMENT B_tatewi tateout_w tevper /end IN_MEASUREMENT /begin OUT_MEASUREMENT B_tevtini /end OUT_MEASUREMENT FUNCTION_VERSION "1.4.0" /end FUNCTION
/begin FUNCTION I14229_Appl "7.0.0" FUNCTION_VERSION "7.0.0" /end FUNCTION
/begin FUNCTION I14229_Reset "9.0.0" /begin IN_MEASUREMENT Epm_nEng vfzg /end IN_MEASUREMENT FUNCTION_VERSION "9.0.0" /end FUNCTION
/begin FUNCTION I14229_TPr "10.0.0" FUNCTION_VERSION "10.0.0" /end FUNCTION
/begin FUNCTION I15031Appl_Std "1.38.0" /begin DEF_CHARACTERISTIC I15031_nMaxSrv4_C /end DEF_CHARACTERISTIC /begin IN_MEASUREMENT Epm_nEng /end IN_MEASUREMENT /begin LOC_MEASUREMENT I15031_PIDSuppSrv1 I15031_PIDSuppSrv2 /end LOC_MEASUREMENT FUNCTION_VERSION "1.38.0" /end FUNCTION
/begin FUNCTION I15031_srv1 "1.16.0"
 /begin DEF_CHARACTERISTIC I15031_PID1C_C I15031_PID4FA_C I15031_PID4FB_C I15031_PID4FC_C I15031_PID4FD_C I15031_PID50A_C I15031_PID5F_C /end DEF_CHARACTERISTIC
 /begin OUT_MEASUREMENT I15031_FILLSIG1 I15031_FILLSIG2 I15031_FILLSIG4 I15031_PID1C I15031_PID4FA I15031_PID4FB I15031_PID4FC I15031_PID4FD I15031_PID50A I15031_PID50B I15031_PID50C I15031_PID50D I15031_PID5F /end OUT_MEASUREMENT
 FUNCTION_VERSION "1.16.0" /end FUNCTION
/begin FUNCTION I15031_srv2 "1.25.0" FUNCTION_VERSION "1.25.0" /end FUNCTION
/begin FUNCTION I15031_srv37 "1.11.0" FUNCTION_VERSION "1.11.0" /end FUNCTION
/begin FUNCTION I15031_srv4 "1.10.0" FUNCTION_VERSION "1.10.0" /end FUNCTION
/begin FUNCTION I15031_srv6 "1.11.0" FUNCTION_VERSION "1.11.0" /end FUNCTION
/begin FUNCTION I15031_Srv8 "1.9.1" FUNCTION_VERSION "1.9.1" /end FUNCTION
/begin FUNCTION I15031_srv9 "1.29.0"
 /begin DEF_CHARACTERISTIC I15031_srv9PIDTable.PID0_C I15031_srv9PIDTable.PID1_C I15031_srv9PIDTable.PID2_C I15031_srv9PIDTable.PID3_C I15031_srv9PIDTable.PID4_C I15031_srv9PIDTable.PID5_C I15031_srv9PIDTable.PID6_C I15031_srv9PIDTable.PID7_C I15031_srv9PIDTable.PID8_C I15031_srv9PIDTable.PID9_C I15031_srv9PIDTable.PIDA_C I15031_srv9PIDTable.PIDB_C /end DEF_CHARACTERISTIC
 FUNCTION_VERSION "1.29.0" /end FUNCTION
/begin FUNCTION I15031_Std "1.25.0" FUNCTION_VERSION "1.25.0" /end FUNCTION
/begin FUNCTION IfxFlash "1.11.0" FUNCTION_VERSION "1.11.0" /end FUNCTION
/begin FUNCTION IgCPs_GlbDef "2.2.0" FUNCTION_VERSION "2.2.0" /end FUNCTION
/begin FUNCTION IgnClPsDD "2.1.0" FUNCTION_VERSION "2.1.0" /end FUNCTION
/begin FUNCTION IgnClPs_ConCK "2.2.0" /begin DEF_CHARACTERISTIC IgnClPs_Count IgnClPs_uBattMax_C IgnClPs_uBattMin_C /end DEF_CHARACTERISTIC /begin IN_MEASUREMENT Epm_nEng SyC_stSub ubsq /end IN_MEASUREMENT
 /begin OUT_MEASUREMENT IgnClPs_bDiagEna IgnClPs_numCommErr_u8 IgnClPs_numIgnCh_a8 IgnClPs_numIgnIc_a8 IgnClPs_numPsErr_a16 /end OUT_MEASUREMENT
 /begin LOC_MEASUREMENT IgnClPs_cntIgnOld_u16 IgnClPs_cntIgn_u16 IgnClPs_numDiagReg_u16 /end LOC_MEASUREMENT
 FUNCTION_VERSION "2.2.0" /end FUNCTION
/begin FUNCTION IgnClPs_Dia "2.3.0"
 /begin IN_MEASUREMENT azoffmsk_w IgnClPs_bDiagEna IgnClPs_numCommErr_u8 IgnClPs_numIgnCh_a8 IgnClPs_numIgnIc_a8 IgnClPs_numPsErr_a16 SyC_stSub /end IN_MEASUREMENT
 /begin OUT_MEASUREMENT IgnClPs_valDiaRes_u8 /end OUT_MEASUREMENT
 /begin LOC_MEASUREMENT B_ignpsol B_ignpsscb B_ignpsscg IgnClPs_DiaLokBitsKoop0 /end LOC_MEASUREMENT
 FUNCTION_VERSION "2.3.0" /end FUNCTION
/begin FUNCTION IgnDD "2.22.0" /begin DEF_CHARACTERISTIC CWZUEAB /end DEF_CHARACTERISTIC /begin REF_CHARACTERISTIC CWDMDZAG /end REF_CHARACTERISTIC
 /begin IN_MEASUREMENT B_nlzoff Epm_ctCyl Epm_nEng Epm_stOpMode Epm_stSync flgstign_w frstinjcyl SyC_stSub szout_w zwcalcar zzylzuear /end IN_MEASUREMENT
 /begin OUT_MEASUREMENT azoffmsk_w B_zesync ignactf_w ovlctr zwoutakt zzaehl zzaehl_w /end OUT_MEASUREMENT
 /begin LOC_MEASUREMENT igndd_cylFreeze igndd_fdOutPattern_u16 igndd_fdPatArray_u16 igndd_oldIgnCntVal_u8 igndd_ovl_u8 igndd_state igndd_zwFreeze ignFadeStatBits_w ignswofdly zwoutaktar /end LOC_MEASUREMENT
 FUNCTION_VERSION "2.22.0" /end FUNCTION
/begin FUNCTION IgnH "2.21.0" FUNCTION_VERSION "2.21.0" /end FUNCTION
/begin FUNCTION IKCDST "1.2.0" /begin DEF_CHARACTERISTIC SNMKRA SNMKRB SRL04DYUB SRL04KRUB /end DEF_CHARACTERISTIC /begin IN_MEASUREMENT nmot rl /end IN_MEASUREMENT FUNCTION_VERSION "1.2.0" /end FUNCTION
/begin FUNCTION InjDDPfi "2.10.0"
 /begin IN_MEASUREMENT B_nsp B_stendes dtemnkt_w Epm_ctCyl Epm_nEng Epm_stOpMode Epm_stSync evz_austot SyC_stSub tez_l te_l tvub_w wea weea weestsim wes /end IN_MEASUREMENT
 /begin OUT_MEASUREMENT anzesab_w anzti anztib anztib_w anzti_w frstinjcyl lastzyl nexttizyl /end OUT_MEASUREMENT
 /begin LOC_MEASUREMENT AngZotTicks B_firstSyn /end LOC_MEASUREMENT
 FUNCTION_VERSION "2.10.0" /end FUNCTION
/begin FUNCTION InjHPfi "2.10.1" FUNCTION_VERSION "2.10.1" /end FUNCTION
/begin FUNCTION IsoTp "1.7.0" FUNCTION_VERSION "1.7.0" /end FUNCTION
/begin FUNCTION IsoTpAppl "8.7.0" FUNCTION_VERSION "8.7.0" /end FUNCTION
/begin FUNCTION KHMR "2.10.0"
 /begin DEF_CHARACTERISTIC KFETAKHKTL KFETAKHKTT KFETAKHKW KLDETAKH KLDLUWSKH KLFSTIMLPR KLFSTKTAGE KLFSTKTFHO KLFSTKTMST KLFSTKTTNS SMG08KHUW SNM08KHUW TETAKHKT VFZGKHKT ZKKHKTL ZKKHKTT /end DEF_CHARACTERISTIC
 /begin IN_MEASUREMENT B_kh B_khakt B_khakw B_khan B_khmr B_ll dsdluts_w etazwmn_w fanfkw_w fcoschmn_w fho_w fkhab imlpr_w mifal_w nmot_w tmst tnse_w vfzg_w /end IN_MEASUREMENT
 /begin OUT_MEASUREMENT etaaktsl_w etakhktl_w etakhktt_w etakh_w fwsanfdlut /end OUT_MEASUREMENT
 /begin LOC_MEASUREMENT B_zwetakh etakhaw_w etakhbg_w etakhktn_w etakhkt_w etakhkwn_w etakhkw_w etakhsu_w etakhtrp_w etazwmnk_w fcoscaw_w fstetakhkt fstetakhkw fstkttmsfh fwetakhkt /end LOC_MEASUREMENT
 FUNCTION_VERSION "2.10.0" /end FUNCTION
/begin FUNCTION KnDetControl "1.8.0"
 /begin DEF_CHARACTERISTIC KnDet_ThresNGradMeasWin_C KnDet_ThresNMeasWin_C KnDet_ThresNumMeasWin_C /end DEF_CHARACTERISTIC
 /begin IN_MEASUREMENT dkrksanf Epm_dnEng Epm_nEng Epm_stOpMode fmfkrnew_w KnDet_bDiaDeb KnDet_numValMeasWin KnDet_stSigEval KnDet_vNewIntegWinEnd ksnew vkrnew wmfaseg wmflcd /end IN_MEASUREMENT
 /begin OUT_MEASUREMENT KnDet_bStMeasWin KnDet_ctDia KnDet_ctIntegRsltInvld KnDet_IntegWinEnd KnDet_numFltNew KnDet_numSensDia KnDet_ReqSigEvalMode KnDet_RlsChkMeasWin KnDet_SensMode KnDet_stDiaCtl KnDet_stSigEvalCurrCmb /end OUT_MEASUREMENT
 /begin LOC_MEASUREMENT KnDet_HwDiaMode KnDet_numValMeasWinEst KnDet_numValMeasWinTmp KnDet_phiMeasWinBgn KnDet_phiMeasWinLngth KnDet_phiMeasWinLngthOld KnDet_stGetDigRawVal KnDet_stGnClb KnDet_stMeasWin KnDet_stOfsClb /end LOC_MEASUREMENT
 FUNCTION_VERSION "1.8.0" /end FUNCTION
/begin FUNCTION KnDetLTest "1.4.0" /begin DEF_CHARACTERISTIC KnDet_SensMaxErr_C KnDet_SensMinErr_C /end DEF_CHARACTERISTIC
 /begin IN_MEASUREMENT KnDet_ctDia KnDet_SensMode KnDet_stDiaCtl KnDet_vNewIntegDia /end IN_MEASUREMENT
 /begin OUT_MEASUREMENT KnDet_bDiaDeb KnDet_DiaRes /end OUT_MEASUREMENT
 /begin LOC_MEASUREMENT KnDet_DebDiagVal1 KnDet_DebDiagVal2 KnDet_vValDia /end LOC_MEASUREMENT
 FUNCTION_VERSION "1.4.0" /end FUNCTION
/begin FUNCTION KnDetSigEval "1.8.0" /begin DEF_CHARACTERISTIC KnDet_CoefFlt_CA /end DEF_CHARACTERISTIC /begin IN_MEASUREMENT KnDet_numFltNew KnDet_ReqSigEvalMode /end IN_MEASUREMENT
 /begin OUT_MEASUREMENT KnDet_bNewEval KnDet_numValMeasWin KnDet_stSigEval KnDet_vNewIntegDia KnDet_vNewIntegWinEnd /end OUT_MEASUREMENT
 /begin LOC_MEASUREMENT KnDet_bEnaSigEval /end LOC_MEASUREMENT
 FUNCTION_VERSION "1.8.0" /end FUNCTION
/begin FUNCTION KnDet_Conf "1.9.0" FUNCTION_VERSION "1.9.0" /end FUNCTION
/begin FUNCTION KnDet_Lld "1.9.0" FUNCTION_VERSION "1.9.0" /end FUNCTION
/begin FUNCTION KnDet_MeasWinCtl "1.8.0" /begin IN_MEASUREMENT Epm_ctCyl /end IN_MEASUREMENT /begin OUT_MEASUREMENT KnDet_ctCyl /end OUT_MEASUREMENT FUNCTION_VERSION "1.8.0" /end FUNCTION
/begin FUNCTION KnDet_MeasWinIntrSrv "1.9.0" FUNCTION_VERSION "1.9.0" /end FUNCTION
/begin FUNCTION KnDet_SubBlockIntrSrv "1.9.0" FUNCTION_VERSION "1.9.0" /end FUNCTION
/begin FUNCTION KOEVAB "1.5.0" /begin IN_MEASUREMENT B_evabeep B_hrevab B_motstop Sia_bInjLck /end IN_MEASUREMENT /begin OUT_MEASUREMENT B_koevab /end OUT_MEASUREMENT FUNCTION_VERSION "1.5.0" /end FUNCTION
/begin FUNCTION KONCW ""
 /begin DEF_CHARACTERISTIC CDAAV CDAGR CDAGRE CDAGRL CDAGRS CDAGRV CDALLR CDATNV CDATVH CDATVV CDDMTL CDDPL CDDSBKV CDDST CDDTESK CDDTKA CDDYLSF CDDYLSH CDDYLSU CDEDSS CDEGFE CDEHFM CDEONV CDFTDLA CDGGGTS CDHELSU CDHNOHK CDHNOHKE CDHSF CDHSFE CDHSH CDHSHE CDHSV CDHSVSA CDICLSU CDKAT CDKATSP CDKVS CDKVSCMB CDLASF CDLASH CDLATP CDLATV CDLBK CDLDP CDLLR CDLSF CDLSH CDLSV CDLSVE CDLSVST CDMD CDMKATS CDNOHK CDNOHKP CDNOLSU CDNWS CDPLLSU CDRHLSH CDSALSU CDSKNO CDSLS CDSLSE CDSWE CDTABKOM CDTANKL CDTES CDULSU CDVKT CDWVERAD CWADRES CWAGR CWAGREO CWAGREO2 CWAGRVBP CWALE CWBDE1 CWBDEMD CWBRCFG CWCANCONF CWDKATNO CWDLSU CWERFIL CWFRST CWGRABH CWKLIMA CWKMMILSCT CWKONABG CWKONFGR CWKONFLS CWKONFZ1 CWKONLS CWKTAGRA CWLSFA CWLSHA CWMDAPP CWNSABG CWOBD CWPWF CWRR CWSCTMDE CWSLS CWSYN2APM CWTF CWUHR CWWAKSH CWZGST CW_HWVAR NSWO1 NSWO2 WESBM /end DEF_CHARACTERISTIC
 /begin IN_MEASUREMENT nmot /end IN_MEASUREMENT
 /begin OUT_MEASUREMENT B_4wd B_abstnl B_adrkra B_adrldra B_adrlra B_adrmdver B_adrmsdk B_adrsta B_ainfgr B_asm B_asrfz B_autget B_brport B_canfgr B_ccpappli B_cdaav B_cdagr B_cdagre B_cdagrl B_cdagrs B_cdagrv B_cdanws B_cdatnv B_cdatvh B_cdatvv B_cddmtl B_cddpl B_cddsbkv B_cddst B_cddtesk B_cddylsf B_cddylsh B_cddylsu B_cdedss B_cdegfe B_cdehfm B_cdenws B_cdeonv B_cdfrst B_cdftdla B_cdgts B_cdhelsu B_cdhnohk B_cdhnohke B_cdhsf B_cdhsfe B_cdhsh B_cdhshe B_cdhsv B_cdhsvsa B_cdiclsu B_cdkat B_cdkatno B_cdkatsp B_cdkatspf B_cdkatspt B_cdkvs B_cdkvscmb B_cdlasf B_cdlash B_cdlatp B_cdlatv B_cdlbk B_cdlbkf B_cdlbko B_cdlbkp B_cdldp B_cdllr B_cdllrkh B_cdlsf B_cdlsh B_cdlsv B_cdlsve B_cdlsvst B_cdmd B_cdmkats B_cdnohk B_cdnohkp B_cdnolsu B_cdnws B_cdpllsu B_cdrhsh B_cdsalsu B_cdskno B_cdsls B_cdslse B_cdswe B_cdtabkom B_cdtankl B_cdtes B_cdtka B_cdulsu B_cdvkt B_cvt B_cwagrap B_cwagrh B_cwagrhap B_cwagrlsr B_cwagrs B_cwlsfdyn B_cwlsfoff B_cwlsfsch B_cwlsfvl B_cwlshdyn B_cwlshsch B_cwlshvl B_cwsfndyn B_cwsfnsch B_cwslow B_cwsnodyn B_cwsnosch B_cwsnslow B_cwzgst B_dinfgr B_dkg B_dslvh B_dssv B_dsuv B_dsvap B_esbhap B_esbkhap B_esbsap B_esesap B_etsport B_fglahmm B_fgzwhmmc B_fpwdkap B_gra6p B_gracan B_hfmv B_hmmlb B_hspmd B_katfz B_kath B_klima B_kmmilsct B_lamhap B_ldsafw B_ldsapp B_lsf B_lsf2 B_lsh B_lsh2 B_lsv B_lsv2 B_mde8e B_mde9e B_mdvur B_mt B_ndsav B_niveau B_nswo1 B_nswo2 B_plsolap B_png B_prsolap B_psmxrkap B_rkapp B_rlsschap B_rriesap B_rrisolap B_slsfz B_tfu B_uhrrmin B_uhrrsec B_varfgr B_waksh B_wdkhomap B_wdksap B_wdkschap B_zwappl B_zwschap cw_erfil cw_obd grdwof grundwert koncwAusBitsKoop0 koncwAusBitsKoop1 koncwAusBitsKoop10 koncwAusBitsKoop11 koncwAusBitsKoop12 koncwAusBitsKoop13 koncwAusBitsKoop14 koncwAusBitsKoop15 koncwAusBitsKoop16 koncwAusBitsKoop17 koncwAusBitsKoop18 koncwAusBitsKoop19 koncwAusBitsKoop2 koncwAusBitsKoop20 koncwAusBitsKoop21 koncwAusBitsKoop3 koncwAusBitsKoop4 koncwAusBitsKoop5 koncwAusBitsKoop6 koncwAusBitsKoop7 koncwAusBitsKoop8 koncwAusBitsKoop9 wessbm zzbank /end OUT_MEASUREMENT
/end FUNCTION
/begin FUNCTION KRADAP "4.0.0" /begin DEF_CHARACTERISTIC KRDWA KRDWKLA KRDWSA /end DEF_CHARACTERISTIC
 /begin IN_MEASUREMENT B_eepwf B_kl B_kr B_kradap B_krdws B_krvf krmxw kr_monitor stkraidx_w wkrkm wkrmv zzylkr /end IN_MEASUREMENT
 /begin OUT_MEASUREMENT wkradap wkratst /end OUT_MEASUREMENT
 FUNCTION_VERSION "4.0.0" /end FUNCTION
/begin FUNCTION KRDY "5.0.0" /begin DEF_CHARACTERISTIC DYADS DZWTIN FKELDYA KFDYMNTVS /end DEF_CHARACTERISTIC /begin REF_CHARACTERISTIC SNMKRB /end REF_CHARACTERISTIC
 /begin IN_MEASUREMENT B_eepwf B_kl B_krdyaen B_krldya B_krldyf B_krldyv B_ladap B_tipin B_tmkr B_zwkraa kek nmot stkrnx taev_w virkr zzylkr /end IN_MEASUREMENT
 /begin OUT_MEASUREMENT wkrdya wkrdyv /end OUT_MEASUREMENT
 /begin LOC_MEASUREMENT B_kldynrm B_kldystk dymntvs stuetz taevkr wkrdyaa wkrdyti zzprz zzwdykr_w zzwdymd_w /end LOC_MEASUREMENT
 FUNCTION_VERSION "5.0.0" /end FUNCTION
/begin FUNCTION KRKE "13.0.0"
 /begin DEF_CHARACTERISTIC FKEDY FKEFMC KFFTPKR KFKE0 KFKE1 KFKE2 KRNGFILO KRNGFILU RKRMX1V6N ZKRNGFIL /end DEF_CHARACTERISTIC
 /begin REF_CHARACTERISTIC SNMKRA SRL04KRUB /end REF_CHARACTERISTIC
 /begin IN_MEASUREMENT B_kr B_krldy B_krndy B_krnl B_stend fmfkrnew_w krintka1_w kr_monitor ngas_w nmot rl zzyl zzylkr zzylkr_int /end IN_MEASUREMENT
 /begin OUT_MEASUREMENT B_kl fmfkrc ikr_tst_w ikr_w kek krngfil rkr_w virkr virkr_mir vkr vkr_tst zzylkr_mir /end OUT_MEASUREMENT
 /begin LOC_MEASUREMENT fmfkrako_w ke kek_tst krftpakt krftpst rkrmx1v6_w rkrmx_w rkrtp_w rkr_tst_w vikrbuf zkrfmu zylmin /end LOC_MEASUREMENT
 FUNCTION_VERSION "13.0.0" /end FUNCTION
/begin FUNCTION KRLZ "1.3.0"
 /begin DEF_CHARACTERISTIC CWKRNLR KRLLZA KRNLZOB KRNLZUN LZFUERV MINAKRLZ TKRLZAMN WKRLZOFEKS WKRLZOFS /end DEF_CHARACTERISTIC
 /begin REF_CHARACTERISTIC SENZZYL /end REF_CHARACTERISTIC
 /begin IN_MEASUREMENT B_kr B_krnl krevz_atot nmot rl stkrkserr wkrv /end IN_MEASUREMENT
 /begin OUT_MEASUREMENT B_krdwslz maskgz wkrlzofv zzylkra /end OUT_MEASUREMENT
 /begin LOC_MEASUREMENT akrgz akrlz B_elzmn B_krlz B_lzup krlzn krlzsfytm maskeks masklz /end LOC_MEASUREMENT
 FUNCTION_VERSION "1.3.0" /end FUNCTION
/begin FUNCTION KRREG "8.0.0"
 /begin DEF_CHARACTERISTIC CWKROFFGZ DWKRMSN FKRVFS KFKRFKN KFKRMXNT KFTKRVFN KRDWSN VZWKR /end DEF_CHARACTERISTIC
 /begin REF_CHARACTERISTIC SNMKRB /end REF_CHARACTERISTIC
 /begin IN_MEASUREMENT B_eepwf B_kl B_kr B_krdws B_krgz B_krkez B_llri B_wkral B_zwkrum evz_austot krevz_atot kr_monitor maskgz nmot stkraidx_w tmot virkr wkradap wkrlzofv zwkrafld zzylkr zzylkra /end IN_MEASUREMENT
 /begin OUT_MEASUREMENT B_krvf B_wkralcpy dwkr dwkrz frlmxdzw_w krmxw wkrkm wkrmav wkrmv wkrv /end OUT_MEASUREMENT
 /begin LOC_MEASUREMENT dwkrms klopfakt krdwsw krfkwz krfkwz_out krvfwz mkrzwsp vszwm wkr_tst zkrvf /end LOC_MEASUREMENT
 FUNCTION_VERSION "8.0.0" /end FUNCTION
/begin FUNCTION LAKH "1.6.0" /begin DEF_CHARACTERISTIC KFLANSKH KFLMSKH KLLAKHFH LMSTMOT /end DEF_CHARACTERISTIC /begin IN_MEASUREMENT anztib_w B_kh B_kha fho_w flakh nmot_w rl_w tmot tmst /end IN_MEASUREMENT /begin OUT_MEASUREMENT B_lamkh B_lamkhe lamkh_w /end OUT_MEASUREMENT /begin LOC_MEASUREMENT B_dslafa lamkhg_w lamkhr_w lanskh_w lmskh_w /end LOC_MEASUREMENT FUNCTION_VERSION "1.6.0" /end FUNCTION
/begin FUNCTION LAMBTS "1.10.2"
 /begin DEF_CHARACTERISTIC CWLAMBTS DFRLBTSN DFRLBTSNN DFRLBTSP DLABTSELSV DLBTS DLBTSGANG DLBTSVFZG DRLMXBTS DTBTSGAS DTBTSKAT DTBTSNL DTBTSNLLSV DTBTSOFF FRLBTSMN KFFDLBTS KFLBTS KFLBTSBG KFLBTSL KLTIKBTSMT KLZDLBTS LBTSSTART SDETA08UW SNM16GKUW SRL12GKUW TANAVMBTS TANVKBTS TAVHKBTS TAVROBTS TAVVKBTS TKIHKBTS TKIVKBTS TVFUABTS TVLBTSGAS TVLBTSKAT ZLBTS /end DEF_CHARACTERISTIC
 /begin IN_MEASUREMENT B_ate B_bevab B_dash B_gsaf B_kuppl B_lalgf B_ll B_sa B_stend etazwb_w etazwimt etazwist_w etazwmn_w gangist ml_w nmot_w rlsol_w rl_w taikr_w tanavm_w tanvk_w tavhk_w tavrom_w tavvk_w tkihkm_w tkivkm_w tmatar_l vfzg_w zwgru zwopt /end IN_MEASUREMENT
 /begin OUT_MEASUREMENT B_fuabts B_lambts dtlabts_w frlmxbts_w lambs_w lambts_w /end OUT_MEASUREMENT
 /begin LOC_MEASUREMENT B_btsnl B_lbtsatm B_lbtsbg detazwbs_w dlbtszwr_w dlbtszw_w dtbtsgs_w dtbtska_w etazwg_w flbtatm_w labtszw_w lbtsaw_w lbtsgs_w lbtsskf_w lbts_w taikrsw_w tmatbts_w /end LOC_MEASUREMENT
 FUNCTION_VERSION "1.10.2" /end FUNCTION
/begin FUNCTION LAMKO "1.16.1"
 /begin DEF_CHARACTERISTIC CWLAMKO CWLAMKOAP LAMHAP LAMLGFKT LAMLGFTM LAMLGMKT LAMLGMTM LASOAB LASOABDMD LASOABDQ TLASOABDQ /end DEF_CHARACTERISTIC
 /begin REF_CHARACTERISTIC STM12ESUB /end REF_CHARACTERISTIC
 /begin IN_MEASUREMENT B_bevab B_fa B_lambts B_lamfa B_lamka B_lamkh B_lamnswl B_zwget esst_stm12esub flgtiab lambts_w lamfa_w lamka_w lamkh_w lamnswl_w tmot /end IN_MEASUREMENT
 /begin OUT_MEASUREMENT B_lalgf B_lamdiag B_lamsdef lambas lambas_w lamlgfmn_w lamlgm_w lamsbg_w lams_w zlamko /end OUT_MEASUREMENT
 /begin LOC_MEASUREMENT B_ldef lamdiag_w lamsfbt_w lamsubg_w lamwbr_w zlamkod /end LOC_MEASUREMENT
 FUNCTION_VERSION "1.16.1" /end FUNCTION
/begin FUNCTION LANSWL "1.4.0"
 /begin DEF_CHARACTERISTIC ATISLATX ATIWKSTX CWWL DLAMNSWL KFLANS KFLASWLRTX LASWLTX ZKLANSWL /end DEF_CHARACTERISTIC
 /begin IN_MEASUREMENT anztib_w B_lrnda B_stendes B_wks tmot tmst /end IN_MEASUREMENT
 /begin OUT_MEASUREMENT anztib1_w B_lamnswl lamnswl_w lamns_w /end OUT_MEASUREMENT
 /begin LOC_MEASUREMENT anztib0_w B_lawlon lamwl_w tmotlanswl tmstlanswl /end LOC_MEASUREMENT
 FUNCTION_VERSION "1.4.0" /end FUNCTION
/begin FUNCTION LLRBB "3.0.0"
 /begin DEF_CHARACTERISTIC CNFKUPPL CWLLRBBSV DNLLR DNLLRLR LLRBBTMOTO LLRBBTMOTU STM06MDUB TLLRPDOFF TVDK TVKUPPL TVLLR TVLLRI TVLLRPD VLLR2 /end DEF_CHARACTERISTIC
 /begin REF_CHARACTERISTIC NLLREIN TVLLRSTE /end REF_CHARACTERISTIC
 /begin IN_MEASUREMENT B_dash B_fil B_fs B_kuppl B_ll B_mdein B_nllstab B_nmot B_sa B_sab B_stend B_wkauf dn_w gangi nmotll nmot_w nsol nstat tmot tnst_w vfzg_w /end IN_MEASUREMENT
 /begin OUT_MEASUREMENT B_enllri B_llr B_llrein B_llri B_llrpd B_nstu B_vllr /end OUT_MEASUREMENT
 FUNCTION_VERSION "3.0.0" /end FUNCTION
/begin FUNCTION LLRNSNF "4.0.0"
 /begin DEF_CHARACTERISTIC DNSNFST DNSNFX DNSOLST DNSTATMST DNSTLST FNSNF FNSSTKM FNSSTM FZKLLSTAB KFZNSM KNSNF NGNSNF NSOLMX NSOLMXTCU SNS06LLSB ZKLLLST ZKLLSTAB /end DEF_CHARACTERISTIC
 /begin REF_CHARACTERISTIC CWNSTAT STM06LLUB STMS06LLUB /end REF_CHARACTERISTIC
 /begin IN_MEASUREMENT B_khn B_ll B_llrein B_llrst B_nsoltcu B_nswo1 esst_stms06llub ngfil nmotll nstate tmot tmst /end IN_MEASUREMENT
 /begin OUT_MEASUREMENT B_nllstab B_nsolst dns nsol nsol_w nsst /end OUT_MEASUREMENT
 /begin LOC_MEASUREMENT dnsolzkst nsnf nsolmaxll nsolst tmp_zknslo /end LOC_MEASUREMENT
 FUNCTION_VERSION "4.0.0" /end FUNCTION
/begin FUNCTION LLRNSTAT "4.0.0"
 /begin DEF_CHARACTERISTIC CNFLLRNS CWFHO CWLLRNS CWNSTAT KLLLRNFHO NFSMIN NLLMG NLLMGAC NLLMGFS NLLMGFSAC NLLMIN NTIPLL SGA08LLUB STM10LLUB ZKNS ZKNSU /end DEF_CHARACTERISTIC
 /begin IN_MEASUREMENT B_br2k B_fs B_ll B_llrein B_nac B_nswo1 B_stend B_vllr fho gangi nmot nsmodac nsmodgen nsmodlph nsmodrec nsolac nsolblp nsolcat nsolgen nsolhtd nsollph nsolpst nsolrec nsolwih tmot /end IN_MEASUREMENT
 /begin OUT_MEASUREMENT B_brufs B_tpn nsolbas nstat nstate nstatfil /end OUT_MEASUREMENT
 /begin LOC_MEASUREMENT gangllr nsolfho nstat2 nstat3 /end LOC_MEASUREMENT
 FUNCTION_VERSION "4.0.0" /end FUNCTION
/begin COMPU_METHOD AngleCrS "" RAT_FUNC "%6.4" "deg CrS" COEFFS 0 45.5111111111 0 0 0 1 /end COMPU_METHOD
/begin COMPU_METHOD B_TRUE "" TAB_VERB "%6.3" "" COMPU_TAB_REF B_TRUE /end COMPU_METHOD
/begin COMPU_VTAB B_TRUE "" TAB_VERB 2 0 "----" 1 "TRUE" /end COMPU_VTAB
/begin COMPU_METHOD dez "" RAT_FUNC "%6.2" "" COEFFS 0 1 0 0 0 1 /end COMPU_METHOD
/begin COMPU_METHOD EngN "" RAT_FUNC "%6.3" "rpm" COEFFS 0 2 0 0 0 1 /end COMPU_METHOD
/begin COMPU_METHOD EngNGrd "" RAT_FUNC "%6.3" "rpm/s" COEFFS 0 2 0 0 0 1 /end COMPU_METHOD
/begin COMPU_METHOD fak_q0p000244 "" RAT_FUNC "%6.5" "-" COEFFS 0 65536 0 0 0 16 /end COMPU_METHOD
/begin COMPU_METHOD fak_sb_b1 "" RAT_FUNC "%6.4" "-" COEFFS 0 256 0 0 0 2 /end COMPU_METHOD
/begin COMPU_METHOD fak_sw_b1 "" RAT_FUNC "%7.6" "-" COEFFS 0 65536 0 0 0 2 /end COMPU_METHOD
/begin COMPU_METHOD fak_sw_b8 "" RAT_FUNC "%6.5" "-" COEFFS 0 65536 0 0 0 16 /end COMPU_METHOD
/begin COMPU_METHOD fak_ub_b1 "" RAT_FUNC "%6.4" "-" COEFFS 0 256 0 0 0 1 /end COMPU_METHOD
/begin COMPU_METHOD fak_ub_b16 "" RAT_FUNC "%6.4" "-" COEFFS 0 256 0 0 0 16 /end COMPU_METHOD
/begin COMPU_METHOD fak_ub_b2 "" RAT_FUNC "%8.5" "-" COEFFS 0 256 0 0 0 2 /end COMPU_METHOD
/begin COMPU_METHOD fak_ub_b4 "" RAT_FUNC "%6.4" "-" COEFFS 0 256 0 0 0 4 /end COMPU_METHOD
/begin COMPU_METHOD fak_uw_b1 "" RAT_FUNC "%7.6" "-" COEFFS 0 65536 0 0 0 1 /end COMPU_METHOD
/begin COMPU_METHOD fak_uw_b16 "" RAT_FUNC "%6.5" "-" COEFFS 0 65536 0 0 0 16 /end COMPU_METHOD
/begin COMPU_METHOD fak_uw_b2 "" RAT_FUNC "%7.6" "-" COEFFS 0 65536 0 0 0 2 /end COMPU_METHOD
/begin COMPU_METHOD fak_uw_b4 "" RAT_FUNC "%7.6" "-" COEFFS 0 65536 0 0 0 4 /end COMPU_METHOD
/begin COMPU_METHOD I15031_PID1CVerb "" TAB_VERB "%6.3" "-" COMPU_TAB_REF I15031_PID1CVerb /end COMPU_METHOD
/begin COMPU_VTAB I15031_PID1CVerb "" TAB_VERB 21 1 "OBD II" 2 "OBD" 3 "OBD and OBD II" 4 "OBD I" 5 "No OBD" 6 "EOBD" 7 "EOBD and OBD II" 8 "EOBD and OBD" 9 "EOBD, OBD and OBD II" 10 "JOBD" 11 "JOBD and OBD II" 12 "JOBD and EOBD" 13 "JOBD, EOBD and OBD II" 17 "EMD" 18 "EMD+" 19 "HD OBD-C" 20 "HD OBD" 21 "WWH OBD" 23 "HD EOBD" 28 "OBDBr-1" 29 "OBDBr-2" /end COMPU_VTAB
/begin COMPU_METHOD I15031_PID5FVerb "" TAB_VERB "%6.3" "-" COMPU_TAB_REF I15031_PID5FVerb /end COMPU_METHOD
/begin COMPU_VTAB I15031_PID5FVerb "" TAB_VERB 3 14 "EURO IV B1" 15 "EURO V B2" 16 "EURO C" /end COMPU_VTAB
/begin COMPU_METHOD kw_q0p75 "" RAT_FUNC "%6.3" "Grad KW" COEFFS 0 4 0 0 0 3 /end COMPU_METHOD
/begin COMPU_METHOD kw_q1 "" RAT_FUNC "%6.2" "Grad KW" COEFFS 0 1 0 0 0 1 /end COMPU_METHOD
/begin COMPU_METHOD kw_q2p8125 "" RAT_FUNC "%6.2" "deg KW" COEFFS 0 1 0 0 0 2.8125 /end COMPU_METHOD
/begin COMPU_METHOD kw_sw_q0p0219 "" RAT_FUNC "%6.4" "Grad KW" COEFFS 0 32768 0 0 0 720 /end COMPU_METHOD
/begin COMPU_METHOD lu_MEx "" RAT_FUNC "%6.4" "(Umdr./sec)^2" COEFFS 0 219.9023255552 0 0 0 1 /end COMPU_METHOD
/begin COMPU_METHOD m_uw_b6553p5 "" RAT_FUNC "%6.3" "kg/h" COEFFS 0 1 0 0 0 0.1 /end COMPU_METHOD
/begin COMPU_METHOD nmotd_sb_q10 "" RAT_FUNC "%6.1" "1/min" COEFFS 0 1 0 0 0 10 /end COMPU_METHOD
/begin COMPU_METHOD nmotg_sb_q100 "" RAT_FUNC "%6.0" "1/(min*s)" COEFFS 0 1 0 0 0 100 /end COMPU_METHOD
/begin COMPU_METHOD nmotg_ub_q100 "" RAT_FUNC "%6.0" "1/(min*s)" COEFFS 0 1 0 0 0 100 /end COMPU_METHOD
/begin COMPU_METHOD nmot_q0p5 "" RAT_FUNC "%6.3" "1/min" COEFFS 0 2 0 0 0 1 /end COMPU_METHOD
/begin COMPU_METHOD nmot_sw_q0p25 "" RAT_FUNC "%6.3" "1/min" COEFFS 0 1 0 0 0 0.25 /end COMPU_METHOD
/begin COMPU_METHOD nmot_ub_q10 "" RAT_FUNC "%6.1" "1/min" COEFFS 0 1 0 0 0 10 /end COMPU_METHOD
/begin COMPU_METHOD nmot_ub_q40 "" RAT_FUNC "%6.1" "1/min" COEFFS 0 1 0 0 0 40 /end COMPU_METHOD
/begin COMPU_METHOD nmot_uw_q0p25 "" RAT_FUNC "%6.3" "1/min" COEFFS 0 1 0 0 0 0.25 /end COMPU_METHOD
/begin COMPU_METHOD OneToOne "" RAT_FUNC "%6.2" "-" COEFFS 0 1 0 0 0 1 /end COMPU_METHOD
/begin COMPU_METHOD OneToTenCarb "" RAT_FUNC "%6.1" "-" COEFFS 0 0.1 0 0 0 1 /end COMPU_METHOD
/begin COMPU_METHOD rel_q0p0234 "" RAT_FUNC "%6.4" "%" COEFFS 0 128 0 0 0 3 /end COMPU_METHOD
/begin COMPU_METHOD rel_q0p39 "" RAT_FUNC "%6.3" "%" COEFFS 0 256 0 0 0 100 /end COMPU_METHOD
/begin COMPU_METHOD rel_sw_q0p0234 "" RAT_FUNC "%6.4" "%/seg" COEFFS 0 32 0 0 0 0.75 /end COMPU_METHOD
/begin COMPU_METHOD rel_ub_q0p75 "" RAT_FUNC "%6.3" "%" COEFFS 0 1 0 0 0 0.75 /end COMPU_METHOD
/begin COMPU_METHOD rel_uw_b100 "" RAT_FUNC "%6.4" "%" COEFFS 0 65536 0 0 0 100 /end COMPU_METHOD
/begin COMPU_METHOD rel_uw_q0p0234 "" RAT_FUNC "%6.4" "%" COEFFS 0 32 0 0 0 0.75 /end COMPU_METHOD
/begin COMPU_METHOD rfak_q0p5 "" RAT_FUNC "%6.2" "-" COEFFS 0 0 128 0 1 0 /end COMPU_METHOD
/begin COMPU_METHOD r_uw_q2 "" RAT_FUNC "%6.2" "Ohm" COEFFS 0 1 0 0 0 2 /end COMPU_METHOD
/begin COMPU_METHOD spg_q0p00488 "" RAT_FUNC "%6.4" "V" COEFFS 0 1024 0 0 0 5 /end COMPU_METHOD
/begin COMPU_METHOD spg_q0p005 "" RAT_FUNC "%6.4" "V" COEFFS 0 1 0 0 0 0.005 /end COMPU_METHOD
/begin COMPU_METHOD spg_q0p1 "" RAT_FUNC "%6.3" "V" COEFFS 0 1 0 0 0 0.1 /end COMPU_METHOD
/begin COMPU_METHOD spg_sw_q0p0001 "" RAT_FUNC "%6.5" "V" COEFFS 0 32768 0 0 0 3.3 /end COMPU_METHOD
/begin COMPU_METHOD spg_uw_q0p000076 "" RAT_FUNC "%7.6" "V" COEFFS 0 65536 0 0 0 5 /end COMPU_METHOD
/begin COMPU_METHOD spg_uw_q0p00488_o1 "" RAT_FUNC "%6.3" "V" COEFFS 0 1024 1024 0 0 5 /end COMPU_METHOD
/begin COMPU_METHOD SY_DVEAMP_Compu "" TAB_VERB "%6.3" "" COMPU_TAB_REF SY_DVEAMP_Compu /end COMPU_METHOD
/begin COMPU_VTAB SY_DVEAMP_Compu "" TAB_VERB 2 0 "= kein Verstärker vorhanden" 1 "= Verstärker vorhanden" /end COMPU_VTAB
/begin COMPU_METHOD SY_DVEANZ_Compu "" RAT_FUNC "%6.2" "" COEFFS 0 1 0 0 0 1 /end COMPU_METHOD
/begin COMPU_METHOD SY_DVEATT_Compu "" TAB_VERB "%6.3" "" COMPU_TAB_REF SY_DVEATT_Compu /end COMPU_METHOD
/begin COMPU_VTAB SY_DVEATT_Compu "" TAB_VERB 2 0 "no DV-E adaption at low temperatures possible" 1 "DV-E adaption at low temperatures possible" /end COMPU_VTAB
/begin COMPU_METHOD SY_DVEFO_Compu "" TAB_VERB "%6.3" "" COMPU_TAB_REF SY_DVEFO_Compu /end COMPU_METHOD
/begin COMPU_VTAB SY_DVEFO_Compu "" TAB_VERB 2 0 "0 = DVE öffnede Federprüfung nicht vorhanden" 1 "1 = DVE öffnede Federprüfung kann eingeschaltet we" /end COMPU_VTAB
/begin COMPU_METHOD SY_DVEKOMP_Compu "" TAB_VERB "%6.3" "" COMPU_TAB_REF SY_DVEKOMP_Compu /end COMPU_METHOD
/begin COMPU_VTAB SY_DVEKOMP_Compu "" TAB_VERB 4 1 "Limp home position in control range (DV-E5)" 2 "Limp home position out of ctrl range (DV-E8.1nc)" 3 "Limp home position out of control range (DV-E8.1c)" 4 "Like 1, but programmed sensor" /end COMPU_VTAB
/begin COMPU_METHOD SY_DVEKOOR_Compu "" TAB_VERB "%6.3" "" COMPU_TAB_REF SY_DVEKOOR_Compu /end COMPU_METHOD
/begin COMPU_VTAB SY_DVEKOOR_Compu "" TAB_VERB 2 0 "kein eigenes DVE-Koordinatensystem" 1 "eigenes DVE-Koordinatensystem" /end COMPU_VTAB
/begin COMPU_METHOD SY_DWVNWKW_Compu "" TAB_VERB "%6.3" "" COMPU_TAB_REF SY_DWVNWKW_Compu /end COMPU_METHOD
/begin COMPU_VTAB SY_DWVNWKW_Compu "" TAB_VERB 2 0 "No OBD2 angle misalignment" 1 "OBD2 angle misalignment diagnosis installed" /end COMPU_VTAB
/begin COMPU_METHOD SY_DYCOP_Compu "" TAB_VERB "%6.3" "" COMPU_TAB_REF SY_DYCOP_Compu /end COMPU_METHOD
/begin COMPU_VTAB SY_DYCOP_Compu "" TAB_VERB 2 0 "disabled" 1 "enabled" /end COMPU_VTAB
/begin COMPU_METHOD SY_DYLSEVAL_Compu "" TAB_VERB "%6.3" "" COMPU_TAB_REF SY_DYLSEVAL_Compu /end COMPU_METHOD
/begin COMPU_VTAB SY_DYLSEVAL_Compu "" TAB_VERB 2 0 "False" 1 "True" /end COMPU_VTAB
/begin COMPU_METHOD SY_DYLSF_Compu "" TAB_VERB "%6.3" "" COMPU_TAB_REF SY_DYLSF_Compu /end COMPU_METHOD
/begin COMPU_VTAB SY_DYLSF_Compu "" TAB_VERB 2 0 "False" 1 "True" /end COMPU_VTAB
/begin COMPU_METHOD SY_DYLSH_Compu "" TAB_VERB "%6.3" "" COMPU_TAB_REF SY_DYLSH_Compu /end COMPU_METHOD
/begin COMPU_VTAB SY_DYLSH_Compu "" TAB_VERB 2 0 "False" 1 "True" /end COMPU_VTAB
/begin COMPU_METHOD SY_DZWB2_Compu "" TAB_VERB "%6.3" "" COMPU_TAB_REF SY_DZWB2_Compu /end COMPU_METHOD
/begin COMPU_VTAB SY_DZWB2_Compu "" TAB_VERB 3 0 "no" 1 "earliest possible" 2 "output" /end COMPU_VTAB
/begin COMPU_METHOD SY_DZWBS_Compu "" TAB_VERB "%6.3" "" COMPU_TAB_REF SY_DZWBS_Compu /end COMPU_METHOD
/begin COMPU_VTAB SY_DZWBS_Compu "" TAB_VERB 2 0 "false" 1 "true" /end COMPU_VTAB
/begin COMPU_METHOD SY_DZWKS_Compu "" TAB_VERB "%6.3" "" COMPU_TAB_REF SY_DZWKS_Compu /end COMPU_METHOD
/begin COMPU_VTAB SY_DZWKS_Compu "" TAB_VERB 2 0 "false" 1 "true" /end COMPU_VTAB
/begin COMPU_METHOD SY_DZWK_Compu "" TAB_VERB "%6.3" "" COMPU_TAB_REF SY_DZWK_Compu /end COMPU_METHOD
/begin COMPU_VTAB SY_DZWK_Compu "" TAB_VERB 4 0 "nicht vorhanden" 1 "dzwzk" 2 "dzwks" 3 "dzwzk+dzwks" /end COMPU_VTAB
/begin COMPU_METHOD SY_EAOMSDK_Compu "" TAB_VERB "%6.3" "" COMPU_TAB_REF SY_EAOMSDK_Compu /end COMPU_METHOD
/begin COMPU_VTAB SY_EAOMSDK_Compu "" TAB_VERB 2 0 "first adaptation disabled" 1 "first adaptation enabled" /end COMPU_VTAB
/begin COMPU_METHOD SY_EBFMOD_Compu "" TAB_VERB "%6.3" "" COMPU_TAB_REF SY_EBFMOD_Compu /end COMPU_METHOD
/begin COMPU_VTAB SY_EBFMOD_Compu "" TAB_VERB 4 0 "Kein Erstbefüllungsmodus des Kraftstoffsystems" 1 "Erstbefüllung ohne Berücksichtigung Urstartsperre" 2 "Erstbefüllung mit Berücksichtigung Urstartsperre" 3 "Automatische Erstbefüllung" /end COMPU_VTAB
/begin COMPU_METHOD SY_ECUGENR_Compu "" TAB_VERB "%6.3" "" COMPU_TAB_REF SY_ECUGENR_Compu /end COMPU_METHOD
/begin COMPU_VTAB SY_ECUGENR_Compu "" TAB_VERB 3 0 "Mx7" 1 "Mx9" 2 "Mx17" /end COMPU_VTAB
/begin COMPU_METHOD SY_EDMMILA_Compu "" RAT_FUNC "%6.2" "" COEFFS 0 1 0 0 0 1 /end COMPU_METHOD
/begin COMPU_METHOD SY_EEPACC_Compu "" TAB_VERB "%6.3" "" COMPU_TAB_REF SY_EEPACC_Compu /end COMPU_METHOD
/begin COMPU_VTAB SY_EEPACC_Compu "" TAB_VERB 4 0 "ME7" 1 "ME7 32Bit-EEPROM" 2 "ME9" 3 "ME17" /end COMPU_VTAB
/begin COMPU_METHOD SY_EGAS_Compu "" TAB_VERB "%6.3" "" COMPU_TAB_REF SY_EGAS_Compu /end COMPU_METHOD
/begin COMPU_VTAB SY_EGAS_Compu "" TAB_VERB 2 0 "kein E-GAS System" 1 "E-GAS System" /end COMPU_VTAB
/begin COMPU_METHOD SY_EGFE_Compu "" RAT_FUNC "%6.2" "" COEFFS 0 1 0 0 0 1 /end COMPU_METHOD
/begin COMPU_METHOD SY_EKPRMK_Compu "" TAB_VERB "%6.3" "" COMPU_TAB_REF SY_EKPRMK_Compu /end COMPU_METHOD
/begin COMPU_VTAB SY_EKPRMK_Compu "" TAB_VERB 2 0 "keine anderen mitversorgten Komponenten oder ME9" 1 "nur ME7: mit anderen mitversorgten Komponenten" /end COMPU_VTAB
/begin COMPU_METHOD SY_EKPTSOF_Compu "" TAB_VERB "%6.3" "" COMPU_TAB_REF SY_EKPTSOF_Compu /end COMPU_METHOD
/begin COMPU_VTAB SY_EKPTSOF_Compu "" TAB_VERB 2 1 "SY_EKPTSOF_1" 0 "SY_EKPTSOF_0" /end COMPU_VTAB
/begin COMPU_METHOD SY_EOLT_Compu "" TAB_VERB "%6.3" "" COMPU_TAB_REF SY_EOLT_Compu /end COMPU_METHOD
/begin COMPU_VTAB SY_EOLT_Compu "" TAB_VERB 2 0 "keine Klopfsensordiagnose am Bandende" 1 "Klopfsensordiagnose am Bandende" /end COMPU_VTAB
/begin COMPU_METHOD SY_EPRFSB_Compu "" TAB_VERB "%6.3" "" COMPU_TAB_REF SY_EPRFSB_Compu /end COMPU_METHOD
/begin COMPU_VTAB SY_EPRFSB_Compu "" TAB_VERB 2 0 "keine erweiterte Prüfung auf Selbstbeschleuniger" 1 "erweiterte Prüfung auf Selbstbeschleuniger" /end COMPU_VTAB
/begin COMPU_METHOD SY_ESNSNA_Compu "" TAB_VERB "%6.3" "" COMPU_TAB_REF SY_ESNSNA_Compu /end COMPU_METHOD
/begin COMPU_VTAB SY_ESNSNA_Compu "" TAB_VERB 2 0 "False" 1 "True" /end COMPU_VTAB
/begin COMPU_METHOD SY_ESNWS_Compu "" TAB_VERB "%6.3" "" COMPU_TAB_REF SY_ESNWS_Compu /end COMPU_METHOD
/begin COMPU_VTAB SY_ESNWS_Compu "" TAB_VERB 2 1 "True" 0 "False" /end COMPU_VTAB
/begin COMPU_METHOD SY_ESUKA_Compu "" TAB_VERB "%6.3" "" COMPU_TAB_REF SY_ESUKA_Compu /end COMPU_METHOD
/begin COMPU_VTAB SY_ESUKA_Compu "" TAB_VERB 2 0 "False" 1 "True" /end COMPU_VTAB
/begin COMPU_METHOD SY_ESUKNGN_Compu "" TAB_VERB "%6.3" "" COMPU_TAB_REF SY_ESUKNGN_Compu /end COMPU_METHOD
/begin COMPU_VTAB SY_ESUKNGN_Compu "" TAB_VERB 2 0 "%ESUKNGN nicht vorhanden" 1 "%ESUKNGN vorhanden" /end COMPU_VTAB
/begin COMPU_METHOD SY_ETADZWF_Compu "" TAB_VERB "%6.3" "" COMPU_TAB_REF SY_ETADZWF_Compu /end COMPU_METHOD
/begin COMPU_VTAB SY_ETADZWF_Compu "" TAB_VERB 2 0 "False" 1 "True" /end COMPU_VTAB
/begin COMPU_METHOD SY_ETAKHZW_Compu "" TAB_VERB "%6.3" "" COMPU_TAB_REF SY_ETAKHZW_Compu /end COMPU_METHOD
/begin COMPU_VTAB SY_ETAKHZW_Compu "" TAB_VERB 2 0 "SY_ETAKHZW=0" 1 "SY_ETAKHZW=1" /end COMPU_VTAB
/begin COMPU_METHOD SY_ETHSENS_Compu "" TAB_VERB "%6.3" "" COMPU_TAB_REF SY_ETHSENS_Compu /end COMPU_METHOD
/begin COMPU_VTAB SY_ETHSENS_Compu "" TAB_VERB 2 0 "false" 1 "true" /end COMPU_VTAB
/begin COMPU_METHOD SY_ETKBYP_Compu "" TAB_VERB "%6.3" "" COMPU_TAB_REF SY_ETKBYP_Compu /end COMPU_METHOD
/begin COMPU_VTAB SY_ETKBYP_Compu "" TAB_VERB 2 0 "ETK Bypass nicht freigegeben" 1 "ETK Bypass freigegeben" /end COMPU_VTAB
/begin COMPU_METHOD SY_ETR_Compu "" TAB_VERB "%6.3" "" COMPU_TAB_REF SY_ETR_Compu /end COMPU_METHOD
/begin COMPU_VTAB SY_ETR_Compu "" TAB_VERB 2 0 "Keine Thermostatregelung vorhanden" 1 "Thermostatregelung vorhanden" /end COMPU_VTAB
/begin COMPU_METHOD SY_EVABEEP_Compu "" TAB_VERB "%6.3" "" COMPU_TAB_REF SY_EVABEEP_Compu /end COMPU_METHOD
/begin COMPU_VTAB SY_EVABEEP_Compu "" TAB_VERB 2 0 "0" 1 "!" /end COMPU_VTAB
/begin COMPU_METHOD SY_EXCWM_Compu "" TAB_VERB "%6.3" "" COMPU_TAB_REF SY_EXCWM_Compu /end COMPU_METHOD
/begin COMPU_VTAB SY_EXCWM_Compu "" TAB_VERB 2 1 "CONDENSE_WAT_FLUIDTRANS" 0 "NO_CONDENSE_WAT" /end COMPU_VTAB
/begin COMPU_METHOD SY_FABE_Compu "" TAB_VERB "%6.3" "" COMPU_TAB_REF SY_FABE_Compu /end COMPU_METHOD
/begin COMPU_VTAB SY_FABE_Compu "" TAB_VERB 2 0 "shortened EOL-test unavailable" 1 "shortened EOL-test available" /end COMPU_VTAB
/begin COMPU_METHOD SY_FAEVZUE_Compu "" TAB_VERB "%6.3" "" COMPU_TAB_REF SY_FAEVZUE_Compu /end COMPU_METHOD
/begin COMPU_VTAB SY_FAEVZUE_Compu "" TAB_VERB 2 0 "False" 1 "True" /end COMPU_VTAB
/begin COMPU_METHOD SY_FAFSTKH_Compu "" TAB_VERB "%6.3" "" COMPU_TAB_REF SY_FAFSTKH_Compu /end COMPU_METHOD
/begin COMPU_VTAB SY_FAFSTKH_Compu "" TAB_VERB 2 0 "FAFSTKH_NO" 1 "FAFSTKH_ONE" /end COMPU_VTAB
/begin COMPU_METHOD SY_FAGALS_Compu "" TAB_VERB "%6.3" "" COMPU_TAB_REF SY_FAGALS_Compu /end COMPU_METHOD
/begin COMPU_VTAB SY_FAGALS_Compu "" TAB_VERB 2 0 "False" 1 "True" /end COMPU_VTAB
/begin COMPU_METHOD SY_FALRAMW_Compu "" TAB_VERB "%6.3" "" COMPU_TAB_REF SY_FALRAMW_Compu /end COMPU_METHOD
/begin COMPU_VTAB SY_FALRAMW_Compu "" TAB_VERB 2 0 "normal diagnosis at tester request" 1 "repeated change of ranges at tester request" /end COMPU_VTAB
/begin COMPU_METHOD SY_FANT_Compu "" TAB_VERB "%6.3" "" COMPU_TAB_REF SY_FANT_Compu /end COMPU_METHOD
/begin COMPU_VTAB SY_FANT_Compu "" TAB_VERB 2 0 "keine Anhebung Schubabschaltedrehzahl über Testere" 1 "Anhebung Schubabschaltedrehzahl über Testereingrif" /end COMPU_VTAB
/begin COMPU_METHOD SY_FAPAFG_Compu "" TAB_VERB "%6.3" "" COMPU_TAB_REF SY_FAPAFG_Compu /end COMPU_METHOD
/begin COMPU_VTAB SY_FAPAFG_Compu "" TAB_VERB 2 0 "FALSE" 1 "TRUE" /end COMPU_VTAB
/begin COMPU_METHOD SY_FAWULA_Compu "" TAB_VERB "%6.3" "" COMPU_TAB_REF SY_FAWULA_Compu /end COMPU_METHOD
/begin COMPU_VTAB SY_FAWULA_Compu "" TAB_VERB 2 0 "Anfettung Fahrerwunsch nicht möglich" 1 "Anfettung über mrfa/nmot möglich" /end COMPU_VTAB
/begin COMPU_METHOD SY_FCOTSTR_Compu "" TAB_VERB "%6.3" "" COMPU_TAB_REF SY_FCOTSTR_Compu /end COMPU_METHOD
/begin COMPU_VTAB SY_FCOTSTR_Compu "" TAB_VERB 2 0 "False" 1 "True" /end COMPU_VTAB
/begin COMPU_METHOD SY_FELMR_Compu "" TAB_VERB "%6.3" "" COMPU_TAB_REF SY_FELMR_Compu /end COMPU_METHOD
/begin COMPU_VTAB SY_FELMR_Compu "" TAB_VERB 2 0 "False" 1 "True" /end COMPU_VTAB
/begin COMPU_METHOD SY_FEPBAL_Compu "" TAB_VERB "%6.3" "" COMPU_TAB_REF SY_FEPBAL_Compu /end COMPU_METHOD
/begin COMPU_VTAB SY_FEPBAL_Compu "" TAB_VERB 3 1 "SY_FEPBAL_1" 0 "SY_FEPBAL_0" 2 "SY_FEPBAL_2" /end COMPU_VTAB
/begin COMPU_METHOD SY_FEPB_Compu "" TAB_VERB "%6.3" "" COMPU_TAB_REF SY_FEPB_Compu /end COMPU_METHOD
/begin COMPU_VTAB SY_FEPB_Compu "" TAB_VERB 3 2 "PINLETEGR" 1 "PINLETCAM" 0 "NOPCHDET" /end COMPU_VTAB
/begin COMPU_METHOD SY_FFV_Compu "" TAB_VERB "%6.3" "" COMPU_TAB_REF SY_FFV_Compu /end COMPU_METHOD
/begin COMPU_VTAB SY_FFV_Compu "" TAB_VERB 2 0 "kein flexible fuel Fahrzeug" 1 "flexible fuel Fahrzeug" /end COMPU_VTAB
/begin COMPU_METHOD SY_FFZ_Compu "" TAB_VERB "%6.3" "" COMPU_TAB_REF SY_FFZ_Compu /end COMPU_METHOD
/begin COMPU_VTAB SY_FFZ_Compu "" TAB_VERB 2 0 "keine Funkenbandzündung" 1 "Funkenbandzündung vorhanden" /end COMPU_VTAB
/begin COMPU_METHOD SY_FKAT2_Compu "" TAB_VERB "%6.3" "" COMPU_TAB_REF SY_FKAT2_Compu /end COMPU_METHOD
/begin COMPU_VTAB SY_FKAT2_Compu "" TAB_VERB 2 0 "kein Frontkat Bank 2" 1 "Frontkat Bank 2 vorhanden" /end COMPU_VTAB
/begin COMPU_METHOD SY_FKAT_Compu "" TAB_VERB "%6.3" "" COMPU_TAB_REF SY_FKAT_Compu /end COMPU_METHOD
/begin COMPU_VTAB SY_FKAT_Compu "" TAB_VERB 2 0 "kein Frontkat Bank 1" 1 "Frontkat Bank 1 vorhanden" /end COMPU_VTAB
/begin COMPU_METHOD SY_FLAFH_Compu "" TAB_VERB "%6.3" "" COMPU_TAB_REF SY_FLAFH_Compu /end COMPU_METHOD
/begin COMPU_VTAB SY_FLAFH_Compu "" TAB_VERB 2 0 "SY_FLAFH=0" 1 "SY_FLAFH=1" /end COMPU_VTAB
/begin COMPU_METHOD SY_FLASHON_Compu "" TAB_VERB "%6.3" "" COMPU_TAB_REF SY_FLASHON_Compu /end COMPU_METHOD
/begin COMPU_VTAB SY_FLASHON_Compu "" TAB_VERB 2 0 "FALSE" 1 "TRUE" /end COMPU_VTAB
/begin COMPU_METHOD SY_FLUQ_Compu "" RAT_FUNC "%6.2" "" COEFFS 0 1 0 0 0 1 /end COMPU_METHOD
/begin COMPU_METHOD SY_FLUTVAR_Compu "" TAB_VERB "%6.3" "" COMPU_TAB_REF SY_FLUTVAR_Compu /end COMPU_METHOD
/begin COMPU_VTAB SY_FLUTVAR_Compu "" TAB_VERB 2 0 "STD_CALC" 1 "IMP_CALC" /end COMPU_VTAB
/begin COMPU_METHOD SY_FMAELSV_Compu "" TAB_VERB "%6.3" "" COMPU_TAB_REF SY_FMAELSV_Compu /end COMPU_METHOD
/begin COMPU_VTAB SY_FMAELSV_Compu "" TAB_VERB 2 0 "Reset with E_lsv" 1 "Reset with E_lsv && !E_dylsu" /end COMPU_VTAB
/begin COMPU_METHOD SY_FNSK_Compu "" TAB_VERB "%6.3" "" COMPU_TAB_REF SY_FNSK_Compu /end COMPU_METHOD
/begin COMPU_VTAB SY_FNSK_Compu "" TAB_VERB 5 0 "Aus" 1 "Ein1" 2 "Ein2" 3 "Ein3" 4 "Ein4" /end COMPU_VTAB
/begin COMPU_METHOD SY_FNSWLK_Compu "" TAB_VERB "%6.3" "" COMPU_TAB_REF SY_FNSWLK_Compu /end COMPU_METHOD
/begin COMPU_VTAB SY_FNSWLK_Compu "" TAB_VERB 2 0 "Aus" 1 "Ein" /end COMPU_VTAB
/begin COMPU_METHOD SY_FOFHEV_Compu "" TAB_VERB "%6.3" "" COMPU_TAB_REF SY_FOFHEV_Compu /end COMPU_METHOD
/begin COMPU_VTAB SY_FOFHEV_Compu "" TAB_VERB 2 0 "not used" 1 "used" /end COMPU_VTAB
/begin COMPU_METHOD SY_FOFSMPN_Compu "" RAT_FUNC "%6.2" "" COEFFS 0 1 0 0 0 1 /end COMPU_METHOD
/begin COMPU_METHOD SY_FONAZNM_Compu "" RAT_FUNC "%6.2" "" COEFFS 0 1 0 0 0 1 /end COMPU_METHOD
/begin COMPU_METHOD SY_FPCES_Compu "" TAB_VERB "%6.3" "" COMPU_TAB_REF SY_FPCES_Compu /end COMPU_METHOD
/begin COMPU_VTAB SY_FPCES_Compu "" TAB_VERB 3 0 "Keine Gemisch-Fehlerverdachtserkennung" 1 "Gemisch-Fehlerverdachtserkennung möglich" 2 "Erw. Gemisch-Fehlerverdachtserkennung möglich" /end COMPU_VTAB
/begin COMPU_METHOD SY_FPCGWRK_Compu "" TAB_VERB "%6.3" "" COMPU_TAB_REF SY_FPCGWRK_Compu /end COMPU_METHOD
/begin COMPU_VTAB SY_FPCGWRK_Compu "" TAB_VERB 2 0 "FALSE" 1 "TRUE" /end COMPU_VTAB
/begin COMPU_METHOD SY_FPCIMV_Compu "" TAB_VERB "%6.3" "" COMPU_TAB_REF SY_FPCIMV_Compu /end COMPU_METHOD
/begin COMPU_VTAB SY_FPCIMV_Compu "" TAB_VERB 2 0 "False" 1 "True" /end COMPU_VTAB
/begin COMPU_METHOD SY_FPCLRBN_Compu "" TAB_VERB "%6.3" "" COMPU_TAB_REF SY_FPCLRBN_Compu /end COMPU_METHOD
/begin COMPU_VTAB SY_FPCLRBN_Compu "" TAB_VERB 2 0 "kein langsamer Reset der Beladung bei Notlauf" 1 "Langsamer Reset der Beladung bei Notlauf" /end COMPU_VTAB
/begin COMPU_METHOD SY_FPCMW_Compu "" TAB_VERB "%6.3" "" COMPU_TAB_REF SY_FPCMW_Compu /end COMPU_METHOD
/begin COMPU_VTAB SY_FPCMW_Compu "" TAB_VERB 2 0 "keine Berücksichtigung der Absteuerung" 1 "Berücksichtigung der Absteuerung" /end COMPU_VTAB
/begin COMPU_METHOD SY_FPCPIN_Compu "" TAB_VERB "%6.3" "" COMPU_TAB_REF SY_FPCPIN_Compu /end COMPU_METHOD
/begin COMPU_VTAB SY_FPCPIN_Compu "" TAB_VERB 3 0 "Keine zusätzliche Einleitstelle" 1 "Zusätzliche Einleitstelle vor Verdichter" 2 "Zusätzliche Einleitstelle vor zweitem Verdichter" /end COMPU_VTAB
/begin COMPU_METHOD SY_FPCPR_Compu "" TAB_VERB "%6.3" "" COMPU_TAB_REF SY_FPCPR_Compu /end COMPU_METHOD
/begin COMPU_VTAB SY_FPCPR_Compu "" TAB_VERB 2 0 "Keine Anforderung Saugrohrdruck von Tankentlüftung" 1 "Anforderung des Saugrohrdrucks von Tankentlüftung" /end COMPU_VTAB
/begin COMPU_METHOD SY_FPCSSP_Compu "" TAB_VERB "%6.3" "" COMPU_TAB_REF SY_FPCSSP_Compu /end COMPU_METHOD
/begin COMPU_VTAB SY_FPCSSP_Compu "" TAB_VERB 2 0 "False" 1 "True" /end COMPU_VTAB
/begin COMPU_METHOD SY_FPCSTP_Compu "" TAB_VERB "%6.3" "" COMPU_TAB_REF SY_FPCSTP_Compu /end COMPU_METHOD
/begin COMPU_VTAB SY_FPCSTP_Compu "" TAB_VERB 2 0 "False" 1 "True" /end COMPU_VTAB
/begin COMPU_METHOD SY_FPCSTRQ_Compu "" TAB_VERB "%6.3" "" COMPU_TAB_REF SY_FPCSTRQ_Compu /end COMPU_METHOD
/begin COMPU_VTAB SY_FPCSTRQ_Compu "" TAB_VERB 2 0 "False" 1 "True" /end COMPU_VTAB
/begin COMPU_METHOD SY_FPCTKTM_Compu "" TAB_VERB "%6.3" "" COMPU_TAB_REF SY_FPCTKTM_Compu /end COMPU_METHOD
/begin COMPU_VTAB SY_FPCTKTM_Compu "" TAB_VERB 2 0 "FALSE" 1 "TRUE" /end COMPU_VTAB
/begin COMPU_METHOD SY_FPCTR_Compu "" TAB_VERB "%6.3" "" COMPU_TAB_REF SY_FPCTR_Compu /end COMPU_METHOD
/begin COMPU_VTAB SY_FPCTR_Compu "" TAB_VERB 2 0 "Keine Momentenreserve von Tankentlüftung möglich" 1 "Momentenreserve von Tankentlüftung möglich" /end COMPU_VTAB
/begin COMPU_METHOD SY_FSGFS_Compu "" TAB_VERB "%6.3" "" COMPU_TAB_REF SY_FSGFS_Compu /end COMPU_METHOD
/begin COMPU_VTAB SY_FSGFS_Compu "" TAB_VERB 2 0 "False" 1 "True" /end COMPU_VTAB
/begin COMPU_METHOD SY_FSGM_Compu "" TAB_VERB "%6.3" "" COMPU_TAB_REF SY_FSGM_Compu /end COMPU_METHOD
/begin COMPU_VTAB SY_FSGM_Compu "" TAB_VERB 2 0 "Kennfelder" 1 "Modelle" /end COMPU_VTAB
/begin COMPU_METHOD SY_FSTCAN_Compu "" TAB_VERB "%6.3" "" COMPU_TAB_REF SY_FSTCAN_Compu /end COMPU_METHOD
/begin COMPU_VTAB SY_FSTCAN_Compu "" TAB_VERB 3 0 "Füllstandssignal nicht über CAN" 1 "Füllstandssignal über CAN" 2 "fertig aufbereitetes Füllstandssignal über CAN" /end COMPU_VTAB
/begin COMPU_METHOD SY_FSTK_Compu "" TAB_VERB "%6.3" "" COMPU_TAB_REF SY_FSTK_Compu /end COMPU_METHOD
/begin COMPU_VTAB SY_FSTK_Compu "" TAB_VERB 2 0 "Aus" 1 "Ein" /end COMPU_VTAB
/begin COMPU_METHOD SY_FSTSTPL_Compu "" TAB_VERB "%6.3" "" COMPU_TAB_REF SY_FSTSTPL_Compu /end COMPU_METHOD
/begin COMPU_VTAB SY_FSTSTPL_Compu "" TAB_VERB 2 0 "FSTSTPL_NO" 1 "FSTSTPL_YES" /end COMPU_VTAB
/begin COMPU_METHOD SY_FTIVDM_Compu "" TAB_VERB "%6.3" "" COMPU_TAB_REF SY_FTIVDM_Compu /end COMPU_METHOD
/begin COMPU_VTAB SY_FTIVDM_Compu "" TAB_VERB 3 0 "0" 1 "1" 2 "2" /end COMPU_VTAB
/begin COMPU_METHOD SY_FTIV_Compu "" TAB_VERB "%6.3" "" COMPU_TAB_REF SY_FTIV_Compu /end COMPU_METHOD
/begin COMPU_VTAB SY_FTIV_Compu "" TAB_VERB 2 0 "FTIV_NOT_EXIST" 1 "FTIV_EXIST" /end COMPU_VTAB
/begin COMPU_METHOD SY_FTOFSLS_Compu "" TAB_VERB "%6.3" "" COMPU_TAB_REF SY_FTOFSLS_Compu /end COMPU_METHOD
/begin COMPU_VTAB SY_FTOFSLS_Compu "" TAB_VERB 3 0 "SY_FTOFSLS_0" 1 "SY_FTOFSLS_1" 2 "SY_FTOFSLS_2" /end COMPU_VTAB
/begin COMPU_METHOD SY_FUELVAP_Compu "" TAB_VERB "%6.3" "" COMPU_TAB_REF SY_FUELVAP_Compu /end COMPU_METHOD
/begin COMPU_VTAB SY_FUELVAP_Compu "" TAB_VERB 3 0 "no central bad fuel detection value" 1 "central bad fuel detection value" 2 "central bad fuel value with reset at fuel fill" /end COMPU_VTAB
/begin COMPU_METHOD SY_FWLK_Compu "" TAB_VERB "%6.3" "" COMPU_TAB_REF SY_FWLK_Compu /end COMPU_METHOD
/begin COMPU_VTAB SY_FWLK_Compu "" TAB_VERB 4 0 "Aus0" 1 "Ein1" 2 "Ein2" 3 "Ein3" /end COMPU_VTAB
/begin COMPU_METHOD SY_FZAGK_Compu "" TAB_VERB "%6.3" "" COMPU_TAB_REF SY_FZAGK_Compu /end COMPU_METHOD
/begin COMPU_VTAB SY_FZAGK_Compu "" TAB_VERB 2 0 "false" 1 "true" /end COMPU_VTAB
/begin COMPU_METHOD SY_FZCVC_Compu "" TAB_VERB "%6.3" "" COMPU_TAB_REF SY_FZCVC_Compu /end COMPU_METHOD
/begin COMPU_VTAB SY_FZCVC_Compu "" TAB_VERB 2 0 "False" 1 "True" /end COMPU_VTAB
/begin COMPU_METHOD SY_FZEATK_Compu "" TAB_VERB "%6.3" "" COMPU_TAB_REF SY_FZEATK_Compu /end COMPU_METHOD
/begin COMPU_VTAB SY_FZEATK_Compu "" TAB_VERB 3 0 "Kein externer Aggregatekoordinator vorhanden" 1 "Standard-Aggregatekoordinator vorhanden" 2 "Spezieller Aggregatekoordinator vorhanden" /end COMPU_VTAB
/begin COMPU_METHOD SY_GAUSD_Compu "" TAB_VERB "%6.3" "" COMPU_TAB_REF SY_GAUSD_Compu /end COMPU_METHOD
/begin COMPU_VTAB SY_GAUSD_Compu "" TAB_VERB 2 0 "Umschaltung Diagnoseschwellen nicht möglich" 1 "Umschaltung Diagnoseschwellen möglich" /end COMPU_VTAB
/begin COMPU_METHOD SY_GP_Compu "" TAB_VERB "%6.3" "" COMPU_TAB_REF SY_GP_Compu /end COMPU_METHOD
/begin COMPU_VTAB SY_GP_Compu "" TAB_VERB 2 0 "Solldrehzahl bei Klima Ein über KL mit tumg" 1 "Solldrehzahl bei Klima Ein über globalen Parameter" /end COMPU_VTAB
/begin COMPU_METHOD SY_GRDWOF_Compu "" RAT_FUNC "%6.2" "" COEFFS 0 1 0 0 0 1 /end COMPU_METHOD
/begin COMPU_METHOD SY_GRDWRTB_Compu "" RAT_FUNC "%6.2" "" COEFFS 0 1 0 0 0 1 /end COMPU_METHOD
/begin COMPU_METHOD SY_GRDWRT_Compu "" RAT_FUNC "%6.2" "" COEFFS 0 1 0 0 0 1 /end COMPU_METHOD
/begin COMPU_METHOD SY_H2COFK_Compu "" TAB_VERB "%6.3" "" COMPU_TAB_REF SY_H2COFK_Compu /end COMPU_METHOD
/begin COMPU_VTAB SY_H2COFK_Compu "" TAB_VERB 2 0 "False" 1 "True" /end COMPU_VTAB
/begin COMPU_METHOD SY_H2COHK_Compu "" TAB_VERB "%6.3" "" COMPU_TAB_REF SY_H2COHK_Compu /end COMPU_METHOD
/begin COMPU_VTAB SY_H2COHK_Compu "" TAB_VERB 2 0 "False" 1 "True" /end COMPU_VTAB
/begin COMPU_METHOD SY_HDP_Compu "" TAB_VERB "%6.3" "" COMPU_TAB_REF SY_HDP_Compu /end COMPU_METHOD
/begin COMPU_VTAB SY_HDP_Compu "" TAB_VERB 4 1 "HDP1" 2 "HDP2" 0 "keine HDP" 3 "HDP3" /end COMPU_VTAB
/begin COMPU_METHOD SY_HDST_Compu "" TAB_VERB "%6.3" "" COMPU_TAB_REF SY_HDST_Compu /end COMPU_METHOD
/begin COMPU_VTAB SY_HDST_Compu "" TAB_VERB 2 0 "kein HDST" 1 "HDST" /end COMPU_VTAB
/begin COMPU_METHOD SY_HEV_Compu "" TAB_VERB "%6.3" "" COMPU_TAB_REF SY_HEV_Compu /end COMPU_METHOD
/begin COMPU_VTAB SY_HEV_Compu "" TAB_VERB 5 0 "HEV nicht vorhanden" 1 "serieller Hybridantrieb" 2 "Seriell-Paralleler Hybridantrieb" 3 "Leistungsverzweigender Hybridantrieb" 4 "Paralleler Hybridantrieb" /end COMPU_VTAB
/begin COMPU_METHOD SY_HFMKOMP_Compu "" TAB_VERB "%6.3" "" COMPU_TAB_REF SY_HFMKOMP_Compu /end COMPU_METHOD
/begin COMPU_VTAB SY_HFMKOMP_Compu "" TAB_VERB 6 0 "no HFM" 1 "voltage output" 2 "frequency output with correction factor" 3 "frequency output without correction factor" 4 "frequency output with double range (up to 1,6ms)" 5 "analogues voltage output with component self diag." /end COMPU_VTAB
/begin COMPU_METHOD SY_HFM_Compu "" TAB_VERB "%6.3" "" COMPU_TAB_REF SY_HFM_Compu /end COMPU_METHOD
/begin COMPU_VTAB SY_HFM_Compu "" TAB_VERB 3 0 "kein HFM verbaut" 1 "HFM verbaut (vor Verdichter)" 2 "HFM verbaut (nach Verdichter)" /end COMPU_VTAB
/begin COMPU_METHOD SY_HKAT2_Compu "" TAB_VERB "%6.3" "" COMPU_TAB_REF SY_HKAT2_Compu /end COMPU_METHOD
/begin COMPU_VTAB SY_HKAT2_Compu "" TAB_VERB 2 0 "kein Hauptkat Bank 2" 1 "Hauptkat Bank 2 vorhanden" /end COMPU_VTAB
/begin COMPU_METHOD SY_HKAT_Compu "" TAB_VERB "%6.3" "" COMPU_TAB_REF SY_HKAT_Compu /end COMPU_METHOD
/begin COMPU_VTAB SY_HKAT_Compu "" TAB_VERB 2 0 "kein Hauptkat Bank 1" 1 "Hauptkat Bank 1 vorhanden" /end COMPU_VTAB
/begin COMPU_METHOD SY_HKS_Compu "" TAB_VERB "%6.3" "" COMPU_TAB_REF SY_HKS_Compu /end COMPU_METHOD
/begin COMPU_VTAB SY_HKS_Compu "" TAB_VERB 2 0 "HomogenKlopfSchutz nicht vorhanden" 1 "HomogenKlopfSchutz vorhanden" /end COMPU_VTAB
/begin COMPU_METHOD SY_HLSFFET_Compu "" TAB_VERB "%6.3" "" COMPU_TAB_REF SY_HLSFFET_Compu /end COMPU_METHOD
/begin COMPU_VTAB SY_HLSFFET_Compu "" TAB_VERB 2 0 "Keine FET-Endstufe Sondenheiz. hinter Front-Kat" 1 "FET-Endstufe Sondenheiz. hinter Front-Kat" /end COMPU_VTAB
/begin COMPU_METHOD SY_HLSHFET_Compu "" TAB_VERB "%6.3" "" COMPU_TAB_REF SY_HLSHFET_Compu /end COMPU_METHOD
/begin COMPU_VTAB SY_HLSHFET_Compu "" TAB_VERB 2 0 "keine FET-Endstufe vorhanden" 1 "FET-Endstufe vorhanden" /end COMPU_VTAB
/begin COMPU_METHOD SY_HLSHRTP_Compu "" TAB_VERB "%6.3" "" COMPU_TAB_REF SY_HLSHRTP_Compu /end COMPU_METHOD
/begin COMPU_VTAB SY_HLSHRTP_Compu "" TAB_VERB 2 0 "False" 1 "True" /end COMPU_VTAB
/begin COMPU_METHOD SY_HLSVFET_Compu "" TAB_VERB "%6.3" "" COMPU_TAB_REF SY_HLSVFET_Compu /end COMPU_METHOD
/begin COMPU_VTAB SY_HLSVFET_Compu "" TAB_VERB 2 0 "FALSE" 1 "TRUE" /end COMPU_VTAB
/begin COMPU_METHOD SY_HMBMBA_Compu "" TAB_VERB "%6.3" "" COMPU_TAB_REF SY_HMBMBA_Compu /end COMPU_METHOD
/begin COMPU_VTAB SY_HMBMBA_Compu "" TAB_VERB 2 0 "False" 1 "True" /end COMPU_VTAB
/begin COMPU_METHOD SY_HMB_Compu "" TAB_VERB "%6.3" "" COMPU_TAB_REF SY_HMB_Compu /end COMPU_METHOD
/begin COMPU_VTAB SY_HMB_Compu "" TAB_VERB 3 0 "No HMB" 1 "CDA" 2 "BDA" /end COMPU_VTAB
/begin COMPU_METHOD SY_HMM_Compu "" TAB_VERB "%6.3" "" COMPU_TAB_REF SY_HMM_Compu /end COMPU_METHOD
/begin COMPU_VTAB SY_HMM_Compu "" TAB_VERB 2 0 "kein HMM-Betrieb vorhanden" 1 "HMM-Betrieb vorhanden" /end COMPU_VTAB
/begin COMPU_METHOD SY_HOS_Compu "" TAB_VERB "%6.3" "" COMPU_TAB_REF SY_HOS_Compu /end COMPU_METHOD
/begin COMPU_VTAB SY_HOS_Compu "" TAB_VERB 2 0 "False" 1 "True" /end COMPU_VTAB
/begin COMPU_METHOD SY_HSG_Compu "" TAB_VERB "%6.3" "" COMPU_TAB_REF SY_HSG_Compu /end COMPU_METHOD
/begin COMPU_VTAB SY_HSG_Compu "" TAB_VERB 2 0 "False" 1 "True" /end COMPU_VTAB
/begin COMPU_METHOD SY_HSPMD_Compu "" TAB_VERB "%6.3" "" COMPU_TAB_REF SY_HSPMD_Compu /end COMPU_METHOD
/begin COMPU_VTAB SY_HSPMD_Compu "" TAB_VERB 3 0 "kein HSP-Betrieb (BDE)" 1 "HSP mit genauer Md-Modellierung" 2 "HSP mit genauer Md-Modellierung + LBK" /end COMPU_VTAB
/begin COMPU_METHOD SY_HSPNWS_Compu "" TAB_VERB "%6.3" "" COMPU_TAB_REF SY_HSPNWS_Compu /end COMPU_METHOD
/begin COMPU_VTAB SY_HSPNWS_Compu "" TAB_VERB 2 0 "False" 1 "True" /end COMPU_VTAB
/begin COMPU_METHOD SY_HSP_Compu "" TAB_VERB "%6.3" "" COMPU_TAB_REF SY_HSP_Compu /end COMPU_METHOD
/begin COMPU_VTAB SY_HSP_Compu "" TAB_VERB 2 1 "TRUE" 0 "FALSE" /end COMPU_VTAB
/begin COMPU_METHOD SY_IATPS11_Compu "" TAB_VERB "%6.3" "" COMPU_TAB_REF SY_IATPS11_Compu /end COMPU_METHOD
/begin COMPU_VTAB SY_IATPS11_Compu "" TAB_VERB 4 0 "no sensor" 1 "TFA1" 2 "TFA2" 3 "TFA3" /end COMPU_VTAB
/begin COMPU_METHOD SY_IATPS12_Compu "" TAB_VERB "%6.3" "" COMPU_TAB_REF SY_IATPS12_Compu /end COMPU_METHOD
/begin COMPU_VTAB SY_IATPS12_Compu "" TAB_VERB 4 0 "no sensor" 1 "TFA1" 2 "TFA2" 3 "TFA3" /end COMPU_VTAB
/begin COMPU_METHOD SY_IATPS13_Compu "" TAB_VERB "%6.3" "" COMPU_TAB_REF SY_IATPS13_Compu /end COMPU_METHOD
/begin COMPU_VTAB SY_IATPS13_Compu "" TAB_VERB 4 0 "no sensor" 1 "TFA1" 2 "TFA2" 3 "TFA3" /end COMPU_VTAB
/begin COMPU_METHOD SY_IATPS21_Compu "" TAB_VERB "%6.3" "" COMPU_TAB_REF SY_IATPS21_Compu /end COMPU_METHOD
/begin COMPU_VTAB SY_IATPS21_Compu "" TAB_VERB 4 0 "no sensor" 1 "TFA1" 2 "TFA2" 3 "TFA3" /end COMPU_VTAB
/begin COMPU_METHOD SY_IATPS22_Compu "" TAB_VERB "%6.3" "" COMPU_TAB_REF SY_IATPS22_Compu /end COMPU_METHOD
/begin COMPU_VTAB SY_IATPS22_Compu "" TAB_VERB 4 0 "no sensor" 1 "TFA1" 2 "TFA2" 3 "TFA3" /end COMPU_VTAB
/begin COMPU_METHOD SY_IATPS23_Compu "" TAB_VERB "%6.3" "" COMPU_TAB_REF SY_IATPS23_Compu /end COMPU_METHOD
/begin COMPU_VTAB SY_IATPS23_Compu "" TAB_VERB 4 0 "no sensor" 1 "TFA1" 2 "TFA2" 3 "TFA3" /end COMPU_VTAB
/begin COMPU_METHOD SY_IFOTMEN_Compu "" TAB_VERB "%6.3" "" COMPU_TAB_REF SY_IFOTMEN_Compu /end COMPU_METHOD
/begin COMPU_VTAB SY_IFOTMEN_Compu "" TAB_VERB 2 0 "SY_IFOTMEN = 0" 1 "SY_IFOTMEN = 1" /end COMPU_VTAB
/begin COMPU_METHOD SY_IFTCWRP_Compu "" TAB_VERB "%6.3" "" COMPU_TAB_REF SY_IFTCWRP_Compu /end COMPU_METHOD
/begin COMPU_VTAB SY_IFTCWRP_Compu "" TAB_VERB 2 0 "SY_IFTCWRP==0" 1 "SY_IFTCWRP>0" /end COMPU_VTAB
/begin COMPU_METHOD SY_IGICCH1_Compu "" RAT_FUNC "%6.2" "" COEFFS 0 1 0 0 0 1 /end COMPU_METHOD
/begin COMPU_METHOD SY_IGICCH2_Compu "" RAT_FUNC "%6.2" "" COEFFS 0 1 0 0 0 1 /end COMPU_METHOD
/begin COMPU_METHOD SY_IGICCH3_Compu "" RAT_FUNC "%6.2" "" COEFFS 0 1 0 0 0 1 /end COMPU_METHOD
/begin COMPU_METHOD SY_IGICCH4_Compu "" RAT_FUNC "%6.2" "" COEFFS 0 1 0 0 0 1 /end COMPU_METHOD
/begin COMPU_METHOD SY_IGICCH5_Compu "" RAT_FUNC "%6.2" "" COEFFS 0 1 0 0 0 1 /end COMPU_METHOD
/begin COMPU_METHOD SY_IGIFLAG_Compu "" TAB_VERB "%6.3" "" COMPU_TAB_REF SY_IGIFLAG_Compu /end COMPU_METHOD
/begin COMPU_VTAB SY_IGIFLAG_Compu "" TAB_VERB 2 0 "False" 1 "True" /end COMPU_VTAB
/begin COMPU_METHOD SY_IGNCHN1_Compu "" RAT_FUNC "%6.2" "" COEFFS 0 1 0 0 0 1 /end COMPU_METHOD
/begin COMPU_METHOD SY_IGNCHN2_Compu "" RAT_FUNC "%6.2" "" COEFFS 0 1 0 0 0 1 /end COMPU_METHOD
/begin COMPU_METHOD SY_IGNCHN3_Compu "" RAT_FUNC "%6.2" "" COEFFS 0 1 0 0 0 1 /end COMPU_METHOD
/begin COMPU_METHOD SY_IGNCHN4_Compu "" RAT_FUNC "%6.2" "" COEFFS 0 1 0 0 0 1 /end COMPU_METHOD
/begin COMPU_METHOD SY_IGNCHN5_Compu "" RAT_FUNC "%6.2" "" COEFFS 0 1 0 0 0 1 /end COMPU_METHOD
/begin COMPU_METHOD SY_IGSWR_Compu "" TAB_VERB "%6.3" "" COMPU_TAB_REF SY_IGSWR_Compu /end COMPU_METHOD
/begin COMPU_VTAB SY_IGSWR_Compu "" TAB_VERB 2 0 "Shließwinkelregelung nicht vorhanden" 1 "Shließwinkelregelung vorhanden" /end COMPU_VTAB
/begin COMPU_METHOD SY_INHIBIT_Compu "" TAB_VERB "%6.3" "" COMPU_TAB_REF SY_INHIBIT_Compu /end COMPU_METHOD
/begin COMPU_VTAB SY_INHIBIT_Compu "" TAB_VERB 3 0 "Kein Inhibitor" 1 "Inhibitor zur Fehlerpfad-spezifischen Sperrung" 2 "Inhibitor zur Fehler-Typ-spezifischen Sperrung" /end COMPU_VTAB
/begin COMPU_METHOD SY_INI_OBD_Compu "" TAB_VERB "%6.3" "" COMPU_TAB_REF SY_INI_OBD_Compu /end COMPU_METHOD
/begin COMPU_VTAB SY_INI_OBD_Compu "" TAB_VERB 6 0 "ISO 14230-4 per WUP und ISO 9141-2 per 5Bd" 1 "ISO 14230-4 per 5Baud" 2 "ISO 9141-2 per 5Baud" 3 "ISO 14230-4 per WUP (fast Ini.)" 4 "kein CARB-Protokoll" 5 "ISO 15765-4 CAN" /end COMPU_VTAB
/begin COMPU_METHOD SY_INJADKM_Compu "" TAB_VERB "%6.3" "" COMPU_TAB_REF SY_INJADKM_Compu /end COMPU_METHOD
/begin COMPU_VTAB SY_INJADKM_Compu "" TAB_VERB 2 0 "False" 1 "True" /end COMPU_VTAB
/begin COMPU_METHOD SY_IPRCRSH_Compu "" TAB_VERB "%6.3" "" COMPU_TAB_REF SY_IPRCRSH_Compu /end COMPU_METHOD
/begin COMPU_VTAB SY_IPRCRSH_Compu "" TAB_VERB 2 0 "False" 1 "True" /end COMPU_VTAB
/begin COMPU_METHOD SY_ISG_Compu "" TAB_VERB "%6.3" "" COMPU_TAB_REF SY_ISG_Compu /end COMPU_METHOD
/begin COMPU_VTAB SY_ISG_Compu "" TAB_VERB 2 0 "False" 1 "True" /end COMPU_VTAB
/begin COMPU_METHOD SY_IUMPR_Compu "" TAB_VERB "%6.3" "" COMPU_TAB_REF SY_IUMPR_Compu /end COMPU_METHOD
/begin COMPU_VTAB SY_IUMPR_Compu "" TAB_VERB 2 0 "keine Auswetung der IUMPR" 1 "Auswertung der IUMPR" /end COMPU_VTAB
/begin COMPU_METHOD SY_KBAWGAA_Compu "" RAT_FUNC "%6.2" "" COEFFS 0 1 0 0 0 1 /end COMPU_METHOD
/begin COMPU_METHOD SY_KDHFM_Compu "" TAB_VERB "%6.3" "" COMPU_TAB_REF SY_KDHFM_Compu /end COMPU_METHOD
/begin COMPU_VTAB SY_KDHFM_Compu "" TAB_VERB 2 0 "SY_KDHFM" 1 "SY_KDHFM" /end COMPU_VTAB
/begin COMPU_METHOD SY_KFLRA_Compu "" TAB_VERB "%6.3" "" COMPU_TAB_REF SY_KFLRA_Compu /end COMPU_METHOD
/begin COMPU_VTAB SY_KFLRA_Compu "" TAB_VERB 2 0 "False" 1 "True" /end COMPU_VTAB
/begin COMPU_METHOD SY_KHETA_Compu "" TAB_VERB "%6.3" "" COMPU_TAB_REF SY_KHETA_Compu /end COMPU_METHOD
/begin COMPU_VTAB SY_KHETA_Compu "" TAB_VERB 2 0 "Momentenreserve" 1 "Wirkungsgrad" /end COMPU_VTAB
/begin COMPU_METHOD SY_KHTMSFH_Compu "" TAB_VERB "%6.3" "" COMPU_TAB_REF SY_KHTMSFH_Compu /end COMPU_METHOD
/begin COMPU_VTAB SY_KHTMSFH_Compu "" TAB_VERB 2 0 "KHTMSFH_LINE" 1 "KHTMSFH_MAP" /end COMPU_VTAB
/begin COMPU_METHOD t100msxs_ub_b25p5 "" RAT_FUNC "%6.3" "s" COEFFS 0 1 0 0 0 0.1 /end COMPU_METHOD
/begin COMPU_METHOD t100msxs_uw_b6553p5 "" RAT_FUNC "%6.3" "s" COEFFS 0 1 0 0 0 0.1 /end COMPU_METHOD
/begin COMPU_METHOD t10msxs_uw_b655p35 "" RAT_FUNC "%6.4" "s" COEFFS 0 1 0 0 0 0.01 /end COMPU_METHOD
/begin COMPU_METHOD t20msxs_ub_b5p1 "" RAT_FUNC "%6.4" "s" COEFFS 0 1 0 0 0 0.02 /end COMPU_METHOD
/begin COMPU_METHOD temp_q0p0234_o273 "" RAT_FUNC "%6.1" "Grad C" COEFFS 0 1 273.15 0 0 0.0234375 /end COMPU_METHOD
/begin COMPU_METHOD temp_q0p0468_K "" RAT_FUNC "%6.4" "Grad K" COEFFS 0 256 0 0 0 12 /end COMPU_METHOD
/begin COMPU_METHOD temp_ub_q0p75_o48 "" RAT_FUNC "%6.2" "Grad C" COEFFS 0 1 48 0 0 0.75 /end COMPU_METHOD
/begin COMPU_METHOD temp_uw_q0p75_o48 "" RAT_FUNC "%6.2" "Grad C" COEFFS 0 1 48 0 0 0.75 /end COMPU_METHOD
/begin COMPU_METHOD t_q0p001 "" RAT_FUNC "%6.5" "s" COEFFS 0 1000 0 0 0 1 /end COMPU_METHOD
/begin COMPU_METHOD t_q0p01 "" RAT_FUNC "%6.4" "" COEFFS 0 100 0 0 0 1 /end COMPU_METHOD
/begin COMPU_METHOD t_q0p1 "" RAT_FUNC "%6.3" "s" COEFFS 0 10 0 0 0 1 /end COMPU_METHOD
/begin COMPU_METHOD vfzg_uw_b512 "" RAT_FUNC "%6.4" "km/h" COEFFS 0 65536 0 0 0 512 /end COMPU_METHOD
/begin COMPU_METHOD vfzg_uw_q0p00781 "" RAT_FUNC "%6.4" "km/h" COEFFS 0 1 0 0 0 0.0078125 /end COMPU_METHOD
/begin COMPU_METHOD zk100msxs_ub_b25p5 "" RAT_FUNC "%6.3" "s" COEFFS 0 0 256 0 10 0 /end COMPU_METHOD
/begin COMPU_METHOD zk100msxs_uw_b6553p6 "" RAT_FUNC "%6.1" "s" COEFFS 0 0 65536 0 10 0 /end COMPU_METHOD
/begin COMPU_METHOD zk10msxs_uw_b655 "" RAT_FUNC "%6.2" "s" COEFFS 0 0 65536 0 100 0 /end COMPU_METHOD
/begin COMPU_METHOD zk20msxs_ub_b5p1 "" RAT_FUNC "%6.4" "s" COEFFS 0 0 5.1 0 1 0 /end COMPU_METHOD
/begin COMPU_METHOD zw_sb_q0p75 "" RAT_FUNC "%6.3" "Grad KW" COEFFS 0 255 0 0 0 191.25 /end COMPU_METHOD
/begin COMPU_METHOD default "" RAT_FUNC "%6.2" "" COEFFS 0 1 0 0 0 1 /end COMPU_METHOD
/begin RECORD_LAYOUT GkfWU16 FNC_VALUES 1 UWORD COLUMN_DIR DIRECT /end RECORD_LAYOUT
/begin RECORD_LAYOUT GkfWU8 FNC_VALUES 1 UBYTE COLUMN_DIR DIRECT /end RECORD_LAYOUT
/begin RECORD_LAYOUT GklWS16 FNC_VALUES 1 SWORD COLUMN_DIR DIRECT /end RECORD_LAYOUT
/begin RECORD_LAYOUT GklWS8 FNC_VALUES 1 SBYTE COLUMN_DIR DIRECT /end RECORD_LAYOUT
/begin RECORD_LAYOUT GklWU16 FNC_VALUES 1 UWORD COLUMN_DIR DIRECT /end RECORD_LAYOUT
/begin RECORD_LAYOUT GklWU8 FNC_VALUES 1 UBYTE COLUMN_DIR DIRECT /end RECORD_LAYOUT
/begin RECORD_LAYOUT KfAxU8AyU8SstxS16SstyS16WS16 NO_AXIS_PTS_X 1 SWORD NO_AXIS_PTS_Y 2 SWORD AXIS_PTS_X 3 SWORD INDEX_INCR DIRECT AXIS_PTS_Y 4 SWORD INDEX_INCR DIRECT FNC_VALUES 5 SWORD COLUMN_DIR DIRECT /end RECORD_LAYOUT
/begin RECORD_LAYOUT KfAxU8AyU8SstxS8SstyU8WU8 NO_AXIS_PTS_X 1 UBYTE NO_AXIS_PTS_Y 2 UBYTE AXIS_PTS_X 3 SBYTE INDEX_INCR DIRECT AXIS_PTS_Y 4 UBYTE INDEX_INCR DIRECT FNC_VALUES 5 UBYTE COLUMN_DIR DIRECT /end RECORD_LAYOUT
/begin RECORD_LAYOUT KfAxU8AyU8SstxU16SstyU16WU16 NO_AXIS_PTS_X 1 UWORD NO_AXIS_PTS_Y 2 UWORD AXIS_PTS_X 3 UWORD INDEX_INCR DIRECT AXIS_PTS_Y 4 UWORD INDEX_INCR DIRECT FNC_VALUES 5 UWORD COLUMN_DIR DIRECT /end RECORD_LAYOUT
/begin RECORD_LAYOUT KfAxU8AyU8SstxU8SstyU16WU16 NO_AXIS_PTS_X 1 UBYTE NO_AXIS_PTS_Y 2 UBYTE AXIS_PTS_X 3 UBYTE INDEX_INCR DIRECT AXIS_PTS_Y 4 UWORD INDEX_INCR DIRECT FNC_VALUES 5 UWORD COLUMN_DIR DIRECT /end RECORD_LAYOUT
/begin RECORD_LAYOUT KfAxU8AyU8SstxU8SstyU8WS8 NO_AXIS_PTS_X 1 UBYTE NO_AXIS_PTS_Y 2 UBYTE AXIS_PTS_X 3 UBYTE INDEX_INCR DIRECT AXIS_PTS_Y 4 UBYTE INDEX_INCR DIRECT FNC_VALUES 5 SBYTE COLUMN_DIR DIRECT /end RECORD_LAYOUT
/begin RECORD_LAYOUT KfAxU8AyU8SstxU8SstyU8WU8 NO_AXIS_PTS_X 1 UBYTE NO_AXIS_PTS_Y 2 UBYTE AXIS_PTS_X 3 UBYTE INDEX_INCR DIRECT AXIS_PTS_Y 4 UBYTE INDEX_INCR DIRECT FNC_VALUES 5 UBYTE COLUMN_DIR DIRECT /end RECORD_LAYOUT
/begin RECORD_LAYOUT KlAxU8SstxS16WS16 NO_AXIS_PTS_X 1 SWORD AXIS_PTS_X 2 SWORD INDEX_INCR DIRECT FNC_VALUES 3 SWORD COLUMN_DIR DIRECT /end RECORD_LAYOUT
/begin RECORD_LAYOUT KlAxU8SstxS16WU16 NO_AXIS_PTS_X 1 UWORD AXIS_PTS_X 2 SWORD INDEX_INCR DIRECT FNC_VALUES 3 UWORD COLUMN_DIR DIRECT /end RECORD_LAYOUT
/begin RECORD_LAYOUT KlAxU8SstxU16WS16 NO_AXIS_PTS_X 1 UWORD AXIS_PTS_X 2 UWORD INDEX_INCR DIRECT FNC_VALUES 3 SWORD COLUMN_DIR DIRECT /end RECORD_LAYOUT
/begin RECORD_LAYOUT KlAxU8SstxU16WU16 NO_AXIS_PTS_X 1 UWORD AXIS_PTS_X 2 UWORD INDEX_INCR DIRECT FNC_VALUES 3 UWORD COLUMN_DIR DIRECT /end RECORD_LAYOUT
/begin RECORD_LAYOUT KlAxU8SstxU16WU8 NO_AXIS_PTS_X 1 UWORD AXIS_PTS_X 2 UWORD INDEX_INCR DIRECT FNC_VALUES 3 UBYTE COLUMN_DIR DIRECT /end RECORD_LAYOUT
/begin RECORD_LAYOUT KlAxU8SstxU8WS8 NO_AXIS_PTS_X 1 UBYTE AXIS_PTS_X 2 UBYTE INDEX_INCR DIRECT FNC_VALUES 3 SBYTE COLUMN_DIR DIRECT /end RECORD_LAYOUT
/begin RECORD_LAYOUT KlAxU8SstxU8WU16 NO_AXIS_PTS_X 1 UBYTE AXIS_PTS_X 2 UBYTE INDEX_INCR DIRECT FNC_VALUES 3 UWORD COLUMN_DIR DIRECT /end RECORD_LAYOUT
/begin RECORD_LAYOUT KlAxU8SstxU8WU8 NO_AXIS_PTS_X 1 UBYTE AXIS_PTS_X 2 UBYTE INDEX_INCR DIRECT FNC_VALUES 3 UBYTE COLUMN_DIR DIRECT /end RECORD_LAYOUT
/begin RECORD_LAYOUT KwbUw FNC_VALUES 1 UWORD COLUMN_DIR DIRECT /end RECORD_LAYOUT
/begin RECORD_LAYOUT KwbWS8 FNC_VALUES 1 SBYTE COLUMN_DIR DIRECT /end RECORD_LAYOUT
/begin RECORD_LAYOUT KwbWU8 FNC_VALUES 1 UBYTE COLUMN_DIR DIRECT /end RECORD_LAYOUT
/begin RECORD_LAYOUT KwSw FNC_VALUES 1 SWORD COLUMN_DIR DIRECT /end RECORD_LAYOUT
/begin RECORD_LAYOUT KwUb FNC_VALUES 1 UBYTE COLUMN_DIR DIRECT /end RECORD_LAYOUT
/begin RECORD_LAYOUT KwUw FNC_VALUES 1 UWORD COLUMN_DIR DIRECT /end RECORD_LAYOUT
/begin RECORD_LAYOUT KwWS16 FNC_VALUES 1 SWORD COLUMN_DIR DIRECT /end RECORD_LAYOUT
/begin RECORD_LAYOUT KwWS8 FNC_VALUES 1 SBYTE COLUMN_DIR DIRECT /end RECORD_LAYOUT
/begin RECORD_LAYOUT KwWU16 FNC_VALUES 1 UWORD COLUMN_DIR DIRECT /end RECORD_LAYOUT
/begin RECORD_LAYOUT KwWU8 FNC_VALUES 1 UBYTE COLUMN_DIR DIRECT /end RECORD_LAYOUT
/begin RECORD_LAYOUT SstAU8SstS8 NO_AXIS_PTS_X 1 SBYTE AXIS_PTS_X 2 SBYTE INDEX_INCR DIRECT /end RECORD_LAYOUT
/begin RECORD_LAYOUT SstAU8SstU16 NO_AXIS_PTS_X 1 UWORD AXIS_PTS_X 2 UWORD INDEX_INCR DIRECT /end RECORD_LAYOUT
/begin RECORD_LAYOUT SstAU8SstU8 NO_AXIS_PTS_X 1 UBYTE AXIS_PTS_X 2 UBYTE INDEX_INCR DIRECT /end RECORD_LAYOUT
/begin RECORD_LAYOUT SstAUbSstUb NO_AXIS_PTS_X 1 UBYTE AXIS_PTS_X 2 UBYTE INDEX_INCR DIRECT /end RECORD_LAYOUT
/begin RECORD_LAYOUT Val_Ws16 FNC_VALUES 1 SWORD COLUMN_DIR DIRECT /end RECORD_LAYOUT
/begin RECORD_LAYOUT Val_Wu8 FNC_VALUES 1 UBYTE COLUMN_DIR DIRECT /end RECORD_LAYOUT
/end MODULE
/end PROJECT
