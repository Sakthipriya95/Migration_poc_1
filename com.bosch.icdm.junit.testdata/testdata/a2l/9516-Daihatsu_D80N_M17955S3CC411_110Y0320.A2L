ASAP2_VERSION 1 4
/begin PROJECT M17955S3CC411_110Y0320 "M17955S3CC411_110Y0320"
/begin HEADER "" VERSION "M17955S3CC411_110Y0320" PROJECT_NO M17955S3CC411_110Y0320 /end HEADER
/begin MODULE DIM ""
/begin MOD_COMMON "" BYTE_ORDER MSB_LAST ALIGNMENT_BYTE 1 ALIGNMENT_WORD 2 ALIGNMENT_LONG 4 ALIGNMENT_FLOAT32_IEEE 4 /end MOD_COMMON
/begin CHARACTERISTIC AUTOGANG "" VALUE 0x80049D1E KwWU8 255.0 dez 0.00 255.0 FORMAT "%5.1" /end CHARACTERISTIC
/begin CHARACTERISTIC CoPT_trqPTPrt_C "" VALUE 0x80049A7A KwWS16 6553.500 Trq -3276.800 3276.700 FORMAT "%8.3" /end CHARACTERISTIC
/begin CHARACTERISTIC CWGENPWM "" VALUE 0x80049802 KwWU8 255.0 dez 0.00 255.0 FORMAT "%5.1" /end CHARACTERISTIC
/begin CHARACTERISTIC CWMSUDKSOM "" VALUE 0x800495CA KwWU8 255.0 dez 0.00 255.0 FORMAT "%5.1" /end CHARACTERISTIC
/begin CHARACTERISTIC CWNACLL "" VALUE 0x800497E0 KwWU8 255.0 dez 0.00 255.0 FORMAT "%5.1" /end CHARACTERISTIC
/begin CHARACTERISTIC CWNMAXMD "" VALUE 0x800496F8 KwWU8 255.0 OneToOne 0.00 255.0 FORMAT "%5.1" /end CHARACTERISTIC
/begin CHARACTERISTIC CWNSGEN "" VALUE 0x80049803 KwWU8 255.0 dez 0.00 255.0 FORMAT "%5.1" /end CHARACTERISTIC
/begin CHARACTERISTIC CWNSKH "" VALUE 0x800499C8 KwWU8 255.0 dez 0.00 255.0 FORMAT "%5.1" /end CHARACTERISTIC
/begin CHARACTERISTIC CWPKAPP "" VALUE 0x80049A84 KwWU8 255.0 dez 0.00 255.0 FORMAT "%5.1" /end CHARACTERISTIC
/begin CHARACTERISTIC DNMAX "" VALUE 0x800496FC KwWS32 32767.5000000 nmot_uw_q0p25 -16383.7500000 16383.7500000 FORMAT "%13.7" /end CHARACTERISTIC
/begin CHARACTERISTIC DNMAXDZ "" VALUE 0x80049700 KwWS32 32767.7500000 nmot_uw_q0p25 -16384.0000000 16383.7500000 FORMAT "%13.7" /end CHARACTERISTIC
/begin CHARACTERISTIC DNMAXH "" VALUE 0x800496F4 KwUw 16383.75 nmot_uw_q0p25 0.00 16383.75 FORMAT "%8.2" /end CHARACTERISTIC
/begin CHARACTERISTIC DNSIAB "" VALUE 0x80049704 KwWS16 16383.75 nmot_sw_q0p25 -8192.000 8191.750 FORMAT "%8.3" /end CHARACTERISTIC
/begin CHARACTERISTIC DNSIRES "" VALUE 0x80049706 KwWS16 16383.75 nmot_sw_q0p25 -8192.000 8191.750 FORMAT "%8.3" /end CHARACTERISTIC
/begin CHARACTERISTIC DTEMN "" VALUE 0x80049A86 KwWU16 65.53500 t1p0usxms 0.00 65.53500 FORMAT "%8.5" /end CHARACTERISTIC
/begin CHARACTERISTIC DWDSH "" VALUE 0x80049D20 KwWS16 1599.976 relDK_q0p02441 -800.0000 799.9756 FORMAT "%8.4" /end CHARACTERISTIC
/begin CHARACTERISTIC FKKVS "" MAP 0x80049A88 KfAxU8AyU8SstxU16SstyU16WU16 1.999969 fak_uw_b2 0.00 1.999969 FORMAT "%8.6"
 /begin AXIS_DESCR STD_AXIS nmot_w nmot_uw_q0p25 16 0.00 16383.75 FORMAT "%8.2" DEPOSIT ABSOLUTE /end AXIS_DESCR
 /begin AXIS_DESCR STD_AXIS tevfak_w t1p0usxms 16 0.00 65.53500 FORMAT "%8.5" DEPOSIT ABSOLUTE /end AXIS_DESCR
/end CHARACTERISTIC
/begin CHARACTERISTIC FKODASH "" CURVE 0x80049D22 KlAxU8SstxU8WU8 7.969 fak_ub_b8 0.00 7.969 FORMAT "%5.3"
 /begin AXIS_DESCR STD_AXIS mdko rel_ub_b100 8 0.00 99.61 FORMAT "%5.2" DEPOSIT ABSOLUTE /end AXIS_DESCR
/end CHARACTERISTIC
/begin CHARACTERISTIC FRKEZAP "" VAL_BLK 0x80049CCC KwbWU16 1.999969 fak_uw_b2 0.00 1.999969 FORMAT "%8.6" NUMBER 3 /end CHARACTERISTIC
/begin CHARACTERISTIC FRLFSDP "" CURVE 0x80049CD2 KlAxU8SstxS16WU16 1.999969 fak_uw_b2 0.00 1.999969 FORMAT "%8.6"
 /begin AXIS_DESCR STD_AXIS dppk_w p_sw_q0p312 12 -10240.00 10239.69 FORMAT "%8.2" DEPOSIT ABSOLUTE /end AXIS_DESCR
/end CHARACTERISTIC
/begin CHARACTERISTIC FVDASHM "" CURVE 0x80049D33 KlAxU8SstxU8WU8 7.969 fak_ub_b8 0.00 7.969 FORMAT "%5.3"
 /begin AXIS_DESCR STD_AXIS tmot temp_ub_q0p75_o48 8 -48.00 143.3 FORMAT "%5.1" DEPOSIT ABSOLUTE /end AXIS_DESCR
/end CHARACTERISTIC
/begin CHARACTERISTIC GANGKHLL "" VALUE 0x800499C9 KwWS8 255.0 dez -128.0 127.0 FORMAT "%5.1" /end CHARACTERISTIC
/begin CHARACTERISTIC ITNMXH "" VALUE 0x80049708 KwWU16 655.3500 t10msxs_uw_b655p35 0.00 655.3500 FORMAT "%8.4" /end CHARACTERISTIC
/begin CHARACTERISTIC KFMIDSH0 "" MAP 0x80049D44 KfAxU8AyU8SstxU8SstyU8WU8 99.61 rel_ub_q0p3906 0.00 99.61 FORMAT "%5.2"
 /begin AXIS_DESCR STD_AXIS nmot nmot_ub_q40 8 0.00 10200. FORMAT "%5.0" DEPOSIT ABSOLUTE /end AXIS_DESCR
 /begin AXIS_DESCR STD_AXIS iwdkba relDK_ub_b100 6 0.00 100.0 FORMAT "%5.1" DEPOSIT ABSOLUTE /end AXIS_DESCR
/end CHARACTERISTIC
/begin CHARACTERISTIC KFMIDSH1 "" MAP 0x80049D84 KfAxU8AyU8SstxU8SstyU8WU8 99.61 rel_ub_q0p3906 0.00 99.61 FORMAT "%5.2"
 /begin AXIS_DESCR STD_AXIS nmot nmot_ub_q40 8 0.00 10200. FORMAT "%5.0" DEPOSIT ABSOLUTE /end AXIS_DESCR
 /begin AXIS_DESCR STD_AXIS iwdkba relDK_ub_b100 6 0.00 100.0 FORMAT "%5.1" DEPOSIT ABSOLUTE /end AXIS_DESCR
/end CHARACTERISTIC
/begin CHARACTERISTIC KFMIDSH2 "" MAP 0x80049DC4 KfAxU8AyU8SstxU8SstyU8WU8 99.61 rel_ub_q0p3906 0.00 99.61 FORMAT "%5.2"
 /begin AXIS_DESCR STD_AXIS nmot nmot_ub_q40 8 0.00 10200. FORMAT "%5.0" DEPOSIT ABSOLUTE /end AXIS_DESCR
 /begin AXIS_DESCR STD_AXIS iwdkba relDK_ub_b100 6 0.00 100.0 FORMAT "%5.1" DEPOSIT ABSOLUTE /end AXIS_DESCR
/end CHARACTERISTIC
/begin CHARACTERISTIC KFMIDSH3 "" MAP 0x80049E04 KfAxU8AyU8SstxU8SstyU8WU8 99.61 rel_ub_q0p3906 0.00 99.61 FORMAT "%5.2"
 /begin AXIS_DESCR STD_AXIS nmot nmot_ub_q40 8 0.00 10200. FORMAT "%5.0" DEPOSIT ABSOLUTE /end AXIS_DESCR
 /begin AXIS_DESCR STD_AXIS iwdkba relDK_ub_b100 6 0.00 100.0 FORMAT "%5.1" DEPOSIT ABSOLUTE /end AXIS_DESCR
/end CHARACTERISTIC
/begin CHARACTERISTIC KFMSUDKN "" MAP 0x800495CC KfAxU8AyU8SstxU8SstyU16WU16 6553.500 m_uw_b6553p5 0.00 6553.500 FORMAT "%8.3"
 /begin AXIS_DESCR STD_AXIS tmst temp_ub_q0p75_o48 12 -48.00 143.3 FORMAT "%5.1" DEPOSIT ABSOLUTE /end AXIS_DESCR
 /begin AXIS_DESCR STD_AXIS nmot_w nmot_uw_q0p25 4 0.00 16383.75 FORMAT "%8.2" DEPOSIT ABSOLUTE /end AXIS_DESCR
/end CHARACTERISTIC
/begin CHARACTERISTIC KFNSKHLL "" MAP 0x800499CA KfAxU8AyU8SstxU16SstyU16WU16 1.999969 fak_uw_b2 0.00 1.999969 FORMAT "%8.6"
 /begin AXIS_DESCR STD_AXIS tnse_w t100msxs_uw_b6553p5 8 0.00 6553.500 FORMAT "%8.3" DEPOSIT ABSOLUTE /end AXIS_DESCR
 /begin AXIS_DESCR STD_AXIS frhokor_w fak_uw_b4 4 0.00 3.999939 FORMAT "%8.6" DEPOSIT ABSOLUTE /end AXIS_DESCR
/end CHARACTERISTIC
/begin CHARACTERISTIC KFTMHTD "" MAP 0x80049874 KfAxU8AyU8SstxU8SstyU8WU8 2550. nmot_ub_q10 0.00 2550. FORMAT "%5.0"
 /begin AXIS_DESCR STD_AXIS tmot temp_ub_q0p75_o48 10 -48.00 143.3 FORMAT "%5.1" DEPOSIT ABSOLUTE /end AXIS_DESCR
 /begin AXIS_DESCR STD_AXIS tmst temp_ub_q0p75_o48 6 -48.00 143.3 FORMAT "%5.1" DEPOSIT ABSOLUTE /end AXIS_DESCR
/end CHARACTERISTIC
/begin CHARACTERISTIC KFTMHTDFS "" MAP 0x800498C2 KfAxU8AyU8SstxU8SstyU8WU8 2550. nmot_ub_q10 0.00 2550. FORMAT "%5.0"
 /begin AXIS_DESCR STD_AXIS tmot temp_ub_q0p75_o48 10 -48.00 143.3 FORMAT "%5.1" DEPOSIT ABSOLUTE /end AXIS_DESCR
 /begin AXIS_DESCR STD_AXIS tmst temp_ub_q0p75_o48 6 -48.00 143.3 FORMAT "%5.1" DEPOSIT ABSOLUTE /end AXIS_DESCR
/end CHARACTERISTIC
/begin CHARACTERISTIC KFTUMHTD "" MAP 0x80049910 KfAxU8AyU8SstxU8SstyU8WU8 2550. nmot_ub_q10 0.00 2550. FORMAT "%5.0"
 /begin AXIS_DESCR STD_AXIS tmot temp_ub_q0p75_o48 10 -48.00 143.3 FORMAT "%5.1" DEPOSIT ABSOLUTE /end AXIS_DESCR
 /begin AXIS_DESCR STD_AXIS tum temp_ub_q0p75_o48 8 -48.00 143.3 FORMAT "%5.1" DEPOSIT ABSOLUTE /end AXIS_DESCR
/end CHARACTERISTIC
/begin CHARACTERISTIC KFTUMHTDFS "" MAP 0x80049974 KfAxU8AyU8SstxU8SstyU8WU8 2550. nmot_ub_q10 0.00 2550. FORMAT "%5.0"
 /begin AXIS_DESCR STD_AXIS tmot temp_ub_q0p75_o48 10 -48.00 143.3 FORMAT "%5.1" DEPOSIT ABSOLUTE /end AXIS_DESCR
 /begin AXIS_DESCR STD_AXIS tum temp_ub_q0p75_o48 6 -48.00 143.3 FORMAT "%5.1" DEPOSIT ABSOLUTE /end AXIS_DESCR
/end CHARACTERISTIC
/begin CHARACTERISTIC KFWMSABST "" MAP 0x80049642 KfAxU8AyU8SstxU16SstyU8WU8 1.992188 fak_ub_b2 0.00 1.992188 FORMAT "%8.6"
 /begin AXIS_DESCR STD_AXIS tengsq1_w t_q1 4 0.00 65535.00 FORMAT "%8.2" DEPOSIT ABSOLUTE /end AXIS_DESCR
 /begin AXIS_DESCR STD_AXIS tmst temp_ub_q0p75_o48 4 -48.00 143.3 FORMAT "%5.1" DEPOSIT ABSOLUTE /end AXIS_DESCR
/end CHARACTERISTIC
/begin CHARACTERISTIC KINMXNL "" VALUE 0x8004970A KwWU8 5.100 relnmot_q0p02 0.00 5.100 FORMAT "%5.3" /end CHARACTERISTIC
/begin CHARACTERISTIC KINMXRLG "" MAP 0x8004970B GkfWU8 5.100 relnmot_q0p02 0.00 5.100 FORMAT "%5.3"
 /begin AXIS_DESCR COM_AXIS rl rel_q0p75 8 0.00 191.3 FORMAT "%5.1" AXIS_PTS_REF SRL08NXUB /end AXIS_DESCR
 /begin AXIS_DESCR COM_AXIS gangi dez 8 0.00 255.0 FORMAT "%5.1" AXIS_PTS_REF SGA08MDUB /end AXIS_DESCR
/end CHARACTERISTIC
/begin CHARACTERISTIC KLDNSOLGEN "" CURVE 0x80049804 KlAxU8SstxU8WU8 2550. nmot_q10 0.00 2550. FORMAT "%5.0"
 /begin AXIS_DESCR STD_AXIS nsolgentp nmot_q10 8 0.00 2550. FORMAT "%5.0" DEPOSIT ABSOLUTE /end AXIS_DESCR
/end CHARACTERISTIC
/begin CHARACTERISTIC KLINSOLGEN "" CURVE 0x80049815 KlAxU8SstxU8WU8 2550. nmot_q10 0.00 2550. FORMAT "%5.0"
 /begin AXIS_DESCR STD_AXIS nsolgentp nmot_q10 8 0.00 2550. FORMAT "%5.0" DEPOSIT ABSOLUTE /end AXIS_DESCR
/end CHARACTERISTIC
/begin CHARACTERISTIC KLMSUDKKH "" CURVE 0x80049660 KlAxU8SstxU8WU16 255.0000 m_uw_b6553p5 0.00 255.0000 FORMAT "%8.4"
 /begin AXIS_DESCR STD_AXIS tmst temp_ub_q0p75_o48 12 -48.00 143.3 FORMAT "%5.1" DEPOSIT ABSOLUTE /end AXIS_DESCR
/end CHARACTERISTIC
/begin CHARACTERISTIC KLMSUDKPED "" CURVE 0x80049686 KlAxU8SstxU8WU16 6553.500 m_uw_b6553p5 0.00 6553.500 FORMAT "%8.3"
 /begin AXIS_DESCR STD_AXIS wped relPED_ub_b100 3 0.00 100.0 FORMAT "%5.1" DEPOSIT ABSOLUTE /end AXIS_DESCR
/end CHARACTERISTIC
/begin CHARACTERISTIC KLMSUDKTM "" CURVE 0x80049690 KlAxU8SstxU8WU16 6553.500 m_uw_b6553p5 0.00 6553.500 FORMAT "%8.3"
 /begin AXIS_DESCR STD_AXIS tmst temp_ub_q0p75_o48 12 -48.00 143.3 FORMAT "%5.1" DEPOSIT ABSOLUTE /end AXIS_DESCR
/end CHARACTERISTIC
/begin CHARACTERISTIC KLNFSKHM "" CURVE 0x80049A26 KlAxU8SstxU8WU8 2550. nmot_q10 0.00 2550. FORMAT "%5.0"
 /begin AXIS_DESCR STD_AXIS tmotloc temp_ub_q0p75_o48 8 -48.00 143.3 FORMAT "%5.1" DEPOSIT ABSOLUTE /end AXIS_DESCR
/end CHARACTERISTIC
/begin CHARACTERISTIC KLNLLKHAGE "" CURVE 0x80049A38 KlAxU8SstxU16WU16 1.999969 fak_uw_b2 0.00 1.999969 FORMAT "%8.6"
 /begin AXIS_DESCR STD_AXIS fcosawnl_w fak_uw_b2 4 0.00 1.999969 FORMAT "%8.6" DEPOSIT ABSOLUTE /end AXIS_DESCR
/end CHARACTERISTIC
/begin CHARACTERISTIC KLNLLKHM "" CURVE 0x80049A4A KlAxU8SstxU8WU8 2550. nmot_q10 0.00 2550. FORMAT "%5.0"
 /begin AXIS_DESCR STD_AXIS tmotloc temp_ub_q0p75_o48 8 -48.00 143.3 FORMAT "%5.1" DEPOSIT ABSOLUTE /end AXIS_DESCR
/end CHARACTERISTIC
/begin CHARACTERISTIC KLTDSOLGEN "" CURVE 0x80049826 KlAxU8SstxU8WU16 1310.700 t20msxs_uw_q0p02 0.00 1310.700 FORMAT "%8.3"
 /begin AXIS_DESCR STD_AXIS nsolgentp nmot_q10 8 0.00 2550. FORMAT "%5.0" DEPOSIT ABSOLUTE /end AXIS_DESCR
/end CHARACTERISTIC
/begin CHARACTERISTIC KLTISOLGEN "" CURVE 0x80049840 KlAxU8SstxU8WU16 1310.700 t20msxs_uw_q0p02 0.00 1310.700 FORMAT "%8.3"
 /begin AXIS_DESCR STD_AXIS nsolgentp nmot_q10 8 0.00 2550. FORMAT "%5.0" DEPOSIT ABSOLUTE /end AXIS_DESCR
/end CHARACTERISTIC
/begin CHARACTERISTIC KLTNMXPR "" CURVE 0x8004974B GklWU8 5.100 relnmot_q0p02 0.00 5.100 FORMAT "%5.3"
 /begin AXIS_DESCR COM_AXIS gangi dez 8 0.00 255.0 FORMAT "%5.1" AXIS_PTS_REF SGA08MDUB /end AXIS_DESCR
/end CHARACTERISTIC
/begin CHARACTERISTIC KRKATE "" VALUE 0x80049D04 KwWU16 0.6826562 rkti_q0p10416Em4 0.00 0.6826562 FORMAT "%9.7" /end CHARACTERISTIC
/begin CHARACTERISTIC LBZO1 "" VALUE 0x80049A6C KwWU8 99.61 rel_ub_b99p6 0.00 99.61 FORMAT "%5.2" /end CHARACTERISTIC
/begin CHARACTERISTIC LBZO2 "" VALUE 0x80049A6D KwWU8 99.61 rel_ub_b99p6 0.00 99.61 FORMAT "%5.2" /end CHARACTERISTIC
/begin CHARACTERISTIC LBZO3 "" VALUE 0x80049A6E KwWU8 99.61 rel_ub_b99p6 0.00 99.61 FORMAT "%5.2" /end CHARACTERISTIC
/begin CHARACTERISTIC LBZU "" VALUE 0x80049A6F KwWU8 99.61 rel_ub_b99p6 0.00 99.61 FORMAT "%5.2" /end CHARACTERISTIC
/begin CHARACTERISTIC LTHPWMGEN "" VALUE 0x8004985A KwWS16 100.0000 DtyCyc 0.00 100.0000 FORMAT "%8.4" /end CHARACTERISTIC
/begin CHARACTERISTIC MDIMX "" VALUE 0x80049753 KwWU8 99.61 rel_ub_b99p6 0.00 99.61 FORMAT "%5.2" /end CHARACTERISTIC
/begin CHARACTERISTIC MIDSHMN "" VALUE 0x80049E44 KwWU16 99.99847 rel_uw_b100 0.00 99.99847 FORMAT "%8.5" /end CHARACTERISTIC
/begin CHARACTERISTIC MILLmp_DigOutPar_C.tiBtwTstSCB_C "" VALUE 0x8004BE2E Kw_Ws16 655350.0 Time_ms -327680.0 327670.0 FORMAT "%8.1" /end CHARACTERISTIC
/begin CHARACTERISTIC MILLmp_DigOutPar_C.tiBtwTstOT_C "" VALUE 0x8004BE30 Kw_Ws16 655.3500 Time_s -327.6800 327.6700 FORMAT "%8.4" /end CHARACTERISTIC
/begin CHARACTERISTIC MILLmp_DigOutPar_C.numTstMax_C "" VALUE 0x8004BE32 Kw_Wu16 65535.00 OneToOne 0.00 65535.00 FORMAT "%8.2" /end CHARACTERISTIC
/begin CHARACTERISTIC MILLmp_stMILCfg_CW "" VALUE 0x8004BE36 Val_Wu8 255.0 OneToOne 0.00 255.0 FORMAT "%5.1" /end CHARACTERISTIC
/begin CHARACTERISTIC MILLmp_stPwrStgEnaCond_C "" VALUE 0x8004BE34 Val_Wu8 255.0 OneToOne 0.00 255.0 FORMAT "%5.1" /end CHARACTERISTIC
/begin CHARACTERISTIC MILLmp_tiAftStrt_C "" VALUE 0x8004BE37 Val_Wu8 254.0 t1sxs_q1 1.000 255.0 FORMAT "%5.1" /end CHARACTERISTIC
/begin CHARACTERISTIC MILLmp_tiRdnBln_C "" VALUE 0x8004BE38 Val_Wu8 5.000 t1sxs_q1 5.000 10.00 FORMAT "%5.2" /end CHARACTERISTIC
/begin CHARACTERISTIC MILLmp_tiVisTst_C "" VALUE 0x8004BE39 Val_Wu8 5.000 t1sxs_q1 15.00 20.00 FORMAT "%5.2" /end CHARACTERISTIC
/begin CHARACTERISTIC MNNSOLGEN "" VALUE 0x8004985C KwWU8 2550. nmot_q10 0.00 2550. FORMAT "%5.0" /end CHARACTERISTIC
/begin CHARACTERISTIC MNTVGENSOL "" VALUE 0x8004985E KwWS16 100.0000 DtyCyc 0.00 100.0000 FORMAT "%8.4" /end CHARACTERISTIC
/begin CHARACTERISTIC MoCADC_ctDebNTP_C "" VALUE 0x800400F0 Mo_DataU8 5100.00 t20ms_ub_b5100 0.00 5100.00 /end CHARACTERISTIC
/begin CHARACTERISTIC MoCADC_ctDebTst_C "" VALUE 0x800400F1 Mo_DataU8 255.0 dez 0.00 255.0 FORMAT "%5.1" /end CHARACTERISTIC
/begin CHARACTERISTIC MoCADC_ctRstNTP_C "" VALUE 0x800400F2 Mo_DataU8 255.0 dez 0.00 255.0 FORMAT "%5.1" /end CHARACTERISTIC
/begin CHARACTERISTIC MoCADC_ctRstTst_C "" VALUE 0x800400F3 Mo_DataU8 255.0 dez 0.00 255.0 FORMAT "%5.1" /end CHARACTERISTIC
/begin CHARACTERISTIC MoCADC_uTPMax_C "" VALUE 0x800400F4 Mo_DataU8 2.490 spg_q0p00977 0.00 2.490 FORMAT "%5.3" /end CHARACTERISTIC
/begin CHARACTERISTIC MoCADC_uTstMax_C "" VALUE 0x800400F6 Mo_DataS16 319995.1 spg_q4p88_mV -160000.0 159995.1 FORMAT "%8.1" /end CHARACTERISTIC
/begin CHARACTERISTIC MoCADC_uTstMin_C "" VALUE 0x800400F8 Mo_DataS16 319995.1 spg_q4p88_mV -160000.0 159995.1 FORMAT "%8.1" /end CHARACTERISTIC
/begin CHARACTERISTIC MoCGPTA_numErr_C "" VALUE 0x800400FA Mo_DataU8 255.0 dez 0.00 255.0 FORMAT "%5.1" /end CHARACTERISTIC
/begin CHARACTERISTIC MoCGPTA_tiDvtMax_C "" VALUE 0x800400FC Mo_DataU16 65535.00 dez 0.00 65535.00 FORMAT "%8.2" /end CHARACTERISTIC
/begin CHARACTERISTIC MoCMem_ctDebErrChkRAM_C "" VALUE 0x800400FE Mo_DataU8 255.0 dez 0.00 255.0 FORMAT "%5.1" /end CHARACTERISTIC
/begin CHARACTERISTIC MoCMem_ctDebErrChkROM_C "" VALUE 0x800400FF Mo_DataU8 255.0 dez 0.00 255.0 FORMAT "%5.1" /end CHARACTERISTIC
/begin CHARACTERISTIC MoCMem_ctDebHealChkRAM_C "" VALUE 0x80040100 Mo_DataU8 255.0 dez 0.00 255.0 FORMAT "%5.1" /end CHARACTERISTIC
/begin CHARACTERISTIC MoCMem_ctDebHealChkROM_C "" VALUE 0x80040101 Mo_DataU8 255.0 dez 0.00 255.0 FORMAT "%5.1" READ_ONLY /end CHARACTERISTIC
/begin CHARACTERISTIC MoCMem_noMEMCodeChkRst_CW "" VALUE 0x80040102 Mo_DataU8 255.0 dez 0.00 255.0 FORMAT "%5.1" /end CHARACTERISTIC
/begin CHARACTERISTIC MoCMem_noMEMDataChkRst_CW "" VALUE 0x80040103 Mo_DataU8 255.0 dez 0.00 255.0 FORMAT "%5.1" /end CHARACTERISTIC
/begin CHARACTERISTIC MoCMem_RamTst_CW "" VALUE 0x8004010C Mo_DataU8 255.0 dez 0.00 255.0 FORMAT "%5.1" /end CHARACTERISTIC
/begin CHARACTERISTIC MoCMem_RomTst_CW "" VALUE 0x8004010D Mo_DataU8 255.0 dez 0.00 255.0 FORMAT "%5.1" /end CHARACTERISTIC
/begin CHARACTERISTIC MoCPCP_numErr_C "" VALUE 0x80040104 Mo_DataU8 255.0 dez 0.00 255.0 FORMAT "%5.1" /end CHARACTERISTIC
/begin CHARACTERISTIC MoCPCP_stEnaMFTst_CW "" VALUE 0x80040105 Mo_DataU8 255.0 dez 0.00 255.0 FORMAT "%5.1" /end CHARACTERISTIC
/begin CHARACTERISTIC MoCPCP_tiHeal_C "" VALUE 0x80040106 Mo_DataU8 255.0 dez 0.00 255.0 FORMAT "%5.1" /end CHARACTERISTIC
/begin CHARACTERISTIC MoCRam_ChkRAMIFA9TstSD_CW "" VALUE 0x8004010E Mo_DataU8 255.0 dez 0.00 255.0 FORMAT "%5.1" /end CHARACTERISTIC
/begin CHARACTERISTIC MoCRom_BgSwOffTst_CW "" VALUE 0x80040110 Mo_DataU8 255.0 dez 0.00 255.0 FORMAT "%5.1" /end CHARACTERISTIC
/begin CHARACTERISTIC MoCRom_noROMCodeChkRst_CW "" VALUE 0x80040111 Mo_DataU8 255.0 dez 0.00 255.0 FORMAT "%5.1" READ_ONLY /end CHARACTERISTIC
/begin CHARACTERISTIC MoCRom_noROMDataChkRst_CW "" VALUE 0x80040112 Mo_DataU8 255.0 dez 0.00 255.0 FORMAT "%5.1" /end CHARACTERISTIC
/begin CHARACTERISTIC MoCRom_RepExTst_CW "" VALUE 0x80040113 Mo_DataU8 255.0 dez 0.00 255.0 FORMAT "%5.1" /end CHARACTERISTIC
/begin CHARACTERISTIC MoCSOP_nMaxOVLthDisbl_C "" VALUE 0x80040115 Mo_DataU8 10200. nmot_ub_q40 0.00 10200. FORMAT "%5.0" /end CHARACTERISTIC
/begin CHARACTERISTIC MSUDKSNLN "" CURVE 0x800496B6 KlAxU8SstxU8WU16 6553.500 m_uw_b6553p5 0.00 6553.500 FORMAT "%8.3"
 /begin AXIS_DESCR STD_AXIS nmotmsudks nmot_ub_q10 8 0.00 2550. FORMAT "%5.0" DEPOSIT ABSOLUTE /end AXIS_DESCR
/end CHARACTERISTIC
/begin CHARACTERISTIC MXNSOLGEN "" VALUE 0x80049860 KwWU8 2550. nmot_q10 0.00 2550. FORMAT "%5.0" /end CHARACTERISTIC
/begin CHARACTERISTIC MXNSOLGEND "" VALUE 0x80049861 KwWU8 2550. nmot_q10 0.00 2550. FORMAT "%5.0" /end CHARACTERISTIC
/begin CHARACTERISTIC NFHZ "" VALUE 0x80049A76 KwWU8 2550. nmot_ub_q10 0.00 2550. FORMAT "%5.0" /end CHARACTERISTIC
/begin CHARACTERISTIC NFHZFS "" VALUE 0x80049A77 KwWU8 2550. nmot_ub_q10 0.00 2550. FORMAT "%5.0" /end CHARACTERISTIC
/begin CHARACTERISTIC NFSKS "" VALUE 0x800497FE KwWU8 2550. nmot_ub_q10 0.00 2550. FORMAT "%5.0" /end CHARACTERISTIC
/begin CHARACTERISTIC NFSNLDG "" VALUE 0x80049A66 KwWU8 2550. nmot_q10 0.00 2550. FORMAT "%5.0" /end CHARACTERISTIC
/begin CHARACTERISTIC NMAX "" VALUE 0x80049754 KwWU16 16383.75 nmot_uw_q0p25 0.00 16383.75 FORMAT "%8.2" /end CHARACTERISTIC
/begin CHARACTERISTIC NMAXDV "" VALUE 0x80049756 KwWU16 10200.00 nmot_uw_q0p25 0.00 10200.00 FORMAT "%8.2" /end CHARACTERISTIC
/begin CHARACTERISTIC NMAXDVG "" CURVE 0x80049758 GklWU16 16383.75 nmot_uw_q0p25 0.00 16383.75 FORMAT "%8.2"
 /begin AXIS_DESCR COM_AXIS gangi dez 8 0.00 255.0 FORMAT "%5.1" AXIS_PTS_REF SGA08MDUB /end AXIS_DESCR
/end CHARACTERISTIC
/begin CHARACTERISTIC NMAXDZ "" VALUE 0x80049768 KwWU16 16383.75 nmot_uw_q0p25 0.00 16383.75 FORMAT "%8.2" /end CHARACTERISTIC
/begin CHARACTERISTIC NMAXGA "" CURVE 0x8004976A GklWU16 16383.75 nmot_uw_q0p25 0.00 16383.75 FORMAT "%8.2"
 /begin AXIS_DESCR COM_AXIS gangi dez 8 0.00 255.0 FORMAT "%5.1" AXIS_PTS_REF SGA08MDUB /end AXIS_DESCR
/end CHARACTERISTIC
/begin CHARACTERISTIC NMAXKR "" VALUE 0x8004977A KwWU16 16383.75 nmot_uw_q0p25 0.00 16383.75 FORMAT "%8.2" /end CHARACTERISTIC
/begin CHARACTERISTIC NMAXNL "" VALUE 0x8004977C KwWU16 16383.75 nmot_uw_q0p25 0.00 16383.75 FORMAT "%8.2" /end CHARACTERISTIC
/begin CHARACTERISTIC NMAXOG "" VALUE 0x8004977E KwWU16 16383.75 nmot_uw_q0p25 0.00 16383.75 FORMAT "%8.2" /end CHARACTERISTIC
/begin CHARACTERISTIC NMXDAEF "" CURVE 0x80049780 KlAxU8SstxU8WU8 10200. nmot_ub_q40 0.00 10200. FORMAT "%5.0"
 /begin AXIS_DESCR STD_AXIS wped relPED_ub_b100 6 0.00 100.0 FORMAT "%5.1" DEPOSIT ABSOLUTE /end AXIS_DESCR
/end CHARACTERISTIC
/begin CHARACTERISTIC NMXDKPU "" VALUE 0x8004978E KwWU16 16383.75 nmot_uw_q0p25 0.00 16383.75 FORMAT "%8.2" /end CHARACTERISTIC
/begin CHARACTERISTIC NMXPNL "" VALUE 0x80049790 KwWU8 0.9961 relnmot_q0p0039 0.00 0.9961 /end CHARACTERISTIC
/begin CHARACTERISTIC NMXPRLG "" MAP 0x80049791 GkfWU8 0.9961 relnmot_q0p0039 0.00 0.9961
 /begin AXIS_DESCR COM_AXIS rl rel_q0p75 8 0.00 191.3 FORMAT "%5.1" AXIS_PTS_REF SRL08NXUB /end AXIS_DESCR
 /begin AXIS_DESCR COM_AXIS gangi dez 8 0.00 255.0 FORMAT "%5.1" AXIS_PTS_REF SGA08MDUB /end AXIS_DESCR
/end CHARACTERISTIC
/begin CHARACTERISTIC NNSMODGEN "" VALUE 0x80049862 KwWU8 255.0 dez 0.00 255.0 FORMAT "%5.1" /end CHARACTERISTIC
/begin CHARACTERISTIC NSACEL "" VALUE 0x800497E1 KwWU8 2550. nmot_ub_q10 0.00 2550. FORMAT "%5.0" /end CHARACTERISTIC
/begin CHARACTERISTIC NSACELFS "" VALUE 0x800497E2 KwWU8 2550. nmot_ub_q10 0.00 2550. FORMAT "%5.0" /end CHARACTERISTIC
/begin CHARACTERISTIC NSACFSTM "" CURVE 0x800497E3 KlAxU8SstxU8WU8 2550. nmot_ub_q10 0.00 2550. FORMAT "%5.0"
 /begin AXIS_DESCR STD_AXIS tumg temp_ub_q0p75_o48 6 -48.00 143.3 FORMAT "%5.1" DEPOSIT ABSOLUTE /end AXIS_DESCR
/end CHARACTERISTIC
/begin CHARACTERISTIC NSACTM "" CURVE 0x800497F0 KlAxU8SstxU8WU8 2550. nmot_ub_q10 0.00 2550. FORMAT "%5.0"
 /begin AXIS_DESCR STD_AXIS tumg temp_ub_q0p75_o48 6 -48.00 143.3 FORMAT "%5.1" DEPOSIT ABSOLUTE /end AXIS_DESCR
/end CHARACTERISTIC
/begin CHARACTERISTIC NSEL1 "" VALUE 0x80049863 KwWU8 2550. nmot_q10 0.00 2550. FORMAT "%5.0" /end CHARACTERISTIC
/begin CHARACTERISTIC NSEL2 "" VALUE 0x80049864 KwWU8 2550. nmot_q10 0.00 2550. FORMAT "%5.0" /end CHARACTERISTIC
/begin CHARACTERISTIC NSELFS2 "" VALUE 0x80049865 KwWU8 2550. nmot_q10 0.00 2550. FORMAT "%5.0" /end CHARACTERISTIC
/begin CHARACTERISTIC NSELN1 "" VALUE 0x80049866 KwWU8 2550. nmot_q10 0.00 2550. FORMAT "%5.0" /end CHARACTERISTIC
/begin CHARACTERISTIC NSELN2 "" VALUE 0x80049867 KwWU8 2550. nmot_q10 0.00 2550. FORMAT "%5.0" /end CHARACTERISTIC
/begin CHARACTERISTIC NSKS "" VALUE 0x800497FF KwWU8 2550. nmot_ub_q10 0.00 2550. FORMAT "%5.0" /end CHARACTERISTIC
/begin CHARACTERISTIC NSL "" VALUE 0x80049A6A KwWU8 2550. nmot_q10 0.00 2550. FORMAT "%5.0" /end CHARACTERISTIC
/begin CHARACTERISTIC NSLBZFS "" VALUE 0x80049A70 KwWU8 2550. nmot_ub_q10 0.00 2550. FORMAT "%5.0" /end CHARACTERISTIC
/begin CHARACTERISTIC NSLBZFS2 "" VALUE 0x80049A71 KwWU8 2550. nmot_ub_q10 0.00 2550. FORMAT "%5.0" /end CHARACTERISTIC
/begin CHARACTERISTIC NSLBZLL "" VALUE 0x80049A72 KwWU8 2550. nmot_ub_q10 0.00 2550. FORMAT "%5.0" /end CHARACTERISTIC
/begin CHARACTERISTIC NSLBZLL2 "" VALUE 0x80049A73 KwWU8 2550. nmot_ub_q10 0.00 2550. FORMAT "%5.0" /end CHARACTERISTIC
/begin CHARACTERISTIC NSLBZS "" VALUE 0x80049A74 KwWU8 10200. nmot_ub_q40 0.00 10200. FORMAT "%5.0" /end CHARACTERISTIC
/begin CHARACTERISTIC NSNLDG "" VALUE 0x80049A67 KwWU8 2550. nmot_q10 0.00 2550. FORMAT "%5.0" /end CHARACTERISTIC
/begin CHARACTERISTIC NSNOT "" VALUE 0x80049A68 KwWU8 2550. nmot_q10 0.00 2550. FORMAT "%5.0" /end CHARACTERISTIC
/begin CHARACTERISTIC NSOLGENBK "" VALUE 0x80049868 KwWU8 2550. nmot_q10 0.00 2550. FORMAT "%5.0" /end CHARACTERISTIC
/begin CHARACTERISTIC NSOLGENDEF "" VALUE 0x80049869 KwWU8 2550. nmot_q10 0.00 2550. FORMAT "%5.0" /end CHARACTERISTIC
/begin CHARACTERISTIC NSSL "" VALUE 0x8004986A KwWU8 2550. nmot_q10 0.00 2550. FORMAT "%5.0" /end CHARACTERISTIC
/begin CHARACTERISTIC NSSLFS "" VALUE 0x8004986B KwWU8 2550. nmot_q10 0.00 2550. FORMAT "%5.0" /end CHARACTERISTIC
/begin CHARACTERISTIC NSSLN "" VALUE 0x8004986C KwWU8 2550. nmot_q10 0.00 2550. FORMAT "%5.0" /end CHARACTERISTIC
/begin CHARACTERISTIC NTUM "" VALUE 0x800499C2 KwWU8 2550. nmot_ub_q10 0.00 2550. FORMAT "%5.0" /end CHARACTERISTIC
/begin CHARACTERISTIC NTUMFS "" VALUE 0x800499C3 KwWU8 2550. nmot_ub_q10 0.00 2550. FORMAT "%5.0" /end CHARACTERISTIC
/begin CHARACTERISTIC NWDKSST "" CURVE 0x800496D0 KlAxU8SstxU8WU8 10200. nmot_ub_q40 0.00 10200. FORMAT "%5.0"
 /begin AXIS_DESCR STD_AXIS tmst temp_ub_q0p75_o48 6 -48.00 143.3 FORMAT "%5.1" DEPOSIT ABSOLUTE /end AXIS_DESCR
/end CHARACTERISTIC
/begin CHARACTERISTIC OCWDA_ctDebOvrVltgOn_C "" VALUE 0x80049A78 KwUb 255.0 dez 0.00 255.0 FORMAT "%5.1" /end CHARACTERISTIC
/begin CHARACTERISTIC PSAPES "" VALUE 0x80049D06 KwWU16 2559.961 p_uw_q0p039 0.00 2559.961 FORMAT "%8.3" /end CHARACTERISTIC
/begin CHARACTERISTIC PTADP10MS "" VALUE 0x80049A7C KwWU8 255.0 OneToOne 0.00 255.0 FORMAT "%5.1" /end CHARACTERISTIC
/begin CHARACTERISTIC PT_stStabIntv_C "" VALUE 0x80049A7D KwWU8 255.0 OneToOne 0.00 255.0 FORMAT "%5.1" /end CHARACTERISTIC
/begin CHARACTERISTIC PT_stTraIntv_C "" VALUE 0x80049A7E KwWU8 255.0 OneToOne 0.00 255.0 FORMAT "%5.1" /end CHARACTERISTIC
/begin CHARACTERISTIC PT_stTraType_C "" VALUE 0x80049A7F KwWU8 255.0 OneToOne 0.00 255.0 FORMAT "%5.1" /end CHARACTERISTIC
/begin CHARACTERISTIC PT_trqLos_C "" VALUE 0x80049A80 KwWS16 6553.500 Trq -3276.800 3276.700 FORMAT "%8.3" /end CHARACTERISTIC
/begin CHARACTERISTIC PT_trqTraPrt_C "" VALUE 0x80049A82 KwWS16 6553.500 Trq -3276.800 3276.700 FORMAT "%8.3" /end CHARACTERISTIC
/begin CHARACTERISTIC Reset_rstFlMRErrBuf_C "" VALUE 0x8004BE3A Val_Wu8 255.0 OneToOne 0.00 255.0 FORMAT "%5.1" /end CHARACTERISTIC
/begin CHARACTERISTIC Reset_rstHistBuf_C "" VALUE 0x8004BE3B Val_Wu8 255.0 OneToOne 0.00 255.0 FORMAT "%5.1" /end CHARACTERISTIC
/begin CHARACTERISTIC Reset_rstTrapErrIntrBuf_C "" VALUE 0x8004BE3C Val_Wu8 255.0 OneToOne 0.00 255.0 FORMAT "%5.1" /end CHARACTERISTIC
/begin CHARACTERISTIC Reset_xGrpId_C "" VALUE 0x8004BE3D Val_Wu8 255.0 OneToOne 0.00 255.0 FORMAT "%5.1" /end CHARACTERISTIC
/begin CHARACTERISTIC Reset_xTrgId_C "" VALUE 0x8004BE3E Val_Wu16 65535.00 OneToOne 0.00 65535.00 FORMAT "%8.2" /end CHARACTERISTIC
/begin CHARACTERISTIC Rtmo_adCalling_u32 "" VALUE 0x8004BE40 Val_Wu32 4294967295.00 OneToOne 0.00 4294967295.00 FORMAT "%13.2" /end CHARACTERISTIC
/begin CHARACTERISTIC Rtmo_adData_u32 "" VALUE 0x8004BE44 Val_Wu32 4294967295.00 OneToOne 0.00 4294967295.00 FORMAT "%13.2" /end CHARACTERISTIC
/begin CHARACTERISTIC Rtmo_stSampleTime_u8 "" VALUE 0x8004BE48 Val_Wu8 255.0 OneToOne 0.00 255.0 FORMAT "%5.1" /end CHARACTERISTIC
/begin CHARACTERISTIC Rtmo_swLoadMode_u8 "" VALUE 0x8004BE49 Val_Wu8 255.0 OneToOne 0.00 255.0 FORMAT "%5.1" /end CHARACTERISTIC
/begin CHARACTERISTIC Rtmo_swMode_u8 "" VALUE 0x8004BE4A Val_Wu8 255.0 OneToOne 0.00 255.0 FORMAT "%5.1" /end CHARACTERISTIC
/begin CHARACTERISTIC Rtmo_tiIntOverhead_Tick "" VALUE 0x8004BE4C Val_Wu32 4294967295.00 OneToOne 0.00 4294967295.00 FORMAT "%13.2" /end CHARACTERISTIC
/begin CHARACTERISTIC Rtmo_tiOverhead_Tick "" VALUE 0x8004BE50 Val_Wu32 4294967295.00 OneToOne 0.00 4294967295.00 FORMAT "%13.2" /end CHARACTERISTIC
/begin AXIS_PTS SGA08MDUB "" 0x80049E57 gangi SstAUbSstUb 255.0 dez 8 0.00 255.0 FORMAT "%5.1" DEPOSIT ABSOLUTE /end AXIS_PTS
/begin AXIS_PTS SRL08NXUB "" 0x800497D1 rl SstAU8SstU8 191.3 rel_q0p75 8 0.00 191.3 FORMAT "%5.1" DEPOSIT ABSOLUTE /end AXIS_PTS
/begin CHARACTERISTIC TDENPWMSOL "" VALUE 0x8004986D KwWU8 5.100 t20msxs_ub_b5p1 0.00 5.100 FORMAT "%5.3" /end CHARACTERISTIC
/begin CHARACTERISTIC TDTUMG "" VALUE 0x800499C4 KwWU16 6553.500 t100msxs_uw_q100 0.00 6553.500 FORMAT "%8.3" /end CHARACTERISTIC
/begin CHARACTERISTIC TEMN "" VALUE 0x80049D08 KwWU16 65.53500 t1p0usxms 0.00 65.53500 FORMAT "%8.5" /end CHARACTERISTIC
/begin CHARACTERISTIC TEMNVA "" VALUE 0x80049D0A KwWU16 65.53500 t1p0usxms 0.00 65.53500 FORMAT "%8.5" /end CHARACTERISTIC
/begin CHARACTERISTIC TINSOLGENN "" VALUE 0x8004986E KwWU16 1310.700 t20msxs_uw_q0p02 0.00 1310.700 FORMAT "%8.3" /end CHARACTERISTIC
/begin CHARACTERISTIC TKHFSAB "" VALUE 0x80049A5B KwWU8 25.50 t100msxs_uw_b6553p5 0.00 25.50 FORMAT "%5.2" /end CHARACTERISTIC
/begin CHARACTERISTIC TKHLLMX "" VALUE 0x80049A5C KwWU16 6553.500 t100msxs_uw_b6553p5 0.00 6553.500 FORMAT "%8.3" /end CHARACTERISTIC
/begin CHARACTERISTIC TKHN "" VALUE 0x80049A5E KwWU8 25.4996 zk100msxs_ub_b25p5 0.100392 25.6000 FORMAT "%7.4" /end CHARACTERISTIC
/begin CHARACTERISTIC TKHNABBKV "" VALUE 0x80049A5F KwWU8 25.4996 zk100msxs_ub_b25p5 0.100392 25.6000 FORMAT "%7.4" /end CHARACTERISTIC
/begin CHARACTERISTIC TKHNEND "" VALUE 0x80049A60 KwWU8 25.4996 zk100msxs_ub_b25p5 0.100392 25.6000 FORMAT "%7.4" /end CHARACTERISTIC
/begin CHARACTERISTIC TMLLX "" VALUE 0x80049800 KwWU8 191.3 temp_ub_q0p75_o48 -48.00 143.3 FORMAT "%5.1" /end CHARACTERISTIC
/begin CHARACTERISTIC TMOTNMX "" VALUE 0x800497DA KwWU8 191.3 temp_ub_q0p75_o48 -48.00 143.3 FORMAT "%5.1" /end CHARACTERISTIC
/begin CHARACTERISTIC TNMXH "" VALUE 0x800497DC KwWU16 655.3500 t10msxs_uw_b655p35 0.00 655.3500 FORMAT "%8.4" /end CHARACTERISTIC
/begin CHARACTERISTIC TTUM "" VALUE 0x800499C6 KwWU8 191.3 temp_ub_q0p75_o48 -48.00 143.3 FORMAT "%5.1" /end CHARACTERISTIC
/begin CHARACTERISTIC TVUBAT "" CURVE 0x80049D0C KlAxU8SstxU8WU16 65.53500 t1p0usxms 0.00 65.53500 FORMAT "%8.5"
 /begin AXIS_DESCR STD_AXIS ubsq spg_q0p1 5 0.00 25.50 FORMAT "%5.2" DEPOSIT ABSOLUTE /end AXIS_DESCR
/end CHARACTERISTIC
/begin CHARACTERISTIC TWDKRED "" VALUE 0x800496DE KwWU16 655.34999985 zk10msxs_uw_b655 0.010000152590 655.36000000 FORMAT "%12.8" /end CHARACTERISTIC
/begin CHARACTERISTIC TWDKSNST "" CURVE 0x800496E0 KlAxU8SstxU8WU16 655.3500 t10msxs_uw_b655p35 0.00 655.3500 FORMAT "%8.4"
 /begin AXIS_DESCR STD_AXIS tmst temp_ub_q0p75_o48 6 -48.00 143.3 FORMAT "%5.1" DEPOSIT ABSOLUTE /end AXIS_DESCR
/end CHARACTERISTIC
/begin CHARACTERISTIC UTHPWMGEN "" VALUE 0x80049870 KwWS16 100.0000 DtyCyc 0.00 100.0000 FORMAT "%8.4" /end CHARACTERISTIC
/begin CHARACTERISTIC VFZGGRDKH "" VALUE 0x80049A62 KwWU16 511.9922 vfzg_uw_b512 0.00 511.9922 FORMAT "%8.4" /end CHARACTERISTIC
/begin CHARACTERISTIC VFZGNLLKH "" VALUE 0x80049A64 KwWU16 511.9922 vfzg_uw_b512 0.00 511.9922 FORMAT "%8.4" /end CHARACTERISTIC
/begin CHARACTERISTIC VNMX "" VALUE 0x800497DE KwWU8 318.8 vfzg_ub_q1p25 0.00 318.8 FORMAT "%5.1" /end CHARACTERISTIC
/begin CHARACTERISTIC ZDSH1GS "" CURVE 0x80049E46 FklWU8 5.08000 zk10msxs_ub_b5p1 0.0200000 5.10000 FORMAT "%7.5"
 /begin AXIS_DESCR FIX_AXIS gsdat dez 6 0.00 5.000 FORMAT "%5.3" FIX_AXIS_PAR 0 0 6 /end AXIS_DESCR
/end CHARACTERISTIC
/begin CHARACTERISTIC ZDSHGS "" CURVE 0x80049E4C FklWU8 5.08000 zk10msxs_ub_b5p1 0.0200000 5.10000 FORMAT "%7.5"
 /begin AXIS_DESCR FIX_AXIS gsdat dez 6 0.00 5.000 FORMAT "%5.3" FIX_AXIS_PAR 0 0 6 /end AXIS_DESCR
/end CHARACTERISTIC
/begin CHARACTERISTIC ZKNSOLEL "" VALUE 0x80049872 KwWU8 5.080 t20msxs_ub_b5p1 0.02000 5.100 FORMAT "%5.3" /end CHARACTERISTIC
/begin CHARACTERISTIC ZKNSOLPWM "" VALUE 0x80049873 KwWU8 5.080 t20msxs_ub_b5p1 0.02000 5.100 FORMAT "%5.3" /end CHARACTERISTIC
/begin CHARACTERISTIC ZNSUB "" VALUE 0x80049A75 KwWU8 50.9992 zk200msxs_ub_b51p2 0.200784 51.2000 FORMAT "%7.4" /end CHARACTERISTIC
/begin CHARACTERISTIC ZYLCRKMN "" VALUE 0x80049D1C KwWU8 1.992188 fak_ub_b2 0.00 1.992188 FORMAT "%8.6" /end CHARACTERISTIC
/begin CHARACTERISTIC ZYLCRKMX "" VALUE 0x80049D1D KwWU8 1.992188 fak_ub_b2 0.00 1.992188 FORMAT "%8.6" /end CHARACTERISTIC
/begin MEASUREMENT B_ausc_act "" UBYTE B_TRUE 1 100 0.00 1.00000000000 BIT_MASK 0x8 FORMAT "%13.11" ECU_ADDRESS 0xD0000096 /end MEASUREMENT
/begin MEASUREMENT B_bkvkhab "" UBYTE B_TRUE 1 100 0.00 1.00000000000 BIT_MASK 0x4 FORMAT "%13.11" ECU_ADDRESS 0xD0000093 /end MEASUREMENT
/begin MEASUREMENT B_cwnllkh0 "" UBYTE B_TRUE 1 100 0.00 1.00000000000 BIT_MASK 0x1 FORMAT "%13.11" ECU_ADDRESS 0xD0000E84 /end MEASUREMENT
/begin MEASUREMENT B_cwnllkh1 "" UBYTE B_TRUE 1 100 0.00 1.00000000000 BIT_MASK 0x2 FORMAT "%13.11" ECU_ADDRESS 0xD0000E84 /end MEASUREMENT
/begin MEASUREMENT B_cwnllkh2 "" UBYTE B_TRUE 1 100 0.00 1.00000000000 BIT_MASK 0x4 FORMAT "%13.11" ECU_ADDRESS 0xD0000E84 /end MEASUREMENT
/begin MEASUREMENT B_cwnllkh3 "" UBYTE B_TRUE 1 100 0.00 1.00000000000 BIT_MASK 0x8 FORMAT "%13.11" ECU_ADDRESS 0xD0000E84 /end MEASUREMENT
/begin MEASUREMENT B_cwnllkh4 "" UBYTE B_TRUE 1 100 0.00 1.00000000000 BIT_MASK 0x10 FORMAT "%13.11" ECU_ADDRESS 0xD0000E84 /end MEASUREMENT
/begin MEASUREMENT B_dash "" UBYTE B_TRUE 1 100 0.00 1.00000000000 BIT_MASK 0x10 FORMAT "%13.11" ECU_ADDRESS 0xD000005C /end MEASUREMENT
/begin MEASUREMENT B_dmdsteol "" UBYTE B_TRUE 1 100 0.00 1.00000000000 BIT_MASK 0x10 FORMAT "%13.11" ECU_ADDRESS 0xD0000080 /end MEASUREMENT
/begin MEASUREMENT B_ecudev "" UBYTE B_TRUE 1 100 0.00 1.00000000000 BIT_MASK 0x40 FORMAT "%13.11" ECU_ADDRESS 0xD0000058 /end MEASUREMENT
/begin MEASUREMENT B_enpwmsol "" UBYTE B_TRUE 1 100 0.00 1.00000000000 BIT_MASK 0x1 FORMAT "%13.11" ECU_ADDRESS 0xD0000048 /end MEASUREMENT
/begin MEASUREMENT B_evabu "" UBYTE B_TRUE 1 100 0.00 1.00000000000 BIT_MASK 0x8 FORMAT "%13.11" ECU_ADDRESS 0xD0000062 /end MEASUREMENT
/begin MEASUREMENT B_gsch "" UBYTE B_TRUE 1 100 0.00 1.00000000000 BIT_MASK 0x1 FORMAT "%13.11" ECU_ADDRESS 0xD0000E9C /end MEASUREMENT
/begin MEASUREMENT B_hr "" UBYTE B_TRUE 1 100 0.00 1.00000000000 BIT_MASK 0x20 FORMAT "%13.11" ECU_ADDRESS 0xD0000065 /end MEASUREMENT
/begin MEASUREMENT B_initf "" UBYTE B_TRUE 1 100 0.00 1.00000000000 BIT_MASK 0x20 FORMAT "%13.11" ECU_ADDRESS 0xD0000048 /end MEASUREMENT
/begin MEASUREMENT B_inolu "" UBYTE B_TRUE 1 100 0.00 1.00000000000 BIT_MASK 0x1 FORMAT "%13.11" ECU_ADDRESS 0xD0000E89 /end MEASUREMENT
/begin MEASUREMENT B_itnmxh "" UBYTE B_TRUE 1 100 0.00 1.00000000000 BIT_MASK 0x8 FORMAT "%13.11" ECU_ADDRESS 0xD0000047 /end MEASUREMENT
/begin MEASUREMENT B_i_ska_um "" UBYTE B_TRUE 1 100 0.00 1.00000000000 BIT_MASK 0x10 FORMAT "%13.11" ECU_ADDRESS 0xD000006A /end MEASUREMENT
/begin MEASUREMENT B_khn "" UBYTE B_TRUE 1 100 0.00 1.00000000000 BIT_MASK 0x80 FORMAT "%13.11" ECU_ADDRESS 0xD0000074 /end MEASUREMENT
/begin MEASUREMENT B_khnshp "" UBYTE B_TRUE 1 100 0.00 1.00000000000 BIT_MASK 0x20 FORMAT "%13.11" ECU_ADDRESS 0xD0000055 /end MEASUREMENT
/begin MEASUREMENT B_kupsch "" UBYTE B_TRUE 1 100 0.00 1.00000000000 BIT_MASK 0x2 FORMAT "%13.11" ECU_ADDRESS 0xD0000E9C /end MEASUREMENT
/begin MEASUREMENT B_loadel "" UBYTE B_TRUE 1 100 0.00 1.00000000000 BIT_MASK 0x2 FORMAT "%13.11" ECU_ADDRESS 0xD0000048 /end MEASUREMENT
/begin MEASUREMENT B_med2otmtcwcpXPostDrv "" UBYTE B_TRUE 1 100 0.00 1.00000000000 BIT_MASK 0x1 FORMAT "%13.11" ECU_ADDRESS 0xD0000E69 /end MEASUREMENT
/begin MEASUREMENT B_msudksom "" UBYTE B_TRUE 1 100 0.00 1.00000000000 BIT_MASK 0x4 FORMAT "%13.11" ECU_ADDRESS 0xD0000E6C /end MEASUREMENT
/begin MEASUREMENT B_munst "" UBYTE B_TRUE 1 100 0.00 1.00000000000 BIT_MASK 0x1 FORMAT "%13.11" ECU_ADDRESS 0xD0000E6C /end MEASUREMENT
/begin MEASUREMENT B_nfskh "" UBYTE B_TRUE 1 100 0.00 1.00000000000 BIT_MASK 0x20 FORMAT "%13.11" ECU_ADDRESS 0xD0000E84 /end MEASUREMENT
/begin MEASUREMENT B_nlzoff "" UBYTE B_TRUE 1 100 0.00 1.00000000000 BIT_MASK 0x20 FORMAT "%13.11" ECU_ADDRESS 0xD000007E /end MEASUREMENT
/begin MEASUREMENT B_nmax "" UBYTE B_TRUE 1 100 0.00 1.00000000000 BIT_MASK 0x2 FORMAT "%13.11" ECU_ADDRESS 0xD0000060 /end MEASUREMENT
/begin MEASUREMENT B_nmaxd "" UBYTE B_TRUE 1 100 0.00 1.00000000000 BIT_MASK 0x80 FORMAT "%13.11" ECU_ADDRESS 0xD0000047 /end MEASUREMENT
/begin MEASUREMENT B_nmxkr "" UBYTE B_TRUE 1 100 0.00 1.00000000000 BIT_MASK 0x40 FORMAT "%13.11" ECU_ADDRESS 0xD0000047 /end MEASUREMENT
/begin MEASUREMENT B_nsks "" UBYTE B_TRUE 1 100 0.00 1.00000000000 BIT_MASK 0x1 FORMAT "%13.11" ECU_ADDRESS 0xD0000E73 /end MEASUREMENT
/begin MEASUREMENT B_temin "" UBYTE B_TRUE 1 100 0.00 1.00000000000 BIT_MASK 0x40 FORMAT "%13.11" ECU_ADDRESS 0xD0000071 /end MEASUREMENT
/begin MEASUREMENT B_tfwdksom "" UBYTE B_TRUE 1 100 0.00 1.00000000000 BIT_MASK 0x2 FORMAT "%13.11" ECU_ADDRESS 0xD0000E6C /end MEASUREMENT
/begin MEASUREMENT B_tmotnmx "" UBYTE B_TRUE 1 100 0.00 1.00000000000 BIT_MASK 0x20 FORMAT "%13.11" ECU_ADDRESS 0xD0000047 /end MEASUREMENT
/begin MEASUREMENT B_tnmxh "" UBYTE B_TRUE 1 100 0.00 1.00000000000 BIT_MASK 0x10 FORMAT "%13.11" ECU_ADDRESS 0xD0000047 /end MEASUREMENT
/begin MEASUREMENT B_wdaactiv "" UBYTE B_TRUE 1 100 0.00 1.00000000000 BIT_MASK 0x2 FORMAT "%13.11" ECU_ADDRESS 0xD0000056 /end MEASUREMENT
/begin MEASUREMENT B_wk "" UBYTE B_TRUE 1 100 0.00 1.00000000000 BIT_MASK 0x4 FORMAT "%13.11" ECU_ADDRESS 0xD0000E9C /end MEASUREMENT
/begin MEASUREMENT B_wkauf "" UBYTE B_TRUE 1 100 0.00 1.00000000000 BIT_MASK 0x10 FORMAT "%13.11" ECU_ADDRESS 0xD000009A /end MEASUREMENT
/begin MEASUREMENT B_wkr "" UBYTE B_TRUE 1 100 0.00 1.00000000000 BIT_MASK 0x8 FORMAT "%13.11" ECU_ADDRESS 0xD0000E9C /end MEASUREMENT
/begin MEASUREMENT B_zwget "" UBYTE B_TRUE 1 100 0.00 1.00000000000 BIT_MASK 0x10 FORMAT "%13.11" ECU_ADDRESS 0xD0000E9C /end MEASUREMENT
/begin MEASUREMENT CEngDsT_t "" SWORD Temp_Cels 1 100 -3549.940 3003.560 FORMAT "%8.3" ECU_ADDRESS 0xD000347A /end MEASUREMENT
/begin MEASUREMENT CEngDsT_tMod "" SWORD Temp_Cels 1 100 -3549.940 3003.560 FORMAT "%8.3" ECU_ADDRESS 0xD000347C /end MEASUREMENT
/begin MEASUREMENT CEngDsT_tRaw "" SWORD Temp_Cels 1 100 -3549.940 3003.560 FORMAT "%8.3" ECU_ADDRESS 0xD000347E /end MEASUREMENT
/begin MEASUREMENT CEngDsT_tStrtFrst "" SWORD Temp_Cels 1 100 -3549.940 3003.560 FORMAT "%8.3" ECU_ADDRESS 0xD0003480 /end MEASUREMENT
/begin MEASUREMENT CoPT_trqClthWoTraIntv "" SWORD Trq 1 100 -3276.800 3276.700 FORMAT "%8.3" ECU_ADDRESS 0xD00034A0 /end MEASUREMENT
/begin MEASUREMENT CoPT_trqPTPrt "" SWORD Trq 1 100 -3276.800 3276.700 FORMAT "%8.3" ECU_ADDRESS 0xD00034A2 /end MEASUREMENT
/begin MEASUREMENT dmnmxi_w "" SWORD rel_sw_b100 1 100 -100.0000 99.99695 FORMAT "%8.4" ECU_ADDRESS 0xD00009D4 /end MEASUREMENT
/begin MEASUREMENT dmnmxp_w "" SWORD rel_sw_b100 1 100 -100.0000 99.99695 FORMAT "%8.4" ECU_ADDRESS 0xD00009D6 /end MEASUREMENT
/begin MEASUREMENT dnsi_w "" SWORD nmot_sw_q0p25 1 100 -8192.000 8191.750 FORMAT "%8.3" ECU_ADDRESS 0xD00009D8 /end MEASUREMENT
/begin MEASUREMENT dppk_w "" SWORD p_sw_q0p312 1 100 -10240.00 10239.69 FORMAT "%8.2" ECU_ADDRESS 0xD0000A02 /end MEASUREMENT
/begin MEASUREMENT dpus_w "" SWORD p_sw_q0p078 1 100 -2560.000 2559.922 FORMAT "%8.3" ECU_ADDRESS 0xD0000A04 /end MEASUREMENT
/begin MEASUREMENT dtemnkt_w "" UWORD t1p0usxms 1 100 0.00 65.53500 FORMAT "%8.5" ECU_ADDRESS 0xD0000A06 /end MEASUREMENT
/begin MEASUREMENT EngDa_tEng "" SWORD Temp_Cels 1 100 -3549.940 3003.560 FORMAT "%8.3" ECU_ADDRESS 0xD00034DA /end MEASUREMENT
/begin MEASUREMENT EngTrqPtd_trqLead "" SWORD md_q0p1 1 100 -3276.800 3276.700 FORMAT "%8.3" ECU_ADDRESS 0xD00034E2 /end MEASUREMENT
/begin MEASUREMENT EngTrqPtd_trqSet "" SWORD md_q0p1 1 100 -3276.800 3276.700 FORMAT "%8.3" ECU_ADDRESS 0xD00034E4 /end MEASUREMENT
/begin MEASUREMENT ErrLmp_stMIL "" UBYTE OneToOne 1 100 0.00 255.0 FORMAT "%5.1" ECU_ADDRESS 0xD0003C5F /end MEASUREMENT
/begin MEASUREMENT fcosawnl_w "" UWORD fak_uw_b2 1 100 0.00 1.999969 FORMAT "%8.6" ECU_ADDRESS 0xD00009EC /end MEASUREMENT
/begin MEASUREMENT fkrk_w "" UWORD fak_uw_b2 1 100 0.00 1.999969 FORMAT "%8.6" ARRAY_SIZE 3 ECU_ADDRESS 0xD0000A08 /end MEASUREMENT
/begin MEASUREMENT fnwua "" UBYTE fak_ub_b1 1 100 0.00 0.9961 ECU_ADDRESS 0xD0000E90 /end MEASUREMENT
/begin MEASUREMENT fnwue "" UBYTE fak_ub_b1 1 100 0.00 0.9961 ECU_ADDRESS 0xD0000E91 /end MEASUREMENT
/begin MEASUREMENT fnwu_w "" UWORD fak_uw_b2 1 100 0.00 1.999969 FORMAT "%8.6" ECU_ADDRESS 0xD00009F2 /end MEASUREMENT
/begin MEASUREMENT frhokor_w "" UWORD fak_uw_b4 1 100 0.00 3.999939 FORMAT "%8.6" ECU_ADDRESS 0xD00009EE /end MEASUREMENT
/begin MEASUREMENT frkate_w "" UWORD rkti_q0p4166Em4 1 100 0.00 2.730625 FORMAT "%8.6" ECU_ADDRESS 0xD0000A0E /end MEASUREMENT
/begin MEASUREMENT frlfs_w "" UWORD fak_uw_b2 1 100 0.00 1.999969 FORMAT "%8.6" ECU_ADDRESS 0xD0000A10 /end MEASUREMENT
/begin MEASUREMENT ftek_w "" UWORD fak_uw_b2 1 100 0.00 1.999969 FORMAT "%8.6" ECU_ADDRESS 0xD00009FE /end MEASUREMENT
/begin MEASUREMENT InjSys_bActvDiaCPVPsbl "" UBYTE B_TRUE 1 100 0.00 1.00000000000 BIT_MASK 0x40 FORMAT "%13.11" ECU_ADDRESS 0xD0000091 /end MEASUREMENT
/begin MEASUREMENT InjSys_bCPVOpnForDia "" UBYTE B_TRUE 1 100 0.00 1.00000000000 BIT_MASK 0x80 FORMAT "%13.11" ECU_ADDRESS 0xD0000086 /end MEASUREMENT
/begin MEASUREMENT InjSys_bCPVRdyForDia "" UBYTE B_TRUE 1 100 0.00 1.00000000000 BIT_MASK 0x20 FORMAT "%13.11" ECU_ADDRESS 0xD000009D /end MEASUREMENT
/begin MEASUREMENT InjSys_bFlTnkEmp "" UBYTE B_TRUE 1 100 0.00 1.00000000000 BIT_MASK 0x4 FORMAT "%13.11" ECU_ADDRESS 0xD000009B /end MEASUREMENT
/begin MEASUREMENT InjSys_bFlTnkEmpVal "" UBYTE B_TRUE 1 100 0.00 1.00000000000 BIT_MASK 0x4 FORMAT "%13.11" ECU_ADDRESS 0xD0000054 /end MEASUREMENT
/begin MEASUREMENT InjSys_bInjVlvActv "" UBYTE B_TRUE 1 100 0.00 1.00000000000 BIT_MASK 0x10 FORMAT "%13.11" ECU_ADDRESS 0xD000008E /end MEASUREMENT
/begin MEASUREMENT InjSys_bMinPtdInjDurActv "" UBYTE B_TRUE 1 100 0.00 1.00000000000 BIT_MASK 0x10 FORMAT "%13.11" ECU_ADDRESS 0xD0000082 /end MEASUREMENT
/begin MEASUREMENT InjSys_stActRedStg "" UBYTE dez 1 100 0.00 255.0 FORMAT "%5.1" ECU_ADDRESS 0xD0003C8A /end MEASUREMENT
/begin MEASUREMENT iwdkba "" UBYTE relDK_ub_b100 1 100 0.00 100.0 FORMAT "%5.1" ECU_ADDRESS 0xD0000E9D /end MEASUREMENT
/begin MEASUREMENT kinmx "" UBYTE relnmot_q0p02 1 100 0.00 5.100 FORMAT "%5.3" ECU_ADDRESS 0xD0000E6D /end MEASUREMENT
/begin MEASUREMENT kltnmxpr_w "" UBYTE relnmot_q0p02 1 100 0.00 5.100 FORMAT "%5.3" ECU_ADDRESS 0xD0000E6E /end MEASUREMENT
/begin MEASUREMENT midash "" UBYTE rel_ub_q0p3906 1 100 0.00 99.61 FORMAT "%5.2" ECU_ADDRESS 0xD0000E9E /end MEASUREMENT
/begin MEASUREMENT midash_w "" UWORD rel_uw_b100 1 100 0.00 99.99847 FORMAT "%8.5" ECU_ADDRESS 0xD0000A22 /end MEASUREMENT
/begin MEASUREMENT midshfz_w "" UWORD rel_uw_b100 1 100 0.00 99.99847 FORMAT "%8.5" ECU_ADDRESS 0xD0000A16 /end MEASUREMENT
/begin MEASUREMENT midshf_w "" UWORD rel_uw_b100 1 100 0.00 99.99847 FORMAT "%8.5" ECU_ADDRESS 0xD0000A18 /end MEASUREMENT
/begin MEASUREMENT midsh_old_w "" UWORD rel_uw_b100 1 100 0.00 99.99847 FORMAT "%8.5" ECU_ADDRESS 0xD0000A1A /end MEASUREMENT
/begin MEASUREMENT midsh_w "" UWORD rel_uw_b100 1 100 0.00 99.99847 FORMAT "%8.5" ECU_ADDRESS 0xD0000A1C /end MEASUREMENT
/begin MEASUREMENT mifabh_w "" UWORD rel_uw_b100 1 100 0.00 99.99847 FORMAT "%8.5" ECU_ADDRESS 0xD00009DA /end MEASUREMENT
/begin MEASUREMENT MILLmp_stMIL "" UBYTE OneToOne 1 100 0.00 255.0 FORMAT "%5.1" ECU_ADDRESS 0xD0003C8C /end MEASUREMENT
/begin MEASUREMENT MILLmp_stMILWoTstr "" UBYTE OneToOne 1 100 0.00 255.0 FORMAT "%5.1" ECU_ADDRESS 0xD0003DA6 /end MEASUREMENT
/begin MEASUREMENT MILLmp_stPs "" UBYTE OneToOne 1 100 0.00 255.0 BIT_MASK 0x1 FORMAT "%5.1" ECU_ADDRESS 0xD0003CD2 /end MEASUREMENT
/begin MEASUREMENT MILLmp_stReqBln "" UBYTE MILLmp_ReqVerb 1 100 0.00 255.000000000 FORMAT "%13.9" ECU_ADDRESS 0xAFE801D1 /end MEASUREMENT
/begin MEASUREMENT MILLmp_stReqOn "" UBYTE MILLmp_ReqVerb 1 100 0.00 255.000000000 FORMAT "%13.9" ECU_ADDRESS 0xAFE801D0 /end MEASUREMENT
/begin MEASUREMENT MILLmp_stSt "" UBYTE MILLmp_StVerb 1 100 0.00 65.0000000000 FORMAT "%13.10" ECU_ADDRESS 0xD0003DA4 /end MEASUREMENT
/begin MEASUREMENT MILLmp_tiRmnBln "" UBYTE t50msxs_q0p05 1 100 0.00 12.75 FORMAT "%5.2" ECU_ADDRESS 0xD0003DA7 /end MEASUREMENT
/begin MEASUREMENT MILLmp_tiRmnSt "" UBYTE t1sxs_q1 1 100 0.00 255.0 FORMAT "%5.1" ECU_ADDRESS 0xD0003DA5 /end MEASUREMENT
/begin MEASUREMENT minmxb_w "" SWORD rel_sw_b100 1 100 -100.0000 99.99695 FORMAT "%8.4" ECU_ADDRESS 0xD00009DC /end MEASUREMENT
/begin MEASUREMENT minmx_w "" UWORD rel_uw_b100 1 100 0.00 99.99847 FORMAT "%8.5" ECU_ADDRESS 0xD00009E8 /end MEASUREMENT
/begin MEASUREMENT miszul_w "" UWORD rel_uw_b100 1 100 0.00 99.99847 FORMAT "%8.5" ECU_ADDRESS 0xD00009C6 /end MEASUREMENT
/begin MEASUREMENT MoCADC_bChkActv "" UBYTE B_TRUE 1 100 0.00 1.00000000000 BIT_MASK 0x8 FORMAT "%13.11" ECU_ADDRESS 0xD0005413 /end MEASUREMENT
/begin MEASUREMENT MoCADC_bDef "" UBYTE B_TRUE 1 100 0.00 1.00000000000 BIT_MASK 0x80 FORMAT "%13.11" ECU_ADDRESS 0xD0005413 /end MEASUREMENT
/begin MEASUREMENT MoCADC_bNTPActv "" UBYTE B_TRUE 1 100 0.00 1.00000000000 BIT_MASK 0x1 FORMAT "%13.11" ECU_ADDRESS 0xD0005413 /end MEASUREMENT
/begin MEASUREMENT MoCADC_bNTPErr "" UBYTE B_TRUE 1 100 0.00 1.00000000000 BIT_MASK 0x40 FORMAT "%13.11" ECU_ADDRESS 0xD0005413 /end MEASUREMENT
/begin MEASUREMENT MoCADC_bTstErr "" UBYTE B_TRUE 1 100 0.00 1.00000000000 BIT_MASK 0x4 FORMAT "%13.11" ECU_ADDRESS 0xD0005413 /end MEASUREMENT
/begin MEASUREMENT MoCADC_ctDebNTP "" UBYTE dez 1 100 0.00 255.0 FORMAT "%5.1" ECU_ADDRESS 0xD0005411 /end MEASUREMENT
/begin MEASUREMENT MoCADC_ctDebNTPCpl "" UBYTE dez 1 100 0.00 255.0 FORMAT "%5.1" ECU_ADDRESS 0xD0005448 /end MEASUREMENT
/begin MEASUREMENT MoCADC_ctDebTst "" UBYTE dez 1 100 0.00 255.0 FORMAT "%5.1" ECU_ADDRESS 0xD0005412 /end MEASUREMENT
/begin MEASUREMENT MoCADC_ctDebTstCpl "" UBYTE dez 1 100 0.00 255.0 FORMAT "%5.1" ECU_ADDRESS 0xD0005449 /end MEASUREMENT
/begin MEASUREMENT MoCADC_ctTstNTP "" UBYTE dez 1 100 0.00 255.0 FORMAT "%5.1" ECU_ADDRESS 0xD000549C /end MEASUREMENT
/begin MEASUREMENT MoCADC_ctTstTst "" UBYTE dez 1 100 0.00 255.0 FORMAT "%5.1" ECU_ADDRESS 0xD000549D /end MEASUREMENT
/begin MEASUREMENT MoCADC_facVltgRatio "" UWORD fak_q0p0009766 1 100 0.00 63.99902 FORMAT "%8.5" ECU_ADDRESS 0xD000549E /end MEASUREMENT
/begin MEASUREMENT MoCADC_st "" UBYTE dez 1 100 0.00 255.0 FORMAT "%5.1" ECU_ADDRESS 0xD0005413 /end MEASUREMENT
/begin MEASUREMENT MoCADC_stCpl "" UBYTE dez 1 100 0.00 255.0 FORMAT "%5.1" ECU_ADDRESS 0xD000544A /end MEASUREMENT
/begin MEASUREMENT MoCADC_stMsg "" UBYTE dez 1 100 0.00 255.0 FORMAT "%5.1" ECU_ADDRESS 0xD0003C8D /end MEASUREMENT
/begin MEASUREMENT MoCADC_uTP_mp "" UWORD spg_q0p00977 1 100 0.00 639.9902 FORMAT "%8.4" ECU_ADDRESS 0xD00053F4 /end MEASUREMENT
/begin MEASUREMENT MoCADC_uTst_mp "" SWORD spg_q4p88_mV 1 100 -160000.0 159995.1 FORMAT "%8.1" ECU_ADDRESS 0xD00053F6 /end MEASUREMENT
/begin MEASUREMENT MoCCom_bCPUNew "" UBYTE B_TRUE 1 100 0.00 1.00000000000 BIT_MASK 0x1 FORMAT "%13.11" ECU_ADDRESS 0xD000544C /end MEASUREMENT
/begin MEASUREMENT MoCCom_bPCPNew "" UBYTE B_TRUE 1 100 0.00 1.00000000000 BIT_MASK 0x4 FORMAT "%13.11" ECU_ADDRESS 0xD000544C /end MEASUREMENT
/begin MEASUREMENT MoCCom_bPFCNew "" UBYTE B_TRUE 1 100 0.00 1.00000000000 BIT_MASK 0x2 FORMAT "%13.11" ECU_ADDRESS 0xD000544C /end MEASUREMENT
/begin MEASUREMENT MoCCom_ctCorRespCnt "" UBYTE dez 1 100 0.00 255.0 FORMAT "%5.1" ECU_ADDRESS 0xAFE8070E /end MEASUREMENT
/begin MEASUREMENT MoCCom_ctErrFC "" UBYTE dez 1 100 0.00 255.0 FORMAT "%5.1" ECU_ADDRESS 0xD0000F41 /end MEASUREMENT
/begin MEASUREMENT MoCCom_ctErrFCCpl "" UBYTE dez 1 100 0.00 255.0 FORMAT "%5.1" ECU_ADDRESS 0xD0000F42 /end MEASUREMENT
/begin MEASUREMENT MoCCom_ctErrMM "" UBYTE dez 1 100 0.00 255.0 FORMAT "%5.1" ECU_ADDRESS 0xD0000F49 /end MEASUREMENT
/begin MEASUREMENT MoCCom_ctErrMMMsg "" UBYTE dez 1 100 0.00 255.0 FORMAT "%5.1" ECU_ADDRESS 0xD0003C8E /end MEASUREMENT
/begin MEASUREMENT MoCCom_ctErrMMOld "" UBYTE dez 1 100 0.00 255.0 FORMAT "%5.1" ECU_ADDRESS 0xD0000F43 /end MEASUREMENT
/begin MEASUREMENT MoCCom_ctErrOSTimeout "" UBYTE dez 1 100 0.00 255.0 FORMAT "%5.1" ECU_ADDRESS 0xD0000F44 /end MEASUREMENT
/begin MEASUREMENT MoCCom_ctErrSPI "" UBYTE dez 1 100 0.00 255.0 FORMAT "%5.1" ECU_ADDRESS 0xD0000F45 /end MEASUREMENT
/begin MEASUREMENT MoCCom_ctSOPNoRdy "" UBYTE dez 1 100 0.00 255.0 FORMAT "%5.1" ECU_ADDRESS 0xD000544B /end MEASUREMENT
/begin MEASUREMENT MoCCom_ctSOPTstActv "" UBYTE dez 1 100 0.00 255.0 FORMAT "%5.1" ECU_ADDRESS 0xD0000F46 /end MEASUREMENT
/begin MEASUREMENT MoCCom_Query "" ULONG dez 1 100 0.00 4294967295.00 FORMAT "%13.2" ECU_ADDRESS 0xD0004770 /end MEASUREMENT
/begin MEASUREMENT MoCCom_Response "" ULONG dez 1 100 0.00 4294967295.00 FORMAT "%13.2" ECU_ADDRESS 0xD000476C /end MEASUREMENT
/begin MEASUREMENT MoCCom_Response_mp "" ULONG dez 1 100 0.00 4294967295.00 FORMAT "%13.2" ECU_ADDRESS 0xD00053F8 /end MEASUREMENT
/begin MEASUREMENT MoCCom_stMm "" UBYTE dez 1 100 0.00 255.0 FORMAT "%5.1" ECU_ADDRESS 0xD0000F47 /end MEASUREMENT
/begin MEASUREMENT MoCCom_stMmRespCnt "" UBYTE dez 1 100 0.00 255.0 FORMAT "%5.1" ECU_ADDRESS 0xD0000F48 /end MEASUREMENT
/begin MEASUREMENT MoCCom_stQueryNew "" UBYTE dez 1 100 0.00 255.0 FORMAT "%5.1" ECU_ADDRESS 0xD000544C /end MEASUREMENT
/begin MEASUREMENT MoCCom_stWDAActvMsg "" UBYTE OneToOne 1 100 0.00 255.0 BIT_MASK 0x1 FORMAT "%5.1" ECU_ADDRESS 0xD0003CD4 /end MEASUREMENT
/begin MEASUREMENT MoCCPU_ctSeq "" UBYTE dez 1 100 0.00 255.0 FORMAT "%5.1" ECU_ADDRESS 0xD0005450 /end MEASUREMENT
/begin MEASUREMENT MoCCPU_PartResp "" ULONG dez 1 100 0.00 4294967295.00 FORMAT "%13.2" ECU_ADDRESS 0xD0005458 /end MEASUREMENT
/begin MEASUREMENT MoCCPU_Query "" UBYTE dez 1 100 0.00 255.0 FORMAT "%5.1" ECU_ADDRESS 0xD0005451 /end MEASUREMENT
/begin MEASUREMENT MoCCPU_TempRes "" ULONG dez 1 100 0.00 4294967295.00 FORMAT "%13.2" ECU_ADDRESS 0xD0005454 /end MEASUREMENT
/begin MEASUREMENT MoCMem_adRAMCurrent "" ULONG dez 1 100 0.00 4294967295.00 FORMAT "%13.2" ECU_ADDRESS 0xD0005418 /end MEASUREMENT
/begin MEASUREMENT MoCMem_adRAMCurrentCpl "" ULONG dez 1 100 0.00 4294967295.00 FORMAT "%13.2" ECU_ADDRESS 0xD0005464 /end MEASUREMENT
/begin MEASUREMENT MoCMem_adROMCurrent "" ULONG dez 1 100 0.00 4294967295.00 FORMAT "%13.2" ECU_ADDRESS 0xD000541C /end MEASUREMENT
/begin MEASUREMENT MoCMem_adROMCurrentCpl "" ULONG dez 1 100 0.00 4294967295.00 FORMAT "%13.2" ECU_ADDRESS 0xD0005468 /end MEASUREMENT
/begin MEASUREMENT MoCMem_ChkRAMIFA9TstSD "" UBYTE dez 1 100 0.00 255.0 FORMAT "%5.1" ECU_ADDRESS 0xD0005460 /end MEASUREMENT
/begin MEASUREMENT MoCMem_ChkRAMIFA9TstSDCpl "" UBYTE dez 1 100 0.00 255.0 FORMAT "%5.1" ECU_ADDRESS 0xD0005461 /end MEASUREMENT
/begin MEASUREMENT MoCMem_ctDebErrChkRAM "" UBYTE dez 1 100 0.00 255.0 FORMAT "%5.1" ECU_ADDRESS 0xD0005414 /end MEASUREMENT
/begin MEASUREMENT MoCMem_ctDebErrChkRAMCpl "" UBYTE dez 1 100 0.00 255.0 FORMAT "%5.1" ECU_ADDRESS 0xD000545C /end MEASUREMENT
/begin MEASUREMENT MoCMem_ctDebErrChkROM "" UBYTE dez 1 100 0.00 255.0 FORMAT "%5.1" ECU_ADDRESS 0xD0005415 /end MEASUREMENT
/begin MEASUREMENT MoCMem_ctDebErrChkROMCpl "" UBYTE dez 1 100 0.00 255.0 FORMAT "%5.1" ECU_ADDRESS 0xD000545D /end MEASUREMENT
/begin MEASUREMENT MoCMem_ctDebHealChkRAM "" UBYTE dez 1 100 0.00 255.0 FORMAT "%5.1" ECU_ADDRESS 0xD0005416 /end MEASUREMENT
/begin MEASUREMENT MoCMem_ctDebHealChkRAMCpl "" UBYTE dez 1 100 0.00 255.0 FORMAT "%5.1" ECU_ADDRESS 0xD000545E /end MEASUREMENT
/begin MEASUREMENT MoCMem_ctDebHealChkROM "" UBYTE dez 1 100 0.00 255.0 FORMAT "%5.1" ECU_ADDRESS 0xD0005417 /end MEASUREMENT
/begin MEASUREMENT MoCMem_ctDebHealChkROMCpl "" UBYTE dez 1 100 0.00 255.0 FORMAT "%5.1" ECU_ADDRESS 0xD000545F /end MEASUREMENT
/begin MEASUREMENT MoCMem_numChkSumCurrent "" ULONG dez 1 100 0.00 4294967295.00 FORMAT "%13.2" ECU_ADDRESS 0xD0005420 /end MEASUREMENT
/begin MEASUREMENT MoCMem_numChkSumCurrentCpl "" ULONG dez 1 100 0.00 4294967295.00 FORMAT "%13.2" ECU_ADDRESS 0xD000546C /end MEASUREMENT
/begin MEASUREMENT MoCMem_st "" UBYTE dez 1 100 0.00 255.0 FORMAT "%5.1" ECU_ADDRESS 0xAFE8070F /end MEASUREMENT
/begin MEASUREMENT MoCMem_stCpl "" UBYTE dez 1 100 0.00 255.0 FORMAT "%5.1" ECU_ADDRESS 0xAFE80710 /end MEASUREMENT
/begin MEASUREMENT MoCPCP_adCurrent "" ULONG dez 1 100 0.00 4294967295.00 FORMAT "%13.2" ECU_ADDRESS 0xD0005428 /end MEASUREMENT
/begin MEASUREMENT MoCPCP_adCurrentCpl "" ULONG dez 1 100 0.00 4294967295.00 FORMAT "%13.2" ECU_ADDRESS 0xD0005474 /end MEASUREMENT
/begin MEASUREMENT MoCPCP_ctErr "" UBYTE dez 1 100 0.00 255.0 FORMAT "%5.1" ECU_ADDRESS 0xD0005424 /end MEASUREMENT
/begin MEASUREMENT MoCPCP_ctErrCpl "" UBYTE dez 1 100 0.00 255.0 FORMAT "%5.1" ECU_ADDRESS 0xD0005470 /end MEASUREMENT
/begin MEASUREMENT MoCPCP_ctHeal "" UBYTE dez 1 100 0.00 255.0 FORMAT "%5.1" ECU_ADDRESS 0xD0005425 /end MEASUREMENT
/begin MEASUREMENT MoCPCP_ctHealCpl "" UBYTE dez 1 100 0.00 255.0 FORMAT "%5.1" ECU_ADDRESS 0xD0005471 /end MEASUREMENT
/begin MEASUREMENT MoCPCP_numCurrentCSum "" ULONG dez 1 100 0.00 4294967295.00 FORMAT "%13.2" ECU_ADDRESS 0xD000542C /end MEASUREMENT
/begin MEASUREMENT MoCPCP_numCurrentCSumCpl "" ULONG dez 1 100 0.00 4294967295.00 FORMAT "%13.2" ECU_ADDRESS 0xD0005478 /end MEASUREMENT
/begin MEASUREMENT MoCPFC_Checksum "" ULONG dez 1 100 0.00 4294967295.00 FORMAT "%13.2" ECU_ADDRESS 0xD0005480 /end MEASUREMENT
/begin MEASUREMENT MoCPFC_Checkword "" ULONG dez 1 100 0.00 4294967295.00 FORMAT "%13.2" ECU_ADDRESS 0xD0005484 /end MEASUREMENT
/begin MEASUREMENT MoCPFC_Counter "" UBYTE dez 1 100 0.00 255.0 FORMAT "%5.1" ECU_ADDRESS 0xD000547C /end MEASUREMENT
/begin MEASUREMENT MoCPFC_PartResp "" ULONG dez 1 100 0.00 4294967295.00 FORMAT "%13.2" ECU_ADDRESS 0xD0005488 /end MEASUREMENT
/begin MEASUREMENT MoCRam_ctMain1RamChk "" ULONG t_q1p0_us 1 100 0.00 4294967295.00 FORMAT "%13.2" ECU_ADDRESS 0xAFE8071C /end MEASUREMENT
/begin MEASUREMENT MoCRam_ctMain2RamChk "" ULONG t_q1p0_us 1 100 0.00 4294967295.00 FORMAT "%13.2" ECU_ADDRESS 0xAFE80720 /end MEASUREMENT
/begin MEASUREMENT MoCRam_ctMainProtRam "" ULONG t_q1p0_us 1 100 0.00 4294967295.00 FORMAT "%13.2" ECU_ADDRESS 0xAFE80724 /end MEASUREMENT
/begin MEASUREMENT MoCRam_ctRepEx "" ULONG t_q1p0_us 1 100 0.00 4294967295.00 FORMAT "%13.2" ECU_ADDRESS 0xAFE80728 /end MEASUREMENT
/begin MEASUREMENT MoCRam_numAreasChecked "" UBYTE dez 1 100 0.00 255.0 FORMAT "%5.1" ECU_ADDRESS 0xAFE80714 /end MEASUREMENT
/begin MEASUREMENT MoCRam_numReset "" UBYTE dez 1 100 0.00 255.0 FORMAT "%5.1" ECU_ADDRESS 0xAFE80715 /end MEASUREMENT
/begin MEASUREMENT MoCRam_stEEPInit "" UBYTE dez 1 100 0.00 255.0 FORMAT "%5.1" ECU_ADDRESS 0xAFE80716 /end MEASUREMENT
/begin MEASUREMENT MoCRam_stProtRAMCleared "" UBYTE dez 1 100 0.00 255.0 FORMAT "%5.1" ECU_ADDRESS 0xAFE80719 /end MEASUREMENT
/begin MEASUREMENT MoCRam_stRepExRam "" UBYTE dez 1 100 0.00 255.0 FORMAT "%5.1" ECU_ADDRESS 0xAFE80717 /end MEASUREMENT
/begin MEASUREMENT MoCRam_stRepExRamCpl "" UBYTE dez 1 100 0.00 255.0 FORMAT "%5.1" ECU_ADDRESS 0xAFE80718 /end MEASUREMENT
/begin MEASUREMENT MoCROM_bXPostDrv "" UBYTE B_TRUE 1 100 0.00 1.00000000000 BIT_MASK 0x4 FORMAT "%13.11" ECU_ADDRESS 0xD0000077 /end MEASUREMENT
/begin MEASUREMENT MoCRom_ctRepEx_mp "" ULONG t_q1p0_us 1 100 0.00 4294967295.00 FORMAT "%13.2" ECU_ADDRESS 0xD00053FC /end MEASUREMENT
/begin MEASUREMENT MoCRom_KeyCode "" UBYTE dez 1 100 0.00 255.0 FORMAT "%5.1" ECU_ADDRESS 0xD000548C /end MEASUREMENT
/begin MEASUREMENT MoCRom_KeyCodeCpl "" UBYTE dez 1 100 0.00 255.0 FORMAT "%5.1" ECU_ADDRESS 0xD000548D /end MEASUREMENT
/begin MEASUREMENT MoCRom_KeyData "" UBYTE dez 1 100 0.00 255.0 FORMAT "%5.1" ECU_ADDRESS 0xD000548E /end MEASUREMENT
/begin MEASUREMENT MoCRom_KeyDataCpl "" UBYTE dez 1 100 0.00 255.0 FORMAT "%5.1" ECU_ADDRESS 0xD000548F /end MEASUREMENT
/begin MEASUREMENT MoCRom_numRomPageErr "" UBYTE dez 1 100 0.00 255.0 FORMAT "%5.1" ECU_ADDRESS 0xAFE8072C /end MEASUREMENT
/begin MEASUREMENT MoCRom_numRomPageErrCpl "" UBYTE dez 1 100 0.00 255.0 FORMAT "%5.1" ECU_ADDRESS 0xAFE8072D /end MEASUREMENT
/begin MEASUREMENT MoCRom_ptrTabIndexAct "" UBYTE dez 1 100 0.00 255.0 FORMAT "%5.1" ECU_ADDRESS 0xAFE8072E /end MEASUREMENT
/begin MEASUREMENT MoCRom_ptrTabIndexActCpl "" UBYTE dez 1 100 0.00 255.0 FORMAT "%5.1" ECU_ADDRESS 0xAFE8072F /end MEASUREMENT
/begin MEASUREMENT MoCSOP_ctDebPSDia "" UBYTE dez 1 100 0.00 255.0 FORMAT "%5.1" ECU_ADDRESS 0xD0000F4A /end MEASUREMENT
/begin MEASUREMENT MoCSOP_ctDebSOPTst "" UBYTE dez 1 100 0.00 255.0 FORMAT "%5.1" ECU_ADDRESS 0xD0000F4B /end MEASUREMENT
/begin MEASUREMENT MoCSOP_ctErrMM "" UBYTE dez 1 100 0.00 255.0 FORMAT "%5.1" ECU_ADDRESS 0xD0000F4C /end MEASUREMENT
/begin MEASUREMENT MoCSOP_ctErrMSC "" UBYTE dez 1 100 0.00 255.0 FORMAT "%5.1" ECU_ADDRESS 0xD0000F4D /end MEASUREMENT
/begin MEASUREMENT MoCSOP_ctErrOSTimeout "" UBYTE dez 1 100 0.00 255.0 FORMAT "%5.1" ECU_ADDRESS 0xD0000F4E /end MEASUREMENT
/begin MEASUREMENT MoCSOP_ctErrRespTime "" UBYTE dez 1 100 0.00 255.0 FORMAT "%5.1" ECU_ADDRESS 0xD0000F4F /end MEASUREMENT
/begin MEASUREMENT MoCSOP_ctErrSPI "" UBYTE dez 1 100 0.00 255.0 FORMAT "%5.1" ECU_ADDRESS 0xD0000F50 /end MEASUREMENT
/begin MEASUREMENT MoCSOP_numSyCJ_mp "" UBYTE dez 1 100 0.00 255.0 FORMAT "%5.1" ECU_ADDRESS 0xD0005400 /end MEASUREMENT
/begin MEASUREMENT MoCSOP_stActMsg "" UBYTE dez 1 100 0.00 255.0 FORMAT "%5.1" ECU_ADDRESS 0xD0003C8F /end MEASUREMENT
/begin MEASUREMENT MoCSOP_stActvMsg "" UBYTE dez 1 100 0.00 255.0 FORMAT "%5.1" ECU_ADDRESS 0xD0003C90 /end MEASUREMENT
/begin MEASUREMENT MoCSOP_stComActv "" UBYTE dez 1 100 0.00 255.0 FORMAT "%5.1" ECU_ADDRESS 0xD0000F53 /end MEASUREMENT
/begin MEASUREMENT MoCSOP_stComActvCpl "" UBYTE dez 1 100 0.00 255.0 FORMAT "%5.1" ECU_ADDRESS 0xD0000F54 /end MEASUREMENT
/begin MEASUREMENT MoCSOP_stErrOld "" UBYTE dez 1 100 0.00 255.0 FORMAT "%5.1" ECU_ADDRESS 0xAFE80730 /end MEASUREMENT
/begin MEASUREMENT MoCSOP_stMm "" UBYTE dez 1 100 0.00 255.0 FORMAT "%5.1" ECU_ADDRESS 0xD0000F51 /end MEASUREMENT
/begin MEASUREMENT MoCSOP_stMmRespCnt "" UBYTE dez 1 100 0.00 255.0 FORMAT "%5.1" ECU_ADDRESS 0xD0000F52 /end MEASUREMENT
/begin MEASUREMENT MoCSOP_stOvl "" UBYTE dez 1 100 0.00 255.0 FORMAT "%5.1" ECU_ADDRESS 0xD0003C91 /end MEASUREMENT
/begin MEASUREMENT MoCSOP_stOvlCpl "" UBYTE dez 1 100 0.00 255.0 FORMAT "%5.1" ECU_ADDRESS 0xD0003C92 /end MEASUREMENT
/begin MEASUREMENT MoCSOP_stOvTstRdy "" UBYTE dez 1 100 0.00 255.0 FORMAT "%5.1" ECU_ADDRESS 0xAFE80731 /end MEASUREMENT
/begin MEASUREMENT MoCSOP_stOvTstRdyCpl "" UBYTE dez 1 100 0.00 255.0 FORMAT "%5.1" ECU_ADDRESS 0xAFE80732 /end MEASUREMENT
/begin MEASUREMENT MoCSOP_stRdy "" UBYTE dez 1 100 0.00 255.0 FORMAT "%5.1" ECU_ADDRESS 0xD0000F55 /end MEASUREMENT
/begin MEASUREMENT MoCSOP_stRdyCpl "" UBYTE dez 1 100 0.00 255.0 FORMAT "%5.1" ECU_ADDRESS 0xD0000F56 /end MEASUREMENT
/begin MEASUREMENT MoExe_ctCyc "" UBYTE dez 1 100 0.00 255.0 FORMAT "%5.1" ECU_ADDRESS 0xD0005430 /end MEASUREMENT
/begin MEASUREMENT MoFAPP_stLimpMsg "" UBYTE dez 1 100 0.00 255.0 FORMAT "%5.1" ECU_ADDRESS 0xD0003C93 /end MEASUREMENT
/begin MEASUREMENT MoFDrAs_stACCPtdMsg "" UBYTE dez 1 100 0.00 255.0 FORMAT "%5.1" ECU_ADDRESS 0xD0003C94 /end MEASUREMENT
/begin MEASUREMENT MoFDrAs_stPtdMsg "" UBYTE dez 1 100 0.00 255.0 FORMAT "%5.1" ECU_ADDRESS 0xD0003C95 /end MEASUREMENT
/begin MEASUREMENT MoFExtInt_stASTPtdMsg "" UBYTE dez 1 100 0.00 255.0 FORMAT "%5.1" ECU_ADDRESS 0xD0003C96 /end MEASUREMENT
/begin MEASUREMENT MoFExtInt_stDCSPtdMsg "" UBYTE dez 1 100 0.00 255.0 FORMAT "%5.1" ECU_ADDRESS 0xD0003C97 /end MEASUREMENT
/begin MEASUREMENT MoFExtInt_stTIIPtdMsg "" UBYTE dez 1 100 0.00 255.0 FORMAT "%5.1" ECU_ADDRESS 0xD0003C98 /end MEASUREMENT
/begin MEASUREMENT MoFExtInt_stTSCPtdMsg "" UBYTE dez 1 100 0.00 255.0 FORMAT "%5.1" ECU_ADDRESS 0xD0003C99 /end MEASUREMENT
/begin MEASUREMENT MoF_nEng "" UBYTE nmot_q40 1 100 0.00 10200. FORMAT "%5.0" ECU_ADDRESS 0xD0005408 /end MEASUREMENT
/begin MEASUREMENT MoF_rBrkDes "" SWORD rel_q0p012207 1 100 -400.0000 399.9878 FORMAT "%8.4" ECU_ADDRESS 0xD0003566 /end MEASUREMENT
/begin MEASUREMENT MoF_stBrkstLim "" UBYTE dez 1 100 0.00 255.0 FORMAT "%5.1" ECU_ADDRESS 0xD0003C9A /end MEASUREMENT
/begin MEASUREMENT MoF_stDemEnBrkDemRls "" UBYTE dez 1 100 0.00 255.0 FORMAT "%5.1" ECU_ADDRESS 0xD0003C9B /end MEASUREMENT
/begin MEASUREMENT MoF_trqBrkAbs "" SLONG md_q0p1 1 100 -214748364.800 214748364.700 FORMAT "%13.3" ECU_ADDRESS 0xD0002308 /end MEASUREMENT
/begin MEASUREMENT MoX_nMaxICOMsg "" SWORD EngN 1 100 -16384.00 16383.50 FORMAT "%8.2" ECU_ADDRESS 0xD0003568 /end MEASUREMENT
/begin MEASUREMENT Mo_bACCActv "" UBYTE B_TRUE 1 100 0.00 1.00000000000 BIT_MASK 0x8 FORMAT "%13.11" ECU_ADDRESS 0xD0005409 /end MEASUREMENT
/begin MEASUREMENT Mo_bACCPtd "" UBYTE B_TRUE 1 100 0.00 1.00000000000 BIT_MASK 0x20 FORMAT "%13.11" ECU_ADDRESS 0xD0005409 /end MEASUREMENT
/begin MEASUREMENT Mo_bAddConPFC "" UBYTE B_TRUE 1 100 0.00 1.00000000000 BIT_MASK 0x80 FORMAT "%13.11" ECU_ADDRESS 0xD000540D /end MEASUREMENT
/begin MEASUREMENT Mo_bAddDisblPreICORst "" UBYTE B_TRUE 1 100 0.00 1.00000000000 BIT_MASK 0x8 FORMAT "%13.11" ECU_ADDRESS 0xD000540D /end MEASUREMENT
/begin MEASUREMENT Mo_bAddIntvPtd "" UBYTE B_TRUE 1 100 0.00 1.00000000000 BIT_MASK 0x20 FORMAT "%13.11" ECU_ADDRESS 0xD000540B /end MEASUREMENT
/begin MEASUREMENT Mo_bAftStrt "" UBYTE B_TRUE 1 100 0.00 1.00000000000 BIT_MASK 0x2 FORMAT "%13.11" ECU_ADDRESS 0xD0005410 /end MEASUREMENT
/begin MEASUREMENT Mo_bBrk "" UBYTE B_TRUE 1 100 0.00 1.00000000000 BIT_MASK 0x8 FORMAT "%13.11" ECU_ADDRESS 0xD000540B /end MEASUREMENT
/begin MEASUREMENT Mo_bCplChk "" UBYTE B_TRUE 1 100 0.00 1.00000000000 BIT_MASK 0x1 FORMAT "%13.11" ECU_ADDRESS 0xD000540C /end MEASUREMENT
/begin MEASUREMENT Mo_bCrCtlActv "" UBYTE B_TRUE 1 100 0.00 1.00000000000 BIT_MASK 0x1 FORMAT "%13.11" ECU_ADDRESS 0xD0005409 /end MEASUREMENT
/begin MEASUREMENT Mo_bCrCtlPtd "" UBYTE B_TRUE 1 100 0.00 1.00000000000 BIT_MASK 0x2 FORMAT "%13.11" ECU_ADDRESS 0xD0005409 /end MEASUREMENT
/begin MEASUREMENT Mo_bCrCtlShOff "" UBYTE B_TRUE 1 100 0.00 1.00000000000 BIT_MASK 0x4 FORMAT "%13.11" ECU_ADDRESS 0xD0005409 /end MEASUREMENT
/begin MEASUREMENT Mo_bDCSPtd "" UBYTE B_TRUE 1 100 0.00 1.00000000000 BIT_MASK 0x1 FORMAT "%13.11" ECU_ADDRESS 0xD000540B /end MEASUREMENT
/begin MEASUREMENT Mo_bDrAsActv "" UBYTE B_TRUE 1 100 0.00 1.00000000000 BIT_MASK 0x10 FORMAT "%13.11" ECU_ADDRESS 0xD0005409 /end MEASUREMENT
/begin MEASUREMENT Mo_bDrAsPtd "" UBYTE B_TRUE 1 100 0.00 1.00000000000 BIT_MASK 0x40 FORMAT "%13.11" ECU_ADDRESS 0xD0005409 /end MEASUREMENT
/begin MEASUREMENT Mo_bECom "" UBYTE B_TRUE 1 100 0.00 1.00000000000 BIT_MASK 0x80 FORMAT "%13.11" ECU_ADDRESS 0xAFE8070F /end MEASUREMENT
/begin MEASUREMENT Mo_bEMem "" UBYTE B_TRUE 1 100 0.00 1.00000000000 BIT_MASK 0x8 FORMAT "%13.11" ECU_ADDRESS 0xAFE8070F /end MEASUREMENT
/begin MEASUREMENT Mo_bEmgcyAir "" UBYTE B_TRUE 1 100 0.00 1.00000000000 BIT_MASK 0x20 FORMAT "%13.11" ECU_ADDRESS 0xD000540D /end MEASUREMENT
/begin MEASUREMENT Mo_bEPcp "" UBYTE B_TRUE 1 100 0.00 1.00000000000 BIT_MASK 0x40 FORMAT "%13.11" ECU_ADDRESS 0xAFE8070F /end MEASUREMENT
/begin MEASUREMENT Mo_bERam "" UBYTE B_TRUE 1 100 0.00 1.00000000000 BIT_MASK 0x1 FORMAT "%13.11" ECU_ADDRESS 0xAFE8070F /end MEASUREMENT
/begin MEASUREMENT Mo_bERomSPg "" UBYTE B_TRUE 1 100 0.00 1.00000000000 BIT_MASK 0x2 FORMAT "%13.11" ECU_ADDRESS 0xAFE8070F /end MEASUREMENT
/begin MEASUREMENT Mo_bERomXPg "" UBYTE B_TRUE 1 100 0.00 1.00000000000 BIT_MASK 0x4 FORMAT "%13.11" ECU_ADDRESS 0xAFE8070F /end MEASUREMENT
/begin MEASUREMENT Mo_bErrVelVeh "" UBYTE B_TRUE 1 100 0.00 1.00000000000 BIT_MASK 0x4 FORMAT "%13.11" ECU_ADDRESS 0xD000540B /end MEASUREMENT
/begin MEASUREMENT Mo_bICOL1 "" UBYTE B_TRUE 1 100 0.00 1.00000000000 BIT_MASK 0x2 FORMAT "%13.11" ECU_ADDRESS 0xD000540D /end MEASUREMENT
/begin MEASUREMENT Mo_bICOL2 "" UBYTE B_TRUE 1 100 0.00 1.00000000000 BIT_MASK 0x1 FORMAT "%13.11" ECU_ADDRESS 0xD000540D /end MEASUREMENT
/begin MEASUREMENT Mo_bIrvElMIdl "" UBYTE B_TRUE 1 100 0.00 1.00000000000 BIT_MASK 0x20 FORMAT "%13.11" ECU_ADDRESS 0xD000540A /end MEASUREMENT
/begin MEASUREMENT Mo_bIrvErrNTP "" UBYTE B_TRUE 1 100 0.00 1.00000000000 BIT_MASK 0x10 FORMAT "%13.11" ECU_ADDRESS 0xD0000083 /end MEASUREMENT
/begin MEASUREMENT Mo_bIrvErrTst "" UBYTE B_TRUE 1 100 0.00 1.00000000000 BIT_MASK 0x80 FORMAT "%13.11" ECU_ADDRESS 0xD000008A /end MEASUREMENT
/begin MEASUREMENT Mo_bIrvHybLimpL1 "" UBYTE B_TRUE 1 100 0.00 1.00000000000 BIT_MASK 0x2 FORMAT "%13.11" ECU_ADDRESS 0xD000540A /end MEASUREMENT
/begin MEASUREMENT Mo_bIrvHybLimpL2 "" UBYTE B_TRUE 1 100 0.00 1.00000000000 BIT_MASK 0x1 FORMAT "%13.11" ECU_ADDRESS 0xD000540A /end MEASUREMENT
/begin MEASUREMENT Mo_bIrvHybP1LimpL2 "" UBYTE B_TRUE 1 100 0.00 1.00000000000 BIT_MASK 0x10 FORMAT "%13.11" ECU_ADDRESS 0xD000540A /end MEASUREMENT
/begin MEASUREMENT Mo_bIrvICOL1 "" UBYTE B_TRUE 1 100 0.00 1.00000000000 BIT_MASK 0x4 FORMAT "%13.11" ECU_ADDRESS 0xD000540E /end MEASUREMENT
/begin MEASUREMENT Mo_bIrvTrqLimL1 "" UBYTE B_TRUE 1 100 0.00 1.00000000000 BIT_MASK 0x8 FORMAT "%13.11" ECU_ADDRESS 0xD000540A /end MEASUREMENT
/begin MEASUREMENT Mo_bIrvTrqLimL2 "" UBYTE B_TRUE 1 100 0.00 1.00000000000 BIT_MASK 0x4 FORMAT "%13.11" ECU_ADDRESS 0xD000540A /end MEASUREMENT
/begin MEASUREMENT Mo_bKhls "" UBYTE B_TRUE 1 100 0.00 1.00000000000 BIT_MASK 0x8 FORMAT "%13.11" ECU_ADDRESS 0xD000540F /end MEASUREMENT
/begin MEASUREMENT Mo_bLoVltg "" UBYTE B_TRUE 1 100 0.00 1.00000000000 BIT_MASK 0x4 FORMAT "%13.11" ECU_ADDRESS 0xD000540D /end MEASUREMENT
/begin MEASUREMENT Mo_bNlh "" UBYTE B_TRUE 1 100 0.00 1.00000000000 BIT_MASK 0x10 FORMAT "%13.11" ECU_ADDRESS 0xD000540D /end MEASUREMENT
/begin MEASUREMENT Mo_bNlhr "" UBYTE B_TRUE 1 100 0.00 1.00000000000 BIT_MASK 0x4 FORMAT "%13.11" ECU_ADDRESS 0xD000540F /end MEASUREMENT
/begin MEASUREMENT Mo_bPostDrv "" UBYTE B_TRUE 1 100 0.00 1.00000000000 BIT_MASK 0x2 FORMAT "%13.11" ECU_ADDRESS 0xD000540E /end MEASUREMENT
/begin MEASUREMENT Mo_bPreDrv "" UBYTE B_TRUE 1 100 0.00 1.00000000000 BIT_MASK 0x1 FORMAT "%13.11" ECU_ADDRESS 0xD000540E /end MEASUREMENT
/begin MEASUREMENT Mo_bRamErr "" UBYTE B_TRUE 1 100 0.00 1.00000000000 BIT_MASK 0x2 FORMAT "%13.11" ECU_ADDRESS 0xD000540C /end MEASUREMENT
/begin MEASUREMENT Mo_bReacICO "" UBYTE B_TRUE 1 100 0.00 1.00000000000 BIT_MASK 0x1 FORMAT "%13.11" ECU_ADDRESS 0xD0005410 /end MEASUREMENT
/begin MEASUREMENT Mo_bRomErr "" UBYTE B_TRUE 1 100 0.00 1.00000000000 BIT_MASK 0x4 FORMAT "%13.11" ECU_ADDRESS 0xD000540C /end MEASUREMENT
/begin MEASUREMENT Mo_bRvICOL1 "" UBYTE B_TRUE 1 100 0.00 1.00000000000 BIT_MASK 0x8 FORMAT "%13.11" ECU_ADDRESS 0xD000540E /end MEASUREMENT
/begin MEASUREMENT Mo_bSyncLos "" UBYTE B_TRUE 1 100 0.00 1.00000000000 BIT_MASK 0x40 FORMAT "%13.11" ECU_ADDRESS 0xD000540D /end MEASUREMENT
/begin MEASUREMENT Mo_bTraPtd "" UBYTE B_TRUE 1 100 0.00 1.00000000000 BIT_MASK 0x2 FORMAT "%13.11" ECU_ADDRESS 0xD000540B /end MEASUREMENT
/begin MEASUREMENT Mo_bUfol "" UBYTE B_TRUE 1 100 0.00 1.00000000000 BIT_MASK 0x1 FORMAT "%13.11" ECU_ADDRESS 0xD000540F /end MEASUREMENT
/begin MEASUREMENT Mo_bUfolv "" UBYTE B_TRUE 1 100 0.00 1.00000000000 BIT_MASK 0x2 FORMAT "%13.11" ECU_ADDRESS 0xD000540F /end MEASUREMENT
/begin MEASUREMENT Mo_ctRst "" UBYTE dez 1 100 0.00 255.0 FORMAT "%5.1" ECU_ADDRESS 0xAFE8070C /end MEASUREMENT
/begin MEASUREMENT Mo_ctRstCpl "" UBYTE dez 1 100 0.00 255.0 FORMAT "%5.1" ECU_ADDRESS 0xAFE8070D /end MEASUREMENT
/begin MEASUREMENT Mo_stCplChk "" ULONG dez 1 100 0.00 4294967295.00 FORMAT "%13.2" ECU_ADDRESS 0xD0005498 /end MEASUREMENT
/begin MEASUREMENT Mo_stCplChk_mp "" ULONG dez 1 100 0.00 4294967295.00 FORMAT "%13.2" ECU_ADDRESS 0xD00053F0 /end MEASUREMENT
/begin MEASUREMENT Mo_stDrAs "" UBYTE dez 1 100 0.00 255.0 FORMAT "%5.1" ECU_ADDRESS 0xD0005409 /end MEASUREMENT
/begin MEASUREMENT Mo_stDrAsCpl "" UBYTE dez 1 100 0.00 255.0 FORMAT "%5.1" ECU_ADDRESS 0xD0005440 /end MEASUREMENT
/begin MEASUREMENT Mo_stErrHyb "" UBYTE dez 1 100 0.00 255.0 FORMAT "%5.1" ECU_ADDRESS 0xD000540A /end MEASUREMENT
/begin MEASUREMENT Mo_stErrHybCpl "" UBYTE dez 1 100 0.00 255.0 FORMAT "%5.1" ECU_ADDRESS 0xD0005441 /end MEASUREMENT
/begin MEASUREMENT Mo_stIntv "" UBYTE dez 1 100 0.00 255.0 FORMAT "%5.1" ECU_ADDRESS 0xD000540B /end MEASUREMENT
/begin MEASUREMENT Mo_stIntvCpl "" UBYTE dez 1 100 0.00 255.0 FORMAT "%5.1" ECU_ADDRESS 0xD0005442 /end MEASUREMENT
/begin MEASUREMENT Mo_stIrvErrReacMsg "" UBYTE dez 1 100 0.00 255.0 FORMAT "%5.1" ECU_ADDRESS 0xD0003C9C /end MEASUREMENT
/begin MEASUREMENT Mo_stMoC "" UBYTE dez 1 100 0.00 255.0 FORMAT "%5.1" ECU_ADDRESS 0xD000540C /end MEASUREMENT
/begin MEASUREMENT Mo_stMoCCpl "" UBYTE dez 1 100 0.00 255.0 FORMAT "%5.1" ECU_ADDRESS 0xD0005443 /end MEASUREMENT
/begin MEASUREMENT Mo_stMoF "" UBYTE dez 1 100 0.00 255.0 FORMAT "%5.1" ECU_ADDRESS 0xD000540D /end MEASUREMENT
/begin MEASUREMENT Mo_stMoFCpl "" UBYTE dez 1 100 0.00 255.0 FORMAT "%5.1" ECU_ADDRESS 0xD0005444 /end MEASUREMENT
/begin MEASUREMENT Mo_stSys "" UBYTE dez 1 100 0.00 255.0 FORMAT "%5.1" ECU_ADDRESS 0xD000540E /end MEASUREMENT
/begin MEASUREMENT Mo_stSysCpl "" UBYTE dez 1 100 0.00 255.0 FORMAT "%5.1" ECU_ADDRESS 0xD0005445 /end MEASUREMENT
/begin MEASUREMENT Mo_stTrqAct "" UBYTE dez 1 100 0.00 255.0 FORMAT "%5.1" ECU_ADDRESS 0xD000540F /end MEASUREMENT
/begin MEASUREMENT Mo_stTrqActCpl "" UBYTE dez 1 100 0.00 255.0 FORMAT "%5.1" ECU_ADDRESS 0xD0005446 /end MEASUREMENT
/begin MEASUREMENT Mo_stTrqPtd "" UBYTE dez 1 100 0.00 255.0 FORMAT "%5.1" ECU_ADDRESS 0xD0005410 /end MEASUREMENT
/begin MEASUREMENT Mo_stTrqPtdCpl "" UBYTE dez 1 100 0.00 255.0 FORMAT "%5.1" ECU_ADDRESS 0xD0005447 /end MEASUREMENT
/begin MEASUREMENT MRly_st "" UBYTE dez 1 100 0.00 255.0 BIT_MASK 0x1 FORMAT "%5.1" ECU_ADDRESS 0xD0003CD3 /end MEASUREMENT
/begin MEASUREMENT MRly_stAct "" UWORD OneToOne 1 100 0.00 65535.00 FORMAT "%8.2" ECU_ADDRESS 0xD0003614 /end MEASUREMENT
/begin MEASUREMENT Msc_ctErr_mp "" UWORD OneToOne 1 100 0.00 65535.00 FORMAT "%8.2" ECU_ADDRESS 0xD00053A0 /end MEASUREMENT
/begin MEASUREMENT msudkped_w "" UWORD m_uw_b6553p5 1 100 0.00 6553.500 FORMAT "%8.3" ECU_ADDRESS 0xD00009C8 /end MEASUREMENT
/begin MEASUREMENT msudksom_w "" UWORD m_uw_b6553p5 1 100 0.00 6553.500 FORMAT "%8.3" ECU_ADDRESS 0xD00009D0 /end MEASUREMENT
/begin MEASUREMENT mxnsolgenc "" UBYTE nmot_q10 1 100 0.00 2550. FORMAT "%5.0" ECU_ADDRESS 0xD0000E75 /end MEASUREMENT
/begin MEASUREMENT nllkh "" UBYTE nmot_q10 1 100 0.00 2550. FORMAT "%5.0" ECU_ADDRESS 0xD0000E86 /end MEASUREMENT
/begin MEASUREMENT nmaxdvg_w "" UWORD nmot_uw_q0p25 1 100 0.00 16383.75 FORMAT "%8.2" ECU_ADDRESS 0xD00009DE /end MEASUREMENT
/begin MEASUREMENT nmaxga_w "" UWORD nmot_uw_q0p25 1 100 0.00 16383.75 FORMAT "%8.2" ECU_ADDRESS 0xD00009E0 /end MEASUREMENT
/begin MEASUREMENT nmaxllkh "" UBYTE nmot_q10 1 100 0.00 2550. FORMAT "%5.0" ECU_ADDRESS 0xD0000E87 /end MEASUREMENT
/begin MEASUREMENT nmax_w "" UWORD nmot_uw_q0p25 1 100 0.00 16383.75 FORMAT "%8.2" ECU_ADDRESS 0xD00009E2 /end MEASUREMENT
/begin MEASUREMENT nmfskh "" UBYTE nmot_q10 1 100 0.00 2550. FORMAT "%5.0" ECU_ADDRESS 0xD0000E82 /end MEASUREMENT
/begin MEASUREMENT nmllkh "" UBYTE nmot_q10 1 100 0.00 2550. FORMAT "%5.0" ECU_ADDRESS 0xD0000E83 /end MEASUREMENT
/begin MEASUREMENT nmotmsudks "" UBYTE nmot_ub_q10 1 100 0.00 2550. FORMAT "%5.0" ECU_ADDRESS 0xD0000E6B /end MEASUREMENT
/begin MEASUREMENT nmotpr_w "" UWORD nmot_uw_q0p25 1 100 0.00 16383.75 FORMAT "%8.2" ECU_ADDRESS 0xD00009E4 /end MEASUREMENT
/begin MEASUREMENT nmxpr "" UBYTE relnmot_q0p0039 1 100 0.00 0.9961 ECU_ADDRESS 0xD0000E6F /end MEASUREMENT
/begin MEASUREMENT nsbertmp_w "" UWORD nmot_uw_q0p25 1 100 0.00 16383.75 FORMAT "%8.2" ECU_ADDRESS 0xD00009E6 /end MEASUREMENT
/begin MEASUREMENT nsber_w "" UWORD nmot_uw_q0p25 1 100 0.00 16383.75 FORMAT "%8.2" ECU_ADDRESS 0xD00009EA /end MEASUREMENT
/begin MEASUREMENT nsblpLokBits20ms "" UBYTE dez 1 100 0.00 255.0 FORMAT "%5.1" ECU_ADDRESS 0xD0000E73 /end MEASUREMENT
/begin MEASUREMENT nsmdgenpwm "" UBYTE dez 1 100 0.00 255.0 FORMAT "%5.1" ECU_ADDRESS 0xD0000E7A /end MEASUREMENT
/begin MEASUREMENT nsmodac "" UBYTE dez 1 100 0.00 255.0 FORMAT "%5.1" ECU_ADDRESS 0xD0000E71 /end MEASUREMENT
/begin MEASUREMENT nsmodgen "" UBYTE dez 1 100 0.00 255.0 FORMAT "%5.1" ECU_ADDRESS 0xD0000E7B /end MEASUREMENT
/begin MEASUREMENT nsmodgenel "" UBYTE dez 1 100 0.00 255.0 FORMAT "%5.1" ECU_ADDRESS 0xD0000E7C /end MEASUREMENT
/begin MEASUREMENT nsmodhtd "" UBYTE DEZ 1 100 0.00 255.0 FORMAT "%5.1" ECU_ADDRESS 0xD0000E80 /end MEASUREMENT
/begin MEASUREMENT nsmodlph "" UBYTE dez 1 100 0.00 255.0 FORMAT "%5.1" ECU_ADDRESS 0xD0000E8A /end MEASUREMENT
/begin MEASUREMENT nsmodrec "" UBYTE dez 1 100 0.00 255.0 FORMAT "%5.1" ECU_ADDRESS 0xD0000E8D /end MEASUREMENT
/begin MEASUREMENT nsolac "" UBYTE nmot_q10 1 100 0.00 2550. FORMAT "%5.0" ECU_ADDRESS 0xD0000E72 /end MEASUREMENT
/begin MEASUREMENT nsolblp "" UBYTE nmot_q10 1 100 0.00 2550. FORMAT "%5.0" ECU_ADDRESS 0xD0000E74 /end MEASUREMENT
/begin MEASUREMENT nsolcat "" UBYTE nmot_q10 1 100 0.00 2550. FORMAT "%5.0" ECU_ADDRESS 0xD0000E88 /end MEASUREMENT
/begin MEASUREMENT nsolgen "" UBYTE nmot_q10 1 100 0.00 2550. FORMAT "%5.0" ECU_ADDRESS 0xD0000E7D /end MEASUREMENT
/begin MEASUREMENT nsolgenelf "" UBYTE nmot_q10 1 100 0.00 2550. FORMAT "%5.0" ECU_ADDRESS 0xD0000E78 /end MEASUREMENT
/begin MEASUREMENT nsolgentp "" UBYTE nmot_q10 1 100 0.00 2550. FORMAT "%5.0" ECU_ADDRESS 0xD0000E79 /end MEASUREMENT
/begin MEASUREMENT nsolhtd "" UBYTE nmot_ub_q10 1 100 0.00 2550. FORMAT "%5.0" ECU_ADDRESS 0xD0000E81 /end MEASUREMENT
/begin MEASUREMENT nsolhtdtm "" UBYTE nmot_ub_q10 1 100 0.00 2550. FORMAT "%5.0" ECU_ADDRESS 0xD0000E7E /end MEASUREMENT
/begin MEASUREMENT nsolhtdtum "" UBYTE nmot_ub_q10 1 100 0.00 2550. FORMAT "%5.0" ECU_ADDRESS 0xD0000E7F /end MEASUREMENT
/begin MEASUREMENT nsollph "" UBYTE nmot_q10 1 100 0.00 2550. FORMAT "%5.0" ECU_ADDRESS 0xD0000E8B /end MEASUREMENT
/begin MEASUREMENT nsolpst "" UBYTE nmot_q10 1 100 0.00 2550. FORMAT "%5.0" ECU_ADDRESS 0xD0000E8C /end MEASUREMENT
/begin MEASUREMENT nsolrec "" UBYTE nmot_q10 1 100 0.00 2550. FORMAT "%5.0" ECU_ADDRESS 0xD0000E8E /end MEASUREMENT
/begin MEASUREMENT nsolwih "" UBYTE nmot_ub_q10 1 100 0.00 2550. FORMAT "%5.0" ECU_ADDRESS 0xD0000E8F /end MEASUREMENT
/begin MEASUREMENT OCWDA_bMonitor "" UBYTE B_TRUE 1 100 0.00 1.00000000000 BIT_MASK 0x20 FORMAT "%13.11" ECU_ADDRESS 0xD0000094 /end MEASUREMENT
/begin MEASUREMENT OCWDA_bWDAActv "" UBYTE B_TRUE 1 100 0.00 1.00000000000 BIT_MASK 0x80 FORMAT "%13.11" ECU_ADDRESS 0xD000007B /end MEASUREMENT
/begin MEASUREMENT OCWDA_ctDebLowVltgOn "" UBYTE dez 1 100 0.00 255.0 FORMAT "%5.1" ECU_ADDRESS 0xD0000E93 /end MEASUREMENT
/begin MEASUREMENT OCWDA_ctDebOvrVltgOn "" UBYTE dez 1 100 0.00 255.0 FORMAT "%5.1" ECU_ADDRESS 0xD0000E94 /end MEASUREMENT
/begin MEASUREMENT OCWDA_ctDebSOPNotActv "" UBYTE dez 1 100 0.00 255.0 FORMAT "%5.1" ECU_ADDRESS 0xD0000E95 /end MEASUREMENT
/begin MEASUREMENT OCWDA_ctDebWDAActv "" UBYTE dez 1 100 0.00 255.0 FORMAT "%5.1" ECU_ADDRESS 0xD0000E96 /end MEASUREMENT
/begin MEASUREMENT OCWDA_ctDebWDANotActv "" UBYTE dez 1 100 0.00 255.0 FORMAT "%5.1" ECU_ADDRESS 0xD0000E97 /end MEASUREMENT
/begin MEASUREMENT OCWDA_ctErrMM "" UBYTE dez 1 100 0.00 255.0 FORMAT "%5.1" ECU_ADDRESS 0xD0000E98 /end MEASUREMENT
/begin MEASUREMENT OCWDA_ctTstComErr "" UWORD dez 1 100 0.00 65535.00 FORMAT "%8.2" ECU_ADDRESS 0xD00009FC /end MEASUREMENT
/begin MEASUREMENT OCWDA_ctTstOCWDA "" UBYTE dez 1 100 0.00 255.0 FORMAT "%5.1" ECU_ADDRESS 0xD0000E99 /end MEASUREMENT
/begin MEASUREMENT OCWDA_ctTstWDAActv "" UBYTE dez 1 100 0.00 255.0 FORMAT "%5.1" ECU_ADDRESS 0xD0000E9A /end MEASUREMENT
/begin MEASUREMENT OCWDA_ctUbsq "" UBYTE dez 1 100 0.00 255.0 FORMAT "%5.1" ECU_ADDRESS 0xD0000E9B /end MEASUREMENT
/begin MEASUREMENT OCWDA_stCheckState "" ULONG dez 1 100 0.00 4294967295.00 FORMAT "%13.2" ECU_ADDRESS 0xD000242C /end MEASUREMENT
/begin MEASUREMENT OCWDA_stWDAPtt "" ULONG dez 1 100 0.00 4294967295.00 FORMAT "%13.2" ECU_ADDRESS 0xD0002430 /end MEASUREMENT
/begin MEASUREMENT OCWDA_stWDA_mp "" UBYTE dez 1 100 0.00 255.0 FORMAT "%5.1" ECU_ADDRESS 0xD0005401 /end MEASUREMENT
/begin MEASUREMENT Oil_tSwmp "" SWORD Temp_Cels 1 100 -50.04000 199.9600 FORMAT "%8.4" ECU_ADDRESS 0xD000356E /end MEASUREMENT
/begin MEASUREMENT OS_cntDrv1000msTask "" UWORD OneToOne 1 100 0.00 65535.00 FORMAT "%8.2" ECU_ADDRESS 0xD00036FC /end MEASUREMENT
/begin MEASUREMENT OS_cntDrv100msTask "" UWORD OneToOne 1 100 0.00 65535.00 FORMAT "%8.2" ECU_ADDRESS 0xD00036F8 /end MEASUREMENT
/begin MEASUREMENT OS_cntDrv10msTask "" UWORD OneToOne 1 100 0.00 65535.00 FORMAT "%8.2" ECU_ADDRESS 0xD00036F2 /end MEASUREMENT
/begin MEASUREMENT OS_cntDrv1msTask "" UWORD OneToOne 1 100 0.00 65535.00 FORMAT "%8.2" ECU_ADDRESS 0xD00036EC /end MEASUREMENT
/begin MEASUREMENT OS_cntDrv200msTask "" UWORD OneToOne 1 100 0.00 65535.00 FORMAT "%8.2" ECU_ADDRESS 0xD00036FA /end MEASUREMENT
/begin MEASUREMENT OS_cntDrv20msTask "" UWORD OneToOne 1 100 0.00 65535.00 FORMAT "%8.2" ECU_ADDRESS 0xD00036F4 /end MEASUREMENT
/begin MEASUREMENT OS_cntDrv2msTask "" UWORD OneToOne 1 100 0.00 65535.00 FORMAT "%8.2" ECU_ADDRESS 0xD00036EE /end MEASUREMENT
/begin MEASUREMENT OS_cntDrv50msTask "" UWORD OneToOne 1 100 0.00 65535.00 FORMAT "%8.2" ECU_ADDRESS 0xD00036F6 /end MEASUREMENT
/begin MEASUREMENT OS_cntDrv5msTask "" UWORD OneToOne 1 100 0.00 65535.00 FORMAT "%8.2" ECU_ADDRESS 0xD00036F0 /end MEASUREMENT
/begin MEASUREMENT OS_cntDrvBgTask "" UWORD OneToOne 1 100 0.00 65535.00 FORMAT "%8.2" ECU_ADDRESS 0xD00036EA /end MEASUREMENT
/begin MEASUREMENT OS_cntDsmClearTask "" UWORD OneToOne 1 100 0.00 65535.00 FORMAT "%8.2" ECU_ADDRESS 0xD0003712 /end MEASUREMENT
/begin MEASUREMENT OS_cntEngReStrtTask "" UWORD OneToOne 1 100 0.00 65535.00 FORMAT "%8.2" ECU_ADDRESS 0xD0003722 /end MEASUREMENT
/begin MEASUREMENT OS_cntEpmNoSyncTask "" UWORD OneToOne 1 100 0.00 65535.00 FORMAT "%8.2" ECU_ADDRESS 0xD000371A /end MEASUREMENT
/begin MEASUREMENT OS_cntIniDrvTask "" UWORD OneToOne 1 100 0.00 65535.00 FORMAT "%8.2" ECU_ADDRESS 0xD00036D0 /end MEASUREMENT
/begin MEASUREMENT OS_cntIniEndTask "" UWORD OneToOne 1 100 0.00 65535.00 FORMAT "%8.2" ECU_ADDRESS 0xD00036D4 /end MEASUREMENT
/begin MEASUREMENT OS_cntIniTask "" UWORD OneToOne 1 100 0.00 65535.00 FORMAT "%8.2" ECU_ADDRESS 0xD00036D2 /end MEASUREMENT
/begin MEASUREMENT OS_cntMoTask "" UWORD OneToOne 1 100 0.00 65535.00 FORMAT "%8.2" ECU_ADDRESS 0xD0003714 /end MEASUREMENT
/begin MEASUREMENT OS_cntPostDrv1000msTask "" UWORD OneToOne 1 100 0.00 65535.00 FORMAT "%8.2" ECU_ADDRESS 0xD0003710 /end MEASUREMENT
/begin MEASUREMENT OS_cntPostDrv100msTask "" UWORD OneToOne 1 100 0.00 65535.00 FORMAT "%8.2" ECU_ADDRESS 0xD000370C /end MEASUREMENT
/begin MEASUREMENT OS_cntPostDrv10msTask "" UWORD OneToOne 1 100 0.00 65535.00 FORMAT "%8.2" ECU_ADDRESS 0xD0003706 /end MEASUREMENT
/begin MEASUREMENT OS_cntPostDrv1msTask "" UWORD OneToOne 1 100 0.00 65535.00 FORMAT "%8.2" ECU_ADDRESS 0xD0003700 /end MEASUREMENT
/begin MEASUREMENT OS_cntPostDrv200msTask "" UWORD OneToOne 1 100 0.00 65535.00 FORMAT "%8.2" ECU_ADDRESS 0xD000370E /end MEASUREMENT
/begin MEASUREMENT OS_cntPostDrv20msTask "" UWORD OneToOne 1 100 0.00 65535.00 FORMAT "%8.2" ECU_ADDRESS 0xD0003708 /end MEASUREMENT
/begin MEASUREMENT OS_cntPostDrv2msTask "" UWORD OneToOne 1 100 0.00 65535.00 FORMAT "%8.2" ECU_ADDRESS 0xD0003702 /end MEASUREMENT
/begin MEASUREMENT OS_cntPostDrv50msTask "" UWORD OneToOne 1 100 0.00 65535.00 FORMAT "%8.2" ECU_ADDRESS 0xD000370A /end MEASUREMENT
/begin MEASUREMENT OS_cntPostDrv5msTask "" UWORD OneToOne 1 100 0.00 65535.00 FORMAT "%8.2" ECU_ADDRESS 0xD0003704 /end MEASUREMENT
/begin MEASUREMENT OS_cntPostDrvBgTask "" UWORD OneToOne 1 100 0.00 65535.00 FORMAT "%8.2" ECU_ADDRESS 0xD00036FE /end MEASUREMENT
/begin MEASUREMENT OS_cntPreDrv1000msTask "" UWORD OneToOne 1 100 0.00 65535.00 FORMAT "%8.2" ECU_ADDRESS 0xD00036E8 /end MEASUREMENT
/begin MEASUREMENT OS_cntPreDrv100msTask "" UWORD OneToOne 1 100 0.00 65535.00 FORMAT "%8.2" ECU_ADDRESS 0xD00036E4 /end MEASUREMENT
/begin MEASUREMENT OS_cntPreDrv10msTask "" UWORD OneToOne 1 100 0.00 65535.00 FORMAT "%8.2" ECU_ADDRESS 0xD00036DE /end MEASUREMENT
/begin MEASUREMENT OS_cntPreDrv1msTask "" UWORD OneToOne 1 100 0.00 65535.00 FORMAT "%8.2" ECU_ADDRESS 0xD00036D8 /end MEASUREMENT
/begin MEASUREMENT OS_cntPreDrv200msTask "" UWORD OneToOne 1 100 0.00 65535.00 FORMAT "%8.2" ECU_ADDRESS 0xD00036E6 /end MEASUREMENT
/begin MEASUREMENT OS_cntPreDrv20msTask "" UWORD OneToOne 1 100 0.00 65535.00 FORMAT "%8.2" ECU_ADDRESS 0xD00036E0 /end MEASUREMENT
/begin MEASUREMENT OS_cntPreDrv2msTask "" UWORD OneToOne 1 100 0.00 65535.00 FORMAT "%8.2" ECU_ADDRESS 0xD00036DA /end MEASUREMENT
/begin MEASUREMENT OS_cntPreDrv50msTask "" UWORD OneToOne 1 100 0.00 65535.00 FORMAT "%8.2" ECU_ADDRESS 0xD00036E2 /end MEASUREMENT
/begin MEASUREMENT OS_cntPreDrv5msTask "" UWORD OneToOne 1 100 0.00 65535.00 FORMAT "%8.2" ECU_ADDRESS 0xD00036DC /end MEASUREMENT
/begin MEASUREMENT OS_cntPreDrvBgTask "" UWORD OneToOne 1 100 0.00 65535.00 FORMAT "%8.2" ECU_ADDRESS 0xD00036D6 /end MEASUREMENT
/begin MEASUREMENT OS_cntSyncFirstTask "" UWORD OneToOne 1 100 0.00 65535.00 FORMAT "%8.2" ECU_ADDRESS 0xD0003718 /end MEASUREMENT
/begin MEASUREMENT OS_cntSyncIniTask "" UWORD OneToOne 1 100 0.00 65535.00 FORMAT "%8.2" ECU_ADDRESS 0xD0003716 /end MEASUREMENT
/begin MEASUREMENT OS_cntSyncPreTask "" UWORD OneToOne 1 100 0.00 65535.00 FORMAT "%8.2" ECU_ADDRESS 0xD000371C /end MEASUREMENT
/begin MEASUREMENT OS_cntSyncS0Task "" UWORD OneToOne 1 100 0.00 65535.00 FORMAT "%8.2" ECU_ADDRESS 0xD000371E /end MEASUREMENT
/begin MEASUREMENT OS_cntSyncS1Task "" UWORD OneToOne 1 100 0.00 65535.00 FORMAT "%8.2" ECU_ADDRESS 0xD0003720 /end MEASUREMENT
/begin MEASUREMENT OS_ErrCtr_accessResource_u8 "" UBYTE OneToOne 1 100 0.00 255.0 FORMAT "%5.1" ECU_ADDRESS 0xD000469B /end MEASUREMENT
/begin MEASUREMENT OS_ErrCtr_callevel_u8 "" UBYTE OneToOne 1 100 0.00 255.0 FORMAT "%5.1" ECU_ADDRESS 0xD000469C /end MEASUREMENT
/begin MEASUREMENT OS_ErrCtr_deadline_u8 "" UBYTE OneToOne 1 100 0.00 255.0 FORMAT "%5.1" ECU_ADDRESS 0xD00046A3 /end MEASUREMENT
/begin MEASUREMENT OS_ErrCtr_default_u8 "" UBYTE OneToOne 1 100 0.00 255.0 FORMAT "%5.1" ECU_ADDRESS 0xD00046A2 /end MEASUREMENT
/begin MEASUREMENT OS_ErrCtr_generalError_u8 "" UBYTE OneToOne 1 100 0.00 255.0 FORMAT "%5.1" ECU_ADDRESS 0xD00046A1 /end MEASUREMENT
/begin MEASUREMENT OS_ErrCtr_idValue_u8 "" UBYTE OneToOne 1 100 0.00 255.0 FORMAT "%5.1" ECU_ADDRESS 0xD000469D /end MEASUREMENT
/begin MEASUREMENT OS_ErrCtr_limit_u8 "" UBYTE OneToOne 1 100 0.00 255.0 FORMAT "%5.1" ECU_ADDRESS 0xD000469E /end MEASUREMENT
/begin MEASUREMENT OS_ErrCtr_noFuncState_u8 "" UBYTE OneToOne 1 100 0.00 255.0 FORMAT "%5.1" ECU_ADDRESS 0xD000469F /end MEASUREMENT
/begin MEASUREMENT OS_ErrCtr_stackcnt_u8 "" UBYTE OneToOne 1 100 0.00 255.0 FORMAT "%5.1" ECU_ADDRESS 0xD00046A4 /end MEASUREMENT
/begin MEASUREMENT OS_ErrCtr_stackstat_u8 "" UBYTE OneToOne 1 100 0.00 255.0 FORMAT "%5.1" ECU_ADDRESS 0xD00046A5 /end MEASUREMENT
/begin MEASUREMENT OS_ErrCtr_sum_u8 "" UBYTE OneToOne 1 100 0.00 255.0 FORMAT "%5.1" ECU_ADDRESS 0xD00046A6 /end MEASUREMENT
/begin MEASUREMENT OS_ErrCtr_timetable_u8 "" UBYTE OneToOne 1 100 0.00 255.0 FORMAT "%5.1" ECU_ADDRESS 0xD00046A0 /end MEASUREMENT
/begin MEASUREMENT PSP_st "" UBYTE OneToOne 1 100 0.00 255.0 FORMAT "%5.1" ECU_ADDRESS 0xD0003CA3 /end MEASUREMENT
/begin MEASUREMENT PT_stGrip "" UBYTE OneToOne 1 100 0.00 255.0 FORMAT "%5.1" ECU_ADDRESS 0xD0003CA4 /end MEASUREMENT
/begin MEASUREMENT PT_stStabIntv "" UBYTE OneToOne 1 100 0.00 255.0 FORMAT "%5.1" ECU_ADDRESS 0xD0003CA5 /end MEASUREMENT
/begin MEASUREMENT PT_stTraIntv "" UBYTE OneToOne 1 100 0.00 255.0 FORMAT "%5.1" ECU_ADDRESS 0xD0003CA6 /end MEASUREMENT
/begin MEASUREMENT PT_stTraType "" UBYTE OneToOne 1 100 0.00 255.0 FORMAT "%5.1" ECU_ADDRESS 0xD0003CA7 /end MEASUREMENT
/begin MEASUREMENT PT_trqLos "" SWORD Trq 1 100 -3276.800 3276.700 FORMAT "%8.3" ECU_ADDRESS 0xD0003576 /end MEASUREMENT
/begin MEASUREMENT PT_trqTraPrt "" SWORD Trq 1 100 -3276.800 3276.700 FORMAT "%8.3" ECU_ADDRESS 0xD0003578 /end MEASUREMENT
/begin MEASUREMENT Reset_Env.adLoc "" ULONG OneToOne 1 100 0.00 4294967295.00 FORMAT "%13.2" ECU_ADDRESS 0xD00030B4 /end MEASUREMENT
/begin MEASUREMENT Reset_Env.xUserValue "" ULONG OneToOne 1 100 0.00 4294967295.00 FORMAT "%13.2" ECU_ADDRESS 0xD00030B8 /end MEASUREMENT
/begin MEASUREMENT Reset_Env.xId "" UWORD Reset_ID 1 100 0.00 12358.0000000 FORMAT "%13.7" ECU_ADDRESS 0xD00030BC /end MEASUREMENT
/begin MEASUREMENT Reset_Env.xGrp "" UBYTE Reset_GrpID 1 100 0.00 30.0000000000 FORMAT "%13.10" ECU_ADDRESS 0xD00030BE /end MEASUREMENT
/begin MEASUREMENT Reset_Env.ctRst "" UBYTE OneToOne 1 100 0.00 255.0 FORMAT "%5.1" ECU_ADDRESS 0xD00030BF /end MEASUREMENT
/begin MEASUREMENT Reset_FlMRErrBuf "" UBYTE OneToOne 1 100 0.00 255.0 FORMAT "%5.1" ARRAY_SIZE 4 ECU_ADDRESS 0xD0004696 /end MEASUREMENT
/begin MEASUREMENT Reset_TrapErrIntrBuf "" UBYTE OneToOne 1 100 0.00 255.0 FORMAT "%5.1" ARRAY_SIZE 4 ECU_ADDRESS 0xD0004692 /end MEASUREMENT
/begin MEASUREMENT Reset_xHistBuf "" UWORD Reset_ID 1 100 0.00 12358.0000000 FORMAT "%13.7" ARRAY_SIZE 8 ECU_ADDRESS 0xD0006670 /end MEASUREMENT
/begin MEASUREMENT Rtmo_ctInterrupt_u16 "" UWORD OneToOne 1 100 0.00 65535.00 FORMAT "%8.2" ECU_ADDRESS 0xD00053A2 /end MEASUREMENT
/begin MEASUREMENT Rtmo_ctReentrantSample_u32 "" ULONG OneToOne 1 100 0.00 4294967295.00 FORMAT "%13.2" ECU_ADDRESS 0xD0005258 /end MEASUREMENT
/begin MEASUREMENT Rtmo_ctSampleProc_u8 "" UBYTE OneToOne 1 100 0.00 255.0 FORMAT "%5.1" ECU_ADDRESS 0xD0004686 /end MEASUREMENT
/begin MEASUREMENT Rtmo_ctSample_u16 "" UWORD OneToOne 1 100 0.00 65535.00 FORMAT "%8.2" ECU_ADDRESS 0xD00053A4 /end MEASUREMENT
/begin MEASUREMENT Rtmo_flState_u8 "" UBYTE OneToOne 1 100 0.00 255.0 FORMAT "%5.1" ECU_ADDRESS 0xD00053EB /end MEASUREMENT
/begin MEASUREMENT Rtmo_tiAvrg_Tick "" ULONG Rtmo_Time_us 1 100 0.00 53687091.1875 FORMAT "%13.4" ECU_ADDRESS 0xD000525C /end MEASUREMENT
/begin MEASUREMENT Rtmo_tiLoad_u16 "" UWORD Rtmo_Percent_u16 1 100 0.00 99.99847 FORMAT "%8.5" ECU_ADDRESS 0xD00053A6 /end MEASUREMENT
/begin MEASUREMENT Rtmo_tiMaxCalldist_Tick "" ULONG Rtmo_Time_us 1 100 0.00 53687091.1875 FORMAT "%13.4" ECU_ADDRESS 0xD0005260 /end MEASUREMENT
/begin MEASUREMENT Rtmo_tiMaxLoadRun_u16 "" UWORD Rtmo_Percent_u16 1 100 0.00 99.99847 FORMAT "%8.5" ECU_ADDRESS 0xD0003A12 /end MEASUREMENT
/begin MEASUREMENT Rtmo_tiMaxLoad_u16 "" UWORD Rtmo_Percent_u16 1 100 0.00 99.99847 FORMAT "%8.5" ECU_ADDRESS 0xAFE804DC /end MEASUREMENT
/begin MEASUREMENT Rtmo_tiMax_Tick "" ULONG Rtmo_Time_us 1 100 0.00 53687091.1875 FORMAT "%13.4" ECU_ADDRESS 0xD0005264 /end MEASUREMENT
/begin MEASUREMENT Rtmo_tiMinCalldist_Tick "" ULONG Rtmo_Time_us 1 100 0.00 53687091.1875 FORMAT "%13.4" ECU_ADDRESS 0xD0005268 /end MEASUREMENT
/begin MEASUREMENT Rtmo_tiMin_Tick "" ULONG Rtmo_Time_us 1 100 0.00 53687091.1875 FORMAT "%13.4" ECU_ADDRESS 0xD000526C /end MEASUREMENT
/begin MEASUREMENT Rtmo_tiSampleDuration_Tick "" ULONG Rtmo_Time_us 1 100 0.00 53687091.1875 FORMAT "%13.4" ECU_ADDRESS 0xD0005270 /end MEASUREMENT
/begin MEASUREMENT Sia_bFlPmpLck "" UWORD B_TRUE 1 100 0.00 1.00000000000 BIT_MASK 0x10 FORMAT "%13.11" ECU_ADDRESS 0xD00000A2 /end MEASUREMENT
/begin MEASUREMENT Sia_bFshPrgLck "" UWORD B_TRUE 1 100 0.00 1.00000000000 BIT_MASK 0x20 FORMAT "%13.11" ECU_ADDRESS 0xD00000A2 /end MEASUREMENT
/begin MEASUREMENT Sia_bIgnLck "" UWORD B_TRUE 1 100 0.00 1.00000000000 BIT_MASK 0x4 FORMAT "%13.11" ECU_ADDRESS 0xD00000A2 /end MEASUREMENT
/begin MEASUREMENT Sia_bInjLck "" UWORD B_TRUE 1 100 0.00 1.00000000000 BIT_MASK 0x2 FORMAT "%13.11" ECU_ADDRESS 0xD00000A2 /end MEASUREMENT
/begin MEASUREMENT Sia_bStaLck "" UWORD B_TRUE 1 100 0.00 1.00000000000 BIT_MASK 0x8 FORMAT "%13.11" ECU_ADDRESS 0xD00000A2 /end MEASUREMENT
/begin MEASUREMENT Sia_bThrVlvLck "" UWORD B_TRUE 1 100 0.00 1.00000000000 BIT_MASK 0x40 FORMAT "%13.11" ECU_ADDRESS 0xD00000A2 /end MEASUREMENT
/begin MEASUREMENT StSys_stStrt "" UBYTE dez 1 100 0.00 255.0 FORMAT "%5.1" ECU_ADDRESS 0xD0003CB0 /end MEASUREMENT
/begin MEASUREMENT tef_w "" UWORD t100msxs_q16Em6 1 100 0.00 1.048560 FORMAT "%8.6" ECU_ADDRESS 0xD0000A12 /end MEASUREMENT
/begin MEASUREMENT tevfak_w "" UWORD t1p0usxms 1 100 0.00 65.53500 FORMAT "%8.5" ECU_ADDRESS 0xD0000A00 /end MEASUREMENT
/begin MEASUREMENT tevfa_l "" ULONG t1p0usxms 1 100 0.00 4294967.29500 FORMAT "%13.5" ECU_ADDRESS 0xD0002434 /end MEASUREMENT
/begin MEASUREMENT tez_l "" ULONG t1p0usxms 1 100 0.00 4294967.29500 FORMAT "%13.5" ARRAY_SIZE 3 ECU_ADDRESS 0xD0002438 /end MEASUREMENT
/begin MEASUREMENT te_l "" ULONG t1p0usxms 1 100 0.00 4294967.29500 FORMAT "%13.5" ECU_ADDRESS 0xD0002444 /end MEASUREMENT
/begin MEASUREMENT tfwdksom_w "" UWORD zk10msxs_uw_b655 1 100 0.010000152590 655.36000000 FORMAT "%12.8" ECU_ADDRESS 0xD00009D2 /end MEASUREMENT
/begin MEASUREMENT tmotloc "" UBYTE temp_ub_q0p75_o48 1 100 -48.00 143.3 FORMAT "%5.1" ECU_ADDRESS 0xD0000E85 /end MEASUREMENT
/begin MEASUREMENT Tra_bCANErrMax "" UBYTE dez 1 100 0.00 255.0 BIT_MASK 0x1 FORMAT "%5.1" ECU_ADDRESS 0xD0003CDA /end MEASUREMENT
/begin MEASUREMENT Tra_rIncFree "" SWORD Prc 1 100 -400.0000 399.9878 FORMAT "%8.4" ECU_ADDRESS 0xD00035BC /end MEASUREMENT
/begin MEASUREMENT Tra_stTII "" UBYTE OneToOne 1 100 0.00 255.0 FORMAT "%5.1" ECU_ADDRESS 0xD0003CC6 /end MEASUREMENT
/begin MEASUREMENT Tra_stTSC "" UBYTE OneToOne 1 100 0.00 255.0 FORMAT "%5.1" ECU_ADDRESS 0xD0003CC7 /end MEASUREMENT
/begin MEASUREMENT tvub_w "" UWORD t1p0usxms 1 100 0.00 65.53500 FORMAT "%8.5" ECU_ADDRESS 0xD0000A14 /end MEASUREMENT
/begin MEASUREMENT wnwgv_w "" UWORD kw_q0p0078 1 100 0.00 511.9922 FORMAT "%8.4" ECU_ADDRESS 0xD00009F4 /end MEASUREMENT
/begin MEASUREMENT wnwue "" UBYTE kw_q0p5 1 100 0.00 127.5 FORMAT "%5.1" ECU_ADDRESS 0xD0000E92 /end MEASUREMENT
/begin MEASUREMENT wnwue_w "" UWORD kw_q0p0019 1 100 0.00 127.9980 FORMAT "%8.4" ECU_ADDRESS 0xD00009F6 /end MEASUREMENT
/begin MEASUREMENT wnwvg_w "" UWORD kw_q0p0019 1 100 0.00 127.9980 FORMAT "%8.4" ECU_ADDRESS 0xD00009F8 /end MEASUREMENT
/begin MEASUREMENT wnwvu_w "" UWORD kw_q0p0078 1 100 0.00 511.9922 FORMAT "%8.4" ECU_ADDRESS 0xD00009FA /end MEASUREMENT
/begin MEASUREMENT zzdsh1gs "" UWORD zk10msxs_uw_b655 1 100 0.010000152590 655.36000000 FORMAT "%12.8" ECU_ADDRESS 0xD0000A1E /end MEASUREMENT
/begin MEASUREMENT zzdshgs "" UWORD zk10msxs_uw_b655 1 100 0.010000152590 655.36000000 FORMAT "%12.8" ECU_ADDRESS 0xD0000A20 /end MEASUREMENT
/begin FUNCTION MED2FIT "1.5.0" /begin IN_MEASUREMENT B_evakt B_temin redist /end IN_MEASUREMENT
 /begin OUT_MEASUREMENT InjSys_bInjVlvActv InjSys_bMinPtdInjDurActv InjSys_stActRedStg /end OUT_MEASUREMENT
 FUNCTION_VERSION "1.5.0" /end FUNCTION
/begin FUNCTION MED2FPC "1.1.0" /begin IN_MEASUREMENT B_dteaam B_dtes B_dtest /end IN_MEASUREMENT
 /begin OUT_MEASUREMENT InjSys_bActvDiaCPVPsbl InjSys_bCPVOpnForDia InjSys_bCPVRdyForDia /end OUT_MEASUREMENT
 FUNCTION_VERSION "1.1.0" /end FUNCTION
/begin FUNCTION MED2FSS "1.7.1" /begin IN_MEASUREMENT B_ekp B_tal B_talval /end IN_MEASUREMENT /begin OUT_MEASUREMENT InjSys_bFlTnkEmp InjSys_bFlTnkEmpVal PSP_st /end OUT_MEASUREMENT FUNCTION_VERSION "1.7.1" /end FUNCTION
/begin FUNCTION MED2OILT "1.0.0" /begin IN_MEASUREMENT tosp /end IN_MEASUREMENT /begin OUT_MEASUREMENT Oil_tSwmp /end OUT_MEASUREMENT FUNCTION_VERSION "1.0.0" /end FUNCTION
/begin FUNCTION MED2OTMTCWCP "1.3.0" /begin IN_MEASUREMENT B_nltcw tmew tmot tmotlin tmstz /end IN_MEASUREMENT
 /begin OUT_MEASUREMENT B_med2otmtcwcpXPostDrv CEngDsT_t CEngDsT_tMod CEngDsT_tRaw CEngDsT_tStrtFrst EngDa_tEng /end OUT_MEASUREMENT
 FUNCTION_VERSION "1.3.0" /end FUNCTION
/begin FUNCTION MED2STSYS "1.2.0" /begin IN_MEASUREMENT B_stend CoEng_st /end IN_MEASUREMENT /begin OUT_MEASUREMENT StSys_stStrt /end OUT_MEASUREMENT FUNCTION_VERSION "1.2.0" /end FUNCTION
/begin FUNCTION MEDC_Axispoints_Custom "" /end FUNCTION
/begin FUNCTION MEDC_Compu_Core_CELPrj "8.0.0" FUNCTION_VERSION "8.0.0" /end FUNCTION
/begin FUNCTION MEDC_Compu_Custom_CELPrj "8.1.0" FUNCTION_VERSION "8.1.0" /end FUNCTION
/begin FUNCTION MEDC_Compu_DS_CELPrj "8.1.0" FUNCTION_VERSION "8.1.0" /end FUNCTION
/begin FUNCTION MEDC_Compu_DS_GS_CELPrj "8.1.1" FUNCTION_VERSION "8.1.1" /end FUNCTION
/begin FUNCTION MEDC_FixConst_Core_CELPrj "8.1.0" FUNCTION_VERSION "8.1.0" /end FUNCTION
/begin FUNCTION MEDC_FixConst_Custom_CELPrj "8.1.0" FUNCTION_VERSION "8.1.0" /end FUNCTION
/begin FUNCTION MEDC_FixConst_DS_CELPrj "8.1.0" FUNCTION_VERSION "8.1.0" /end FUNCTION
/begin FUNCTION MEDC_FixConst_DS_GS_CELPrj "8.1.0" FUNCTION_VERSION "8.1.0" /end FUNCTION
/begin FUNCTION MEDC_Models_Core_CELPrj "8.0.0" FUNCTION_VERSION "8.0.0" /end FUNCTION
/begin FUNCTION MEDC_Models_Custom_CELPrj "8.0.0" FUNCTION_VERSION "8.0.0" /end FUNCTION
/begin FUNCTION MEDC_Models_DS_CELPrj "8.0.0" FUNCTION_VERSION "8.0.0" /end FUNCTION
/begin FUNCTION MEDC_Models_DS_GS_CELPrj "8.0.0" FUNCTION_VERSION "8.0.0" /end FUNCTION
/begin FUNCTION MemLay "1.10.0" FUNCTION_VERSION "1.10.0" /end FUNCTION
/begin FUNCTION MILLmp_DD "1.2.0"
 /begin DEF_CHARACTERISTIC MILLmp_DigOutPar_C.tiBtwTstSCB_C MILLmp_DigOutPar_C.tiBtwTstOT_C MILLmp_DigOutPar_C.numTstMax_C MILLmp_stPwrStgEnaCond_C /end DEF_CHARACTERISTIC
 /begin IN_MEASUREMENT DevLib_stPwrStgEnaCond MILLmp_stReqBln MILLmp_stReqOn /end IN_MEASUREMENT
 /begin OUT_MEASUREMENT ErrLmp_stMIL MILLmp_stMIL MILLmp_stPs /end OUT_MEASUREMENT
 /begin LOC_MEASUREMENT MILLmp_tiRmnBln /end LOC_MEASUREMENT
 FUNCTION_VERSION "1.2.0" /end FUNCTION
/begin FUNCTION MILLmp_VD "1.2.0"
 /begin DEF_CHARACTERISTIC MILLmp_stMILCfg_CW MILLmp_tiAftStrt_C MILLmp_tiRdnBln_C MILLmp_tiVisTst_C /end DEF_CHARACTERISTIC
 /begin OUT_MEASUREMENT MILLmp_stReqBln MILLmp_stReqOn /end OUT_MEASUREMENT
 /begin LOC_MEASUREMENT MILLmp_stMILWoTstr MILLmp_stSt MILLmp_tiRmnSt /end LOC_MEASUREMENT
 FUNCTION_VERSION "1.2.0" /end FUNCTION
/begin FUNCTION MisfDet_AdpPrj "10.0.0" /begin OUT_MEASUREMENT B_dmdsteol /end OUT_MEASUREMENT FUNCTION_VERSION "10.0.0" /end FUNCTION
/begin FUNCTION Mli "1.9.0" FUNCTION_VERSION "1.9.0" /end FUNCTION
/begin FUNCTION Mm "1.9.0" FUNCTION_VERSION "1.9.0" /end FUNCTION
/begin FUNCTION Mmo "1.5.0" FUNCTION_VERSION "1.5.0" /end FUNCTION
/begin FUNCTION MoCADC_Co "2.3.0"
 /begin DEF_CHARACTERISTIC MoCADC_ctDebNTP_C MoCADC_ctDebTst_C MoCADC_ctRstNTP_C MoCADC_ctRstTst_C MoCADC_uTPMax_C MoCADC_uTstMax_C MoCADC_uTstMin_C /end DEF_CHARACTERISTIC
 /begin IN_MEASUREMENT B_i_ska_um MoExe_ctCyc Mo_ctRst Mo_ctRstCpl Mo_stMoC Mo_stMoCCpl Mo_stMoF Mo_stMoFCpl /end IN_MEASUREMENT
 /begin OUT_MEASUREMENT MoCADC_facVltgRatio MoCADC_st MoCADC_stMsg Mo_bIrvErrNTP Mo_bIrvErrTst /end OUT_MEASUREMENT
 /begin LOC_MEASUREMENT MoCADC_bChkActv MoCADC_bDef MoCADC_bNTPActv MoCADC_bNTPErr MoCADC_bTstErr MoCADC_ctDebNTP MoCADC_ctDebNTPCpl MoCADC_ctDebTst MoCADC_ctDebTstCpl MoCADC_ctTstNTP MoCADC_ctTstTst MoCADC_stCpl MoCADC_uTP_mp MoCADC_uTst_mp /end LOC_MEASUREMENT
 FUNCTION_VERSION "2.3.0" /end FUNCTION
/begin FUNCTION MoCCom_Co "2.5.0"
 /begin IN_MEASUREMENT B_ausc_act MoCCPU_PartResp MoCMem_st MoCMem_stCpl MoCPFC_PartResp MoCSOP_stActvMsg MoCSOP_stComActv MoCSOP_stComActvCpl MoCSOP_stRdy MoCSOP_stRdyCpl SyC_stSub /end IN_MEASUREMENT
 /begin OUT_MEASUREMENT MoCCom_ctErrMM MoCCom_ctErrMMMsg MoCCom_Query MoCCom_stQueryNew /end OUT_MEASUREMENT
 /begin LOC_MEASUREMENT MoCCom_bCPUNew MoCCom_bPCPNew MoCCom_bPFCNew MoCCom_ctCorRespCnt MoCCom_ctErrFC MoCCom_ctErrFCCpl MoCCom_ctErrMMOld MoCCom_ctErrOSTimeout MoCCom_ctErrSPI MoCCom_ctSOPNoRdy MoCCom_ctSOPTstActv MoCCom_Response MoCCom_Response_mp MoCCom_stMm MoCCom_stMmRespCnt /end LOC_MEASUREMENT
 FUNCTION_VERSION "2.5.0" /end FUNCTION
/begin FUNCTION MoCCPU_Co "2.1.0" /begin IN_MEASUREMENT MoCCom_Query MoCCom_stQueryNew /end IN_MEASUREMENT /begin OUT_MEASUREMENT MoCCPU_PartResp MoCCPU_Query /end OUT_MEASUREMENT /begin LOC_MEASUREMENT MoCCPU_ctSeq MoCCPU_TempRes /end LOC_MEASUREMENT FUNCTION_VERSION "2.1.0" /end FUNCTION
/begin FUNCTION MoCGPTA_Co "2.1.0" /begin DEF_CHARACTERISTIC MoCGPTA_numErr_C MoCGPTA_tiDvtMax_C /end DEF_CHARACTERISTIC /begin IN_MEASUREMENT Mo_stMoC Mo_stMoCCpl /end IN_MEASUREMENT FUNCTION_VERSION "2.1.0" /end FUNCTION
/begin FUNCTION MoCMem_Co "2.4.0"
 /begin DEF_CHARACTERISTIC MoCMem_ctDebErrChkRAM_C MoCMem_ctDebErrChkROM_C MoCMem_ctDebHealChkRAM_C MoCMem_ctDebHealChkROM_C MoCMem_noMEMCodeChkRst_CW MoCMem_noMEMDataChkRst_CW MoCMem_RamTst_CW MoCMem_RomTst_CW /end DEF_CHARACTERISTIC
 /begin REF_CHARACTERISTIC MoCRam_ChkRAMIFA9TstSD_CW /end REF_CHARACTERISTIC
 /begin IN_MEASUREMENT Mo_stMoC Mo_stMoCCpl /end IN_MEASUREMENT
 /begin OUT_MEASUREMENT MoCMem_ChkRAMIFA9TstSD MoCMem_ChkRAMIFA9TstSDCpl MoCMem_st MoCMem_stCpl /end OUT_MEASUREMENT
 /begin LOC_MEASUREMENT MoCMem_adRAMCurrent MoCMem_adRAMCurrentCpl MoCMem_adROMCurrent MoCMem_adROMCurrentCpl MoCMem_ctDebErrChkRAM MoCMem_ctDebErrChkRAMCpl MoCMem_ctDebErrChkROM MoCMem_ctDebErrChkROMCpl MoCMem_ctDebHealChkRAM MoCMem_ctDebHealChkRAMCpl MoCMem_ctDebHealChkROM MoCMem_ctDebHealChkROMCpl MoCMem_numChkSumCurrent MoCMem_numChkSumCurrentCpl /end LOC_MEASUREMENT
 FUNCTION_VERSION "2.4.0" /end FUNCTION
/begin FUNCTION MoCPCP_Co "2.3.0" /begin DEF_CHARACTERISTIC MoCPCP_numErr_C MoCPCP_stEnaMFTst_CW MoCPCP_tiHeal_C /end DEF_CHARACTERISTIC
 /begin IN_MEASUREMENT MoCCom_Query MoCCom_stQueryNew MoCMem_st MoCMem_stCpl Mo_stMoC Mo_stMoCCpl /end IN_MEASUREMENT
 /begin LOC_MEASUREMENT MoCPCP_adCurrent MoCPCP_adCurrentCpl MoCPCP_ctErr MoCPCP_ctErrCpl MoCPCP_ctHeal MoCPCP_ctHealCpl MoCPCP_numCurrentCSum MoCPCP_numCurrentCSumCpl /end LOC_MEASUREMENT
 FUNCTION_VERSION "2.3.0" /end FUNCTION
/begin FUNCTION MoCPFC_Co "2.1.0" /begin IN_MEASUREMENT MoCCom_Query MoCCom_stQueryNew /end IN_MEASUREMENT /begin OUT_MEASUREMENT MoCPFC_PartResp /end OUT_MEASUREMENT /begin LOC_MEASUREMENT MoCPFC_Checksum MoCPFC_Checkword MoCPFC_Counter /end LOC_MEASUREMENT FUNCTION_VERSION "2.1.0" /end FUNCTION
/begin FUNCTION MoCRAM_Co "2.3.0" /begin DEF_CHARACTERISTIC MoCRam_ChkRAMIFA9TstSD_CW /end DEF_CHARACTERISTIC
 /begin IN_MEASUREMENT MoCMem_ChkRAMIFA9TstSD MoCMem_ChkRAMIFA9TstSDCpl MoCMem_st MoCMem_stCpl MoCRom_numRomPageErr MoCRom_numRomPageErrCpl MoCRom_ptrTabIndexAct MoCRom_ptrTabIndexActCpl /end IN_MEASUREMENT
 /begin OUT_MEASUREMENT MoCRam_stProtRAMCleared /end OUT_MEASUREMENT
 /begin LOC_MEASUREMENT MoCRam_ctMain1RamChk MoCRam_ctMain2RamChk MoCRam_ctMainProtRam MoCRam_ctRepEx MoCRam_numAreasChecked MoCRam_numReset MoCRam_stEEPInit MoCRam_stRepExRam MoCRam_stRepExRamCpl /end LOC_MEASUREMENT
 FUNCTION_VERSION "2.3.0" /end FUNCTION
/begin FUNCTION MoCROM_Co "2.3.0"
 /begin DEF_CHARACTERISTIC MoCRom_BgSwOffTst_CW MoCRom_noROMCodeChkRst_CW MoCRom_noROMDataChkRst_CW MoCRom_RepExTst_CW /end DEF_CHARACTERISTIC
 /begin IN_MEASUREMENT MoCMem_st MoCMem_stCpl /end IN_MEASUREMENT
 /begin OUT_MEASUREMENT MoCRom_numRomPageErr MoCRom_numRomPageErrCpl MoCRom_ptrTabIndexAct MoCRom_ptrTabIndexActCpl /end OUT_MEASUREMENT
 /begin LOC_MEASUREMENT MoCROM_bXPostDrv MoCRom_ctRepEx_mp MoCRom_KeyCode MoCRom_KeyCodeCpl MoCRom_KeyData MoCRom_KeyDataCpl /end LOC_MEASUREMENT
 FUNCTION_VERSION "2.3.0" /end FUNCTION
/begin FUNCTION MoCSOP_Co "17.0.0" /begin DEF_CHARACTERISTIC MoCSOP_nMaxOVLthDisbl_C /end DEF_CHARACTERISTIC /begin IN_MEASUREMENT evz_austot MoCMem_st MoCMem_stCpl MoF_nEng SyC_stSub /end IN_MEASUREMENT
 /begin OUT_MEASUREMENT B_ausc_act MoCSOP_stActMsg MoCSOP_stActvMsg MoCSOP_stComActv MoCSOP_stComActvCpl MoCSOP_stOvl MoCSOP_stRdy MoCSOP_stRdyCpl /end OUT_MEASUREMENT
 /begin LOC_MEASUREMENT MoCSOP_ctDebPSDia MoCSOP_ctDebSOPTst MoCSOP_ctErrMM MoCSOP_ctErrMSC MoCSOP_ctErrOSTimeout MoCSOP_ctErrRespTime MoCSOP_ctErrSPI MoCSOP_numSyCJ_mp MoCSOP_stErrOld MoCSOP_stMm MoCSOP_stMmRespCnt MoCSOP_stOvlCpl MoCSOP_stOvTstRdy MoCSOP_stOvTstRdyCpl /end LOC_MEASUREMENT
 FUNCTION_VERSION "17.0.0" /end FUNCTION
/begin FUNCTION MoExe_Co "36.0.0" /begin IN_MEASUREMENT SyC_stSub /end IN_MEASUREMENT /begin OUT_MEASUREMENT MoExe_ctCyc /end OUT_MEASUREMENT FUNCTION_VERSION "36.0.0" /end FUNCTION
/begin FUNCTION Mo_Adap "4.0.0" /begin DEF_CHARACTERISTIC DNMAXH /end DEF_CHARACTERISTIC
 /begin OUT_MEASUREMENT B_evabu B_i_ska_um B_nlzoff EngTrqPtd_trqLead EngTrqPtd_trqSet miszul_w MoFAPP_stLimpMsg MoFDrAs_stACCPtdMsg MoFDrAs_stPtdMsg MoFExtInt_stASTPtdMsg MoFExtInt_stDCSPtdMsg MoFExtInt_stTIIPtdMsg MoFExtInt_stTSCPtdMsg MoF_nEng MoF_rBrkDes MoF_stBrkstLim MoF_stDemEnBrkDemRls MoF_trqBrkAbs MoX_nMaxICOMsg Mo_ctRst Mo_ctRstCpl Mo_stIrvErrReacMsg /end OUT_MEASUREMENT
 FUNCTION_VERSION "4.0.0" /end FUNCTION
/begin FUNCTION Mo_Conf "" /end FUNCTION
/begin FUNCTION Mo_Glbl "2.6.0" /begin IN_MEASUREMENT MoCMem_st /end IN_MEASUREMENT
 /begin OUT_MEASUREMENT Mo_stCplChk Mo_stDrAs Mo_stDrAsCpl Mo_stErrHyb Mo_stErrHybCpl Mo_stIntv Mo_stIntvCpl Mo_stMoC Mo_stMoCCpl Mo_stMoF Mo_stMoFCpl Mo_stSys Mo_stSysCpl Mo_stTrqAct Mo_stTrqActCpl Mo_stTrqPtd Mo_stTrqPtdCpl /end OUT_MEASUREMENT
 /begin LOC_MEASUREMENT Mo_bACCActv Mo_bACCPtd Mo_bAddConPFC Mo_bAddDisblPreICORst Mo_bAddIntvPtd Mo_bAftStrt Mo_bBrk Mo_bCplChk Mo_bCrCtlActv Mo_bCrCtlPtd Mo_bCrCtlShOff Mo_bDCSPtd Mo_bDrAsActv Mo_bDrAsPtd Mo_bECom Mo_bEMem Mo_bEmgcyAir Mo_bEPcp Mo_bERam Mo_bERomSPg Mo_bERomXPg Mo_bErrVelVeh Mo_bICOL1 Mo_bICOL2 Mo_bIrvElMIdl Mo_bIrvHybLimpL1 Mo_bIrvHybLimpL2 Mo_bIrvHybP1LimpL2 Mo_bIrvICOL1 Mo_bIrvTrqLimL1 Mo_bIrvTrqLimL2 Mo_bKhls Mo_bLoVltg Mo_bNlh Mo_bNlhr Mo_bPostDrv Mo_bPreDrv Mo_bRamErr Mo_bReacICO Mo_bRomErr Mo_bRvICOL1 Mo_bSyncLos Mo_bTraPtd Mo_bUfol Mo_bUfolv Mo_stCplChk_mp /end LOC_MEASUREMENT
 FUNCTION_VERSION "2.6.0" /end FUNCTION
/begin FUNCTION MRly2MED "1.20.0" /begin IN_MEASUREMENT MRly_st /end IN_MEASUREMENT /begin OUT_MEASUREMENT B_hr /end OUT_MEASUREMENT FUNCTION_VERSION "1.20.0" /end FUNCTION
/begin FUNCTION MRly_DD "1.41.0" FUNCTION_VERSION "1.41.0" /end FUNCTION
/begin FUNCTION MRly_VD "1.40.0" /begin OUT_MEASUREMENT MRly_st MRly_stAct /end OUT_MEASUREMENT FUNCTION_VERSION "1.40.0" /end FUNCTION
/begin FUNCTION Msc "1.12.0" /begin LOC_MEASUREMENT Msc_ctErr_mp /end LOC_MEASUREMENT FUNCTION_VERSION "1.12.0" /end FUNCTION
/begin FUNCTION MSUDKSOM "1.1.1"
 /begin DEF_CHARACTERISTIC CWMSUDKSOM KFMSUDKN KFWMSABST KLMSUDKKH KLMSUDKPED KLMSUDKTM MSUDKSNLN NWDKSST TWDKRED TWDKSNST /end DEF_CHARACTERISTIC
 /begin IN_MEASUREMENT B_enllri B_kha B_nmin B_nmot B_nsolst B_stendmd miist_w miszul_w nmot nmot_w tengslst tengsq1_w tmst wped /end IN_MEASUREMENT
 /begin OUT_MEASUREMENT B_msudksom B_munst B_tfwdksom msudksom_w tfwdksom_w /end OUT_MEASUREMENT
 /begin LOC_MEASUREMENT msudkped_w nmotmsudks /end LOC_MEASUREMENT
 FUNCTION_VERSION "1.1.1" /end FUNCTION
/begin FUNCTION NMAXMD "6.0.0"
 /begin DEF_CHARACTERISTIC CWNMAXMD DNMAX DNMAXDZ DNSIAB DNSIRES ITNMXH KINMXNL KINMXRLG KLTNMXPR MDIMX NMAX NMAXDV NMAXDVG NMAXDZ NMAXGA NMAXKR NMAXNL NMAXOG NMXDAEF NMXDKPU NMXPNL NMXPRLG SRL08NXUB TMOTNMX TNMXH VNMX /end DEF_CHARACTERISTIC
 /begin REF_CHARACTERISTIC DNMAXH SGA08MDUB /end REF_CHARACTERISTIC
 /begin IN_MEASUREMENT B_autget B_dknolu B_dkpu B_dopzue B_krdws B_nldg B_nmaxext esst_sga08mdub gangi mifab_w ngfil_w nmaxext_w nmot_w rl tmot vfzg wped /end IN_MEASUREMENT
 /begin OUT_MEASUREMENT B_nmax minmx_w nsber_w /end OUT_MEASUREMENT
 /begin LOC_MEASUREMENT B_itnmxh B_nmaxd B_nmxkr B_tmotnmx B_tnmxh dmnmxi_w dmnmxp_w dnsi_w kinmx kltnmxpr_w mifabh_w minmxb_w nmaxdvg_w nmaxga_w nmax_w nmotpr_w nmxpr nsbertmp_w /end LOC_MEASUREMENT
 FUNCTION_VERSION "6.0.0" /end FUNCTION
/begin FUNCTION NSAC "4.0.0" /begin DEF_CHARACTERISTIC CWNACLL NSACEL NSACELFS NSACFSTM NSACTM /end DEF_CHARACTERISTIC /begin REF_CHARACTERISTIC CWNSTAT /end REF_CHARACTERISTIC /begin IN_MEASUREMENT B_fs B_load1 B_load3 B_nac B_nswo1 S_ac tumg /end IN_MEASUREMENT /begin OUT_MEASUREMENT nsmodac nsolac /end OUT_MEASUREMENT FUNCTION_VERSION "4.0.0" /end FUNCTION
/begin FUNCTION NSBLP "1.1.0" /begin DEF_CHARACTERISTIC NFSKS NSKS TMLLX /end DEF_CHARACTERISTIC /begin IN_MEASUREMENT B_fs B_ll B_nswo1 nmotll tmot /end IN_MEASUREMENT /begin OUT_MEASUREMENT nsolblp /end OUT_MEASUREMENT /begin LOC_MEASUREMENT B_nsks nsblpLokBits20ms /end LOC_MEASUREMENT FUNCTION_VERSION "1.1.0" /end FUNCTION
/begin FUNCTION NSGEN "4.0.0"
 /begin DEF_CHARACTERISTIC CWGENPWM CWNSGEN KLDNSOLGEN KLINSOLGEN KLTDSOLGEN KLTISOLGEN LTHPWMGEN MNNSOLGEN MNTVGENSOL MXNSOLGEN MXNSOLGEND NNSMODGEN NSEL1 NSEL2 NSELFS2 NSELN1 NSELN2 NSOLGENBK NSOLGENDEF NSSL NSSLFS NSSLN TDENPWMSOL TINSOLGENN UTHPWMGEN ZKNSOLEL ZKNSOLPWM /end DEF_CHARACTERISTIC
 /begin IN_MEASUREMENT AltIO_rAltLoad B_autget B_fs B_ll B_load1 B_load2 B_load3 B_stendes nstat /end IN_MEASUREMENT
 /begin OUT_MEASUREMENT nsmdgenpwm nsmodgen nsmodgenel nsolgen /end OUT_MEASUREMENT
 /begin LOC_MEASUREMENT B_enpwmsol B_loadel mxnsolgenc nsolgenelf nsolgentp /end LOC_MEASUREMENT
 FUNCTION_VERSION "4.0.0" /end FUNCTION
/begin FUNCTION NSHTD "3.0.0"
 /begin DEF_CHARACTERISTIC KFTMHTD KFTMHTDFS KFTUMHTD KFTUMHTDFS NTUM NTUMFS TDTUMG TTUM /end DEF_CHARACTERISTIC
 /begin IN_MEASUREMENT B_autget B_fs B_ll tmot tmst tum /end IN_MEASUREMENT
 /begin OUT_MEASUREMENT nsmodhtd nsolhtd /end OUT_MEASUREMENT
 /begin LOC_MEASUREMENT nsolhtdtm nsolhtdtum /end LOC_MEASUREMENT
 FUNCTION_VERSION "3.0.0" /end FUNCTION
/begin FUNCTION NSKH "1.3.0"
 /begin DEF_CHARACTERISTIC CWNSKH GANGKHLL KFNSKHLL KLNFSKHM KLNLLKHAGE KLNLLKHM TKHFSAB TKHLLMX TKHN TKHNABBKV TKHNEND VFZGGRDKH VFZGNLLKH /end DEF_CHARACTERISTIC
 /begin IN_MEASUREMENT B_brems B_fs B_kh B_khan B_kuppl B_ll B_vllr fcoschmn_w fho_w frhol_w gangsziel tmot tnse_w vfzg_w /end IN_MEASUREMENT
 /begin OUT_MEASUREMENT B_bkvkhab B_khn B_khnshp nllkh nmaxllkh nsolcat /end OUT_MEASUREMENT
 /begin LOC_MEASUREMENT B_cwnllkh0 B_cwnllkh1 B_cwnllkh2 B_cwnllkh3 B_cwnllkh4 B_nfskh fcosawnl_w frhokor_w nmfskh nmllkh tmotloc /end LOC_MEASUREMENT
 FUNCTION_VERSION "1.3.0" /end FUNCTION
/begin FUNCTION NSLPH "2.0.0" /begin DEF_CHARACTERISTIC NFSNLDG NSNLDG NSNOT /end DEF_CHARACTERISTIC /begin IN_MEASUREMENT B_dknolu B_dkpu B_fs B_nldg B_nswo1 /end IN_MEASUREMENT /begin OUT_MEASUREMENT nsmodlph nsollph /end OUT_MEASUREMENT /begin LOC_MEASUREMENT B_inolu /end LOC_MEASUREMENT FUNCTION_VERSION "2.0.0" /end FUNCTION
/begin FUNCTION NSPST "3.0.0" /begin DEF_CHARACTERISTIC NSL /end DEF_CHARACTERISTIC /begin IN_MEASUREMENT B_nswo1 B_sl /end IN_MEASUREMENT /begin OUT_MEASUREMENT nsolpst /end OUT_MEASUREMENT FUNCTION_VERSION "3.0.0" /end FUNCTION
/begin FUNCTION NSREC "2.0.0"
 /begin DEF_CHARACTERISTIC LBZO1 LBZO2 LBZO3 LBZU NSLBZFS NSLBZFS2 NSLBZLL NSLBZLL2 NSLBZS ZNSUB /end DEF_CHARACTERISTIC
 /begin REF_CHARACTERISTIC CNFLLRNS CWNSTAT /end REF_CHARACTERISTIC
 /begin IN_MEASUREMENT B_fs B_ll B_nswo1 lbz nmot /end IN_MEASUREMENT
 /begin OUT_MEASUREMENT nsmodrec nsolrec /end OUT_MEASUREMENT
 FUNCTION_VERSION "2.0.0" /end FUNCTION
/begin FUNCTION NSWIH "1.0.0" /begin DEF_CHARACTERISTIC NFHZ NFHZFS /end DEF_CHARACTERISTIC /begin IN_MEASUREMENT B_fhz B_fs B_nswo1 /end IN_MEASUREMENT /begin OUT_MEASUREMENT nsolwih /end OUT_MEASUREMENT FUNCTION_VERSION "1.0.0" /end FUNCTION
/begin FUNCTION NWWUE "1.2.1" /begin OUT_MEASUREMENT fnwua fnwue fnwu_w wnwgv_w wnwue wnwue_w wnwvg_w wnwvu_w /end OUT_MEASUREMENT FUNCTION_VERSION "1.2.1" /end FUNCTION
/begin FUNCTION OCWDA_Co "5.1.0" /begin DEF_CHARACTERISTIC OCWDA_ctDebOvrVltgOn_C /end DEF_CHARACTERISTIC /begin IN_MEASUREMENT MoCSOP_stActMsg MoCSOP_stOvl SyC_stSub ubsq /end IN_MEASUREMENT /begin OUT_MEASUREMENT B_wdaactiv MoCCom_stWDAActvMsg OCWDA_bWDAActv /end OUT_MEASUREMENT
 /begin LOC_MEASUREMENT OCWDA_bMonitor OCWDA_ctDebLowVltgOn OCWDA_ctDebOvrVltgOn OCWDA_ctDebSOPNotActv OCWDA_ctDebWDAActv OCWDA_ctDebWDANotActv OCWDA_ctErrMM OCWDA_ctTstComErr OCWDA_ctTstOCWDA OCWDA_ctTstWDAActv OCWDA_ctUbsq OCWDA_stCheckState OCWDA_stWDAPtt OCWDA_stWDA_mp /end LOC_MEASUREMENT
 FUNCTION_VERSION "5.1.0" /end FUNCTION
/begin FUNCTION OS_Conf ""
 /begin LOC_MEASUREMENT OS_cntDrv1000msTask OS_cntDrv100msTask OS_cntDrv10msTask OS_cntDrv1msTask OS_cntDrv200msTask OS_cntDrv20msTask OS_cntDrv2msTask OS_cntDrv50msTask OS_cntDrv5msTask OS_cntDrvBgTask OS_cntDsmClearTask OS_cntEngReStrtTask OS_cntEpmNoSyncTask OS_cntIniDrvTask OS_cntIniEndTask OS_cntIniTask OS_cntMoTask OS_cntPostDrv1000msTask OS_cntPostDrv100msTask OS_cntPostDrv10msTask OS_cntPostDrv1msTask OS_cntPostDrv200msTask OS_cntPostDrv20msTask OS_cntPostDrv2msTask OS_cntPostDrv50msTask OS_cntPostDrv5msTask OS_cntPostDrvBgTask OS_cntPreDrv1000msTask OS_cntPreDrv100msTask OS_cntPreDrv10msTask OS_cntPreDrv1msTask OS_cntPreDrv200msTask OS_cntPreDrv20msTask OS_cntPreDrv2msTask OS_cntPreDrv50msTask OS_cntPreDrv5msTask OS_cntPreDrvBgTask OS_cntSyncFirstTask OS_cntSyncIniTask OS_cntSyncPreTask OS_cntSyncS0Task OS_cntSyncS1Task /end LOC_MEASUREMENT
/end FUNCTION
/begin FUNCTION OS_Shell "1.12.0"
 /begin LOC_MEASUREMENT OS_ErrCtr_accessResource_u8 OS_ErrCtr_callevel_u8 OS_ErrCtr_deadline_u8 OS_ErrCtr_default_u8 OS_ErrCtr_generalError_u8 OS_ErrCtr_idValue_u8 OS_ErrCtr_limit_u8 OS_ErrCtr_noFuncState_u8 OS_ErrCtr_stackcnt_u8 OS_ErrCtr_stackstat_u8 OS_ErrCtr_sum_u8 OS_ErrCtr_timetable_u8 /end LOC_MEASUREMENT
 FUNCTION_VERSION "1.12.0" /end FUNCTION
/begin FUNCTION Pcp "1.9.0" FUNCTION_VERSION "1.9.0" /end FUNCTION
/begin FUNCTION Pmd "1.10.0" FUNCTION_VERSION "1.10.0" /end FUNCTION
/begin FUNCTION Port "1.11.0" FUNCTION_VERSION "1.11.0" /end FUNCTION
/begin FUNCTION PT_Adp "2.0.0"
 /begin DEF_CHARACTERISTIC CoPT_trqPTPrt_C PTADP10MS PT_stStabIntv_C PT_stTraIntv_C PT_stTraType_C PT_trqLos_C PT_trqTraPrt_C /end DEF_CHARACTERISTIC
 /begin IN_MEASUREMENT PT_bGrip /end IN_MEASUREMENT
 /begin OUT_MEASUREMENT B_gsch B_kupsch B_wk B_wkauf B_wkr B_zwget CoPT_trqClthWoTraIntv CoPT_trqPTPrt PT_stGrip PT_stStabIntv PT_stTraIntv PT_stTraType PT_trqLos PT_trqTraPrt Tra_bCANErrMax Tra_rIncFree Tra_stTII Tra_stTSC /end OUT_MEASUREMENT
 FUNCTION_VERSION "2.0.0" /end FUNCTION
/begin FUNCTION PwmHal "1.14.0" FUNCTION_VERSION "1.14.0" /end FUNCTION
/begin FUNCTION PwmIn "1.14.0" FUNCTION_VERSION "1.14.0" /end FUNCTION
/begin FUNCTION PwmOut "1.14.0" FUNCTION_VERSION "1.14.0" /end FUNCTION
/begin FUNCTION Pwr "1.14.0" FUNCTION_VERSION "1.14.0" /end FUNCTION
/begin FUNCTION Reg "1.11.0" FUNCTION_VERSION "1.11.0" /end FUNCTION
/begin FUNCTION Reset "1.11.0"
 /begin DEF_CHARACTERISTIC Reset_rstFlMRErrBuf_C Reset_rstHistBuf_C Reset_rstTrapErrIntrBuf_C Reset_xGrpId_C Reset_xTrgId_C /end DEF_CHARACTERISTIC
 /begin OUT_MEASUREMENT Reset_Env.adLoc Reset_Env.xUserValue Reset_Env.xId Reset_Env.xGrp Reset_Env.ctRst Reset_FlMRErrBuf Reset_TrapErrIntrBuf Reset_xHistBuf /end OUT_MEASUREMENT
 FUNCTION_VERSION "1.11.0" /end FUNCTION
/begin FUNCTION RKTE "1.6.0"
 /begin DEF_CHARACTERISTIC CWPKAPP DTEMN FKKVS FRKEZAP FRLFSDP KRKATE PSAPES TEMN TEMNVA TVUBAT ZYLCRKMN ZYLCRKMX /end DEF_CHARACTERISTIC
 /begin IN_MEASUREMENT B_stendes B_va evz_austot nmot_w ps_w pu_w rk_l rk_w ubsq /end IN_MEASUREMENT
 /begin OUT_MEASUREMENT B_temin dppk_w dpus_w dtemnkt_w fkrk_w frkate_w frlfs_w tef_w tez_l te_l tvub_w /end OUT_MEASUREMENT
 /begin LOC_MEASUREMENT ftek_w tevfak_w tevfa_l /end LOC_MEASUREMENT
 FUNCTION_VERSION "1.6.0" /end FUNCTION
/begin FUNCTION Rtmo "1.7.0"
 /begin DEF_CHARACTERISTIC Rtmo_adCalling_u32 Rtmo_adData_u32 Rtmo_stSampleTime_u8 Rtmo_swLoadMode_u8 Rtmo_swMode_u8 Rtmo_tiIntOverhead_Tick Rtmo_tiOverhead_Tick /end DEF_CHARACTERISTIC
 /begin OUT_MEASUREMENT Rtmo_ctInterrupt_u16 Rtmo_ctReentrantSample_u32 Rtmo_ctSampleProc_u8 Rtmo_ctSample_u16 Rtmo_flState_u8 Rtmo_tiAvrg_Tick Rtmo_tiLoad_u16 Rtmo_tiMaxCalldist_Tick Rtmo_tiMaxLoadRun_u16 Rtmo_tiMaxLoad_u16 Rtmo_tiMax_Tick Rtmo_tiMinCalldist_Tick Rtmo_tiMin_Tick Rtmo_tiSampleDuration_Tick /end OUT_MEASUREMENT
 FUNCTION_VERSION "1.7.0" /end FUNCTION
/begin FUNCTION SHPOT "1.0.0"
 /begin DEF_CHARACTERISTIC AUTOGANG DWDSH FKODASH FVDASHM KFMIDSH0 KFMIDSH1 KFMIDSH2 KFMIDSH3 MIDSHMN ZDSH1GS ZDSHGS /end DEF_CHARACTERISTIC
 /begin IN_MEASUREMENT B_autget B_gawec B_nmot B_sa B_stend B_vnull dwdkba_w gsdat mdko nmot tmot wdkba /end IN_MEASUREMENT
 /begin OUT_MEASUREMENT B_dash midash midash_w /end OUT_MEASUREMENT
 /begin LOC_MEASUREMENT B_initf iwdkba midshfz_w midshf_w midsh_old_w midsh_w zzdsh1gs zzdshgs /end LOC_MEASUREMENT
 FUNCTION_VERSION "1.0.0" /end FUNCTION
/begin FUNCTION SIA_Core "18.1.0" FUNCTION_VERSION "18.1.0" /end FUNCTION
/begin FUNCTION SIA_EMSIFC "18.1.0"
 /begin OUT_MEASUREMENT Sia_bFlPmpLck Sia_bFshPrgLck Sia_bIgnLck Sia_bInjLck Sia_bStaLck Sia_bThrVlvLck /end OUT_MEASUREMENT
 /begin LOC_MEASUREMENT B_ecudev /end LOC_MEASUREMENT
 FUNCTION_VERSION "18.1.0" /end FUNCTION
/begin COMPU_METHOD B_TRUE "" TAB_VERB "%6.3" "" COMPU_TAB_REF B_TRUE /end COMPU_METHOD
/begin COMPU_VTAB B_TRUE "" TAB_VERB 2 0 "----" 1 "TRUE" /end COMPU_VTAB
/begin COMPU_METHOD DEZ "" RAT_FUNC "%6.2" "" COEFFS 0 1 0 0 0 1 /end COMPU_METHOD
/begin COMPU_METHOD dez "" RAT_FUNC "%6.2" "" COEFFS 0 1 0 0 0 1 /end COMPU_METHOD
/begin COMPU_METHOD DtyCyc "" RAT_FUNC "%6.4" "%" COEFFS 0 100 0 0 0 1 /end COMPU_METHOD
/begin COMPU_METHOD EngN "" RAT_FUNC "%6.3" "rpm" COEFFS 0 2 0 0 0 1 /end COMPU_METHOD
/begin COMPU_METHOD fak_q0p0009766 "" RAT_FUNC "%6.5" "-" COEFFS 0 65536 0 0 0 64 /end COMPU_METHOD
/begin COMPU_METHOD fak_ub_b1 "" RAT_FUNC "%6.4" "-" COEFFS 0 256 0 0 0 1 /end COMPU_METHOD
/begin COMPU_METHOD fak_ub_b2 "" RAT_FUNC "%8.5" "-" COEFFS 0 256 0 0 0 2 /end COMPU_METHOD
/begin COMPU_METHOD fak_ub_b8 "" RAT_FUNC "%6.4" "-" COEFFS 0 256 0 0 0 8 /end COMPU_METHOD
/begin COMPU_METHOD fak_uw_b2 "" RAT_FUNC "%7.6" "-" COEFFS 0 65536 0 0 0 2 /end COMPU_METHOD
/begin COMPU_METHOD fak_uw_b4 "" RAT_FUNC "%7.6" "-" COEFFS 0 65536 0 0 0 4 /end COMPU_METHOD
/begin COMPU_METHOD kw_q0p0019 "" RAT_FUNC "%6.4" "Grad KW" COEFFS 0 512 0 0 0 1 /end COMPU_METHOD
/begin COMPU_METHOD kw_q0p0078 "" RAT_FUNC "%6.4" "Grad KW" COEFFS 0 128 0 0 0 1 /end COMPU_METHOD
/begin COMPU_METHOD kw_q0p5 "" RAT_FUNC "%6.3" "Grad KW" COEFFS 0 2 0 0 0 1 /end COMPU_METHOD
/begin COMPU_METHOD md_q0p1 "" RAT_FUNC "%6.3" "Nm" COEFFS 0 10 0 0 0 1 /end COMPU_METHOD
/begin COMPU_METHOD MILLmp_ReqVerb "" TAB_VERB "%6.3" "" COMPU_TAB_REF MILLmp_ReqVerb /end COMPU_METHOD
/begin COMPU_VTAB MILLmp_ReqVerb "" TAB_VERB 256 0 "---|---|---|---|---|---|---|---" 1 "---|---|---|---|---|---|---|FES" 2 "---|---|---|---|---|---|DMD|---" 3 "---|---|---|---|---|---|DMD|FES" 4 "---|---|---|---|---|TRA|---|---" 5 "---|---|---|---|---|TRA|---|FES" 6 "---|---|---|---|---|TRA|DMD|---" 7 "---|---|---|---|---|TRA|DMD|FES" 8 "---|---|---|---|ECU1|---|---|---" 9 "---|---|---|---|ECU1|---|---|FES" 10 "---|---|---|---|ECU1|---|DMD|---" 11 "---|---|---|---|ECU1|---|DMD|FES" 12 "---|---|---|---|ECU1|TRA|---|---" 13 "---|---|---|---|ECU1|TRA|---|FES" 14 "---|---|---|---|ECU1|TRA|DMD|---" 15 "---|---|---|---|ECU1|TRA|DMD|FES" 16 "---|---|---|ECU2|---|---|---|---" 17 "---|---|---|ECU2|---|---|---|FES" 18 "---|---|---|ECU2|---|---|DMD|---" 19 "---|---|---|ECU2|---|---|DMD|FES" 20 "---|---|---|ECU2|---|TRA|---|---" 21 "---|---|---|ECU2|---|TRA|---|FES" 22 "---|---|---|ECU2|---|TRA|DMD|---" 23 "---|---|---|ECU2|---|TRA|DMD|FES" 24 "---|---|---|ECU2|ECU1|---|---|---" 25 "---|---|---|ECU2|ECU1|---|---|FES" 26 "---|---|---|ECU2|ECU1|---|DMD|---" 27 "---|---|---|ECU2|ECU1|---|DMD|FES" 28 "---|---|---|ECU2|ECU1|TRA|---|---" 29 "---|---|---|ECU2|ECU1|TRA|---|FES" 30 "---|---|---|ECU2|ECU1|TRA|DMD|---" 31 "---|---|---|ECU2|ECU1|TRA|DMD|FES" 32 "---|---|ECU3|---|---|---|---|---" 33 "---|---|ECU3|---|---|---|---|FES" 34 "---|---|ECU3|---|---|---|DMD|---" 35 "---|---|ECU3|---|---|---|DMD|FES" 36 "---|---|ECU3|---|---|TRA|---|---" 37 "---|---|ECU3|---|---|TRA|---|FES" 38 "---|---|ECU3|---|---|TRA|DMD|---" 39 "---|---|ECU3|---|---|TRA|DMD|FES" 40 "---|---|ECU3|---|ECU1|---|---|---" 41 "---|---|ECU3|---|ECU1|---|---|FES" 42 "---|---|ECU3|---|ECU1|---|DMD|---" 43 "---|---|ECU3|---|ECU1|---|DMD|FES" 44 "---|---|ECU3|---|ECU1|TRA|---|---" 45 "---|---|ECU3|---|ECU1|TRA|---|FES" 46 "---|---|ECU3|---|ECU1|TRA|DMD|---" 47 "---|---|ECU3|---|ECU1|TRA|DMD|FES" 48 "---|---|ECU3|ECU2|---|---|---|---" 49 "---|---|ECU3|ECU2|---|---|---|FES" 50 "---|---|ECU3|ECU2|---|---|DMD|---" 51 "---|---|ECU3|ECU2|---|---|DMD|FES" 52 "---|---|ECU3|ECU2|---|TRA|---|---" 53 "---|---|ECU3|ECU2|---|TRA|---|FES" 54 "---|---|ECU3|ECU2|---|TRA|DMD|---" 55 "---|---|ECU3|ECU2|---|TRA|DMD|FES" 56 "---|---|ECU3|ECU2|ECU1|---|---|---" 57 "---|---|ECU3|ECU2|ECU1|---|---|FES" 58 "---|---|ECU3|ECU2|ECU1|---|DMD|---" 59 "---|---|ECU3|ECU2|ECU1|---|DMD|FES" 60 "---|---|ECU3|ECU2|ECU1|TRA|---|---" 61 "---|---|ECU3|ECU2|ECU1|TRA|---|FES" 62 "---|---|ECU3|ECU2|ECU1|TRA|DMD|---" 63 "---|---|ECU3|ECU2|ECU1|TRA|DMD|FES" 64 "---|ECU4|---|---|---|---|---|---" 65 "---|ECU4|---|---|---|---|---|FES" 66 "---|ECU4|---|---|---|---|DMD|---" 67 "---|ECU4|---|---|---|---|DMD|FES" 68 "---|ECU4|---|---|---|TRA|---|---" 69 "---|ECU4|---|---|---|TRA|---|FES" 70 "---|ECU4|---|---|---|TRA|DMD|---" 71 "---|ECU4|---|---|---|TRA|DMD|FES" 72 "---|ECU4|---|---|ECU1|---|---|---" 73 "---|ECU4|---|---|ECU1|---|---|FES" 74 "---|ECU4|---|---|ECU1|---|DMD|---" 75 "---|ECU4|---|---|ECU1|---|DMD|FES" 76 "---|ECU4|---|---|ECU1|TRA|---|---" 77 "---|ECU4|---|---|ECU1|TRA|---|FES" 78 "---|ECU4|---|---|ECU1|TRA|DMD|---" 79 "---|ECU4|---|---|ECU1|TRA|DMD|FES" 80 "---|ECU4|---|ECU2|---|---|---|---" 81 "---|ECU4|---|ECU2|---|---|---|FES" 82 "---|ECU4|---|ECU2|---|---|DMD|---" 83 "---|ECU4|---|ECU2|---|---|DMD|FES" 84 "---|ECU4|---|ECU2|---|TRA|---|---" 85 "---|ECU4|---|ECU2|---|TRA|---|FES" 86 "---|ECU4|---|ECU2|---|TRA|DMD|---" 87 "---|ECU4|---|ECU2|---|TRA|DMD|FES" 88 "---|ECU4|---|ECU2|ECU1|---|---|---" 89 "---|ECU4|---|ECU2|ECU1|---|---|FES" 90 "---|ECU4|---|ECU2|ECU1|---|DMD|---" 91 "---|ECU4|---|ECU2|ECU1|---|DMD|FES" 92 "---|ECU4|---|ECU2|ECU1|TRA|---|---" 93 "---|ECU4|---|ECU2|ECU1|TRA|---|FES" 94 "---|ECU4|---|ECU2|ECU1|TRA|DMD|---" 95 "---|ECU4|---|ECU2|ECU1|TRA|DMD|FES" 96 "---|ECU4|ECU3|---|---|---|---|---" 97 "---|ECU4|ECU3|---|---|---|---|FES" 98 "---|ECU4|ECU3|---|---|---|DMD|---" 99 "---|ECU4|ECU3|---|---|---|DMD|FES" 100 "---|ECU4|ECU3|---|---|TRA|---|---" 101 "---|ECU4|ECU3|---|---|TRA|---|FES" 102 "---|ECU4|ECU3|---|---|TRA|DMD|---" 103 "---|ECU4|ECU3|---|---|TRA|DMD|FES" 104 "---|ECU4|ECU3|---|ECU1|---|---|---" 105 "---|ECU4|ECU3|---|ECU1|---|---|FES" 106 "---|ECU4|ECU3|---|ECU1|---|DMD|---" 107 "---|ECU4|ECU3|---|ECU1|---|DMD|FES" 108 "---|ECU4|ECU3|---|ECU1|TRA|---|---" 109 "---|ECU4|ECU3|---|ECU1|TRA|---|FES" 110 "---|ECU4|ECU3|---|ECU1|TRA|DMD|---" 111 "---|ECU4|ECU3|---|ECU1|TRA|DMD|FES" 112 "---|ECU4|ECU3|ECU2|---|---|---|---" 113 "---|ECU4|ECU3|ECU2|---|---|---|FES" 114 "---|ECU4|ECU3|ECU2|---|---|DMD|---" 115 "---|ECU4|ECU3|ECU2|---|---|DMD|FES" 116 "---|ECU4|ECU3|ECU2|---|TRA|---|---" 117 "---|ECU4|ECU3|ECU2|---|TRA|---|FES" 118 "---|ECU4|ECU3|ECU2|---|TRA|DMD|---" 119 "---|ECU4|ECU3|ECU2|---|TRA|DMD|FES" 120 "---|ECU4|ECU3|ECU2|ECU1|---|---|---" 121 "---|ECU4|ECU3|ECU2|ECU1|---|---|FES" 122 "---|ECU4|ECU3|ECU2|ECU1|---|DMD|---" 123 "---|ECU4|ECU3|ECU2|ECU1|---|DMD|FES" 124 "---|ECU4|ECU3|ECU2|ECU1|TRA|---|---" 125 "---|ECU4|ECU3|ECU2|ECU1|TRA|---|FES" 126 "---|ECU4|ECU3|ECU2|ECU1|TRA|DMD|---" 127 "---|ECU4|ECU3|ECU2|ECU1|TRA|DMD|FES" 128 "SLV|---|---|---|---|---|---|---" 129 "SLV|---|---|---|---|---|---|FES" 130 "SLV|---|---|---|---|---|DMD|---" 131 "SLV|---|---|---|---|---|DMD|FES" 132 "SLV|---|---|---|---|TRA|---|---" 133 "SLV|---|---|---|---|TRA|---|FES" 134 "SLV|---|---|---|---|TRA|DMD|---" 135 "SLV|---|---|---|---|TRA|DMD|FES" 136 "SLV|---|---|---|ECU1|---|---|---" 137 "SLV|---|---|---|ECU1|---|---|FES" 138 "SLV|---|---|---|ECU1|---|DMD|---" 139 "SLV|---|---|---|ECU1|---|DMD|FES" 140 "SLV|---|---|---|ECU1|TRA|---|---" 141 "SLV|---|---|---|ECU1|TRA|---|FES" 142 "SLV|---|---|---|ECU1|TRA|DMD|---" 143 "SLV|---|---|---|ECU1|TRA|DMD|FES" 144 "SLV|---|---|ECU2|---|---|---|---" 145 "SLV|---|---|ECU2|---|---|---|FES" 146 "SLV|---|---|ECU2|---|---|DMD|---" 147 "SLV|---|---|ECU2|---|---|DMD|FES" 148 "SLV|---|---|ECU2|---|TRA|---|---" 149 "SLV|---|---|ECU2|---|TRA|---|FES" 150 "SLV|---|---|ECU2|---|TRA|DMD|---" 151 "SLV|---|---|ECU2|---|TRA|DMD|FES" 152 "SLV|---|---|ECU2|ECU1|---|---|---" 153 "SLV|---|---|ECU2|ECU1|---|---|FES" 154 "SLV|---|---|ECU2|ECU1|---|DMD|---" 155 "SLV|---|---|ECU2|ECU1|---|DMD|FES" 156 "SLV|---|---|ECU2|ECU1|TRA|---|---" 157 "SLV|---|---|ECU2|ECU1|TRA|---|FES" 158 "SLV|---|---|ECU2|ECU1|TRA|DMD|---" 159 "SLV|---|---|ECU2|ECU1|TRA|DMD|FES" 160 "SLV|---|ECU3|---|---|---|---|---" 161 "SLV|---|ECU3|---|---|---|---|FES" 162 "SLV|---|ECU3|---|---|---|DMD|---" 163 "SLV|---|ECU3|---|---|---|DMD|FES" 164 "SLV|---|ECU3|---|---|TRA|---|---" 165 "SLV|---|ECU3|---|---|TRA|---|FES" 166 "SLV|---|ECU3|---|---|TRA|DMD|---" 167 "SLV|---|ECU3|---|---|TRA|DMD|FES" 168 "SLV|---|ECU3|---|ECU1|---|---|---" 169 "SLV|---|ECU3|---|ECU1|---|---|FES" 170 "SLV|---|ECU3|---|ECU1|---|DMD|---" 171 "SLV|---|ECU3|---|ECU1|---|DMD|FES" 172 "SLV|---|ECU3|---|ECU1|TRA|---|---" 173 "SLV|---|ECU3|---|ECU1|TRA|---|FES" 174 "SLV|---|ECU3|---|ECU1|TRA|DMD|---" 175 "SLV|---|ECU3|---|ECU1|TRA|DMD|FES" 176 "SLV|---|ECU3|ECU2|---|---|---|---" 177 "SLV|---|ECU3|ECU2|---|---|---|FES" 178 "SLV|---|ECU3|ECU2|---|---|DMD|---" 179 "SLV|---|ECU3|ECU2|---|---|DMD|FES" 180 "SLV|---|ECU3|ECU2|---|TRA|---|---" 181 "SLV|---|ECU3|ECU2|---|TRA|---|FES" 182 "SLV|---|ECU3|ECU2|---|TRA|DMD|---" 183 "SLV|---|ECU3|ECU2|---|TRA|DMD|FES" 184 "SLV|---|ECU3|ECU2|ECU1|---|---|---" 185 "SLV|---|ECU3|ECU2|ECU1|---|---|FES" 186 "SLV|---|ECU3|ECU2|ECU1|---|DMD|---" 187 "SLV|---|ECU3|ECU2|ECU1|---|DMD|FES" 188 "SLV|---|ECU3|ECU2|ECU1|TRA|---|---" 189 "SLV|---|ECU3|ECU2|ECU1|TRA|---|FES" 190 "SLV|---|ECU3|ECU2|ECU1|TRA|DMD|---" 191 "SLV|---|ECU3|ECU2|ECU1|TRA|DMD|FES" 192 "SLV|ECU4|---|---|---|---|---|---" 193 "SLV|ECU4|---|---|---|---|---|FES" 194 "SLV|ECU4|---|---|---|---|DMD|---" 195 "SLV|ECU4|---|---|---|---|DMD|FES" 196 "SLV|ECU4|---|---|---|TRA|---|---" 197 "SLV|ECU4|---|---|---|TRA|---|FES" 198 "SLV|ECU4|---|---|---|TRA|DMD|---" 199 "SLV|ECU4|---|---|---|TRA|DMD|FES" 200 "SLV|ECU4|---|---|ECU1|---|---|---" 201 "SLV|ECU4|---|---|ECU1|---|---|FES" 202 "SLV|ECU4|---|---|ECU1|---|DMD|---" 203 "SLV|ECU4|---|---|ECU1|---|DMD|FES" 204 "SLV|ECU4|---|---|ECU1|TRA|---|---" 205 "SLV|ECU4|---|---|ECU1|TRA|---|FES" 206 "SLV|ECU4|---|---|ECU1|TRA|DMD|---" 207 "SLV|ECU4|---|---|ECU1|TRA|DMD|FES" 208 "SLV|ECU4|---|ECU2|---|---|---|---" 209 "SLV|ECU4|---|ECU2|---|---|---|FES" 210 "SLV|ECU4|---|ECU2|---|---|DMD|---" 211 "SLV|ECU4|---|ECU2|---|---|DMD|FES" 212 "SLV|ECU4|---|ECU2|---|TRA|---|---" 213 "SLV|ECU4|---|ECU2|---|TRA|---|FES" 214 "SLV|ECU4|---|ECU2|---|TRA|DMD|---" 215 "SLV|ECU4|---|ECU2|---|TRA|DMD|FES" 216 "SLV|ECU4|---|ECU2|ECU1|---|---|---" 217 "SLV|ECU4|---|ECU2|ECU1|---|---|FES" 218 "SLV|ECU4|---|ECU2|ECU1|---|DMD|---" 219 "SLV|ECU4|---|ECU2|ECU1|---|DMD|FES" 220 "SLV|ECU4|---|ECU2|ECU1|TRA|---|---" 221 "SLV|ECU4|---|ECU2|ECU1|TRA|---|FES" 222 "SLV|ECU4|---|ECU2|ECU1|TRA|DMD|---" 223 "SLV|ECU4|---|ECU2|ECU1|TRA|DMD|FES" 224 "SLV|ECU4|ECU3|---|---|---|---|---" 225 "SLV|ECU4|ECU3|---|---|---|---|FES" 226 "SLV|ECU4|ECU3|---|---|---|DMD|---" 227 "SLV|ECU4|ECU3|---|---|---|DMD|FES" 228 "SLV|ECU4|ECU3|---|---|TRA|---|---" 229 "SLV|ECU4|ECU3|---|---|TRA|---|FES" 230 "SLV|ECU4|ECU3|---|---|TRA|DMD|---" 231 "SLV|ECU4|ECU3|---|---|TRA|DMD|FES" 232 "SLV|ECU4|ECU3|---|ECU1|---|---|---" 233 "SLV|ECU4|ECU3|---|ECU1|---|---|FES" 234 "SLV|ECU4|ECU3|---|ECU1|---|DMD|---" 235 "SLV|ECU4|ECU3|---|ECU1|---|DMD|FES" 236 "SLV|ECU4|ECU3|---|ECU1|TRA|---|---" 237 "SLV|ECU4|ECU3|---|ECU1|TRA|---|FES" 238 "SLV|ECU4|ECU3|---|ECU1|TRA|DMD|---" 239 "SLV|ECU4|ECU3|---|ECU1|TRA|DMD|FES" 240 "SLV|ECU4|ECU3|ECU2|---|---|---|---" 241 "SLV|ECU4|ECU3|ECU2|---|---|---|FES" 242 "SLV|ECU4|ECU3|ECU2|---|---|DMD|---" 243 "SLV|ECU4|ECU3|ECU2|---|---|DMD|FES" 244 "SLV|ECU4|ECU3|ECU2|---|TRA|---|---" 245 "SLV|ECU4|ECU3|ECU2|---|TRA|---|FES" 246 "SLV|ECU4|ECU3|ECU2|---|TRA|DMD|---" 247 "SLV|ECU4|ECU3|ECU2|---|TRA|DMD|FES" 248 "SLV|ECU4|ECU3|ECU2|ECU1|---|---|---" 249 "SLV|ECU4|ECU3|ECU2|ECU1|---|---|FES" 250 "SLV|ECU4|ECU3|ECU2|ECU1|---|DMD|---" 251 "SLV|ECU4|ECU3|ECU2|ECU1|---|DMD|FES" 252 "SLV|ECU4|ECU3|ECU2|ECU1|TRA|---|---" 253 "SLV|ECU4|ECU3|ECU2|ECU1|TRA|---|FES" 254 "SLV|ECU4|ECU3|ECU2|ECU1|TRA|DMD|---" 255 "SLV|ECU4|ECU3|ECU2|ECU1|TRA|DMD|FES" /end COMPU_VTAB
/begin COMPU_METHOD MILLmp_StVerb "" TAB_VERB "%6.3" "" COMPU_TAB_REF MILLmp_StVerb /end COMPU_METHOD
/begin COMPU_VTAB MILLmp_StVerb "" TAB_VERB 6 0 "Init_State" 17 "PreStart_VisTest" 33 "PreStart_RdnBln" 65 "PreStart_WaitForStart" 2 "AfterStart" 4 "Cruising" /end COMPU_VTAB
/begin COMPU_METHOD m_uw_b6553p5 "" RAT_FUNC "%6.3" "kg/h" COEFFS 0 1 0 0 0 0.1 /end COMPU_METHOD
/begin COMPU_METHOD nmot_q10 "" RAT_FUNC "%6.1" "1/min" COEFFS 0 1 0 0 0 10 /end COMPU_METHOD
/begin COMPU_METHOD nmot_q40 "" RAT_FUNC "%6.1" "1/min" COEFFS 0 1 0 0 0 40 /end COMPU_METHOD
/begin COMPU_METHOD nmot_sw_q0p25 "" RAT_FUNC "%6.3" "1/min" COEFFS 0 1 0 0 0 0.25 /end COMPU_METHOD
/begin COMPU_METHOD nmot_ub_q10 "" RAT_FUNC "%6.1" "1/min" COEFFS 0 1 0 0 0 10 /end COMPU_METHOD
/begin COMPU_METHOD nmot_ub_q40 "" RAT_FUNC "%6.1" "1/min" COEFFS 0 1 0 0 0 40 /end COMPU_METHOD
/begin COMPU_METHOD nmot_uw_q0p25 "" RAT_FUNC "%6.3" "1/min" COEFFS 0 1 0 0 0 0.25 /end COMPU_METHOD
/begin COMPU_METHOD OneToOne "" RAT_FUNC "%6.2" "-" COEFFS 0 1 0 0 0 1 /end COMPU_METHOD
/begin COMPU_METHOD Prc "" RAT_FUNC "%6.4" "%" COEFFS 0 81.92 0 0 0 1 /end COMPU_METHOD
/begin COMPU_METHOD p_sw_q0p078 "" RAT_FUNC "%6.4" "hPa" COEFFS 0 65536 0 0 0 5120 /end COMPU_METHOD
/begin COMPU_METHOD p_sw_q0p312 "" RAT_FUNC "%6.3" "hPa" COEFFS 0 256 0 0 0 80 /end COMPU_METHOD
/begin COMPU_METHOD p_uw_q0p039 "" RAT_FUNC "%6.4" "hPa" COEFFS 0 256 0 0 0 10 /end COMPU_METHOD
/begin COMPU_METHOD relDK_q0p02441 "" RAT_FUNC "%6.4" "%DK" COEFFS 0 65536 0 0 0 1600 /end COMPU_METHOD
/begin COMPU_METHOD relDK_ub_b100 "" RAT_FUNC "%6.3" "%DK" COEFFS 0 255 0 0 0 100 /end COMPU_METHOD
/begin COMPU_METHOD relnmot_q0p0039 "" RAT_FUNC "%6.4" "%/(1/min)" COEFFS 0 256 0 0 0 1 /end COMPU_METHOD
/begin COMPU_METHOD relnmot_q0p02 "" RAT_FUNC "%6.4" "%/(1/min)/s" COEFFS 0 1 0 0 0 0.02 /end COMPU_METHOD
/begin COMPU_METHOD relPED_ub_b100 "" RAT_FUNC "%6.3" "%PED" COEFFS 0 255 0 0 0 100 /end COMPU_METHOD
/begin COMPU_METHOD rel_q0p012207 "" RAT_FUNC "%6.4" "%" COEFFS 0 8192 0 0 0 100 /end COMPU_METHOD
/begin COMPU_METHOD rel_q0p75 "" RAT_FUNC "%6.3" "%" COEFFS 0 4 0 0 0 3 /end COMPU_METHOD
/begin COMPU_METHOD rel_sw_b100 "" RAT_FUNC "%6.4" "%" COEFFS 0 32768 0 0 0 100 /end COMPU_METHOD
/begin COMPU_METHOD rel_ub_b100 "" RAT_FUNC "%6.3" "%" COEFFS 0 256 0 0 0 100 /end COMPU_METHOD
/begin COMPU_METHOD rel_ub_b99p6 "" RAT_FUNC "%6.3" "%" COEFFS 0 256 0 0 0 100 /end COMPU_METHOD
/begin COMPU_METHOD rel_ub_q0p3906 "" RAT_FUNC "%6.3" "%" COEFFS 0 256 0 0 0 100 /end COMPU_METHOD
/begin COMPU_METHOD rel_uw_b100 "" RAT_FUNC "%6.4" "%" COEFFS 0 65536 0 0 0 100 /end COMPU_METHOD
/begin COMPU_METHOD Reset_GrpID "" TAB_VERB "%6.3" "" COMPU_TAB_REF Reset_GrpID /end COMPU_METHOD
/begin COMPU_VTAB Reset_GrpID "" TAB_VERB 31 0 "SWRESET_GRP_POWERON_E" 1 "SWRESET_GRP_HWRESET_E" 2 "SWRESET_GRP_WDT_E" 3 "SWRESET_GRP_WAKEUP_E" 4 "SWRESET_GRP_TRAP_E" 5 "SWRESET_GRP_SB_E" 6 "SWRESET_GRP_CB_E" 7 "SWRESET_SOFTRESETGRP_E" 8 "SWRESET_GRP_DUMMY_01" 9 "SWRESET_GRP_DUMMY_02" 10 "SWRESET_GRP_DUMMY_03" 11 "RESET_CANGRP_E" 12 "RESET_EEP_GRP_E" 13 "RESET_SWRESET_EPM_E" 14 "RESET_SWRESET_ESC_E" 15 "RESET_EXECON_GRP_E" 16 "RESET_SWRESET_ASW_01" 17 "SWRESET_GRP_MO_PREICO" 18 "RESET_SWRESET_MOC" 19 "RESET_SWRESET_SOP" 20 "SWRESET_OCWDA" 21 "RESET_SWRESET_OS_01" 22 "RESET_HWEMONGRP_E" 23 "RESET_ERRINTRGRP_E" 24 "SWRESET_SYCGRP_E" 25 "RESET_SWRESET_TPROT" 26 "SWRESET_UNSUPPORTED_CPU_E" 27 "RESET_ADCI_E" 28 "RESET_DMA_E" 29 "RESET_FLASH_E" 30 "SWRESET_PCP_GRP_E" /end COMPU_VTAB
/begin COMPU_METHOD Reset_ID "" TAB_VERB "%6.3" "" COMPU_TAB_REF Reset_ID /end COMPU_METHOD
/begin COMPU_VTAB Reset_ID "" TAB_VERB 132 0 "SWRESET_POWERON_E" 1 "SWRESET_POWERON_WDT_E" 2 "SWRESET_POWERON_KL15_E" 3 "SWRESET_HW_E" 4 "SWRESET_WDT_E" 4096 "TRAP_MMU_VAF_E" 4097 "TRAP_MMU_VAP_E" 4098 "TRAP_INTPROT_PRIV_E" 4099 "TRAP_INTPROT_MPR_E" 4100 "TRAP_INTPROT_MPW_E" 4101 "TRAP_INTPROT_MPX_E" 4102 "TRAP_INTPROT_MPP_E" 4103 "TRAP_INTPROT_MPN_E" 4104 "TRAP_INTPROT_GRWP_E" 4105 "TRAP_INSTRERR_IOPC_E" 4106 "TRAP_INSTRERR_UOPC_E" 4107 "TRAP_INSTRERR_OPD_E" 4108 "TRAP_INSTRERR_ALN_E" 4109 "TRAP_INSTRERR_MEM_E" 4110 "TRAP_CONTMANA_FCD_E" 4111 "TRAP_CONTMANA_CDO_E" 4112 "TRAP_CONTMANA_CDU_E" 4113 "TRAP_CONTMANA_FCU_E" 4114 "TRAP_CONTMANA_CSU_E" 4115 "TRAP_CONTMANA_CTYP_E" 4116 "TRAP_CONTMANA_NEST_E" 4117 "TRAP_SYSBUSERR_PSE_E" 4118 "TRAP_SYSBUSERR_DSE_E" 4119 "TRAP_SYSBUSERR_DAE_E" 4120 "TRAP_SYSBUSERR_CAE_E" 4121 "TRAP_SYSBUSERR_PIE_E" 4122 "TRAP_SYSBUSERR_DIE_E" 4123 "TRAP_ASSTRAP_OVF_E" 4124 "TRAP_ASSTRAP_SOVF_E" 4125 "TRAP_SYSCALL_SYS_E" 4126 "TRAP_NMI_ESR0_E" 4127 "TRAP_NMI_ESR1_E" 4128 "TRAP_NMI_RES0_E" 4129 "TRAP_NMI_WDT_E" 4130 "TRAP_NMI_PE_E" 4131 "TRAP_NMI_OSCLWD_E" 4132 "TRAP_NMI_OSCHWD_E" 4133 "TRAP_NMI_OSCSPWD_E" 4134 "TRAP_NMI_SYSVCOLCK_E" 4135 "TRAP_NMI_ERAYVCOLCKT" 4136 "TRAP_NMI_FLOT_E" 8192 "SWRESET_POWERON_SIMU_E" 8193 "SWRESET_HRESET_SIMU_E" 8194 "SWRESET_RB_PROG_E" 8195 "SWRESET_SOFTRESET_5VUNDERVOLTAGE_E" 8196 "SWRESET_SOFTRESET_POSTDRV2PREDRV_E" 8197 "SWRESET_CBPROG_E" 8198 "SWRESET_CBCPU_E" 8199 "SWRESET_SBDUMMY_1_E" 8200 "SWRESET_SBDUMMY_2_E" 8201 "SWRESET_SBDUMMY_3_E" 8202 "SWRESET_SBDUMMY_4_E" 8203 "SWRESET_SBDUMMY_5_E" 8204 "SWRESET_SBDUMMY_6_E" 8205 "SWRESET_SBDUMMY_7_E" 8206 "SWRESET_SBDUMMY_8_E" 12288 "SWRST_CAN_MESSAGECONFIG" 12289 "SWRST_EEPBANDGAP_E" 12290 "SWRST_EEPNODEBUGGER_E" 12291 "SWRST_EEPDELENVRAM_E" 12292 "SWRST_WRITE_ERRORS_SECTORCHANGE_E" 12293 "SWRST_EEPACTFIRSTINIT_E" 12294 "RESET_SWRESET_EPMHCRS_WAIT_PCP_RESET_E" 12295 "RESET_SWRESET_ESC_SCHED_RESET_E" 12296 "SWRST_EXECON_FAULTYSTATE_E" 12297 "RESET_SWRESET_ILLEGAL_OPCODE" 12298 "RESET_SWRESET_ILLEGAL_RETURN_TO_MAIN" 12299 "SWRESET_MOCADCNTP_PREICO" 12300 "SWRESET_MOCADCTST_PREICO" 12301 "RESET_SWRESET_ILLEGAL_SW_PATH" 12302 "RESET_SWRESET_MOCCOM_SPI_ERROR" 12303 "RESET_SWRESET_MOCCOM_CTSOPTST" 12304 "RESET_SWRESET_MOCCOM_SOPTST" 12305 "RESET_SWRESET_MOCCOM_CPLCHK_FAILED" 12306 "RESET_SWRESET_MOCCOM_OS_TIMEOUT_ERROR" 12307 "RESET_SWRESET_MOCGPTA" 12308 "RESET_SWRESET_MOCMEM_CPL" 12309 "RESET_SWRESET_MOCMEM_RAM" 12310 "RESET_SWRESET_MOCMEM_ROM" 12311 "RESET_SWRESET_MOCPCP" 12312 "RESET_SWRESET_MOCRAM_WRI" 12313 "RESET_SWRESET_MOCRAM_CPL" 12314 "RESET_SWRESET_MOCRAM_RAMTAB" 12315 "RESET_SWRESET_MOCRAM_RSTPTRRAM" 12316 "RESET_SWRESET_MOCRAM_STACKRAM" 12317 "RESET_SWRESET_MOCRAM_CSARAM" 12318 "RESET_SWRESET_MOCRAM_XRAM" 12319 "RESET_SWRESET_MOCRAM_IRAM" 12320 "RESET_SWRESET_MOCRAM_EXRAM" 12321 "RESET_SWRESET_MOCRAM_PROTRAM" 12322 "RESET_SWRESET_MOCRAM_EEPCPL" 12323 "RESET_SWRESET_MOCRAM_REPEXOK" 12324 "RESET_SWRESET_MOCROM" 12325 "RESET_SWRESET_MOCROM_CPL" 12326 "RESET_SWRESET_MOCROM_INDEX" 12327 "RESET_SWRESET_MOCROM_WD" 12328 "RESET_SWRESET_SOPTEST_FAILED" 12329 "RESET_SWRESET_CPLCHK_FAILED" 12330 "RESET_SWRESET_MOCSOP_MSC_ERROR" 12331 "RESET_SWRESET_MOCSOP_SPI_ERROR" 12332 "RESET_SWRESET_MOCSOP_OS_TIMEOUT_ERROR" 12333 "RESET_SWRESET_MOCSOP_TIRESPTIME_ERROR" 12334 "SWRESET_OCWDA_WDA_ACTV" 12335 "SWRESET_OCWDA_WDA_MONITOR" 12336 "SWRESET_OCWDA_LOW_VLTG" 12337 "SWRESET_OCWDA_OVR_VLTG" 12338 "RESET_SWRESET_INTERRUPTLOCK_EXPECTED" 12339 "RESET_USERSTACKOVERFLOW_DETECTED" 12340 "SWRST_HWEMONDEFAULT_E" 12341 "RESET_ERRINTR_E" 12342 "SWRESET_CALWAKEUP_E" 12343 "SWRESET_DEADLINE1MS_E" 12344 "SWRESET_DEADLINE10MS_E" 12345 "SWRESET_DEADLINEBG_E" 12346 "SWRESET_NMIDISABLED_E" 12347 "SWRESET_POSTDRIVE_E" 12348 "SWRESET_UNEXPSYCSTSUB_E" 12349 "SWRESET_SOFTRESET_WAKEUP_E" 12350 "SWRESET_SOFTRESET_SHUTDOWN_E" 12351 "SWRESET_T15RSTSHUTDOWN_E" 12352 "SWRESET_UNDERVOLTAGE_E" 12353 "RESET_SWRESET_SWOVER_DONE" 12354 "SWRESET_CORE_ENV_E" 12355 "SWRST_ADCI_ERROR_E" 12356 "RESET_DMA_ERROR_E" 12357 "SWRST_FLASHCONFIG_E" 12358 "SWRESET_PCP_ERROR_E" /end COMPU_VTAB
/begin COMPU_METHOD rkti_q0p10416Em4 "" RAT_FUNC "%7.6" "ms/%" COEFFS 0 96000 0 0 0 1 /end COMPU_METHOD
/begin COMPU_METHOD rkti_q0p4166Em4 "" RAT_FUNC "%7.6" "ms/%" COEFFS 0 24000 0 0 0 1 /end COMPU_METHOD
/begin COMPU_METHOD Rtmo_Percent_u16 "" RAT_FUNC "%6.4" "%" COEFFS 0 65536 0 0 0 100 /end COMPU_METHOD
/begin COMPU_METHOD Rtmo_Time_us "" RAT_FUNC "%6.4" "us" COEFFS 0 80 0 0 0 1 /end COMPU_METHOD
/begin COMPU_METHOD spg_q0p00977 "" RAT_FUNC "%6.4" "V" COEFFS 0 256 0 0 0 2.5 /end COMPU_METHOD
/begin COMPU_METHOD spg_q0p1 "" RAT_FUNC "%6.3" "V" COEFFS 0 1 0 0 0 0.1 /end COMPU_METHOD
/begin COMPU_METHOD spg_q4p88_mV "" RAT_FUNC "%6.2" "mV" COEFFS 0 1024 0 0 0 5000 /end COMPU_METHOD
/begin COMPU_METHOD SY_MDBGV_Compu "" TAB_VERB "%6.3" "" COMPU_TAB_REF SY_MDBGV_Compu /end COMPU_METHOD
/begin COMPU_VTAB SY_MDBGV_Compu "" TAB_VERB 2 0 "False" 1 "True" /end COMPU_VTAB
/begin COMPU_METHOD SY_MDISTM_Compu "" TAB_VERB "%6.3" "" COMPU_TAB_REF SY_MDISTM_Compu /end COMPU_METHOD
/begin COMPU_VTAB SY_MDISTM_Compu "" TAB_VERB 2 0 "keine Modellierung eines mittleren Ist-Drehmomente" 1 "Bereitstellung eines mittleren Ist-Drehmomentes" /end COMPU_VTAB
/begin COMPU_METHOD SY_MDI_Compu "" TAB_VERB "%6.3" "" COMPU_TAB_REF SY_MDI_Compu /end COMPU_METHOD
/begin COMPU_VTAB SY_MDI_Compu "" TAB_VERB 2 0 "False" 1 "True" /end COMPU_VTAB
/begin COMPU_METHOD SY_MDKAR_Compu "" TAB_VERB "%6.3" "" COMPU_TAB_REF SY_MDKAR_Compu /end COMPU_METHOD
/begin COMPU_VTAB SY_MDKAR_Compu "" TAB_VERB 2 0 "False" 1 "True" /end COMPU_VTAB
/begin COMPU_METHOD SY_MDMXEXC_Compu "" TAB_VERB "%6.3" "" COMPU_TAB_REF SY_MDMXEXC_Compu /end COMPU_METHOD
/begin COMPU_VTAB SY_MDMXEXC_Compu "" TAB_VERB 2 0 "False" 1 "True" /end COMPU_VTAB
/begin COMPU_METHOD SY_MDSRL_Compu "" TAB_VERB "%6.3" "" COMPU_TAB_REF SY_MDSRL_Compu /end COMPU_METHOD
/begin COMPU_VTAB SY_MDSRL_Compu "" TAB_VERB 2 0 "False" 1 "True" /end COMPU_VTAB
/begin COMPU_METHOD SY_MISAFON_Compu "" TAB_VERB "%6.3" "" COMPU_TAB_REF SY_MISAFON_Compu /end COMPU_METHOD
/begin COMPU_VTAB SY_MISAFON_Compu "" TAB_VERB 2 0 "False" 1 "True" /end COMPU_VTAB
/begin COMPU_METHOD SY_MISAKOR_Compu "" TAB_VERB "%6.3" "" COMPU_TAB_REF SY_MISAKOR_Compu /end COMPU_METHOD
/begin COMPU_VTAB SY_MISAKOR_Compu "" TAB_VERB 4 0 "NoOffset" 1 "Offset_KFMISALFHO" 2 "Offset_KFMISALTMT" 3 "Offset_KFMISALFHO_TMT" /end COMPU_VTAB
/begin COMPU_METHOD SY_MOROM_Compu "" TAB_VERB "%6.3" "" COMPU_TAB_REF SY_MOROM_Compu /end COMPU_METHOD
/begin COMPU_VTAB SY_MOROM_Compu "" TAB_VERB 2 0 "False" 1 "True" /end COMPU_VTAB
/begin COMPU_METHOD SY_MSDKN_Compu "" TAB_VERB "%6.3" "" COMPU_TAB_REF SY_MSDKN_Compu /end COMPU_METHOD
/begin COMPU_VTAB SY_MSDKN_Compu "" TAB_VERB 2 0 "SY_MSDKN" 1 "SY_MSDKN" /end COMPU_VTAB
/begin COMPU_METHOD SY_MSGRED_Compu "" TAB_VERB "%6.3" "" COMPU_TAB_REF SY_MSGRED_Compu /end COMPU_METHOD
/begin COMPU_VTAB SY_MSGRED_Compu "" TAB_VERB 2 0 "SY_MSGRED" 1 "SY_MSGRED" /end COMPU_VTAB
/begin COMPU_METHOD SY_MSVKOMP_Compu "" TAB_VERB "%6.3" "" COMPU_TAB_REF SY_MSVKOMP_Compu /end COMPU_METHOD
/begin COMPU_VTAB SY_MSVKOMP_Compu "" TAB_VERB 6 0 "MSV-Ansteuerung Förderenderegelung, z.B. HDP2" 1 "MSV-Ansteuerung Förderbeginnregelung, z.B. Hitachi" 2 "MSV_DBCTR_PWM" 3 "MSV_SAC" 4 "MSV_Hitachi_Generation3" 5 "MSV_Hitachi_Generation1" /end COMPU_VTAB
/begin COMPU_METHOD SY_MTRXBLR_Compu "" TAB_VERB "%6.3" "" COMPU_TAB_REF SY_MTRXBLR_Compu /end COMPU_METHOD
/begin COMPU_VTAB SY_MTRXBLR_Compu "" TAB_VERB 2 0 "False" 1 "True" /end COMPU_VTAB
/begin COMPU_METHOD SY_MULCATI_Compu "" TAB_VERB "%6.3" "" COMPU_TAB_REF SY_MULCATI_Compu /end COMPU_METHOD
/begin COMPU_VTAB SY_MULCATI_Compu "" TAB_VERB 2 0 "False" 1 "True" /end COMPU_VTAB
/begin COMPU_METHOD SY_NG_Compu "" TAB_VERB "%6.3" "" COMPU_TAB_REF SY_NG_Compu /end COMPU_METHOD
/begin COMPU_VTAB SY_NG_Compu "" TAB_VERB 4 0 "SY_NG_0" 1 "SY_NG_1" 2 "SY_NG_2" 3 "SY_NG_3" /end COMPU_VTAB
/begin COMPU_METHOD SY_NLDG_Compu "" TAB_VERB "%6.3" "" COMPU_TAB_REF SY_NLDG_Compu /end COMPU_METHOD
/begin COMPU_VTAB SY_NLDG_Compu "" TAB_VERB 2 0 "keine Drehzahlgebernotlauf-Funktion aktiv" 1 "Drehzahlgebernotlauf-Funktion aktiv" /end COMPU_VTAB
/begin COMPU_METHOD SY_NLLKHFH_Compu "" TAB_VERB "%6.3" "" COMPU_TAB_REF SY_NLLKHFH_Compu /end COMPU_METHOD
/begin COMPU_VTAB SY_NLLKHFH_Compu "" TAB_VERB 2 0 "SY_NLLKHFH=0" 1 "SY_NLLKHFH=1" /end COMPU_VTAB
/begin COMPU_METHOD SY_NLZOFF_Compu "" TAB_VERB "%6.3" "" COMPU_TAB_REF SY_NLZOFF_Compu /end COMPU_METHOD
/begin COMPU_VTAB SY_NLZOFF_Compu "" TAB_VERB 2 0 "false" 1 "true" /end COMPU_VTAB
/begin COMPU_METHOD SY_NMAXEXT_Compu "" TAB_VERB "%6.3" "" COMPU_TAB_REF SY_NMAXEXT_Compu /end COMPU_METHOD
/begin COMPU_VTAB SY_NMAXEXT_Compu "" TAB_VERB 2 0 "false" 1 "true" /end COMPU_VTAB
/begin COMPU_METHOD SY_NMAXR_Compu "" TAB_VERB "%6.3" "" COMPU_TAB_REF SY_NMAXR_Compu /end COMPU_METHOD
/begin COMPU_VTAB SY_NMAXR_Compu "" TAB_VERB 4 1 "RED_CAL" 3 "FLX_CAL" 2 "TRIV_CAL" 0 "STD_CAL" /end COMPU_VTAB
/begin COMPU_METHOD SY_NMTYP_Compu "" TAB_VERB "%6.3" "" COMPU_TAB_REF SY_NMTYP_Compu /end COMPU_METHOD
/begin COMPU_VTAB SY_NMTYP_Compu "" TAB_VERB 5 0 "No networkmanagement" 1 "INM" 2 "DNM" 3 "NMHigh" 4 "AUTOSAR_NM" /end COMPU_VTAB
/begin COMPU_METHOD SY_NMXELBK_Compu "" TAB_VERB "%6.3" "" COMPU_TAB_REF SY_NMXELBK_Compu /end COMPU_METHOD
/begin COMPU_VTAB SY_NMXELBK_Compu "" TAB_VERB 2 0 "FALSE" 1 "TRUE" /end COMPU_VTAB
/begin COMPU_METHOD SY_NOHK2_Compu "" TAB_VERB "%6.3" "" COMPU_TAB_REF SY_NOHK2_Compu /end COMPU_METHOD
/begin COMPU_VTAB SY_NOHK2_Compu "" TAB_VERB 2 0 "kein NOx-Sensor hinter Kat in Bank2" 1 "NOx-Sensor hinter Kat in Bank2" /end COMPU_VTAB
/begin COMPU_METHOD SY_NOHK_Compu "" TAB_VERB "%6.3" "" COMPU_TAB_REF SY_NOHK_Compu /end COMPU_METHOD
/begin COMPU_VTAB SY_NOHK_Compu "" TAB_VERB 2 0 "kein NOx-Sensor hinter Kat" 1 "NOx-Sensor hinter Kat" /end COMPU_VTAB
/begin COMPU_METHOD SY_NOKT_Compu "" TAB_VERB "%6.3" "" COMPU_TAB_REF SY_NOKT_Compu /end COMPU_METHOD
/begin COMPU_VTAB SY_NOKT_Compu "" TAB_VERB 2 0 "no" 1 "dzwzk" /end COMPU_VTAB
/begin COMPU_METHOD SY_NOXKAT2_Compu "" TAB_VERB "%6.3" "" COMPU_TAB_REF SY_NOXKAT2_Compu /end COMPU_METHOD
/begin COMPU_VTAB SY_NOXKAT2_Compu "" TAB_VERB 2 0 "NOx-Speicherkat in Abgassystem nicht verbaut" 1 "NOx-Speicherkat in Abgassystem verbaut" /end COMPU_VTAB
/begin COMPU_METHOD SY_NOXKAT_Compu "" TAB_VERB "%6.3" "" COMPU_TAB_REF SY_NOXKAT_Compu /end COMPU_METHOD
/begin COMPU_VTAB SY_NOXKAT_Compu "" TAB_VERB 2 0 "kein NOx-Speicherkat vorhanden" 1 "NOx-Speicherkat vorhanden" /end COMPU_VTAB
/begin COMPU_METHOD SY_NSAC_Compu "" RAT_FUNC "%6.2" "" COEFFS 0 1 0 0 0 1 /end COMPU_METHOD
/begin COMPU_METHOD SY_NSAD_Compu "" TAB_VERB "%6.3" "" COMPU_TAB_REF SY_NSAD_Compu /end COMPU_METHOD
/begin COMPU_VTAB SY_NSAD_Compu "" TAB_VERB 2 0 "keine Nachstartadaption" 1 "Nachstartadaption" /end COMPU_VTAB
/begin COMPU_METHOD SY_NSALT_Compu "" RAT_FUNC "%6.2" "" COEFFS 0 1 0 0 0 1 /end COMPU_METHOD
/begin COMPU_METHOD SY_NSARC_Compu "" RAT_FUNC "%6.2" "" COEFFS 0 1 0 0 0 1 /end COMPU_METHOD
/begin COMPU_METHOD SY_NSASG_Compu "" RAT_FUNC "%6.2" "" COEFFS 0 1 0 0 0 1 /end COMPU_METHOD
/begin COMPU_METHOD SY_NSBLP_Compu "" RAT_FUNC "%6.2" "" COEFFS 0 1 0 0 0 1 /end COMPU_METHOD
/begin COMPU_METHOD SY_NSCAM_Compu "" RAT_FUNC "%6.2" "" COEFFS 0 1 0 0 0 1 /end COMPU_METHOD
/begin COMPU_METHOD SY_NSCAT_Compu "" RAT_FUNC "%6.2" "" COEFFS 0 1 0 0 0 1 /end COMPU_METHOD
/begin COMPU_METHOD SY_NSCDE_Compu "" RAT_FUNC "%6.2" "" COEFFS 0 1 0 0 0 1 /end COMPU_METHOD
/begin COMPU_METHOD SY_NSCRP_Compu "" RAT_FUNC "%6.2" "" COEFFS 0 1 0 0 0 1 /end COMPU_METHOD
/begin COMPU_METHOD SY_NSCVT_Compu "" RAT_FUNC "%6.2" "" COEFFS 0 1 0 0 0 1 /end COMPU_METHOD
/begin COMPU_METHOD SY_NSGEN_Compu "" RAT_FUNC "%6.2" "" COEFFS 0 1 0 0 0 1 /end COMPU_METHOD
/begin COMPU_METHOD SY_NSHTD_Compu "" RAT_FUNC "%6.2" "" COEFFS 0 1 0 0 0 1 /end COMPU_METHOD
/begin COMPU_METHOD SY_NSHTI_Compu "" RAT_FUNC "%6.2" "" COEFFS 0 1 0 0 0 1 /end COMPU_METHOD
/begin COMPU_METHOD SY_NSKO_Compu "" RAT_FUNC "%6.2" "" COEFFS 0 1 0 0 0 1 /end COMPU_METHOD
/begin COMPU_METHOD SY_NSLPH_Compu "" RAT_FUNC "%6.2" "" COEFFS 0 1 0 0 0 1 /end COMPU_METHOD
/begin COMPU_METHOD SY_NSLWR_Compu "" RAT_FUNC "%6.2" "" COEFFS 0 1 0 0 0 1 /end COMPU_METHOD
/begin COMPU_METHOD SY_NSPST_Compu "" RAT_FUNC "%6.2" "" COEFFS 0 1 0 0 0 1 /end COMPU_METHOD
/begin COMPU_METHOD SY_NSPTS_Compu "" RAT_FUNC "%6.2" "" COEFFS 0 1 0 0 0 1 /end COMPU_METHOD
/begin COMPU_METHOD SY_NSPWG_Compu "" RAT_FUNC "%6.2" "" COEFFS 0 1 0 0 0 1 /end COMPU_METHOD
/begin COMPU_METHOD SY_NSREC_Compu "" RAT_FUNC "%6.2" "" COEFFS 0 1 0 0 0 1 /end COMPU_METHOD
/begin COMPU_METHOD SY_NSRNG_Compu "" RAT_FUNC "%6.2" "" COEFFS 0 1 0 0 0 1 /end COMPU_METHOD
/begin COMPU_METHOD SY_NSSTR_Compu "" RAT_FUNC "%6.2" "" COEFFS 0 1 0 0 0 1 /end COMPU_METHOD
/begin COMPU_METHOD SY_NSTCU_Compu "" RAT_FUNC "%6.2" "" COEFFS 0 1 0 0 0 1 /end COMPU_METHOD
/begin COMPU_METHOD SY_NSTST_Compu "" RAT_FUNC "%6.2" "" COEFFS 0 1 0 0 0 1 /end COMPU_METHOD
/begin COMPU_METHOD SY_NSVSP_Compu "" RAT_FUNC "%6.2" "" COEFFS 0 1 0 0 0 1 /end COMPU_METHOD
/begin COMPU_METHOD SY_NSWIH_Compu "" RAT_FUNC "%6.2" "" COEFFS 0 1 0 0 0 1 /end COMPU_METHOD
/begin COMPU_METHOD SY_NTV_Compu "" TAB_VERB "%6.3" "" COMPU_TAB_REF SY_NTV_Compu /end COMPU_METHOD
/begin COMPU_VTAB SY_NTV_Compu "" TAB_VERB 2 0 "SY_NTV = 0" 1 "SY_NTV = 1" /end COMPU_VTAB
/begin COMPU_METHOD SY_NVLD_Compu "" TAB_VERB "%6.3" "" COMPU_TAB_REF SY_NVLD_Compu /end COMPU_METHOD
/begin COMPU_VTAB SY_NVLD_Compu "" TAB_VERB 2 0 "False" 1 "True" /end COMPU_VTAB
/begin COMPU_METHOD SY_NVRAMBK_Compu "" TAB_VERB "%6.3" "" COMPU_TAB_REF SY_NVRAMBK_Compu /end COMPU_METHOD
/begin COMPU_VTAB SY_NVRAMBK_Compu "" TAB_VERB 2 0 "kein nonvolatileRAM backup" 1 "nonvolatileRAM backup" /end COMPU_VTAB
/begin COMPU_METHOD SY_NWFH_Compu "" TAB_VERB "%6.3" "" COMPU_TAB_REF SY_NWFH_Compu /end COMPU_METHOD
/begin COMPU_VTAB SY_NWFH_Compu "" TAB_VERB 2 0 "INDEP_HIGHT" 1 "DEP_HIGHT" /end COMPU_VTAB
/begin COMPU_METHOD SY_NWGA2_Compu "" TAB_VERB "%6.3" "" COMPU_TAB_REF SY_NWGA2_Compu /end COMPU_METHOD
/begin COMPU_VTAB SY_NWGA2_Compu "" TAB_VERB 5 0 "kein Phasengeber auf Nockenwelle verbaut" 1 "Phasengeber 1 auf Nockenwelle Auslass 2" 2 "Phasengeber 2 auf Nockenwelle Auslass 2" 3 "Phasengeber 3 auf Nockenwelle Auslass 2" 4 "Phasengeber 4 auf Nockenwelle Auslass 2" /end COMPU_VTAB
/begin COMPU_METHOD SY_NWGA_Compu "" TAB_VERB "%6.3" "" COMPU_TAB_REF SY_NWGA_Compu /end COMPU_METHOD
/begin COMPU_VTAB SY_NWGA_Compu "" TAB_VERB 5 0 "kein Phasengeber auf Nockenwelle verbaut" 1 "Phasengeber 1 auf Nockenwelle Auslass" 2 "Phasengeber 2 auf Nockenwelle Auslass" 3 "Phasengeber 3 auf Nockenwelle Auslass" 4 "Phasengeber 4 auf Nockenwelle Auslass" /end COMPU_VTAB
/begin COMPU_METHOD SY_NWGE2_Compu "" TAB_VERB "%6.3" "" COMPU_TAB_REF SY_NWGE2_Compu /end COMPU_METHOD
/begin COMPU_VTAB SY_NWGE2_Compu "" TAB_VERB 5 0 "kein Phasengeber auf Nockenwelle verbaut" 1 "Phasengeber 1 auf Nockenwelle Einlass 2" 2 "Phasengeber 2 auf Nockenwelle Einlass 2" 3 "Phasengeber 3 auf Nockenwelle Einlass 2" 4 "Phasengeber 4 auf Nockenwelle Einlass 2" /end COMPU_VTAB
/begin COMPU_METHOD SY_NWGE_Compu "" TAB_VERB "%6.3" "" COMPU_TAB_REF SY_NWGE_Compu /end COMPU_METHOD
/begin COMPU_VTAB SY_NWGE_Compu "" TAB_VERB 5 0 "kein Phasengeber auf Nockenwelle verbaut" 1 "Phasengeber 1 auf Nockenwelle Einlass" 2 "Phasengeber 2 auf Nockenwelle Einlass" 3 "Phasengeber 3 auf Nockenwelle Einlass" 4 "Phasengeber 4 auf Nockenwelle Einlass" /end COMPU_VTAB
/begin COMPU_METHOD SY_NWRA_Compu "" TAB_VERB "%6.3" "" COMPU_TAB_REF SY_NWRA_Compu /end COMPU_METHOD
/begin COMPU_VTAB SY_NWRA_Compu "" TAB_VERB 2 0 "Referenzpos. NWA frueh" 1 "Referenzpos. NWA spaet" /end COMPU_VTAB
/begin COMPU_METHOD SY_NWRE_Compu "" TAB_VERB "%6.3" "" COMPU_TAB_REF SY_NWRE_Compu /end COMPU_METHOD
/begin COMPU_VTAB SY_NWRE_Compu "" TAB_VERB 2 0 "Referenzpos. NWE frueh" 1 "Referenzpos. NWE spaet" /end COMPU_VTAB
/begin COMPU_METHOD SY_NWSA_Compu "" TAB_VERB "%6.3" "" COMPU_TAB_REF SY_NWSA_Compu /end COMPU_METHOD
/begin COMPU_VTAB SY_NWSA_Compu "" TAB_VERB 3 0 "keine NWS Auslass" 1 "2-Punkt NWS Auslass" 2 "stetige NWS Auslass" /end COMPU_VTAB
/begin COMPU_METHOD SY_NWSBE_Compu "" TAB_VERB "%6.3" "" COMPU_TAB_REF SY_NWSBE_Compu /end COMPU_METHOD
/begin COMPU_VTAB SY_NWSBE_Compu "" TAB_VERB 2 0 "keine Abschaltung DMD bei FA Diagnose NWS" 1 "Abschaltung DMD bei FA Diagnose NWS" /end COMPU_VTAB
/begin COMPU_METHOD SY_NWSCL_Compu "" TAB_VERB "%6.3" "" COMPU_TAB_REF SY_NWSCL_Compu /end COMPU_METHOD
/begin COMPU_VTAB SY_NWSCL_Compu "" TAB_VERB 4 0 "keine Reinigungungsfunktionalität" 1 "Reinigung durch Verstellsprünge" 2 "Reinigung nach Zündung aus" 3 "Reinigung 1 und 2" /end COMPU_VTAB
/begin COMPU_METHOD SY_NWSGVNW_Compu "" TAB_VERB "%6.3" "" COMPU_TAB_REF SY_NWSGVNW_Compu /end COMPU_METHOD
/begin COMPU_VTAB SY_NWSGVNW_Compu "" TAB_VERB 2 0 "independent adjustment of the inlet and outlet cam" 1 "common adjustment of the inlet and outlet cam" /end COMPU_VTAB
/begin COMPU_METHOD SY_NWSHSS_Compu "" TAB_VERB "%6.3" "" COMPU_TAB_REF SY_NWSHSS_Compu /end COMPU_METHOD
/begin COMPU_VTAB SY_NWSHSS_Compu "" TAB_VERB 2 0 "False" 1 "True" /end COMPU_VTAB
/begin COMPU_METHOD SY_NWSKR_Compu "" TAB_VERB "%6.3" "" COMPU_TAB_REF SY_NWSKR_Compu /end COMPU_METHOD
/begin COMPU_VTAB SY_NWSKR_Compu "" TAB_VERB 2 0 "ErkennungDerVentilVerstellungDynamik_Unaktiv" 1 "ErkennungDerVentilVerstellungDynamik_Aktiv" /end COMPU_VTAB
/begin COMPU_METHOD SY_NWSSTA_Compu "" TAB_VERB "%6.3" "" COMPU_TAB_REF SY_NWSSTA_Compu /end COMPU_METHOD
/begin COMPU_VTAB SY_NWSSTA_Compu "" TAB_VERB 2 0 "false" 1 "true" /end COMPU_VTAB
/begin COMPU_METHOD SY_NWSV_Compu "" TAB_VERB "%6.3" "" COMPU_TAB_REF SY_NWSV_Compu /end COMPU_METHOD
/begin COMPU_VTAB SY_NWSV_Compu "" TAB_VERB 4 0 "DICP" 1 "DECP" 2 "DDCPI" 3 "DDCPE" /end COMPU_VTAB
/begin COMPU_METHOD SY_NWS_Compu "" TAB_VERB "%6.3" "" COMPU_TAB_REF SY_NWS_Compu /end COMPU_METHOD
/begin COMPU_VTAB SY_NWS_Compu "" TAB_VERB 3 0 "keine Nockenwellensteuerung vorhanden" 1 "2 Punkt Nockenwellensteuerung vorhanden" 2 "kontinuierliche Nockenwellensteuerung vorhanden" /end COMPU_VTAB
/begin COMPU_METHOD SY_NWVPE_Compu "" TAB_VERB "%6.3" "" COMPU_TAB_REF SY_NWVPE_Compu /end COMPU_METHOD
/begin COMPU_VTAB SY_NWVPE_Compu "" TAB_VERB 2 0 "0" 1 "1" /end COMPU_VTAB
/begin COMPU_METHOD SY_NXKFATM_Compu "" RAT_FUNC "%6.2" "" COEFFS 0 1 0 0 0 1 /end COMPU_METHOD
/begin COMPU_METHOD SY_NYKFATM_Compu "" RAT_FUNC "%6.2" "" COEFFS 0 1 0 0 0 1 /end COMPU_METHOD
/begin COMPU_METHOD SY_OBDBR05_Compu "" TAB_VERB "%6.3" "" COMPU_TAB_REF SY_OBDBR05_Compu /end COMPU_METHOD
/begin COMPU_VTAB SY_OBDBR05_Compu "" TAB_VERB 2 0 "OBD2 2005 Biennial Review für  will be deactivated" 1 "OBD2 2005 Biennial Review für MY will be activated" /end COMPU_VTAB
/begin COMPU_METHOD SY_OBMD_Compu "" TAB_VERB "%6.3" "" COMPU_TAB_REF SY_OBMD_Compu /end COMPU_METHOD
/begin COMPU_VTAB SY_OBMD_Compu "" TAB_VERB 2 0 "Overboost füllungsbasiert" 1 "Overboost momentenbasiert" /end COMPU_VTAB
/begin COMPU_METHOD SY_OSTERST_Compu "" TAB_VERB "%6.3" "" COMPU_TAB_REF SY_OSTERST_Compu /end COMPU_METHOD
/begin COMPU_VTAB SY_OSTERST_Compu "" TAB_VERB 2 0 "SY_OSTERST == 0" 1 "SY_OSTERST > 0" /end COMPU_VTAB
/begin COMPU_METHOD SY_OSTEXMD_Compu "" TAB_VERB "%6.3" "" COMPU_TAB_REF SY_OSTEXMD_Compu /end COMPU_METHOD
/begin COMPU_VTAB SY_OSTEXMD_Compu "" TAB_VERB 2 0 "SY_OSTEXMD = 0" 1 "SY_OSTEXMD = 1" /end COMPU_VTAB
/begin COMPU_METHOD SY_OSTNOFF_Compu "" TAB_VERB "%6.3" "" COMPU_TAB_REF SY_OSTNOFF_Compu /end COMPU_METHOD
/begin COMPU_VTAB SY_OSTNOFF_Compu "" TAB_VERB 2 0 "FALSE" 1 "TRUE" /end COMPU_VTAB
/begin COMPU_METHOD SY_OTMERST_Compu "" TAB_VERB "%6.3" "" COMPU_TAB_REF SY_OTMERST_Compu /end COMPU_METHOD
/begin COMPU_VTAB SY_OTMERST_Compu "" TAB_VERB 2 0 "SY_OTMERST==0" 1 "SY_OTMERST>0" /end COMPU_VTAB
/begin COMPU_METHOD SY_OVHP_Compu "" TAB_VERB "%6.3" "" COMPU_TAB_REF SY_OVHP_Compu /end COMPU_METHOD
/begin COMPU_VTAB SY_OVHP_Compu "" TAB_VERB 2 0 "False" 1 "True" /end COMPU_VTAB
/begin COMPU_METHOD SY_PABMODU_Compu "" TAB_VERB "%6.3" "" COMPU_TAB_REF SY_PABMODU_Compu /end COMPU_METHOD
/begin COMPU_VTAB SY_PABMODU_Compu "" TAB_VERB 4 3 "SY_PABMODU_3" 1 "SY_PABMODU_1" 2 "SY_PABMODU_2" 0 "SY_PABMODU_0" /end COMPU_VTAB
/begin COMPU_METHOD SY_PAFGBE_Compu "" TAB_VERB "%6.3" "" COMPU_TAB_REF SY_PAFGBE_Compu /end COMPU_METHOD
/begin COMPU_VTAB SY_PAFGBE_Compu "" TAB_VERB 2 0 "end of line features not activated" 1 "end of line features activated" /end COMPU_VTAB
/begin COMPU_METHOD SY_PBKVSEO_Compu "" TAB_VERB "%6.3" "" COMPU_TAB_REF SY_PBKVSEO_Compu /end COMPU_METHOD
/begin COMPU_VTAB SY_PBKVSEO_Compu "" TAB_VERB 4 0 "kein Sensor" 1 "Steuergerät" 2 "CAN" 10 "applizierbar" /end COMPU_VTAB
/begin COMPU_METHOD SY_PEMDIA_Compu "" TAB_VERB "%6.3" "" COMPU_TAB_REF SY_PEMDIA_Compu /end COMPU_METHOD
/begin COMPU_VTAB SY_PEMDIA_Compu "" TAB_VERB 4 1 "PEM_Diag_on" 0 "no_PEM_Diagnosis" 2 "PWMDIAG_20HZ" 3 "PWMDIAG_100Hz" /end COMPU_VTAB
/begin COMPU_METHOD SY_PGRAD2_Compu "" TAB_VERB "%6.3" "" COMPU_TAB_REF SY_PGRAD2_Compu /end COMPU_METHOD
/begin COMPU_VTAB SY_PGRAD2_Compu "" TAB_VERB 3 0 "Phasengeber 2 nicht verbaut" 1 "Phasengeber 2 Normalfunktion" 4 "Phasengeber 2 mit Schnellstart" /end COMPU_VTAB
/begin COMPU_METHOD SY_PGRAD3_Compu "" TAB_VERB "%6.3" "" COMPU_TAB_REF SY_PGRAD3_Compu /end COMPU_METHOD
/begin COMPU_VTAB SY_PGRAD3_Compu "" TAB_VERB 3 0 "Phasengeber 3 nicht verbaut" 1 "Phasengeber 3 Normalfunktion" 4 "Phasengeber 3 mit Schnellstart" /end COMPU_VTAB
/begin COMPU_METHOD SY_PGRAD4_Compu "" TAB_VERB "%6.3" "" COMPU_TAB_REF SY_PGRAD4_Compu /end COMPU_METHOD
/begin COMPU_VTAB SY_PGRAD4_Compu "" TAB_VERB 3 1 "Phasengeber 4 Normalfunktion" 0 "Phasengeber 4 nicht verbaut" 4 "Phasengeber 4 mit Schnellstartgeberrad" /end COMPU_VTAB
/begin COMPU_METHOD SY_PGRAD_Compu "" TAB_VERB "%6.3" "" COMPU_TAB_REF SY_PGRAD_Compu /end COMPU_METHOD
/begin COMPU_VTAB SY_PGRAD_Compu "" TAB_VERB 3 0 "Phasengeber 1 nicht verbaut" 1 "Phasengeber 1 Normalfunktion" 4 "Phasengeber 1 mit Schnellstart" /end COMPU_VTAB
/begin COMPU_METHOD SY_PID41A_Compu "" TAB_VERB "%6.3" "" COMPU_TAB_REF SY_PID41A_Compu /end COMPU_METHOD
/begin COMPU_VTAB SY_PID41A_Compu "" TAB_VERB 2 0 "PID$41A inaktiv" 1 "PID$41A aktiv" /end COMPU_VTAB
/begin COMPU_METHOD SY_PID41_Compu "" TAB_VERB "%6.3" "" COMPU_TAB_REF SY_PID41_Compu /end COMPU_METHOD
/begin COMPU_VTAB SY_PID41_Compu "" TAB_VERB 2 0 "Systemkonstante: PID$41" 1 "Systemkonstante: PID$41" /end COMPU_VTAB
/begin COMPU_METHOD SY_PLNGFIL_Compu "" TAB_VERB "%6.3" "" COMPU_TAB_REF SY_PLNGFIL_Compu /end COMPU_METHOD
/begin COMPU_VTAB SY_PLNGFIL_Compu "" TAB_VERB 2 0 "false" 1 "true" /end COMPU_VTAB
/begin COMPU_METHOD SY_PNWGTYP_Compu "" TAB_VERB "%6.3" "" COMPU_TAB_REF SY_PNWGTYP_Compu /end COMPU_METHOD
/begin COMPU_VTAB SY_PNWGTYP_Compu "" TAB_VERB 3 0 "not configured" 1 "valve two contr pressure" 2 "vacuum modulator" /end COMPU_VTAB
/begin COMPU_METHOD SY_POEL_Compu "" TAB_VERB "%6.3" "" COMPU_TAB_REF SY_POEL_Compu /end COMPU_METHOD
/begin COMPU_VTAB SY_POEL_Compu "" TAB_VERB 2 0 "keine Öldruckerfassung vorhanden" 1 "Öldruckerfassung vorhanden" /end COMPU_VTAB
/begin COMPU_METHOD SY_PREDRV_Compu "" TAB_VERB "%6.3" "" COMPU_TAB_REF SY_PREDRV_Compu /end COMPU_METHOD
/begin COMPU_VTAB SY_PREDRV_Compu "" TAB_VERB 2 0 "Projekt ohne PreDrive" 1 "Projekt mit PreDrive" /end COMPU_VTAB
/begin COMPU_METHOD SY_PSF_Compu "" TAB_VERB "%6.3" "" COMPU_TAB_REF SY_PSF_Compu /end COMPU_METHOD
/begin COMPU_VTAB SY_PSF_Compu "" TAB_VERB 2 0 "gefilterter Saugrohrdruck nicht verwendet" 1 "gefilterter Saugrohrdruck verwendet" /end COMPU_VTAB
/begin COMPU_METHOD SY_PSMXAPP_Compu "" TAB_VERB "%6.3" "" COMPU_TAB_REF SY_PSMXAPP_Compu /end COMPU_METHOD
/begin COMPU_VTAB SY_PSMXAPP_Compu "" TAB_VERB 3 0 "not for test bench" 1 "also for test bench (1 map for all lean modes)" 2 "also for test bench (maps for all lean modes)" /end COMPU_VTAB
/begin COMPU_METHOD SY_PSR2SYN_Compu "" TAB_VERB "%6.3" "" COMPU_TAB_REF SY_PSR2SYN_Compu /end COMPU_METHOD
/begin COMPU_VTAB SY_PSR2SYN_Compu "" TAB_VERB 2 0 "False" 1 "True" /end COMPU_VTAB
/begin COMPU_METHOD SY_PSTDRST_Compu "" TAB_VERB "%6.3" "" COMPU_TAB_REF SY_PSTDRST_Compu /end COMPU_METHOD
/begin COMPU_VTAB SY_PSTDRST_Compu "" TAB_VERB 2 0 "false" 1 "true" /end COMPU_VTAB
/begin COMPU_METHOD SY_PSUV_Compu "" TAB_VERB "%6.3" "" COMPU_TAB_REF SY_PSUV_Compu /end COMPU_METHOD
/begin COMPU_VTAB SY_PSUV_Compu "" TAB_VERB 2 0 "False" 1 "True" /end COMPU_VTAB
/begin COMPU_METHOD SY_PSWDASW_Compu "" TAB_VERB "%6.3" "" COMPU_TAB_REF SY_PSWDASW_Compu /end COMPU_METHOD
/begin COMPU_VTAB SY_PSWDASW_Compu "" TAB_VERB 2 0 "False" 1 "True" /end COMPU_VTAB
/begin COMPU_METHOD SY_PTLHC_Compu "" TAB_VERB "%6.3" "" COMPU_TAB_REF SY_PTLHC_Compu /end COMPU_METHOD
/begin COMPU_VTAB SY_PTLHC_Compu "" TAB_VERB 2 0 "False" 1 "True" /end COMPU_VTAB
/begin COMPU_METHOD SY_PTL_Compu "" TAB_VERB "%6.3" "" COMPU_TAB_REF SY_PTL_Compu /end COMPU_METHOD
/begin COMPU_VTAB SY_PTL_Compu "" TAB_VERB 2 0 "relative inner moment" 1 "Physical Torque Levels" /end COMPU_VTAB
/begin COMPU_METHOD SY_PTO_Compu "" TAB_VERB "%6.3" "" COMPU_TAB_REF SY_PTO_Compu /end COMPU_METHOD
/begin COMPU_VTAB SY_PTO_Compu "" TAB_VERB 2 0 "False" 1 "True" /end COMPU_VTAB
/begin COMPU_METHOD SY_RDE_Compu "" TAB_VERB "%6.3" "" COMPU_TAB_REF SY_RDE_Compu /end COMPU_METHOD
/begin COMPU_VTAB SY_RDE_Compu "" TAB_VERB 5 0 "inaktiv bzw. keine RDE" 1 "über Auswertung des Zahnsignals der Kurbelwelle" 2 "über Nockenwellen-Muster" 3 "über Zahnsignal der KW und NW-Muster" 4 "wie 3 und zusätzlich über Saugrohrdruck" /end COMPU_VTAB
/begin COMPU_METHOD SY_REDEX_Compu "" TAB_VERB "%6.3" "" COMPU_TAB_REF SY_REDEX_Compu /end COMPU_METHOD
/begin COMPU_VTAB SY_REDEX_Compu "" TAB_VERB 2 0 "0" 1 "1" /end COMPU_VTAB
/begin COMPU_METHOD SY_REDMI_Compu "" TAB_VERB "%6.3" "" COMPU_TAB_REF SY_REDMI_Compu /end COMPU_METHOD
/begin COMPU_VTAB SY_REDMI_Compu "" TAB_VERB 2 0 "False" 1 "True" /end COMPU_VTAB
/begin COMPU_METHOD SY_REDMX_Compu "" RAT_FUNC "%6.2" "" COEFFS 0 1 0 0 0 1 /end COMPU_METHOD
/begin COMPU_METHOD SY_REDSTAR_Compu "" TAB_VERB "%6.3" "" COMPU_TAB_REF SY_REDSTAR_Compu /end COMPU_METHOD
/begin COMPU_VTAB SY_REDSTAR_Compu "" TAB_VERB 2 0 "FALSE" 1 "TRUE" /end COMPU_VTAB
/begin COMPU_METHOD SY_RHMLS_Compu "" TAB_VERB "%6.3" "" COMPU_TAB_REF SY_RHMLS_Compu /end COMPU_METHOD
/begin COMPU_VTAB SY_RHMLS_Compu "" TAB_VERB 4 0 "no heater resistor measurement" 1 "LSF3 downstream cat location of heater rest.meas." 2 "LSF2+3 downst. pre- and maincat loc. of the meas." 3 "LSF1+3 upst. frontcat and down. cat loc. of meas." /end COMPU_VTAB
/begin COMPU_METHOD SY_RLAPP_Compu "" TAB_VERB "%6.3" "" COMPU_TAB_REF SY_RLAPP_Compu /end COMPU_METHOD
/begin COMPU_VTAB SY_RLAPP_Compu "" TAB_VERB 2 0 "keine rlsol-Regelung vorhanden" 1 "rlsol-Regelung vorhanden" /end COMPU_VTAB
/begin COMPU_METHOD SY_RLMDSRP_Compu "" TAB_VERB "%6.3" "" COMPU_TAB_REF SY_RLMDSRP_Compu /end COMPU_METHOD
/begin COMPU_VTAB SY_RLMDSRP_Compu "" TAB_VERB 2 0 "SY_RLMDSRP=0" 1 "SY_RLMDSRP=1" /end COMPU_VTAB
/begin COMPU_METHOD SY_RLMXKV_Compu "" TAB_VERB "%6.3" "" COMPU_TAB_REF SY_RLMXKV_Compu /end COMPU_METHOD
/begin COMPU_VTAB SY_RLMXKV_Compu "" TAB_VERB 2 0 "no_rlmxkv" 1 "rlmxkv" /end COMPU_VTAB
/begin COMPU_METHOD SY_RLRK_Compu "" TAB_VERB "%6.3" "" COMPU_TAB_REF SY_RLRK_Compu /end COMPU_METHOD
/begin COMPU_VTAB SY_RLRK_Compu "" TAB_VERB 2 0 "System ohne rl/rk-Überwachung" 1 "System mit rl/rk-Überwachung" /end COMPU_VTAB
/begin COMPU_METHOD SY_RLXDZW_Compu "" TAB_VERB "%6.3" "" COMPU_TAB_REF SY_RLXDZW_Compu /end COMPU_METHOD
/begin COMPU_VTAB SY_RLXDZW_Compu "" TAB_VERB 2 0 "False" 1 "True" /end COMPU_VTAB
/begin COMPU_METHOD SY_RLXRED_Compu "" TAB_VERB "%6.3" "" COMPU_TAB_REF SY_RLXRED_Compu /end COMPU_METHOD
/begin COMPU_VTAB SY_RLXRED_Compu "" TAB_VERB 2 0 "SY_RLXRED=0" 1 "SY_RLXRED=1" /end COMPU_VTAB
/begin COMPU_METHOD SY_RQMNUGA_Compu "" TAB_VERB "%6.3" "" COMPU_TAB_REF SY_RQMNUGA_Compu /end COMPU_METHOD
/begin COMPU_VTAB SY_RQMNUGA_Compu "" TAB_VERB 2 0 "False" 1 "True" /end COMPU_VTAB
/begin COMPU_METHOD SY_RVS_Compu "" TAB_VERB "%6.3" "" COMPU_TAB_REF SY_RVS_Compu /end COMPU_METHOD
/begin COMPU_VTAB SY_RVS_Compu "" TAB_VERB 2 0 "no remote vehicle start request" 1 "remote vehicle start request" /end COMPU_VTAB
/begin COMPU_METHOD SY_RZSZ_Compu "" TAB_VERB "%6.3" "" COMPU_TAB_REF SY_RZSZ_Compu /end COMPU_METHOD
/begin COMPU_VTAB SY_RZSZ_Compu "" TAB_VERB 2 1 "ON" 0 "OFF" /end COMPU_VTAB
/begin COMPU_METHOD SY_SAGS_Compu "" TAB_VERB "%6.3" "" COMPU_TAB_REF SY_SAGS_Compu /end COMPU_METHOD
/begin COMPU_VTAB SY_SAGS_Compu "" TAB_VERB 2 0 "False" 1 "True" /end COMPU_VTAB
/begin COMPU_METHOD SY_SALSU_Compu "" TAB_VERB "%6.3" "" COMPU_TAB_REF SY_SALSU_Compu /end COMPU_METHOD
/begin COMPU_VTAB SY_SALSU_Compu "" TAB_VERB 2 0 "kein Schubabgleich" 1 "Schubabgleich vorhanden" /end COMPU_VTAB
/begin COMPU_METHOD SY_SCG_Compu "" TAB_VERB "%6.3" "" COMPU_TAB_REF SY_SCG_Compu /end COMPU_METHOD
/begin COMPU_VTAB SY_SCG_Compu "" TAB_VERB 2 0 "False" 1 "True" /end COMPU_VTAB
/begin COMPU_METHOD SY_SCHICHT_Compu "" TAB_VERB "%6.3" "" COMPU_TAB_REF SY_SCHICHT_Compu /end COMPU_METHOD
/begin COMPU_VTAB SY_SCHICHT_Compu "" TAB_VERB 2 0 "nur homogen" 1 "mit Schicht" /end COMPU_VTAB
/begin COMPU_METHOD SY_SCHUMZW_Compu "" RAT_FUNC "%6.2" "" COEFFS 0 1 0 0 0 1 /end COMPU_METHOD
/begin COMPU_METHOD SY_SCH_Compu "" TAB_VERB "%6.3" "" COMPU_TAB_REF SY_SCH_Compu /end COMPU_METHOD
/begin COMPU_VTAB SY_SCH_Compu "" TAB_VERB 2 0 "False" 1 "True" /end COMPU_VTAB
/begin COMPU_METHOD SY_SCIO_Compu "" TAB_VERB "%6.3" "" COMPU_TAB_REF SY_SCIO_Compu /end COMPU_METHOD
/begin COMPU_VTAB SY_SCIO_Compu "" TAB_VERB 2 0 "False" 1 "True" /end COMPU_VTAB
/begin COMPU_METHOD SY_SDFP_Compu "" TAB_VERB "%6.3" "" COMPU_TAB_REF SY_SDFP_Compu /end COMPU_METHOD
/begin COMPU_VTAB SY_SDFP_Compu "" TAB_VERB 2 0 "keine Startverzögerung Kraftstoffpumpe" 1 "Startverzögerung Kraftstoffpumpe" /end COMPU_VTAB
/begin COMPU_METHOD SY_SGANLBS_Compu "" TAB_VERB "%6.3" "" COMPU_TAB_REF SY_SGANLBS_Compu /end COMPU_METHOD
/begin COMPU_VTAB SY_SGANLBS_Compu "" TAB_VERB 2 1 "1 SG pro LBK" 2 "2SG pro Ladungsbewegungsklappe" /end COMPU_VTAB
/begin COMPU_METHOD SY_SGANMTR_Compu "" TAB_VERB "%6.3" "" COMPU_TAB_REF SY_SGANMTR_Compu /end COMPU_METHOD
/begin COMPU_VTAB SY_SGANMTR_Compu "" TAB_VERB 3 2 "gemeinsames Motorrelais für 2 SG" 1 "eigenes Motorrelais pro SG" 0 "kein eigenes Motorrelais" /end COMPU_VTAB
/begin COMPU_METHOD SY_SGANZFR_Compu "" TAB_VERB "%6.3" "" COMPU_TAB_REF SY_SGANZFR_Compu /end COMPU_METHOD
/begin COMPU_VTAB SY_SGANZFR_Compu "" TAB_VERB 2 1 "1 SG 1 FR" 2 "2 SG pro Fuel Rail" /end COMPU_VTAB
/begin COMPU_METHOD SY_SGANZ_Compu "" TAB_VERB "%6.3" "" COMPU_TAB_REF SY_SGANZ_Compu /end COMPU_METHOD
/begin COMPU_VTAB SY_SGANZ_Compu "" TAB_VERB 3 1 "Ein Steuergeräte Motormanagement Konzept" 2 "Zwei Steuergeräte Motormanagement Konzept" 3 "Drei Steuergeräte Motormanagement Konzept" /end COMPU_VTAB
/begin COMPU_METHOD SY_SKH_Compu "" TAB_VERB "%6.3" "" COMPU_TAB_REF SY_SKH_Compu /end COMPU_METHOD
/begin COMPU_VTAB SY_SKH_Compu "" TAB_VERB 2 0 "False" 1 "True" /end COMPU_VTAB
/begin COMPU_METHOD SY_SKR_Compu "" TAB_VERB "%6.3" "" COMPU_TAB_REF SY_SKR_Compu /end COMPU_METHOD
/begin COMPU_VTAB SY_SKR_Compu "" TAB_VERB 2 0 "False" 1 "True" /end COMPU_VTAB
/begin COMPU_METHOD SY_SLPANZ_Compu "" TAB_VERB "%6.3" "" COMPU_TAB_REF SY_SLPANZ_Compu /end COMPU_METHOD
/begin COMPU_VTAB SY_SLPANZ_Compu "" TAB_VERB 3 0 "keine SLP" 1 "1 SLP" 2 "2 SLP" /end COMPU_VTAB
/begin COMPU_METHOD SY_SLSHK_Compu "" TAB_VERB "%6.3" "" COMPU_TAB_REF SY_SLSHK_Compu /end COMPU_METHOD
/begin COMPU_VTAB SY_SLSHK_Compu "" TAB_VERB 2 0 "keine SLP für Einblasung vor Hauptkat" 1 "SLP für Einblasung vor Hauptkat vorhanden" /end COMPU_VTAB
/begin COMPU_METHOD SY_SLS_Compu "" TAB_VERB "%6.3" "" COMPU_TAB_REF SY_SLS_Compu /end COMPU_METHOD
/begin COMPU_VTAB SY_SLS_Compu "" TAB_VERB 3 0 "keine Sekundärluftpumpe vorhanden" 1 "Sekundärluftpumpe vorhanden" 2 "GGSLSHFM vorhanden" /end COMPU_VTAB
/begin COMPU_METHOD SY_SLVANZ_Compu "" TAB_VERB "%6.3" "" COMPU_TAB_REF SY_SLVANZ_Compu /end COMPU_METHOD
/begin COMPU_VTAB SY_SLVANZ_Compu "" TAB_VERB 4 0 "kein SLV" 1 "1 SLV" 2 "2 SLV" 4 "4 SLV" /end COMPU_VTAB
/begin COMPU_METHOD SY_SLVEST_Compu "" TAB_VERB "%6.3" "" COMPU_TAB_REF SY_SLVEST_Compu /end COMPU_METHOD
/begin COMPU_VTAB SY_SLVEST_Compu "" TAB_VERB 3 0 "SLVEST_ZERO" 1 "SLVEST_ONE" 2 "SLVEST_TWO" /end COMPU_VTAB
/begin COMPU_METHOD SY_SLVHW_Compu "" TAB_VERB "%6.3" "" COMPU_TAB_REF SY_SLVHW_Compu /end COMPU_METHOD
/begin COMPU_VTAB SY_SLVHW_Compu "" TAB_VERB 3 1 "überdrückbar" 2 "Unterdruck" 3 "elektrisch" /end COMPU_VTAB
/begin COMPU_METHOD SY_SOOTBAL_Compu "" TAB_VERB "%6.3" "" COMPU_TAB_REF SY_SOOTBAL_Compu /end COMPU_METHOD
/begin COMPU_VTAB SY_SOOTBAL_Compu "" TAB_VERB 2 0 "False" 1 "True" /end COMPU_VTAB
/begin COMPU_METHOD SY_SOTUN_Compu "" TAB_VERB "%6.3" "" COMPU_TAB_REF SY_SOTUN_Compu /end COMPU_METHOD
/begin COMPU_VTAB SY_SOTUN_Compu "" TAB_VERB 2 0 "False" 1 "True" /end COMPU_VTAB
/begin COMPU_METHOD SY_SPRSTRT_Compu "" TAB_VERB "%6.3" "" COMPU_TAB_REF SY_SPRSTRT_Compu /end COMPU_METHOD
/begin COMPU_VTAB SY_SPRSTRT_Compu "" TAB_VERB 2 0 "False" 1 "True" /end COMPU_VTAB
/begin COMPU_METHOD SY_SSPDKP_Compu "" TAB_VERB "%6.3" "" COMPU_TAB_REF SY_SSPDKP_Compu /end COMPU_METHOD
/begin COMPU_VTAB SY_SSPDKP_Compu "" TAB_VERB 4 0 "powersupply diagnosis deactivated" 1 "Throttle sensors connected to powerstage1" 2 "Throttle sensors connected to powerstage2" 3 "Throttle sensors connected to powerstage3" /end COMPU_VTAB
/begin COMPU_METHOD SY_SSPPSR2_Compu "" TAB_VERB "%6.3" "" COMPU_TAB_REF SY_SSPPSR2_Compu /end COMPU_METHOD
/begin COMPU_VTAB SY_SSPPSR2_Compu "" TAB_VERB 4 0 "powersupply diagnosis deactivated" 1 "2. MAP sensor connected to powersupply1" 2 "2. MAP sensor connected to powersupply2" 3 "2. MAP sensor connected to powersupply3" /end COMPU_VTAB
/begin COMPU_METHOD SY_SSPPSR_Compu "" TAB_VERB "%6.3" "" COMPU_TAB_REF SY_SSPPSR_Compu /end COMPU_METHOD
/begin COMPU_VTAB SY_SSPPSR_Compu "" TAB_VERB 4 0 "powersupply diagnosis deactivated" 1 "MAP sensor connected to powersupply1" 2 "MAP sensor connected to powersupply2" 3 "MAP sensor connected to powersupply3" /end COMPU_VTAB
/begin COMPU_METHOD SY_SSTNW_Compu "" RAT_FUNC "%6.2" "" COEFFS 0 1 0 0 0 1 /end COMPU_METHOD
/begin COMPU_METHOD SY_ST10_Compu "" TAB_VERB "%6.3" "" COMPU_TAB_REF SY_ST10_Compu /end COMPU_METHOD
/begin COMPU_VTAB SY_ST10_Compu "" TAB_VERB 5 0 "no ST10" 1 "ST10C167" 2 "ST10F269" 3 "ST10F275" 4 "ST10F276" /end COMPU_VTAB
/begin COMPU_METHOD SY_STADAP_Compu "" TAB_VERB "%6.3" "" COMPU_TAB_REF SY_STADAP_Compu /end COMPU_METHOD
/begin COMPU_VTAB SY_STADAP_Compu "" TAB_VERB 3 0 "no STADAP" 1 "STADAP inside" 2 "STADAP incl. fuel reset" /end COMPU_VTAB
/begin COMPU_METHOD SY_STAEVAB_Compu "" TAB_VERB "%6.3" "" COMPU_TAB_REF SY_STAEVAB_Compu /end COMPU_METHOD
/begin COMPU_VTAB SY_STAEVAB_Compu "" TAB_VERB 2 0 "False" 1 "True" /end COMPU_VTAB
/begin COMPU_METHOD SY_STARTDK_Compu "" TAB_VERB "%6.3" "" COMPU_TAB_REF SY_STARTDK_Compu /end COMPU_METHOD
/begin COMPU_VTAB SY_STARTDK_Compu "" TAB_VERB 2 0 "DK-Start-Winkel" 1 "DK-Start-Massenstrom" /end COMPU_VTAB
/begin COMPU_METHOD SY_STASTO_Compu "" TAB_VERB "%6.3" "" COMPU_TAB_REF SY_STASTO_Compu /end COMPU_METHOD
/begin COMPU_VTAB SY_STASTO_Compu "" TAB_VERB 2 0 "Kein Start-Stopp" 1 "Start-Stop vorhanden" /end COMPU_VTAB
/begin COMPU_METHOD SY_STA_Compu "" TAB_VERB "%6.3" "" COMPU_TAB_REF SY_STA_Compu /end COMPU_METHOD
/begin COMPU_VTAB SY_STA_Compu "" TAB_VERB 2 0 "kein Automatikstart" 1 "Automatikstart" /end COMPU_VTAB
/begin COMPU_METHOD SY_STELRHE_Compu "" TAB_VERB "%6.3" "" COMPU_TAB_REF SY_STELRHE_Compu /end COMPU_METHOD
/begin COMPU_VTAB SY_STELRHE_Compu "" TAB_VERB 2 0 "2 Punkt Lambdaregelung vorhanden" 1 "stetige Lambdaregelung mit 2-Punktsonde vorhanden" /end COMPU_VTAB
/begin COMPU_METHOD SY_STERBTS_Compu "" TAB_VERB "%6.3" "" COMPU_TAB_REF SY_STERBTS_Compu /end COMPU_METHOD
/begin COMPU_VTAB SY_STERBTS_Compu "" TAB_VERB 2 0 "kein bankselektiver Bauteileschutz" 1 "bankselektiver Bauteileschutz" /end COMPU_VTAB
/begin COMPU_METHOD SY_STERFK_Compu "" TAB_VERB "%6.3" "" COMPU_TAB_REF SY_STERFK_Compu /end COMPU_METHOD
/begin COMPU_VTAB SY_STERFK_Compu "" TAB_VERB 2 0 "Mono hinter Frontkat" 1 "Stereo hinter Frontkat" /end COMPU_VTAB
/begin COMPU_METHOD SY_STERHK_Compu "" TAB_VERB "%6.3" "" COMPU_TAB_REF SY_STERHK_Compu /end COMPU_METHOD
/begin COMPU_VTAB SY_STERHK_Compu "" TAB_VERB 2 0 "Mono Lambdaregelung hinter KAT" 1 "Stereo Lambdaregelung hinter KAT" /end COMPU_VTAB
/begin COMPU_METHOD SY_STERSY_Compu "" TAB_VERB "%6.3" "" COMPU_TAB_REF SY_STERSY_Compu /end COMPU_METHOD
/begin COMPU_VTAB SY_STERSY_Compu "" TAB_VERB 2 0 "Asymmetrische Abgasanlage" 1 "Symmetrische Abgasanlage" /end COMPU_VTAB
/begin COMPU_METHOD SY_STERVK_Compu "" TAB_VERB "%6.3" "" COMPU_TAB_REF SY_STERVK_Compu /end COMPU_METHOD
/begin COMPU_VTAB SY_STERVK_Compu "" TAB_VERB 2 0 "Mono Lambdaregelung vor KAT" 1 "Stereo Lambdaregelung vor KAT" /end COMPU_VTAB
/begin COMPU_METHOD SY_STETLR_Compu "" TAB_VERB "%6.3" "" COMPU_TAB_REF SY_STETLR_Compu /end COMPU_METHOD
/begin COMPU_VTAB SY_STETLR_Compu "" TAB_VERB 2 0 "2 Punkt Lambdaregelung vorhanden" 1 "stetige Lambdaregelung vorhanden" /end COMPU_VTAB
/begin COMPU_METHOD SY_SUKS_Compu "" TAB_VERB "%6.3" "" COMPU_TAB_REF SY_SUKS_Compu /end COMPU_METHOD
/begin COMPU_VTAB SY_SUKS_Compu "" TAB_VERB 3 0 "keine Lagerückmeldung" 1 "Poti" 2 "PMW-Signal" /end COMPU_VTAB
/begin COMPU_METHOD SY_SUV_Compu "" TAB_VERB "%6.3" "" COMPU_TAB_REF SY_SUV_Compu /end COMPU_METHOD
/begin COMPU_VTAB SY_SUV_Compu "" TAB_VERB 2 0 "FALSE" 1 "TRUE" /end COMPU_VTAB
/begin COMPU_METHOD SY_SU_Compu "" TAB_VERB "%6.3" "" COMPU_TAB_REF SY_SU_Compu /end COMPU_METHOD
/begin COMPU_VTAB SY_SU_Compu "" TAB_VERB 3 0 "keine Saugrohrumschaltung" 1 "1 Saugrohrumschaltungsklappe" 2 "2 Saugrohrumschaltungsklappen" /end COMPU_VTAB
/begin COMPU_METHOD SY_SVBB_Compu "" TAB_VERB "%6.3" "" COMPU_TAB_REF SY_SVBB_Compu /end COMPU_METHOD
/begin COMPU_VTAB SY_SVBB_Compu "" TAB_VERB 2 0 "NOSVBB" 1 "SVBBETAS" /end COMPU_VTAB
/begin COMPU_METHOD SY_SWE_B_Compu "" TAB_VERB "%6.3" "" COMPU_TAB_REF SY_SWE_B_Compu /end COMPU_METHOD
/begin COMPU_VTAB SY_SWE_B_Compu "" TAB_VERB 2 0 "keine Schlechtwegerkennung über ABS" 1 "Schlechtwegerkennung über ABS" /end COMPU_VTAB
/begin COMPU_METHOD SY_SWE_C_Compu "" TAB_VERB "%6.3" "" COMPU_TAB_REF SY_SWE_C_Compu /end COMPU_METHOD
/begin COMPU_VTAB SY_SWE_C_Compu "" TAB_VERB 2 0 "keine Schlechtwegerkennung mittels CAN" 1 "Schlechtwegerkennung mittels CAN" /end COMPU_VTAB
/begin COMPU_METHOD SY_SWE_K_Compu "" TAB_VERB "%6.3" "" COMPU_TAB_REF SY_SWE_K_Compu /end COMPU_METHOD
/begin COMPU_VTAB SY_SWE_K_Compu "" TAB_VERB 2 0 "keine %DSWEB" 1 "SWE über Beschleunigungssensor via %DSWEB" /end COMPU_VTAB
/begin COMPU_METHOD SY_SWE_S_Compu "" TAB_VERB "%6.3" "" COMPU_TAB_REF SY_SWE_S_Compu /end COMPU_METHOD
/begin COMPU_VTAB SY_SWE_S_Compu "" TAB_VERB 2 0 "keine Schlechtwegerk. ueber Laufunruhe Stat." 1 "Schlechtwegerk. ueber Laufunruhe Stat." /end COMPU_VTAB
/begin COMPU_METHOD SY_TAHEVCH_Compu "" TAB_VERB "%6.3" "" COMPU_TAB_REF SY_TAHEVCH_Compu /end COMPU_METHOD
/begin COMPU_VTAB SY_TAHEVCH_Compu "" TAB_VERB 4 0 "TAHEVCH_TMOT" 1 "TAHEVCH_CHdT_TAEV" 2 "TAHEVCH_CHdT_TEV" 3 "TAHEVCH_CHdT" /end COMPU_VTAB
/begin COMPU_METHOD SY_TAKH_Compu "" TAB_VERB "%6.3" "" COMPU_TAB_REF SY_TAKH_Compu /end COMPU_METHOD
/begin COMPU_VTAB SY_TAKH_Compu "" TAB_VERB 2 0 "False" 1 "True" /end COMPU_VTAB
/begin COMPU_METHOD SY_TANDK_Compu "" TAB_VERB "%6.3" "" COMPU_TAB_REF SY_TANDK_Compu /end COMPU_METHOD
/begin COMPU_VTAB SY_TANDK_Compu "" TAB_VERB 2 0 "False" 1 "True" /end COMPU_VTAB
/begin COMPU_METHOD SY_TANSPOS_Compu "" TAB_VERB "%6.3" "" COMPU_TAB_REF SY_TANSPOS_Compu /end COMPU_METHOD
/begin COMPU_VTAB SY_TANSPOS_Compu "" TAB_VERB 3 0 "NO_TANS" 1 "TFA1_TANS" 2 "TFA2_TANS" /end COMPU_VTAB
/begin COMPU_METHOD SY_TASR_Compu "" TAB_VERB "%6.3" "" COMPU_TAB_REF SY_TASR_Compu /end COMPU_METHOD
/begin COMPU_VTAB SY_TASR_Compu "" TAB_VERB 2 0 "False" 1 "True" /end COMPU_VTAB
/begin COMPU_METHOD SY_TAVDK2_Compu "" TAB_VERB "%6.3" "" COMPU_TAB_REF SY_TAVDK2_Compu /end COMPU_METHOD
/begin COMPU_VTAB SY_TAVDK2_Compu "" TAB_VERB 2 0 "False" 1 "True" /end COMPU_VTAB
/begin COMPU_METHOD SY_TAVDK_Compu "" TAB_VERB "%6.3" "" COMPU_TAB_REF SY_TAVDK_Compu /end COMPU_METHOD
/begin COMPU_VTAB SY_TAVDK_Compu "" TAB_VERB 2 0 "False" 1 "True" /end COMPU_VTAB
/begin COMPU_METHOD SY_TCNS_Compu "" TAB_VERB "%6.3" "" COMPU_TAB_REF SY_TCNS_Compu /end COMPU_METHOD
/begin COMPU_VTAB SY_TCNS_Compu "" TAB_VERB 2 0 "kein Testereingriff LL-Solldrehzahlumschaltung" 1 "Testereingriff LL-Solldrehzahlumschaltung" /end COMPU_VTAB
/begin COMPU_METHOD SY_TCWJEC_Compu "" TAB_VERB "%6.3" "" COMPU_TAB_REF SY_TCWJEC_Compu /end COMPU_METHOD
/begin COMPU_VTAB SY_TCWJEC_Compu "" TAB_VERB 2 1 "JITT_CHK" 0 "NO_JITT_CHK" /end COMPU_VTAB
/begin COMPU_METHOD SY_TEBF_Compu "" TAB_VERB "%6.3" "" COMPU_TAB_REF SY_TEBF_Compu /end COMPU_METHOD
/begin COMPU_VTAB SY_TEBF_Compu "" TAB_VERB 3 0 "kein Erstbefüllung" 1 "Erstbefüllung ein über Tester" 2 "Erstbefüllung ein/aus über Tester" /end COMPU_VTAB
/begin COMPU_METHOD SY_TEETH_Compu "" TAB_VERB "%6.3" "" COMPU_TAB_REF SY_TEETH_Compu /end COMPU_METHOD
/begin COMPU_VTAB SY_TEETH_Compu "" TAB_VERB 2 60 "number of crankshaft wheel teeth is 60 minus x" 36 "number of crankshaft wheel teeth is 36 minus x" /end COMPU_VTAB
/begin COMPU_METHOD SY_TEKP_Compu "" TAB_VERB "%6.3" "" COMPU_TAB_REF SY_TEKP_Compu /end COMPU_METHOD
/begin COMPU_VTAB SY_TEKP_Compu "" TAB_VERB 3 0 "TEKP_0" 1 "TEKP_1" 2 "TEKP_2" /end COMPU_VTAB
/begin COMPU_METHOD SY_TEV5_Compu "" TAB_VERB "%6.3" "" COMPU_TAB_REF SY_TEV5_Compu /end COMPU_METHOD
/begin COMPU_VTAB SY_TEV5_Compu "" TAB_VERB 2 0 "TEV5 nicht verbaut" 1 "TEV5 verbaut" /end COMPU_VTAB
/begin COMPU_METHOD SY_TFA1CSD_Compu "" TAB_VERB "%6.3" "" COMPU_TAB_REF SY_TFA1CSD_Compu /end COMPU_METHOD
/begin COMPU_VTAB SY_TFA1CSD_Compu "" TAB_VERB 2 0 "TFA1_CS_DISABLED" 1 "TFA1_CS_ENABLED" /end COMPU_VTAB
/begin COMPU_METHOD SY_TFA1HSC_Compu "" TAB_VERB "%6.3" "" COMPU_TAB_REF SY_TFA1HSC_Compu /end COMPU_METHOD
/begin COMPU_VTAB SY_TFA1HSC_Compu "" TAB_VERB 2 0 "SY_TFA1HSC_DISABLED" 1 "SY_TFA1HSC_ENABLED" /end COMPU_VTAB
/begin COMPU_METHOD SY_TFA1PLD_Compu "" TAB_VERB "%6.3" "" COMPU_TAB_REF SY_TFA1PLD_Compu /end COMPU_METHOD
/begin COMPU_VTAB SY_TFA1PLD_Compu "" TAB_VERB 2 0 "TFA1_PL_DISABLED" 1 "TFA1_PL_ENABLED" /end COMPU_VTAB
/begin COMPU_METHOD SY_TFA1POS_Compu "" TAB_VERB "%6.3" "" COMPU_TAB_REF SY_TFA1POS_Compu /end COMPU_METHOD
/begin COMPU_VTAB SY_TFA1POS_Compu "" TAB_VERB 7 0 "no tfa1-sensor" 1 "TASR" 2 "TAVDK" 3 "TAVLLK" 4 "TAV2V" 5 "TAVV" 6 "TANLF" /end COMPU_VTAB
/begin COMPU_METHOD SY_TFA1W_Compu "" TAB_VERB "%6.3" "" COMPU_TAB_REF SY_TFA1W_Compu /end COMPU_METHOD
/begin COMPU_VTAB SY_TFA1W_Compu "" TAB_VERB 2 0 "byte-range" 1 "word-range" /end COMPU_VTAB
/begin COMPU_METHOD SY_TFA2CSD_Compu "" TAB_VERB "%6.3" "" COMPU_TAB_REF SY_TFA2CSD_Compu /end COMPU_METHOD
/begin COMPU_VTAB SY_TFA2CSD_Compu "" TAB_VERB 2 0 "TFA2_CS_DISABLED" 1 "TFA2_CS_ENABLED" /end COMPU_VTAB
/begin COMPU_METHOD SY_TFA2PLD_Compu "" TAB_VERB "%6.3" "" COMPU_TAB_REF SY_TFA2PLD_Compu /end COMPU_METHOD
/begin COMPU_VTAB SY_TFA2PLD_Compu "" TAB_VERB 2 0 "TFA2_PL_DISABLED" 1 "TFA2_PL_ENABLED" /end COMPU_VTAB
/begin COMPU_METHOD SY_TFA2POS_Compu "" TAB_VERB "%6.3" "" COMPU_TAB_REF SY_TFA2POS_Compu /end COMPU_METHOD
/begin COMPU_VTAB SY_TFA2POS_Compu "" TAB_VERB 7 0 "no tfa2-sensor" 1 "TASR" 2 "TAVDK" 3 "TAVLLK" 4 "TAV2V" 5 "TAVV" 6 "TANLF" /end COMPU_VTAB
/begin COMPU_METHOD SY_TFA3POS_Compu "" TAB_VERB "%6.3" "" COMPU_TAB_REF SY_TFA3POS_Compu /end COMPU_METHOD
/begin COMPU_VTAB SY_TFA3POS_Compu "" TAB_VERB 7 0 "no tfa3-sensor" 1 "TASR" 2 "TAVDK" 3 "TAVLLK" 4 "TAV2V" 5 "TAVV" 6 "TANLF" /end COMPU_VTAB
/begin COMPU_METHOD SY_TFAJEC_Compu "" TAB_VERB "%6.3" "" COMPU_TAB_REF SY_TFAJEC_Compu /end COMPU_METHOD
/begin COMPU_VTAB SY_TFAJEC_Compu "" TAB_VERB 2 0 "no Jump-Check" 1 "Jump-Check" /end COMPU_VTAB
/begin COMPU_METHOD SY_TFAKON_Compu "" TAB_VERB "%6.3" "" COMPU_TAB_REF SY_TFAKON_Compu /end COMPU_METHOD
/begin COMPU_VTAB SY_TFAKON_Compu "" TAB_VERB 2 0 "1 Sensor" 1 "2 Sensoren moeglich" /end COMPU_VTAB
/begin COMPU_METHOD SY_TFAOPL_Compu "" TAB_VERB "%6.3" "" COMPU_TAB_REF SY_TFAOPL_Compu /end COMPU_METHOD
/begin COMPU_VTAB SY_TFAOPL_Compu "" TAB_VERB 2 0 "0" 1 "1" /end COMPU_VTAB
/begin COMPU_METHOD SY_TFAST_Compu "" TAB_VERB "%6.3" "" COMPU_TAB_REF SY_TFAST_Compu /end COMPU_METHOD
/begin COMPU_VTAB SY_TFAST_Compu "" TAB_VERB 2 0 "SY_TFAST" 1 "SY_TFAST" /end COMPU_VTAB
/begin COMPU_METHOD SY_TFATSTR_Compu "" TAB_VERB "%6.3" "" COMPU_TAB_REF SY_TFATSTR_Compu /end COMPU_METHOD
/begin COMPU_VTAB SY_TFATSTR_Compu "" TAB_VERB 3 0 "NO SENSOR" 1 "TFA1_SCAN" 2 "TFA2_SCAN" /end COMPU_VTAB
/begin COMPU_METHOD SY_TFA_Compu "" TAB_VERB "%6.3" "" COMPU_TAB_REF SY_TFA_Compu /end COMPU_METHOD
/begin COMPU_VTAB SY_TFA_Compu "" TAB_VERB 4 1 "SY_TFA_1" 2 "SY_TFA_2" 3 "SY_TFA_3" 0 "SY_TFA_0" /end COMPU_VTAB
/begin COMPU_METHOD SY_TFBA_Compu "" TAB_VERB "%6.3" "" COMPU_TAB_REF SY_TFBA_Compu /end COMPU_METHOD
/begin COMPU_VTAB SY_TFBA_Compu "" TAB_VERB 2 0 "kein Testereingriff Beschleunigungsanreicherung" 1 "Testereingriff Beschleunigungsanreicherung" /end COMPU_VTAB
/begin COMPU_METHOD SY_TFLTKCD_Compu "" TAB_VERB "%6.3" "" COMPU_TAB_REF SY_TFLTKCD_Compu /end COMPU_METHOD
/begin COMPU_VTAB SY_TFLTKCD_Compu "" TAB_VERB 2 1 "ENABL" 0 "DISABL" /end COMPU_VTAB
/begin COMPU_METHOD SY_TFLTNK_Compu "" TAB_VERB "%6.3" "" COMPU_TAB_REF SY_TFLTNK_Compu /end COMPU_METHOD
/begin COMPU_VTAB SY_TFLTNK_Compu "" TAB_VERB 2 0 "SY_TFlTnk" 1 "SY_TFlTnk" /end COMPU_VTAB
/begin COMPU_METHOD SY_TFMO_Compu "" TAB_VERB "%6.3" "" COMPU_TAB_REF SY_TFMO_Compu /end COMPU_METHOD
/begin COMPU_VTAB SY_TFMO_Compu "" TAB_VERB 2 0 "TMOT Sensor nicht als GGTFM Erstzwert" 1 "TMOT Sensor als GGTFM Erstzwert" /end COMPU_VTAB
/begin COMPU_METHOD SY_TFNS_Compu "" TAB_VERB "%6.3" "" COMPU_TAB_REF SY_TFNS_Compu /end COMPU_METHOD
/begin COMPU_VTAB SY_TFNS_Compu "" TAB_VERB 2 0 "kein Testereingriff Nachstartfaktor aktiv" 1 "Testereingriff Nachstartfaktor aktiv" /end COMPU_VTAB
/begin COMPU_METHOD SY_TFRK_Compu "" TAB_VERB "%6.3" "" COMPU_TAB_REF SY_TFRK_Compu /end COMPU_METHOD
/begin COMPU_VTAB SY_TFRK_Compu "" TAB_VERB 2 0 "kein Testereingriff Korrekturfaktor relative Kraft" 1 "Testereingriff Korrekturfaktor relative Kraftstoff" /end COMPU_VTAB
/begin COMPU_METHOD SY_TFST_Compu "" TAB_VERB "%6.3" "" COMPU_TAB_REF SY_TFST_Compu /end COMPU_METHOD
/begin COMPU_VTAB SY_TFST_Compu "" TAB_VERB 2 0 "kein Testereingriff Startfaktor" 1 "Testereingriff Startfaktor" /end COMPU_VTAB
/begin COMPU_METHOD SY_TFUELCN_Compu "" TAB_VERB "%6.3" "" COMPU_TAB_REF SY_TFUELCN_Compu /end COMPU_METHOD
/begin COMPU_VTAB SY_TFUELCN_Compu "" TAB_VERB 7 0 "SY_TFUELCN = 0" 1 "SY_TFUELCN = 1" 2 "SY_TFUELCN = 2" 3 "SY_TFUELCN = 3" 4 "SY_TFUELCN = 4" 5 "SY_TFUELCN = 5" 6 "SY_TFUELCN = 6" /end COMPU_VTAB
/begin COMPU_METHOD SY_TFUEL_Compu "" TAB_VERB "%6.3" "" COMPU_TAB_REF SY_TFUEL_Compu /end COMPU_METHOD
/begin COMPU_VTAB SY_TFUEL_Compu "" TAB_VERB 3 0 "NOTAVL" 1 "TFUELLP" 2 "TFUELLPHP" /end COMPU_VTAB
/begin COMPU_METHOD SY_TFVA_Compu "" TAB_VERB "%6.3" "" COMPU_TAB_REF SY_TFVA_Compu /end COMPU_METHOD
/begin COMPU_VTAB SY_TFVA_Compu "" TAB_VERB 2 0 "kein Testereingriff Verzögerungsabmagerung" 1 "Testereingriff Verzögerungsabmagerung" /end COMPU_VTAB
/begin COMPU_METHOD SY_TFWL_Compu "" TAB_VERB "%6.3" "" COMPU_TAB_REF SY_TFWL_Compu /end COMPU_METHOD
/begin COMPU_VTAB SY_TFWL_Compu "" TAB_VERB 2 0 "kein Testereingriff Warmlauffaktor aktiv" 1 "Testereingriff Warmlauffaktor aktiv" /end COMPU_VTAB
/begin COMPU_METHOD SY_THMTUM_Compu "" TAB_VERB "%6.3" "" COMPU_TAB_REF SY_THMTUM_Compu /end COMPU_METHOD
/begin COMPU_VTAB SY_THMTUM_Compu "" TAB_VERB 2 0 "False" 1 "True" /end COMPU_VTAB
/begin COMPU_METHOD SY_TKAA_Compu "" TAB_VERB "%6.3" "" COMPU_TAB_REF SY_TKAA_Compu /end COMPU_METHOD
/begin COMPU_VTAB SY_TKAA_Compu "" TAB_VERB 2 0 "False" 1 "True" /end COMPU_VTAB
/begin COMPU_METHOD SY_TKA_Compu "" TAB_VERB "%6.3" "" COMPU_TAB_REF SY_TKA_Compu /end COMPU_METHOD
/begin COMPU_VTAB SY_TKA_Compu "" TAB_VERB 2 0 "kein Kühlwassertemperatursensor am Kühleraustritt" 1 "Kühlwassertemperatursensor am Kühleraustritt" /end COMPU_VTAB
/begin COMPU_METHOD SY_TKKHCN_Compu "" TAB_VERB "%6.3" "" COMPU_TAB_REF SY_TKKHCN_Compu /end COMPU_METHOD
/begin COMPU_VTAB SY_TKKHCN_Compu "" TAB_VERB 2 0 "ZERO" 1 "ONE" /end COMPU_VTAB
/begin COMPU_METHOD SY_TKKHCSD_Compu "" TAB_VERB "%6.3" "" COMPU_TAB_REF SY_TKKHCSD_Compu /end COMPU_METHOD
/begin COMPU_VTAB SY_TKKHCSD_Compu "" TAB_VERB 2 0 "ZERO" 1 "ONE" /end COMPU_VTAB
/begin COMPU_METHOD SY_TKKH_Compu "" TAB_VERB "%6.3" "" COMPU_TAB_REF SY_TKKH_Compu /end COMPU_METHOD
/begin COMPU_VTAB SY_TKKH_Compu "" TAB_VERB 2 0 "ZERO" 1 "ONE" /end COMPU_VTAB
/begin COMPU_METHOD SY_TLAM_Compu "" TAB_VERB "%6.3" "" COMPU_TAB_REF SY_TLAM_Compu /end COMPU_METHOD
/begin COMPU_VTAB SY_TLAM_Compu "" TAB_VERB 2 0 "False" 1 "True" /end COMPU_VTAB
/begin COMPU_METHOD SY_TLRARES_Compu "" TAB_VERB "%6.3" "" COMPU_TAB_REF SY_TLRARES_Compu /end COMPU_METHOD
/begin COMPU_VTAB SY_TLRARES_Compu "" TAB_VERB 2 0 "FALSE" 1 "TRUE" /end COMPU_VTAB
/begin COMPU_METHOD t100msxs_q16Em6 "" RAT_FUNC "%7.6" "s" COEFFS 0 1 0 0 0 1.6e-005 /end COMPU_METHOD
/begin COMPU_METHOD t100msxs_uw_b6553p5 "" RAT_FUNC "%6.3" "s" COEFFS 0 1 0 0 0 0.1 /end COMPU_METHOD
/begin COMPU_METHOD t100msxs_uw_q100 "" RAT_FUNC "%6.3" "s" COEFFS 0 1 0 0 0 0.1 /end COMPU_METHOD
/begin COMPU_METHOD t10msxs_uw_b655p35 "" RAT_FUNC "%6.4" "s" COEFFS 0 1 0 0 0 0.01 /end COMPU_METHOD
/begin COMPU_METHOD t1p0usxms "" RAT_FUNC "%6.5" "ms" COEFFS 0 1000 0 0 0 1 /end COMPU_METHOD
/begin COMPU_METHOD t1sxs_q1 "" RAT_FUNC "%6.2" "s" COEFFS 0 1 0 0 0 1 /end COMPU_METHOD
/begin COMPU_METHOD t20msxs_ub_b5p1 "" RAT_FUNC "%6.4" "s" COEFFS 0 1 0 0 0 0.02 /end COMPU_METHOD
/begin COMPU_METHOD t20msxs_uw_q0p02 "" RAT_FUNC "%6.4" "s" COEFFS 0 1 0 0 0 0.02 /end COMPU_METHOD
/begin COMPU_METHOD t20ms_ub_b5100 "" RAT_FUNC "%7.2" "ms" COEFFS 0 1 0 0 0 20 /end COMPU_METHOD
/begin COMPU_METHOD t50msxs_q0p05 "" RAT_FUNC "%6.4" "s" COEFFS 0 1 0 0 0 0.05 /end COMPU_METHOD
/begin COMPU_METHOD Temp_Cels "" RAT_FUNC "%6.1" "deg C" COEFFS 0 10 2731.4 0 0 1 /end COMPU_METHOD
/begin COMPU_METHOD temp_ub_q0p75_o48 "" RAT_FUNC "%6.2" "Grad C" COEFFS 0 1 48 0 0 0.75 /end COMPU_METHOD
/begin COMPU_METHOD Time_ms "" RAT_FUNC "%6.1" "ms" COEFFS 0 0.1 0 0 0 1 /end COMPU_METHOD
/begin COMPU_METHOD Time_s "" RAT_FUNC "%6.4" "s" COEFFS 0 100 0 0 0 1 /end COMPU_METHOD
/begin COMPU_METHOD Trq "" RAT_FUNC "%6.3" "Nm" COEFFS 0 10 0 0 0 1 /end COMPU_METHOD
/begin COMPU_METHOD t_q1 "" RAT_FUNC "%6.2" "s" COEFFS 0 1 0 0 0 1 /end COMPU_METHOD
/begin COMPU_METHOD t_q1p0_us "" RAT_FUNC "%6.2" "us" COEFFS 0 1 0 0 0 1 /end COMPU_METHOD
/begin COMPU_METHOD vfzg_ub_q1p25 "" RAT_FUNC "%6.2" "km/h" COEFFS 0 1 0 0 0 1.25 /end COMPU_METHOD
/begin COMPU_METHOD vfzg_uw_b512 "" RAT_FUNC "%6.4" "km/h" COEFFS 0 65536 0 0 0 512 /end COMPU_METHOD
/begin COMPU_METHOD zk100msxs_ub_b25p5 "" RAT_FUNC "%6.3" "s" COEFFS 0 0 256 0 10 0 /end COMPU_METHOD
/begin COMPU_METHOD zk10msxs_ub_b5p1 "" RAT_FUNC "%6.4" "Sec" COEFFS 0 0 5.1 0 1 0 /end COMPU_METHOD
/begin COMPU_METHOD zk10msxs_uw_b655 "" RAT_FUNC "%6.2" "s" COEFFS 0 0 65536 0 100 0 /end COMPU_METHOD
/begin COMPU_METHOD zk200msxs_ub_b51p2 "" RAT_FUNC "%6.3" "s" COEFFS 0 0 256 0 5 0 /end COMPU_METHOD
/begin RECORD_LAYOUT FklWU8 FNC_VALUES 1 UBYTE COLUMN_DIR DIRECT /end RECORD_LAYOUT
/begin RECORD_LAYOUT GkfWU8 FNC_VALUES 1 UBYTE COLUMN_DIR DIRECT /end RECORD_LAYOUT
/begin RECORD_LAYOUT GklWU16 FNC_VALUES 1 UWORD COLUMN_DIR DIRECT /end RECORD_LAYOUT
/begin RECORD_LAYOUT GklWU8 FNC_VALUES 1 UBYTE COLUMN_DIR DIRECT /end RECORD_LAYOUT
/begin RECORD_LAYOUT KfAxU8AyU8SstxU16SstyU16WU16 NO_AXIS_PTS_X 1 UWORD NO_AXIS_PTS_Y 2 UWORD AXIS_PTS_X 3 UWORD INDEX_INCR DIRECT AXIS_PTS_Y 4 UWORD INDEX_INCR DIRECT FNC_VALUES 5 UWORD COLUMN_DIR DIRECT /end RECORD_LAYOUT
/begin RECORD_LAYOUT KfAxU8AyU8SstxU16SstyU8WU8 NO_AXIS_PTS_X 1 UBYTE NO_AXIS_PTS_Y 2 UBYTE AXIS_PTS_X 3 UWORD INDEX_INCR DIRECT AXIS_PTS_Y 4 UBYTE INDEX_INCR DIRECT FNC_VALUES 5 UBYTE COLUMN_DIR DIRECT /end RECORD_LAYOUT
/begin RECORD_LAYOUT KfAxU8AyU8SstxU8SstyU16WU16 NO_AXIS_PTS_X 1 UBYTE NO_AXIS_PTS_Y 2 UBYTE AXIS_PTS_X 3 UBYTE INDEX_INCR DIRECT AXIS_PTS_Y 4 UWORD INDEX_INCR DIRECT FNC_VALUES 5 UWORD COLUMN_DIR DIRECT /end RECORD_LAYOUT
/begin RECORD_LAYOUT KfAxU8AyU8SstxU8SstyU8WU8 NO_AXIS_PTS_X 1 UBYTE NO_AXIS_PTS_Y 2 UBYTE AXIS_PTS_X 3 UBYTE INDEX_INCR DIRECT AXIS_PTS_Y 4 UBYTE INDEX_INCR DIRECT FNC_VALUES 5 UBYTE COLUMN_DIR DIRECT /end RECORD_LAYOUT
/begin RECORD_LAYOUT KlAxU8SstxS16WU16 NO_AXIS_PTS_X 1 UWORD AXIS_PTS_X 2 SWORD INDEX_INCR DIRECT FNC_VALUES 3 UWORD COLUMN_DIR DIRECT /end RECORD_LAYOUT
/begin RECORD_LAYOUT KlAxU8SstxU16WU16 NO_AXIS_PTS_X 1 UWORD AXIS_PTS_X 2 UWORD INDEX_INCR DIRECT FNC_VALUES 3 UWORD COLUMN_DIR DIRECT /end RECORD_LAYOUT
/begin RECORD_LAYOUT KlAxU8SstxU8WU16 NO_AXIS_PTS_X 1 UBYTE AXIS_PTS_X 2 UBYTE INDEX_INCR DIRECT FNC_VALUES 3 UWORD COLUMN_DIR DIRECT /end RECORD_LAYOUT
/begin RECORD_LAYOUT KlAxU8SstxU8WU8 NO_AXIS_PTS_X 1 UBYTE AXIS_PTS_X 2 UBYTE INDEX_INCR DIRECT FNC_VALUES 3 UBYTE COLUMN_DIR DIRECT /end RECORD_LAYOUT
/begin RECORD_LAYOUT KwbWU16 FNC_VALUES 1 UWORD COLUMN_DIR DIRECT /end RECORD_LAYOUT
/begin RECORD_LAYOUT KwUb FNC_VALUES 1 UBYTE COLUMN_DIR DIRECT /end RECORD_LAYOUT
/begin RECORD_LAYOUT KwUw FNC_VALUES 1 UWORD COLUMN_DIR DIRECT /end RECORD_LAYOUT
/begin RECORD_LAYOUT KwWS16 FNC_VALUES 1 SWORD COLUMN_DIR DIRECT /end RECORD_LAYOUT
/begin RECORD_LAYOUT KwWS32 FNC_VALUES 1 SLONG COLUMN_DIR DIRECT /end RECORD_LAYOUT
/begin RECORD_LAYOUT KwWS8 FNC_VALUES 1 SBYTE COLUMN_DIR DIRECT /end RECORD_LAYOUT
/begin RECORD_LAYOUT KwWU16 FNC_VALUES 1 UWORD COLUMN_DIR DIRECT /end RECORD_LAYOUT
/begin RECORD_LAYOUT KwWU8 FNC_VALUES 1 UBYTE COLUMN_DIR DIRECT /end RECORD_LAYOUT
/begin RECORD_LAYOUT Kw_Ws16 FNC_VALUES 1 SWORD COLUMN_DIR DIRECT /end RECORD_LAYOUT
/begin RECORD_LAYOUT Kw_Wu16 FNC_VALUES 1 UWORD COLUMN_DIR DIRECT /end RECORD_LAYOUT
/begin RECORD_LAYOUT Mo_DataS16 FNC_VALUES 1 SWORD COLUMN_DIR DIRECT /end RECORD_LAYOUT
/begin RECORD_LAYOUT Mo_DataU16 FNC_VALUES 1 UWORD COLUMN_DIR DIRECT /end RECORD_LAYOUT
/begin RECORD_LAYOUT Mo_DataU8 FNC_VALUES 1 UBYTE COLUMN_DIR DIRECT /end RECORD_LAYOUT
/begin RECORD_LAYOUT SstAU8SstU8 NO_AXIS_PTS_X 1 UBYTE AXIS_PTS_X 2 UBYTE INDEX_INCR DIRECT /end RECORD_LAYOUT
/begin RECORD_LAYOUT SstAUbSstUb NO_AXIS_PTS_X 1 UBYTE AXIS_PTS_X 2 UBYTE INDEX_INCR DIRECT /end RECORD_LAYOUT
/begin RECORD_LAYOUT Val_Wu16 FNC_VALUES 1 UWORD COLUMN_DIR DIRECT /end RECORD_LAYOUT
/begin RECORD_LAYOUT Val_Wu32 FNC_VALUES 1 ULONG COLUMN_DIR DIRECT /end RECORD_LAYOUT
/begin RECORD_LAYOUT Val_Wu8 FNC_VALUES 1 UBYTE COLUMN_DIR DIRECT /end RECORD_LAYOUT
/end MODULE
/end PROJECT
