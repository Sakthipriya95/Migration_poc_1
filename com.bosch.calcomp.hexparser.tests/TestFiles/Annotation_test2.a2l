ASAP2_VERSION 1 4
/* Erstellt von DAMOS++ V5.6.4 WinServer 2008 R2 */
/begin PROJECT P695 "EDC17DC"
/begin HEADER "" VERSION "P_695_FDS3__CV141100" PROJECT_NO P695 /end HEADER
/begin MODULE DIM ""
/begin COMPU_TAB AIRSYS_NUMTEMPFLDLENGTH_SY_Compu "Schwelle für den alterungsabh䮧igen Wirkungsgrad" TAB_NOINTP 9 0 0 1 1 2 2 3 3 4 4 5 5 6 6 7 7 8 8 /end COMPU_TAB
/begin CHARACTERISTIC AirSys_stMskOpModeSysTst_C "Maske zur Auswahl des Zustandes des Betriebsartenkoordinators" VALUE 0x80877994 Val_Wu16 65535.00 OneToOne 0.00 65535.00 FORMAT "%8.2"
 /begin ANNOTATION ANNOTATION_LABEL "Calibration Note" ANNOTATION_ORIGIN "Graf Zeppelin"
  /begin ANNOTATION_TEXT "The very nice ASAM MCD-2 MC Specification." "Text.\r\n" "In case of a quotation mark " "use \" or "" to mark it." /end ANNOTATION_TEXT
 /end ANNOTATION
 /begin ANNOTATION ANNOTATION_LABEL "Calibration Note3" ANNOTATION_ORIGIN "Graf Zeppelin"
  /begin ANNOTATION_TEXT "The very nice ASAM MCD-2 MC Specification." "Text.\r\n" "In case of a quotation mark " "use \" or "" to mark it." /end ANNOTATION_TEXT
 /end ANNOTATION
/end CHARACTERISTIC
/begin CHARACTERISTIC AirSys_stMskOpModeSysTst_C11 "Maske zur Auswahl des Zustandes ""des"" Betriebsartenkoordinators" VALUE 0x80877994 Val_Wu16 65535.00 OneToOne 0.00 65535.00 FORMAT "%8.2"
 /begin ANNOTATION ANNOTATION_LABEL "Calibration Note4" ANNOTATION_ORIGIN "Graf Zeppelin"
  /begin ANNOTATION_TEXT "The very nice ASAM MCD-2 MC Specification." "Text.\r\n" "In case of a quotation mark " "use \" or "" to mark it." /end ANNOTATION_TEXT
 /end ANNOTATION
 /begin ANNOTATION ANNOTATION_LABEL "Calibration Note35" ANNOTATION_ORIGIN "Graf Zeppelin"
  /begin ANNOTATION_TEXT "The very nice ASAM MCD-2 MC Specification." "Text.\r\n" "In case of a quotation mark " "use \" or "" to mark it." /end ANNOTATION_TEXT
 /end ANNOTATION
/end CHARACTERISTIC
/begin CHARACTERISTIC AFS_uBattMax_C "Obere Batterieschwelle für䴢 Bestimmung der AFS-Signalqualit" VALUE 0x808621FE Val_Ws16 1310700. OneToOne -655360.0 655340.0 FORMAT "%8.1" /end CHARACTERISTIC
/begin AXIS_PTS AirSysPDrift_CtrHeatInThrd_A "Luftsystem Druck Driftplausibilität : Stützstellen Wärmeeintrag Schwelle" 0x808E7008 AirSysPDrift_TpRefCold Axis_Xs16 8191.875 DC_TEMP 4 -4096.000 4095.875 FORMAT "%8.3" DEPOSIT ABSOLUTE /end AXIS_PTS
/begin CHARACTERISTIC AirSysPDrift_CtrHeatInThrd_L "Luftsystem Druck Driftplausibilität : Kennlinie Wärmeeintrag Schwelle" CURVE 0x808E7012 CurG_Wu16 65535.00 DC_CNTR 0.00 65535.00 FORMAT "%8.2"
 /begin AXIS_DESCR RES_AXIS AirSysPDrift_TpRefCold DC_TEMP 4 -4096.000 4095.875 FORMAT "%8.3" AXIS_PTS_REF AirSysPDrift_CtrHeatInThrd_A /end AXIS_DESCR
/end CHARACTERISTIC
/begin CHARACTERISTIC FUEL_ADJ "Air fuel table" MAP 0x7140 DEP_12E 1.0 OneToOne 0.0 2.0
 /begin AXIS_DESCR CURVE_AXIS SPEED NO_COMPU_METHOD 13 0 12 CURVE_AXIS_REF SPD_NORM /end AXIS_DESCR
 /begin AXIS_DESCR CURVE_AXIS LOAD NO_COMPU_METHOD 17 0 16 CURVE_AXIS_REF MAF_NORM /end AXIS_DESCR
/end CHARACTERISTIC
/begin MEASUREMENT aadps_vg "Variationsgrad der AAD für das ܢerwachungskonzept" UBYTE DEZ 1 100 0.00 255.0 FORMAT "%5.1" ECU_ADDRESS 0xD0000149
 /begin ANNOTATION ANNOTATION_LABEL "Calibration Note3" ANNOTATION_ORIGIN "Graf Zeppelin"
  /begin ANNOTATION_TEXT "The very nice ASAM MCD-2 MC Specification." "Text.\r\n" "In case of a quotation mark " "use \" or "" to mark it." /end ANNOTATION_TEXT
 /end ANNOTATION
/end MEASUREMENT
/begin RECORD_LAYOUT Val_Wu8 FNC_VALUES 1 UBYTE COLUMN_DIR DIRECT /end RECORD_LAYOUT
/begin COMPU_METHOD OneToOne "" RAT_FUNC "%6.2" "-" COEFFS 0 1 0 0 0 1 /end COMPU_METHOD
/begin COMPU_METHOD DC_CNTR "" RAT_FUNC "%6.2" "" COEFFS 0 1 0 0 0 1 /end COMPU_METHOD
/begin COMPU_METHOD DC_TEMP "" RAT_FUNC "%6.3" "°C" COEFFS 0 8 0 0 0 1 /end COMPU_METHOD
/end MODULE
/end PROJECT
